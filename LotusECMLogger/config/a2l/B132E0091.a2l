ASAP2_VERSION 1 61
/begin PROJECT B132E0091 "Lotus T6 B132E0091"
/begin HEADER "" VERSION "generated v1" /end HEADER
/begin MODULE B132E0091 ""
/begin MOD_COMMON "" BYTE_ORDER MSB_FIRST ALIGNMENT_BYTE 1 ALIGNMENT_WORD 2 ALIGNMENT_LONG 4 /end MOD_COMMON
/begin RECORD_LAYOUT RL_VALUE_SLONG FNC_VALUES 1 SLONG ROW_DIR DIRECT /end RECORD_LAYOUT
/begin RECORD_LAYOUT RL_AXIS_SLONG AXIS_PTS_X 1 SLONG INDEX_INCR DIRECT /end RECORD_LAYOUT
/begin COMPU_METHOD CM_i16_flow_100_1024mg_s "i16_flow_100/1024mg/s" RAT_FUNC "%12.4" "mg/s" COEFFS 0 1 0 0 0 0.09765625 /end COMPU_METHOD
/begin COMPU_METHOD CM_u16_angle_1_10deg "u16_angle_1/10deg" RAT_FUNC "%9.1" "deg" COEFFS 0 1 0 0 0 0.1 /end COMPU_METHOD
/begin COMPU_METHOD CM_u16_factor_1_1023 "u16_factor_1/1023" RAT_FUNC "%12.4" "%" COEFFS 0 1 0 0 0 0.0977517106549365 /end COMPU_METHOD
/begin COMPU_METHOD CM_u16_flow_10mg_s "u16_flow_10mg/s" RAT_FUNC "%8.0" "mg/s" COEFFS 0 1 0 0 0 10 /end COMPU_METHOD
/begin COMPU_METHOD CM_u16_flow_mg_s "u16_flow_mg/s" RAT_FUNC "%8.0" "mg/s" COEFFS 0 1 0 0 0 1 /end COMPU_METHOD
/begin COMPU_METHOD CM_u16_load_mg_stroke "u16_load_mg/stroke" RAT_FUNC "%8.0" "mg/stroke" COEFFS 0 1 0 0 0 1 /end COMPU_METHOD
/begin COMPU_METHOD CM_u16_voltage_18_1023v "u16_voltage_18/1023v" RAT_FUNC "%12.4" "V" COEFFS 0 1 0 0 0 0.0175953079178886 /end COMPU_METHOD
/begin COMPU_METHOD CM_u16_voltage_5_1023v "u16_voltage_5/1023v" RAT_FUNC "%12.4" "V" COEFFS 0 1 0 0 0 0.00488758553274682 /end COMPU_METHOD
/begin COMPU_METHOD CM_u32_distance_10cm "u32_distance_10cm" RAT_FUNC "%8.0" "cm" COEFFS 0 1 0 0 0 10 /end COMPU_METHOD
/begin COMPU_METHOD CM_u8_accel_1_255g "u8_accel_1/255g" RAT_FUNC "%12.4" "g" COEFFS 0 1 0 0 0 0.00392156862745098 /end COMPU_METHOD
/begin COMPU_METHOD CM_u8_angle_1_4deg "u8_angle_1/4deg" RAT_FUNC "%10.2" "deg" COEFFS 0 1 0 0 0 0.25 /end COMPU_METHOD
/begin COMPU_METHOD CM_u8_factor_1_255 "u8_factor_1/255" RAT_FUNC "%12.4" "%" COEFFS 0 1 0 0 0 0.392156862745098 /end COMPU_METHOD
/begin COMPU_METHOD CM_u8_flow_2g_s "u8_flow_2g/s" RAT_FUNC "%8.0" "g/s" COEFFS 0 1 0 0 0 2 /end COMPU_METHOD
/begin COMPU_METHOD CM_u8_percent_100_256_50 "u8_percent_100/256-50" RAT_FUNC "%12.4" "%" COEFFS 0 1 50 0 0 0.390625 /end COMPU_METHOD
/begin COMPU_METHOD CM_u8_rspeed_2rpm "u8_rspeed_2rpm" RAT_FUNC "%8.0" "rpm" COEFFS 0 1 0 0 0 2 /end COMPU_METHOD
/begin COMPU_METHOD CM_u8_rspeed_rpm "u8_rspeed_rpm" RAT_FUNC "%8.0" "rpm" COEFFS 0 1 0 0 0 1 /end COMPU_METHOD
/begin COMPU_METHOD CM_u8_speed_1_100kph "u8_speed_1/100kph" RAT_FUNC "%10.2" "km/h" COEFFS 0 1 0 0 0 0.01 /end COMPU_METHOD
/begin COMPU_METHOD CM_u8_speed_kph "u8_speed_kph" RAT_FUNC "%8.0" "km/h" COEFFS 0 1 0 0 0 1 /end COMPU_METHOD
/begin COMPU_METHOD CM_u8_temp_1_10C "u8_temp_1/10C" RAT_FUNC "%9.1" "°C" COEFFS 0 1 0 0 0 0.1 /end COMPU_METHOD
/begin COMPU_METHOD CM_u8_temp_5_8_40c "u8_temp_5/8-40c" RAT_FUNC "%11.3" "°C" COEFFS 0 1 40 0 0 0.625 /end COMPU_METHOD
/begin COMPU_METHOD CM_u8_time_100ms "u8_time_100ms" RAT_FUNC "%8.0" "ms" COEFFS 0 1 0 0 0 100 /end COMPU_METHOD
/begin COMPU_METHOD CM_u8_time_10ms "u8_time_10ms" RAT_FUNC "%8.0" "ms" COEFFS 0 1 0 0 0 10 /end COMPU_METHOD
/begin COMPU_METHOD CM_u8_time_5ms "u8_time_5ms" RAT_FUNC "%8.0" "ms" COEFFS 0 1 0 0 0 5 /end COMPU_METHOD
/begin COMPU_METHOD CM_u8_time_ms "u8_time_ms" RAT_FUNC "%8.0" "ms" COEFFS 0 1 0 0 0 1 /end COMPU_METHOD
/begin COMPU_METHOD CM_u8_time_us "u8_time_us" RAT_FUNC "%8.0" "us" COEFFS 0 1 0 0 0 1 /end COMPU_METHOD
/begin COMPU_METHOD CM_u8_torque_nm "u8_torque_nm" RAT_FUNC "%8.0" "Nm" COEFFS 0 1 0 0 0 1 /end COMPU_METHOD
/begin MEASUREMENT vvt_exhaust_advance "u16_angle_1/4deg" UWORD CM_u8_angle_1_4deg 0 0 0 16383.75 ECU_ADDRESS 0x4000211C /end MEASUREMENT
/begin MEASUREMENT vvt_pi_p_term_inlet_b1 "undefined2" UWORD NO_COMPU_METHOD 0 0 0 65535 ECU_ADDRESS 0x4000211E /end MEASUREMENT
/begin MEASUREMENT vvt_pi_integral_inlet_b1 "undefined4" ULONG NO_COMPU_METHOD 0 0 0 4294967295 ECU_ADDRESS 0x40002120 /end MEASUREMENT
/begin MEASUREMENT vvt_pi_output_inlet_b1 "undefined4" ULONG NO_COMPU_METHOD 0 0 0 4294967295 ECU_ADDRESS 0x40002124 /end MEASUREMENT
/begin MEASUREMENT vvt_pi_p_term_inlet_b2 "undefined2" UWORD NO_COMPU_METHOD 0 0 0 65535 ECU_ADDRESS 0x40002128 /end MEASUREMENT
/begin MEASUREMENT vvt_pi_integral_inlet_b2 "undefined4" ULONG NO_COMPU_METHOD 0 0 0 4294967295 ECU_ADDRESS 0x4000212C /end MEASUREMENT
/begin MEASUREMENT vvt_pi_output_inlet_b2 "undefined4" ULONG NO_COMPU_METHOD 0 0 0 4294967295 ECU_ADDRESS 0x40002130 /end MEASUREMENT
/begin MEASUREMENT vvt_pi_p_term_exhaust_b1 "undefined2" UWORD NO_COMPU_METHOD 0 0 0 65535 ECU_ADDRESS 0x40002134 /end MEASUREMENT
/begin MEASUREMENT vvt_pi_integral_exhaust_b1 "undefined4" ULONG NO_COMPU_METHOD 0 0 0 4294967295 ECU_ADDRESS 0x40002138 /end MEASUREMENT
/begin MEASUREMENT vvt_pi_output_exhaust_b1 "undefined4" ULONG NO_COMPU_METHOD 0 0 0 4294967295 ECU_ADDRESS 0x4000213C /end MEASUREMENT
/begin MEASUREMENT vvt_pi_p_term_exhaust_b2 "undefined2" UWORD NO_COMPU_METHOD 0 0 0 65535 ECU_ADDRESS 0x40002140 /end MEASUREMENT
/begin MEASUREMENT vvt_pi_integral_exhaust_b2 "undefined4" ULONG NO_COMPU_METHOD 0 0 0 4294967295 ECU_ADDRESS 0x40002144 /end MEASUREMENT
/begin MEASUREMENT vvt_pi_output_exhaust_b2 "undefined4" ULONG NO_COMPU_METHOD 0 0 0 4294967295 ECU_ADDRESS 0x40002148 /end MEASUREMENT
/begin MEASUREMENT vvt_intake_transition_complete "VVT intake transition complete. Log commanded vs actual cam timing to verify VVT response." UBYTE NO_COMPU_METHOD 0 0 0 255 ECU_ADDRESS 0x4000214C /end MEASUREMENT
/begin MEASUREMENT vvt_exhaust_transition_complete "VVT exhaust transition complete. Log commanded vs actual cam timing to verify VVT response." UBYTE NO_COMPU_METHOD 0 0 0 255 ECU_ADDRESS 0x4000214D /end MEASUREMENT
/begin MEASUREMENT cam_park_position_sum_inlet_b1 "undefined4" ULONG NO_COMPU_METHOD 0 0 0 4294967295 ECU_ADDRESS 0x40002150 /end MEASUREMENT
/begin MEASUREMENT cam_park_position_sum_inlet_b2 "u32_angle_1/4deg" ULONG CM_u8_angle_1_4deg 0 0 0 1073741823.75 ECU_ADDRESS 0x40002154 /end MEASUREMENT
/begin MEASUREMENT cam_park_position_sum_exhaust_b1 "undefined4" ULONG NO_COMPU_METHOD 0 0 0 4294967295 ECU_ADDRESS 0x40002158 /end MEASUREMENT
/begin MEASUREMENT cam_park_position_sum_exhaust_b2 "undefined4" ULONG NO_COMPU_METHOD 0 0 0 4294967295 ECU_ADDRESS 0x4000215C /end MEASUREMENT
/begin MEASUREMENT cam_park_sample_count_inlet_b1 "undefined4" ULONG NO_COMPU_METHOD 0 0 0 4294967295 ECU_ADDRESS 0x40002160 /end MEASUREMENT
/begin MEASUREMENT cam_park_sample_count_inlet_b2 "undefined4" ULONG NO_COMPU_METHOD 0 0 0 4294967295 ECU_ADDRESS 0x40002164 /end MEASUREMENT
/begin MEASUREMENT cam_park_sample_count_exhaust_b1 "undefined4" ULONG NO_COMPU_METHOD 0 0 0 4294967295 ECU_ADDRESS 0x40002168 /end MEASUREMENT
/begin MEASUREMENT cam_park_sample_count_exhaust_b2 "undefined4" ULONG NO_COMPU_METHOD 0 0 0 4294967295 ECU_ADDRESS 0x4000216C /end MEASUREMENT
/begin MEASUREMENT vvt_park_integral_reset_flags "uint8_t" UBYTE NO_COMPU_METHOD 0 0 0 255 ECU_ADDRESS 0x40002170 /end MEASUREMENT
/begin MEASUREMENT vvt_intake_target_zero_timer "VVT inlet bank1 zero timer. Log commanded vs actual cam timing to verify VVT response. (ms; raw*100)" UBYTE CM_u8_time_100ms 0 0 0 25500 ECU_ADDRESS 0x40002171 /end MEASUREMENT
/begin MEASUREMENT vvt_exhaust_target_zero_timer "VVT inlet bank2 zero timer. Log commanded vs actual cam timing to verify VVT response. (ms; raw*100)" UBYTE CM_u8_time_100ms 0 0 0 25500 ECU_ADDRESS 0x40002172 /end MEASUREMENT
/begin MEASUREMENT vvt_low_load_active "undefined1" UBYTE NO_COMPU_METHOD 0 0 0 255 ECU_ADDRESS 0x40002173 /end MEASUREMENT
/begin MEASUREMENT vvt_low_load_cam_offset "undefined1" UBYTE NO_COMPU_METHOD 0 0 0 255 ECU_ADDRESS 0x40002174 /end MEASUREMENT
/begin MEASUREMENT vvt_exhaust_mode_flags "undefined1" UBYTE NO_COMPU_METHOD 0 0 0 255 ECU_ADDRESS 0x40002175 /end MEASUREMENT
/begin MEASUREMENT vvt_intake_low_load_mode_flags "undefined1" UBYTE NO_COMPU_METHOD 0 0 0 255 ECU_ADDRESS 0x40002176 /end MEASUREMENT
/begin MEASUREMENT cam_edge_watchdog_exhaust_b2 "u8_count" UBYTE NO_COMPU_METHOD 0 0 0 255 ECU_ADDRESS 0x40002177 /end MEASUREMENT
/begin MEASUREMENT cam_edge_watchdog_exhaust_b1 "undefined1" UBYTE NO_COMPU_METHOD 0 0 0 255 ECU_ADDRESS 0x40002178 /end MEASUREMENT
/begin MEASUREMENT cam_edge_watchdog_inlet_b2 "undefined1" UBYTE NO_COMPU_METHOD 0 0 0 255 ECU_ADDRESS 0x40002179 /end MEASUREMENT
/begin MEASUREMENT cam_edge_watchdog "undefined1" UBYTE NO_COMPU_METHOD 0 0 0 255 ECU_ADDRESS 0x4000217A /end MEASUREMENT
/begin MEASUREMENT cam_park_position_mean_exhaust_b2 "undefined4" ULONG NO_COMPU_METHOD 0 0 0 4294967295 ECU_ADDRESS 0x4000217C /end MEASUREMENT
/begin MEASUREMENT cam_park_position_mean_exhaust_b1 "undefined4" ULONG NO_COMPU_METHOD 0 0 0 4294967295 ECU_ADDRESS 0x40002180 /end MEASUREMENT
/begin MEASUREMENT cam_park_position_mean_inlet_b2 "undefined4" ULONG NO_COMPU_METHOD 0 0 0 4294967295 ECU_ADDRESS 0x40002184 /end MEASUREMENT
/begin MEASUREMENT cam_park_position_mean_inlet_b1 "undefined4" ULONG NO_COMPU_METHOD 0 0 0 4294967295 ECU_ADDRESS 0x40002188 /end MEASUREMENT
/begin MEASUREMENT cam_park_offset_fault_exhaust_b2 "bool" UBYTE NO_COMPU_METHOD 0 0 0 255 ECU_ADDRESS 0x4000218C /end MEASUREMENT
/begin MEASUREMENT cam_park_offset_fault_exhaust_b1 "bool" UBYTE NO_COMPU_METHOD 0 0 0 255 ECU_ADDRESS 0x4000218D /end MEASUREMENT
/begin MEASUREMENT cam_park_offset_fault_inlet_b2 "bool" UBYTE NO_COMPU_METHOD 0 0 0 255 ECU_ADDRESS 0x4000218E /end MEASUREMENT
/begin MEASUREMENT cam_park_offset_fault_inlet_b1 "bool" UBYTE NO_COMPU_METHOD 0 0 0 255 ECU_ADDRESS 0x4000218F /end MEASUREMENT
/begin MEASUREMENT cam_park_check_done_exhaust_b2 "bool" UBYTE NO_COMPU_METHOD 0 0 0 255 ECU_ADDRESS 0x40002190 /end MEASUREMENT
/begin MEASUREMENT cam_park_check_done_exhaust_b1 "bool" UBYTE NO_COMPU_METHOD 0 0 0 255 ECU_ADDRESS 0x40002191 /end MEASUREMENT
/begin MEASUREMENT cam_park_offset_fault_inlet_b2_40002192 "bool" UBYTE NO_COMPU_METHOD 0 0 0 255 ECU_ADDRESS 0x40002192 /end MEASUREMENT
/begin MEASUREMENT cam_park_check_done_inlet_b1 "bool" UBYTE NO_COMPU_METHOD 0 0 0 255 ECU_ADDRESS 0x40002193 /end MEASUREMENT
/begin MEASUREMENT vvt_start_time "u16_time_5ms" UWORD CM_u8_time_5ms 0 0 0 327675 ECU_ADDRESS 0x40002194 /end MEASUREMENT
/begin MEASUREMENT obd_ii_vvt_exhaust_error_bank2 "undefined2" UWORD NO_COMPU_METHOD 0 0 0 65535 ECU_ADDRESS 0x40002196 /end MEASUREMENT
/begin MEASUREMENT obd_ii_vvt_exhaust_error_bank1 "u16_angle_1/4deg" UWORD CM_u8_angle_1_4deg 0 0 0 16383.75 ECU_ADDRESS 0x40002198 /end MEASUREMENT
/begin MEASUREMENT obd_ii_vvt_inlet_angle_error_bank2 "u16_angle_1/4deg" UWORD CM_u8_angle_1_4deg 0 0 0 16383.75 ECU_ADDRESS 0x4000219A /end MEASUREMENT
/begin MEASUREMENT obd_ii_vvt_inlet_angle_error_bank1 "undefined2" UWORD NO_COMPU_METHOD 0 0 0 65535 ECU_ADDRESS 0x4000219C /end MEASUREMENT
/begin MEASUREMENT obd_ii_vvt_exhaust_target "u16_angle_1/4deg" UWORD CM_u8_angle_1_4deg 0 0 0 16383.75 ECU_ADDRESS 0x4000219E /end MEASUREMENT
/begin MEASUREMENT obd_ii_vvt_inlet_target_position "u16_angle_1/4deg" UWORD CM_u8_angle_1_4deg 0 0 0 16383.75 ECU_ADDRESS 0x400021A0 /end MEASUREMENT
/begin MEASUREMENT obd_ii_throttle_body_range_perf "undefined1" UBYTE NO_COMPU_METHOD 0 0 0 255 ECU_ADDRESS 0x400021A8 /end MEASUREMENT
/begin MEASUREMENT sensor_tps_track_a_voltage "u16_voltage_5/1023v" UWORD CM_u16_voltage_5_1023v 0 0 0 320.307917888563 ECU_ADDRESS 0x400021AA /end MEASUREMENT
/begin MEASUREMENT sensor_tps_track_b_voltage "ABS throttle position b. Log the raw sensor voltage to check sensor health and wiring. (V; raw*5/1023)" UWORD CM_u16_voltage_5_1023v 0 0 0 320.307917888563 ECU_ADDRESS 0x400021AC /end MEASUREMENT
/begin MEASUREMENT obd_ii_commanded_throttle_actuator "Commanded throttle actuator. Log this ratio to see the resulting control output. (0-1; raw/1023)" UWORD CM_u16_factor_1_1023 0 0 0 6406.15835777126 ECU_ADDRESS 0x400021B0 /end MEASUREMENT
/begin MEASUREMENT tps_warmup_limited_target "Throttle position warmup limited target. Log to see throttle/pedal demand and throttle response. (0-1; raw/1023)" UWORD CM_u16_factor_1_1023 0 0 0 6406.15835777126 ECU_ADDRESS 0x400021B2 /end MEASUREMENT
/begin MEASUREMENT etb_position_error "u16_factor_1/1023" UWORD CM_u16_factor_1_1023 0 0 0 6406.15835777126 ECU_ADDRESS 0x400021B4 /end MEASUREMENT
/begin MEASUREMENT debug_tps_target_post_limits_s32 "uint32_t" ULONG NO_COMPU_METHOD 0 0 0 4294967295 ECU_ADDRESS 0x400021D0 /end MEASUREMENT
/begin MEASUREMENT debug_tps_target_post_limits_u16 "u16_factor_1/1023" UWORD CM_u16_factor_1_1023 0 0 0 6406.15835777126 ECU_ADDRESS 0x400021D4 /end MEASUREMENT
/begin MEASUREMENT tps_smoothing_step_flags "enum_tps_smooth_step_flag" UBYTE NO_COMPU_METHOD 0 0 0 255 ECU_ADDRESS 0x400021E8 /end MEASUREMENT
/begin MEASUREMENT throttle_error_flags "undefined1" UBYTE NO_COMPU_METHOD 0 0 0 255 ECU_ADDRESS 0x400021EA /end MEASUREMENT
/begin MEASUREMENT etb_hc08_independent_shutdown "bool" UBYTE NO_COMPU_METHOD 0 0 0 255 ECU_ADDRESS 0x400021EB /end MEASUREMENT
/begin MEASUREMENT throttle_calibrate_fail "Flag: throttle calibration failed. Log to catch DBW faults." UBYTE NO_COMPU_METHOD 0 0 0 255 ECU_ADDRESS 0x400021EC /end MEASUREMENT
/begin MEASUREMENT lfb_pulse_toggle_timer "Long-term fuel pulse toggle timer. Log to track long-term fuel learning and spot a developing fuel fault. (ms; raw*100)" UWORD CM_u8_time_100ms 0 0 0 6553500 ECU_ADDRESS 0x400021EE /end MEASUREMENT
/begin MEASUREMENT lfb_state_flags "undefined1" UBYTE NO_COMPU_METHOD 0 0 0 255 ECU_ADDRESS 0x400021F0 /end MEASUREMENT
/begin MEASUREMENT etb_initialization_state "Electronic-throttle-body init/calibration state. Log to debug throttle limp on startup." UBYTE NO_COMPU_METHOD 0 0 0 255 ECU_ADDRESS 0x400021F2 /end MEASUREMENT
/begin MEASUREMENT tps_max_during_warmup "Throttle position max during warmup. Log to see throttle/pedal demand and throttle response. (0-1; raw/1023)" UWORD CM_u16_factor_1_1023 0 0 0 6406.15835777126 ECU_ADDRESS 0x400021F6 /end MEASUREMENT
/begin MEASUREMENT tps_decrement "undefined2" UWORD NO_COMPU_METHOD 0 0 0 65535 ECU_ADDRESS 0x4000220C /end MEASUREMENT
/begin MEASUREMENT tpssmooth_increment "Tpssmooth increment. Log to see throttle-signal smoothing/filtering behavior. (0-1; raw/1023)" UBYTE CM_u16_factor_1_1023 0 0 0 24.9266862170088 ECU_ADDRESS 0x4000220E /end MEASUREMENT
/begin MEASUREMENT tpssmooth_low_speed_active "Tpssmooth low speed active. Log to see throttle-signal smoothing/filtering behavior." UBYTE NO_COMPU_METHOD 0 0 0 255 ECU_ADDRESS 0x4000220F /end MEASUREMENT
/begin MEASUREMENT etb_init_delay_timer "u16_time_ms" UWORD CM_u8_time_ms 0 0 0 65535 ECU_ADDRESS 0x4000221C /end MEASUREMENT
/begin MEASUREMENT etb_cal_closed_pos_status "uint8_t" UBYTE NO_COMPU_METHOD 0 0 0 255 ECU_ADDRESS 0x4000221E /end MEASUREMENT
/begin MEASUREMENT lbf_hold_timer "undefined2" UWORD NO_COMPU_METHOD 0 0 0 65535 ECU_ADDRESS 0x4000222A /end MEASUREMENT
/begin MEASUREMENT lbf_entry_countdown_timer "undefined2" UWORD NO_COMPU_METHOD 0 0 0 65535 ECU_ADDRESS 0x4000222C /end MEASUREMENT
/begin MEASUREMENT lfb_brake_off_hold_ticks "undefined2" UWORD NO_COMPU_METHOD 0 0 0 65535 ECU_ADDRESS 0x4000222E /end MEASUREMENT
/begin MEASUREMENT tps_track_b_closed_value "undefined2" UWORD NO_COMPU_METHOD 0 0 0 65535 ECU_ADDRESS 0x40002234 /end MEASUREMENT
/begin MEASUREMENT tps_track_a_closed_value "undefined2" UWORD NO_COMPU_METHOD 0 0 0 65535 ECU_ADDRESS 0x40002236 /end MEASUREMENT
/begin MEASUREMENT ips_state_flags "undefined1" UBYTE NO_COMPU_METHOD 0 0 0 255 ECU_ADDRESS 0x40002238 /end MEASUREMENT
/begin MEASUREMENT ips_engine_speed_at_shift "IPS engine speed at shift. Log to follow IPS automated-manual shift behavior. (RPM)" UWORD CM_u8_rspeed_rpm 0 0 0 65535 ECU_ADDRESS 0x4000223A /end MEASUREMENT
/begin MEASUREMENT tps_state_degraded "Throttle position state degraded. Log to see throttle/pedal demand and throttle response." UBYTE NO_COMPU_METHOD 0 0 0 255 ECU_ADDRESS 0x40002240 /end MEASUREMENT
/begin MEASUREMENT tps_16bit "Throttle-plate position, high resolution. Log for precise throttle tracking and DBW diagnostics. (0-1; raw/1023)" UWORD CM_u16_factor_1_1023 0 0 0 6406.15835777126 ECU_ADDRESS 0x40002242 /end MEASUREMENT
/begin MEASUREMENT accel_pedal_diag_state_degraded "(level 1: single pedal sensor faulted/correlation mismatch, still using redundant sensor" UBYTE NO_COMPU_METHOD 0 0 0 255 ECU_ADDRESS 0x40002244 /end MEASUREMENT
/begin MEASUREMENT accel_pedal_pos "Accelerator-pedal position (driver demand). Log it -- the input the DBW throttle is trying to satisfy." UWORD CM_u16_factor_1_1023 0 0 0 6406.15835777126 ECU_ADDRESS 0x40002248 /end MEASUREMENT
/begin MEASUREMENT tps_fault_active "Flag: a throttle-position fault is set. Log to correlate faults with throttle limits." UBYTE NO_COMPU_METHOD 0 0 0 255 ECU_ADDRESS 0x4000224A /end MEASUREMENT
/begin MEASUREMENT accel_pedal_diag_state_fault_active "level 2: confirmed dual-sensor fault, pedal position forced to 0" UBYTE NO_COMPU_METHOD 0 0 0 255 ECU_ADDRESS 0x4000224B /end MEASUREMENT
/begin MEASUREMENT tps_fault_flags "undefined1" UBYTE NO_COMPU_METHOD 0 0 0 255 ECU_ADDRESS 0x4000224D /end MEASUREMENT
/begin MEASUREMENT knock_buffer_last_index "undefined1" UBYTE NO_COMPU_METHOD 0 0 0 255 ECU_ADDRESS 0x40002250 /end MEASUREMENT
/begin MEASUREMENT knock_sensor_new_data_available "Knock sensor new data available. Log to catch knock events and see how much timing is being pulled." UBYTE NO_COMPU_METHOD 0 0 0 255 ECU_ADDRESS 0x40002252 /end MEASUREMENT
/begin MEASUREMENT knock_curr_cylinder "undefined1" UBYTE NO_COMPU_METHOD 0 0 0 255 ECU_ADDRESS 0x40002253 /end MEASUREMENT
/begin MEASUREMENT knock_gain_mode "undefined1" UBYTE NO_COMPU_METHOD 0 0 0 255 ECU_ADDRESS 0x40002254 /end MEASUREMENT
/begin MEASUREMENT knock_agc_override "Knock AGC override. Log to catch knock events and see how much timing is being pulled." UBYTE NO_COMPU_METHOD 0 0 0 255 ECU_ADDRESS 0x40002255 /end MEASUREMENT
/begin MEASUREMENT knock_buffer_index "undefined1" UBYTE NO_COMPU_METHOD 0 0 0 255 ECU_ADDRESS 0x40002256 /end MEASUREMENT
/begin MEASUREMENT knock_freq_bin_count "undefined1" UBYTE NO_COMPU_METHOD 0 0 0 255 ECU_ADDRESS 0x40002258 /end MEASUREMENT
/begin MEASUREMENT ccp_tx_stall_count "u8_count" UBYTE NO_COMPU_METHOD 0 0 0 255 ECU_ADDRESS 0x40002260 /end MEASUREMENT
/begin MEASUREMENT iat_overtemp_monitor_lockout_timer "undefined1" UBYTE NO_COMPU_METHOD 0 0 0 255 ECU_ADDRESS 0x40002277 /end MEASUREMENT
/begin MEASUREMENT obd_ii_tire_pressure_valid_and_error "undefined2" UWORD NO_COMPU_METHOD 0 0 0 65535 ECU_ADDRESS 0x40002278 /end MEASUREMENT
/begin MEASUREMENT iat_overtemp_fail_debounce_counter "undefined1" UBYTE NO_COMPU_METHOD 0 0 0 255 ECU_ADDRESS 0x40002282 /end MEASUREMENT
/begin MEASUREMENT obd_ii_defer_send "Defer send. Runtime state -- log to observe this behavior." UBYTE NO_COMPU_METHOD 0 0 0 255 ECU_ADDRESS 0x40002288 /end MEASUREMENT
/begin MEASUREMENT obd_ii_tx_messages_pending "undefined1" UBYTE NO_COMPU_METHOD 0 0 0 255 ECU_ADDRESS 0x40002289 /end MEASUREMENT
/begin MEASUREMENT isotp_flow_status "undefined1" UBYTE NO_COMPU_METHOD 0 0 0 255 ECU_ADDRESS 0x4000228A /end MEASUREMENT
/begin MEASUREMENT isotp_fc_received "undefined1" UBYTE NO_COMPU_METHOD 0 0 0 255 ECU_ADDRESS 0x4000228B /end MEASUREMENT
/begin MEASUREMENT isotp_block_size "undefined1" UBYTE NO_COMPU_METHOD 0 0 0 255 ECU_ADDRESS 0x4000228C /end MEASUREMENT
/begin MEASUREMENT isotp_stmin "undefined1" UBYTE NO_COMPU_METHOD 0 0 0 255 ECU_ADDRESS 0x4000228D /end MEASUREMENT
/begin MEASUREMENT obd_resp_length "undefined2" UWORD NO_COMPU_METHOD 0 0 0 65535 ECU_ADDRESS 0x4000228E /end MEASUREMENT
/begin MEASUREMENT isotp_block_counter "undefined1" UBYTE NO_COMPU_METHOD 0 0 0 255 ECU_ADDRESS 0x40002290 /end MEASUREMENT
/begin MEASUREMENT isotp_stmin_counter "undefined1" UBYTE NO_COMPU_METHOD 0 0 0 255 ECU_ADDRESS 0x40002291 /end MEASUREMENT
/begin MEASUREMENT gear_index_auto "Inferred gear index. Log for gear-based analysis." UBYTE NO_COMPU_METHOD 0 0 0 255 ECU_ADDRESS 0x40002298 /end MEASUREMENT
/begin MEASUREMENT ips_shift_active "IPS shift active. Log to follow IPS automated-manual shift behavior." UBYTE NO_COMPU_METHOD 0 0 0 255 ECU_ADDRESS 0x40002299 /end MEASUREMENT
/begin MEASUREMENT ips_flags_faults "undefined1" UBYTE NO_COMPU_METHOD 0 0 0 255 ECU_ADDRESS 0x4000229A /end MEASUREMENT
/begin MEASUREMENT obd_ii_oil_temp_ips "undefined1" UBYTE NO_COMPU_METHOD 0 0 0 255 ECU_ADDRESS 0x4000229B /end MEASUREMENT
/begin MEASUREMENT dm_data_buffer "undefined4" ULONG NO_COMPU_METHOD 0 0 0 4294967295 ECU_ADDRESS 0x4000229C /end MEASUREMENT
/begin MEASUREMENT can_rx_msg_timestamp "undefined2" UWORD NO_COMPU_METHOD 0 0 0 65535 ECU_ADDRESS 0x400022A8 /end MEASUREMENT
/begin MEASUREMENT can_b7_rolling_counter "Can b7 rolling counter. Runtime state -- log to observe this behavior." UBYTE NO_COMPU_METHOD 0 0 0 255 ECU_ADDRESS 0x400022B1 /end MEASUREMENT
/begin MEASUREMENT imu_gyro "undefined2" UWORD NO_COMPU_METHOD 0 0 0 65535 ECU_ADDRESS 0x400022CA /end MEASUREMENT
/begin MEASUREMENT imu_accel_lat "Lateral acceleration (IMU). Log for cornering/grip analysis." SWORD CM_u8_accel_1_255g 0 0 -128.501960784314 128.498039215686 ECU_ADDRESS 0x400022CC /end MEASUREMENT
/begin MEASUREMENT steering_angle_sensor_status "undefined1" UBYTE NO_COMPU_METHOD 0 0 0 255 ECU_ADDRESS 0x400022CF /end MEASUREMENT
/begin MEASUREMENT steering_angle_rate_400022D0 "undefined1" UBYTE NO_COMPU_METHOD 0 0 0 255 ECU_ADDRESS 0x400022D0 /end MEASUREMENT
/begin MEASUREMENT steering_angle "Steering-wheel angle (from SAS over CAN). Log for chassis/traction correlation." UWORD CM_u16_angle_1_10deg 0 0 0 6553.5 ECU_ADDRESS 0x400022D2 /end MEASUREMENT
/begin MEASUREMENT obd_o2_value_buf "undefined1" UBYTE NO_COMPU_METHOD 0 0 0 255 ECU_ADDRESS 0x40002334 /end MEASUREMENT
/begin MEASUREMENT obd_MIL_and_DTC "undefined1" UBYTE NO_COMPU_METHOD 0 0 0 255 ECU_ADDRESS 0x40002348 /end MEASUREMENT
/begin MEASUREMENT obd_DTC_count "undefined1" UBYTE NO_COMPU_METHOD 0 0 0 255 ECU_ADDRESS 0x40002349 /end MEASUREMENT
/begin MEASUREMENT hc08_rx_checksum_accum "undefined1" UBYTE NO_COMPU_METHOD 0 0 0 255 ECU_ADDRESS 0x40002350 /end MEASUREMENT
/begin MEASUREMENT hc08_rx_parse_state "undefined1" UBYTE NO_COMPU_METHOD 0 0 0 255 ECU_ADDRESS 0x40002351 /end MEASUREMENT
/begin MEASUREMENT hc08_tx_sequence_counter "undefined1" UBYTE NO_COMPU_METHOD 0 0 0 255 ECU_ADDRESS 0x40002352 /end MEASUREMENT
/begin MEASUREMENT esci_a_rx_queue_count "undefined1" UBYTE NO_COMPU_METHOD 0 0 0 255 ECU_ADDRESS 0x40002355 /end MEASUREMENT
/begin MEASUREMENT esci_a_rx_queue_head "undefined1" UBYTE NO_COMPU_METHOD 0 0 0 255 ECU_ADDRESS 0x40002356 /end MEASUREMENT
/begin MEASUREMENT esci_a_rx_queue_tail "undefined1" UBYTE NO_COMPU_METHOD 0 0 0 255 ECU_ADDRESS 0x40002357 /end MEASUREMENT
/begin MEASUREMENT hc08_tx_rx_delta "undefined2" UWORD NO_COMPU_METHOD 0 0 0 65535 ECU_ADDRESS 0x40002358 /end MEASUREMENT
/begin MEASUREMENT hc08_valid_rx_count "undefined4" ULONG NO_COMPU_METHOD 0 0 0 4294967295 ECU_ADDRESS 0x4000235C /end MEASUREMENT
/begin MEASUREMENT hc08_status_tx_count "undefined4" ULONG NO_COMPU_METHOD 0 0 0 4294967295 ECU_ADDRESS 0x40002360 /end MEASUREMENT
/begin MEASUREMENT cruise_multifunction_switch_voltage "┌───────────────┬───────────┬────────────────────────────┐" UWORD CM_u16_voltage_5_1023v 0 0 0 320.307917888563 ECU_ADDRESS 0x40002368 /end MEASUREMENT
/begin MEASUREMENT cruise_status "1 armed,2 engaged,4 accel hold,8 coast hold,10 accel tap,20 coast tap,40 cancel latched,80 captured,100/200 resync after hold,400 pedal override,800/1000 slew up/down,2000 settled,4000 bad switch V,8000 inhibited,10000 resuming,20000 recent cancel,40" ULONG NO_COMPU_METHOD 0 0 0 4294967295 ECU_ADDRESS 0x4000236C /end MEASUREMENT
/begin MEASUREMENT cruise_speed_target "Cruise speed target. Log to debug cruise engagement and speed holding. (km/h; raw/100)" UWORD CM_u8_speed_1_100kph 0 0 0 655.35 ECU_ADDRESS 0x40002370 /end MEASUREMENT
/begin MEASUREMENT cruise_proportional_term "10 mg/s airflow" SWORD NO_COMPU_METHOD 0 0 -32768 32767 ECU_ADDRESS 0x40002372 /end MEASUREMENT
/begin MEASUREMENT cruise_integral_term "10 mg/s airflow" SWORD NO_COMPU_METHOD 0 0 -32768 32767 ECU_ADDRESS 0x40002374 /end MEASUREMENT
/begin MEASUREMENT cruise_deriv_term "10 mg/s airflow" SWORD NO_COMPU_METHOD 0 0 -32768 32767 ECU_ADDRESS 0x40002376 /end MEASUREMENT
/begin MEASUREMENT cruise_airflow_cmd "slewed airflow request" UWORD CM_u16_flow_10mg_s 0 0 0 655350 ECU_ADDRESS 0x40002378 /end MEASUREMENT
/begin MEASUREMENT cruise_load_request "~1 mg/stroke, max 0x3ff; >>2 into CAL_load_to_tps_mapping" UWORD NO_COMPU_METHOD 0 0 0 65535 ECU_ADDRESS 0x4000237A /end MEASUREMENT
/begin MEASUREMENT cruise_tps_request "TPS above idle sent to accel_pedal_200hz" UWORD CM_u16_factor_1_1023 0 0 0 6406.15835777126 ECU_ADDRESS 0x4000237C /end MEASUREMENT
/begin MEASUREMENT tps_commanded_cruise "undefined2" UWORD NO_COMPU_METHOD 0 0 0 65535 ECU_ADDRESS 0x4000237E /end MEASUREMENT
/begin MEASUREMENT cruise_speed_error "Cruise speed error. Log to debug cruise engagement and speed holding. (km/h; raw/100)" UWORD CM_u8_speed_1_100kph 0 0 0 655.35 ECU_ADDRESS 0x40002380 /end MEASUREMENT
/begin MEASUREMENT cruise_cancel_reason "1 cancel btn,2 brake,4 clutch,8 ABS/ESP,10 ETB cruise fault,20 speed err,40 rpm/revlimit,80 inhibit,100 override timeout,200 ESP b3,400 gear<min,800 ESP b4,1000 LFB,2000 coast in override,4000 clutch implausible; cleared while engaged" UWORD NO_COMPU_METHOD 0 0 0 65535 ECU_ADDRESS 0x40002382 /end MEASUREMENT
/begin MEASUREMENT obd_ii_P0578_fail_countdown "uint8_t" UBYTE NO_COMPU_METHOD 0 0 0 255 ECU_ADDRESS 0x40002384 /end MEASUREMENT
/begin MEASUREMENT obd_ii_P0579_fail_countdown "uint8_t" UBYTE NO_COMPU_METHOD 0 0 0 255 ECU_ADDRESS 0x40002385 /end MEASUREMENT
/begin MEASUREMENT obd_ii_P0579_window_timer "uint16_t" UWORD NO_COMPU_METHOD 0 0 0 65535 ECU_ADDRESS 0x40002386 /end MEASUREMENT
/begin MEASUREMENT cruise_cancel_button_hold_count "undefined1" UBYTE NO_COMPU_METHOD 0 0 0 255 ECU_ADDRESS 0x40002388 /end MEASUREMENT
/begin MEASUREMENT cruise_resume_button_hold_count "undefined1" UBYTE NO_COMPU_METHOD 0 0 0 255 ECU_ADDRESS 0x40002389 /end MEASUREMENT
/begin MEASUREMENT cruise_set_button_hold_count "undefined1" UBYTE NO_COMPU_METHOD 0 0 0 255 ECU_ADDRESS 0x4000238A /end MEASUREMENT
/begin MEASUREMENT cruise_speed_error_prev "int16_t" SWORD NO_COMPU_METHOD 0 0 -32768 32767 ECU_ADDRESS 0x4000238C /end MEASUREMENT
/begin MEASUREMENT cruise_speed_error_integral "+= err/10 at 10 Hz with anti-windup" SWORD NO_COMPU_METHOD 0 0 -32768 32767 ECU_ADDRESS 0x4000238E /end MEASUREMENT
/begin MEASUREMENT cruise_speed_error_rate "delta err /10 at 2 Hz" SWORD NO_COMPU_METHOD 0 0 -32768 32767 ECU_ADDRESS 0x40002390 /end MEASUREMENT
/begin MEASUREMENT cruise_override_timeout_timer "100 ms ticks" UWORD NO_COMPU_METHOD 0 0 0 65535 ECU_ADDRESS 0x40002392 /end MEASUREMENT
/begin MEASUREMENT cruise_coast_switch_override_timer "u8_time_5ms" UBYTE CM_u8_time_5ms 0 0 0 1275 ECU_ADDRESS 0x40002394 /end MEASUREMENT
/begin MEASUREMENT cruise_speed_smoothed "Cruise speed smoothed. Log to debug cruise engagement and speed holding. (km/h; raw/100)" UWORD CM_u8_speed_1_100kph 0 0 0 655.35 ECU_ADDRESS 0x40002396 /end MEASUREMENT
/begin MEASUREMENT cruise_switch_stuck_ref_voltage "P0578 stuck switch reference" UWORD CM_u16_voltage_5_1023v 0 0 0 320.307917888563 ECU_ADDRESS 0x40002398 /end MEASUREMENT
/begin MEASUREMENT cruise_switch_stuck_timer "uint16_t" UWORD NO_COMPU_METHOD 0 0 0 65535 ECU_ADDRESS 0x4000239A /end MEASUREMENT
/begin MEASUREMENT cruise_settle_timer "25 ms ticks, 20 = 0.5 s after engage then status 0x2000" UBYTE NO_COMPU_METHOD 0 0 0 255 ECU_ADDRESS 0x4000239C /end MEASUREMENT
/begin MEASUREMENT cruise_speed_target_prev "u16_speed_1/100kph" UWORD CM_u8_speed_1_100kph 0 0 0 655.35 ECU_ADDRESS 0x4000239E /end MEASUREMENT
/begin MEASUREMENT cruise_airflow_fast_slew_timer "5 ms ticks" UWORD NO_COMPU_METHOD 0 0 0 65535 ECU_ADDRESS 0x400023A0 /end MEASUREMENT
/begin MEASUREMENT cruise_unused_23a2 "only written 0" UBYTE NO_COMPU_METHOD 0 0 0 255 ECU_ADDRESS 0x400023A2 /end MEASUREMENT
/begin MEASUREMENT cruise_cancel_dfco_inhibit_timer "5 ms ticks" UWORD NO_COMPU_METHOD 0 0 0 65535 ECU_ADDRESS 0x400023A4 /end MEASUREMENT
/begin MEASUREMENT cruise_gear_prev "enum_t6e_gear" UBYTE NO_COMPU_METHOD 0 0 0 255 ECU_ADDRESS 0x400023A6 /end MEASUREMENT
/begin MEASUREMENT cruise_clutch_seen_flags "1 seen engaged, 2 seen disengaged since ign on; both needed" UBYTE NO_COMPU_METHOD 0 0 0 255 ECU_ADDRESS 0x400023A7 /end MEASUREMENT
/begin MEASUREMENT cruise_switch_change_count "uint8_t" UBYTE NO_COMPU_METHOD 0 0 0 255 ECU_ADDRESS 0x400023A8 /end MEASUREMENT
/begin MEASUREMENT cruise_switch_change_count_window "uint8_t" UBYTE NO_COMPU_METHOD 0 0 0 255 ECU_ADDRESS 0x400023A9 /end MEASUREMENT
/begin MEASUREMENT cruise_brake_latch_release_timer "5 ms ticks, 100 = 0.5 s stalk released clears status 0x1000000" UBYTE NO_COMPU_METHOD 0 0 0 255 ECU_ADDRESS 0x400023AA /end MEASUREMENT
/begin MEASUREMENT cruise_switch_code_prev "uint8_t" UBYTE NO_COMPU_METHOD 0 0 0 255 ECU_ADDRESS 0x400023AB /end MEASUREMENT
/begin MEASUREMENT cruise_speed_error_normalized "u8_factor_1/255" UBYTE CM_u8_factor_1_255 0 0 0 100 ECU_ADDRESS 0x400023AC /end MEASUREMENT
/begin MEASUREMENT obd_ii_engine_torque "Engine torque. Log to follow the ECU torque estimate and any torque limiting. (Nm)" UWORD CM_u8_torque_nm 0 0 0 65535 ECU_ADDRESS 0x400023B0 /end MEASUREMENT
/begin MEASUREMENT torque_estimated_actual_load "Torque estimated actual load. Log to follow the ECU torque estimate and any torque limiting. (Nm)" UWORD CM_u8_torque_nm 0 0 0 65535 ECU_ADDRESS 0x400023B2 /end MEASUREMENT
/begin MEASUREMENT engine_friction_torque "Engine friction torque. Log to follow the ECU torque estimate and any torque limiting. (Nm)" UWORD CM_u8_torque_nm 0 0 0 65535 ECU_ADDRESS 0x400023B4 /end MEASUREMENT
/begin MEASUREMENT torque_estimated_alphaN "Torque estimated alphaN. Log to follow the ECU torque estimate and any torque limiting. (Nm)" UWORD CM_u8_torque_nm 0 0 0 65535 ECU_ADDRESS 0x400023B6 /end MEASUREMENT
/begin MEASUREMENT torque_engine_friction_base "Torque engine friction base. Log to follow the ECU torque estimate and any torque limiting. (Nm)" UWORD CM_u8_torque_nm 0 0 0 65535 ECU_ADDRESS 0x400023B8 /end MEASUREMENT
/begin MEASUREMENT load_alphaN_base "Load alphaN base. Log engine load -- the main axis for fueling and ignition. (mg/stroke)" UWORD CM_u16_load_mg_stroke 0 0 0 65535 ECU_ADDRESS 0x400023BA /end MEASUREMENT
/begin MEASUREMENT load_alphaN "Load alphaN. Log engine load -- the main axis for fueling and ignition. (mg/stroke)" UWORD CM_u16_load_mg_stroke 0 0 0 65535 ECU_ADDRESS 0x400023BC /end MEASUREMENT
/begin MEASUREMENT load_alphaN_from_torque_request "u16_load_mg/stroke" UWORD CM_u16_load_mg_stroke 0 0 0 65535 ECU_ADDRESS 0x400023BE /end MEASUREMENT
/begin MEASUREMENT torque_limit_tps_target "u16_factor_1/1023" UWORD CM_u16_factor_1_1023 0 0 0 6406.15835777126 ECU_ADDRESS 0x400023C0 /end MEASUREMENT
/begin MEASUREMENT ign_comp_torque_reduction "Ignition compensation torque reduction. Log spark advance to confirm the timing strategy and headroom to knock. (deg; raw/4)" SWORD CM_u8_angle_1_4deg 0 0 -8192 8191.75 ECU_ADDRESS 0x400023C2 /end MEASUREMENT
/begin MEASUREMENT torque_allowed_factor "Torque allowed factor. Log to follow the ECU torque estimate and any torque limiting. (0-1; raw/255)" UBYTE CM_u8_factor_1_255 0 0 0 100 ECU_ADDRESS 0x400023C4 /end MEASUREMENT
/begin MEASUREMENT torque_limit_external_net "Torque limit external net. Log to follow the ECU torque estimate and any torque limiting. (Nm)" UWORD CM_u8_torque_nm 0 0 0 65535 ECU_ADDRESS 0x400023C6 /end MEASUREMENT
/begin MEASUREMENT torque_limit_external_factor "Torque limit external factor. Log to follow the ECU torque estimate and any torque limiting. (0-1; raw/255)" UBYTE CM_u8_factor_1_255 0 0 0 100 ECU_ADDRESS 0x400023C8 /end MEASUREMENT
/begin MEASUREMENT torque_above_external_limit "Torque above external limit. Log to follow the ECU torque estimate and any torque limiting. (Nm)" UWORD CM_u8_torque_nm 0 0 0 65535 ECU_ADDRESS 0x400023CA /end MEASUREMENT
/begin MEASUREMENT torque_net_engine_combustion "Torque net engine combustion. Log to follow the ECU torque estimate and any torque limiting. (Nm)" UWORD CM_u8_torque_nm 0 0 0 65535 ECU_ADDRESS 0x400023CC /end MEASUREMENT
/begin MEASUREMENT torque_alphaN_net "Torque alphaN net. Log to follow the ECU torque estimate and any torque limiting. (Nm)" UWORD CM_u8_torque_nm 0 0 0 65535 ECU_ADDRESS 0x400023CE /end MEASUREMENT
/begin MEASUREMENT torque_limit_base_factor "Torque limit base factor. Log to follow the ECU torque estimate and any torque limiting. (0-1; raw/255)" UBYTE CM_u8_factor_1_255 0 0 0 100 ECU_ADDRESS 0x400023D0 /end MEASUREMENT
/begin MEASUREMENT torque_efficiency_factor "u8_factor_1/255" UBYTE CM_u8_factor_1_255 0 0 0 100 ECU_ADDRESS 0x400023D1 /end MEASUREMENT
/begin MEASUREMENT torque_engine_friction_coolant "Torque engine friction coolant. Log to follow the ECU torque estimate and any torque limiting. (Nm)" UWORD CM_u8_torque_nm 0 0 0 65535 ECU_ADDRESS 0x400023D2 /end MEASUREMENT
/begin MEASUREMENT torque_engine_friction_accessory_scaled "Torque engine friction accessory scaled. Log to follow the ECU torque estimate and any torque limiting. (Nm)" UWORD CM_u8_torque_nm 0 0 0 65535 ECU_ADDRESS 0x400023D4 /end MEASUREMENT
/begin MEASUREMENT torque_cut_trigger_margin "Torque cut trigger margin. Log to follow the ECU torque estimate and any torque limiting. (0-1; raw/255)" UWORD CM_u8_factor_1_255 0 0 0 25700 ECU_ADDRESS 0x400023D6 /end MEASUREMENT
/begin MEASUREMENT torque_factor_per_cyl_step "Torque factor per cylinder step. Log to follow the ECU torque estimate and any torque limiting." UBYTE NO_COMPU_METHOD 0 0 0 255 ECU_ADDRESS 0x400023D8 /end MEASUREMENT
/begin MEASUREMENT torque_limit_active_cyl_cut_count "Torque cut level. Log to follow the ECU torque estimate and any torque limiting." UBYTE NO_COMPU_METHOD 0 0 0 255 ECU_ADDRESS 0x400023D9 /end MEASUREMENT
/begin MEASUREMENT spark_retard_from_mbt "How far timing is retarded from MBT. Log to gauge timing headroom. (deg; raw/4)" SWORD CM_u8_angle_1_4deg 0 0 -8192 8191.75 ECU_ADDRESS 0x400023DA /end MEASUREMENT
/begin MEASUREMENT flexcan_a_tx_114_pending "bool" UBYTE NO_COMPU_METHOD 0 0 0 255 ECU_ADDRESS 0x400023DC /end MEASUREMENT
/begin MEASUREMENT torque_limit_source_flags "uint8_t" UBYTE NO_COMPU_METHOD 0 0 0 255 ECU_ADDRESS 0x400023DD /end MEASUREMENT
/begin MEASUREMENT torque_req_0xb7_abs_esp_active "Torque req 0xb7 ABS ESP active. Log to follow the ECU torque estimate and any torque limiting." UBYTE NO_COMPU_METHOD 0 0 0 255 ECU_ADDRESS 0x400023DE /end MEASUREMENT
/begin MEASUREMENT torque_req_0xb7_cruise_control_active "Torque req 0xb7 cruise control active. Log to follow the ECU torque estimate and any torque limiting." UBYTE NO_COMPU_METHOD 0 0 0 255 ECU_ADDRESS 0x400023DF /end MEASUREMENT
/begin MEASUREMENT tcu_0xc7_torque_request_active "bool" UBYTE NO_COMPU_METHOD 0 0 0 255 ECU_ADDRESS 0x400023E0 /end MEASUREMENT
/begin MEASUREMENT torque_limit_ign_base_delta_from_mbt "i16_angle_1/4" SWORD CM_u8_angle_1_4deg 0 0 -8192 8191.75 ECU_ADDRESS 0x400023E2 /end MEASUREMENT
/begin MEASUREMENT ign_retard_knock_avg "Average knock retard across cylinders. Log for an overall knock-activity trace. (deg; raw/4)" UWORD CM_u8_angle_1_4deg 0 0 0 16383.75 ECU_ADDRESS 0x400023E4 /end MEASUREMENT
/begin MEASUREMENT abs_esp_flags "uint8_t" UBYTE NO_COMPU_METHOD 0 0 0 255 ECU_ADDRESS 0x400023E6 /end MEASUREMENT
/begin MEASUREMENT ips_shift_torque_request_active "bool" UBYTE NO_COMPU_METHOD 0 0 0 255 ECU_ADDRESS 0x400023E7 /end MEASUREMENT
/begin MEASUREMENT torque_limit_0xb7_hold_timer "u8_time_10ms" UBYTE CM_u8_time_10ms 0 0 0 2550 ECU_ADDRESS 0x400023E8 /end MEASUREMENT
/begin MEASUREMENT torque_limit_tcu_hold_timer "u8_time_10ms" UBYTE CM_u8_time_10ms 0 0 0 2550 ECU_ADDRESS 0x400023E9 /end MEASUREMENT
/begin MEASUREMENT tc_torque_limit_use_slow_path "Traction-control torque limit use slow path. Log to follow the ECU torque estimate and any torque limiting." UBYTE NO_COMPU_METHOD 0 0 0 255 ECU_ADDRESS 0x400023EA /end MEASUREMENT
/begin MEASUREMENT tcu_slow_channel_active_never_set "bool" UBYTE NO_COMPU_METHOD 0 0 0 255 ECU_ADDRESS 0x400023EB /end MEASUREMENT
/begin MEASUREMENT torque_limit_ips_shift_active "bool" UBYTE NO_COMPU_METHOD 0 0 0 255 ECU_ADDRESS 0x400023EC /end MEASUREMENT
/begin MEASUREMENT torque_limit_slow_path_active "bool" UBYTE NO_COMPU_METHOD 0 0 0 255 ECU_ADDRESS 0x400023ED /end MEASUREMENT
/begin MEASUREMENT torque_driver_net_clamped "Torque driver net clamped. Log to follow the ECU torque estimate and any torque limiting. (Nm)" UWORD CM_u8_torque_nm 0 0 0 65535 ECU_ADDRESS 0x400023EE /end MEASUREMENT
/begin MEASUREMENT cruise_brake_standstill_timer "u16_time_10ms" UWORD CM_u8_time_10ms 0 0 0 655350 ECU_ADDRESS 0x400023F0 /end MEASUREMENT
/begin MEASUREMENT torque_loss_from_ign_retard "u16_torque_nm" UWORD CM_u8_torque_nm 0 0 0 65535 ECU_ADDRESS 0x400023F2 /end MEASUREMENT
/begin MEASUREMENT spark_retard_for_torque_loss "Spark retard for torque loss. Log to follow the ECU torque estimate and any torque limiting. (deg; raw/4)" SWORD CM_u8_angle_1_4deg 0 0 -8192 8191.75 ECU_ADDRESS 0x400023F4 /end MEASUREMENT
/begin MEASUREMENT ign_comp_torque_reduction_unclipped "u16_angle_1/4deg" UWORD CM_u8_angle_1_4deg 0 0 0 16383.75 ECU_ADDRESS 0x400023F6 /end MEASUREMENT
/begin MEASUREMENT intermediate_calc1 "undefined2" UWORD NO_COMPU_METHOD 0 0 0 65535 ECU_ADDRESS 0x400023F8 /end MEASUREMENT
/begin MEASUREMENT torque_limit_internal "Torque limit internal. Log to follow the ECU torque estimate and any torque limiting. (Nm)" UWORD CM_u8_torque_nm 0 0 0 65535 ECU_ADDRESS 0x400023FA /end MEASUREMENT
/begin MEASUREMENT torque_limit_external_and_internal "Torque limit external and internal. Log to follow the ECU torque estimate and any torque limiting. (Nm)" UWORD CM_u8_torque_nm 0 0 0 65535 ECU_ADDRESS 0x400023FC /end MEASUREMENT
/begin MEASUREMENT nonfiring_cyl_count "u8_count" UBYTE NO_COMPU_METHOD 0 0 0 255 ECU_ADDRESS 0x400023FE /end MEASUREMENT
/begin MEASUREMENT torque_limit_output_clamp_flags "uint8_t" UBYTE NO_COMPU_METHOD 0 0 0 255 ECU_ADDRESS 0x400023FF /end MEASUREMENT
/begin MEASUREMENT torque_tps_limit_delay_timer "u8_time_10ms" UBYTE CM_u8_time_10ms 0 0 0 2550 ECU_ADDRESS 0x40002400 /end MEASUREMENT
/begin MEASUREMENT tcu_torque_limit_onset_latch "bool" UBYTE NO_COMPU_METHOD 0 0 0 255 ECU_ADDRESS 0x40002401 /end MEASUREMENT
/begin MEASUREMENT torque_request_cruise_active "bool" UBYTE NO_COMPU_METHOD 0 0 0 255 ECU_ADDRESS 0x40002402 /end MEASUREMENT
/begin MEASUREMENT brake_timer2 "u8_time_10ms" UBYTE CM_u8_time_10ms 0 0 0 2550 ECU_ADDRESS 0x40002403 /end MEASUREMENT
/begin MEASUREMENT runaway_protection_timeout_unknown "u8_time_10ms" UBYTE CM_u8_time_10ms 0 0 0 2550 ECU_ADDRESS 0x40002404 /end MEASUREMENT
/begin MEASUREMENT ign_adv_sum_firing_cyl "Ignition advance sum firing cylinder. Log spark advance to confirm the timing strategy and headroom to knock. (deg; raw/4)" SWORD CM_u8_angle_1_4deg 0 0 -8192 8191.75 ECU_ADDRESS 0x40002406 /end MEASUREMENT
/begin MEASUREMENT torque_external_min_adder "Torque external min adder. Log to follow the ECU torque estimate and any torque limiting. (Nm)" UWORD CM_u8_torque_nm 0 0 0 65535 ECU_ADDRESS 0x40002408 /end MEASUREMENT
/begin MEASUREMENT torque_external_request_final "Torque external request final. Log to follow the ECU torque estimate and any torque limiting. (Nm)" UWORD CM_u8_torque_nm 0 0 0 65535 ECU_ADDRESS 0x4000240A /end MEASUREMENT
/begin MEASUREMENT torque_engine_friction_accessory "undefined2" UWORD NO_COMPU_METHOD 0 0 0 65535 ECU_ADDRESS 0x4000240C /end MEASUREMENT
/begin MEASUREMENT torque_engine_friction_comp_engine_speed "Torque engine friction compensation engine speed. Log to follow the ECU torque estimate and any torque limiting. (0-1; raw/255)" UBYTE CM_u8_factor_1_255 0 0 0 100 ECU_ADDRESS 0x4000240E /end MEASUREMENT
/begin MEASUREMENT torque_engine_friction_speed_component "Torque engine friction speed component. Log to follow the ECU torque estimate and any torque limiting. (Nm)" UWORD CM_u8_torque_nm 0 0 0 65535 ECU_ADDRESS 0x40002410 /end MEASUREMENT
/begin MEASUREMENT torque_limit_tps_accumulator "uint32_t" ULONG NO_COMPU_METHOD 0 0 0 4294967295 ECU_ADDRESS 0x40002414 /end MEASUREMENT
/begin MEASUREMENT ac_request_valid "bool" UBYTE NO_COMPU_METHOD 0 0 0 255 ECU_ADDRESS 0x40002418 /end MEASUREMENT
/begin MEASUREMENT ac_compressor_state "A/C compressor state. Log to see A/C clutch engagement and its load/idle impact." UBYTE NO_COMPU_METHOD 0 0 0 255 ECU_ADDRESS 0x40002419 /end MEASUREMENT
/begin MEASUREMENT obd_ii_ac_clutch_relay "undefined1" UBYTE NO_COMPU_METHOD 0 0 0 255 ECU_ADDRESS 0x4000241A /end MEASUREMENT
/begin MEASUREMENT ac_compressor_load "undefined2" UWORD NO_COMPU_METHOD 0 0 0 65535 ECU_ADDRESS 0x4000241C /end MEASUREMENT
/begin MEASUREMENT ac_inhibit_flags "undefined2" UWORD NO_COMPU_METHOD 0 0 0 65535 ECU_ADDRESS 0x4000241E /end MEASUREMENT
/begin MEASUREMENT ac_tps_inhibit_timer "A/C throttle position inhibit timer. Log to see throttle/pedal demand and throttle response. (ms; raw*100)" UBYTE CM_u8_time_100ms 0 0 0 25500 ECU_ADDRESS 0x40002423 /end MEASUREMENT
/begin MEASUREMENT ac_clutch_input "A/C clutch input. Log to see A/C clutch engagement and its load/idle impact." UBYTE NO_COMPU_METHOD 0 0 0 255 ECU_ADDRESS 0x40002424 /end MEASUREMENT
/begin MEASUREMENT ac_button_requested "A/C button requested. Log to see A/C clutch engagement and its load/idle impact." UBYTE NO_COMPU_METHOD 0 0 0 255 ECU_ADDRESS 0x40002425 /end MEASUREMENT
/begin MEASUREMENT ac_compressor_ign_compensation_active "A/C compressor ignition compensation active. Log spark advance to confirm the timing strategy and headroom to knock." UBYTE NO_COMPU_METHOD 0 0 0 255 ECU_ADDRESS 0x40002426 /end MEASUREMENT
/begin MEASUREMENT ac_pid_p_term "undefined2" UWORD NO_COMPU_METHOD 0 0 0 65535 ECU_ADDRESS 0x4000242A /end MEASUREMENT
/begin MEASUREMENT ac_pid_i_term "uint16_t" UWORD NO_COMPU_METHOD 0 0 0 65535 ECU_ADDRESS 0x4000242C /end MEASUREMENT
/begin MEASUREMENT ac_pid_d_term "undefined2" UWORD NO_COMPU_METHOD 0 0 0 65535 ECU_ADDRESS 0x4000242E /end MEASUREMENT
/begin MEASUREMENT ac_pid_out_accum "undefined2" UWORD NO_COMPU_METHOD 0 0 0 65535 ECU_ADDRESS 0x40002430 /end MEASUREMENT
/begin MEASUREMENT ac_pid_target_accum "undefined2" UWORD NO_COMPU_METHOD 0 0 0 65535 ECU_ADDRESS 0x40002432 /end MEASUREMENT
/begin MEASUREMENT ac_ramp_step "undefined2" UWORD NO_COMPU_METHOD 0 0 0 65535 ECU_ADDRESS 0x40002434 /end MEASUREMENT
/begin MEASUREMENT ac_power_limit "uint16_t" UWORD NO_COMPU_METHOD 0 0 0 65535 ECU_ADDRESS 0x40002436 /end MEASUREMENT
/begin MEASUREMENT ac_evap_temp_delta "A/C EVAP temperature delta. Log to see A/C clutch engagement and its load/idle impact. (deg C; raw/10)" UWORD CM_u8_temp_1_10C 0 0 0 6553.5 ECU_ADDRESS 0x40002438 /end MEASUREMENT
/begin MEASUREMENT ac_compressor_dc "undefined2" UWORD NO_COMPU_METHOD 0 0 0 65535 ECU_ADDRESS 0x4000243C /end MEASUREMENT
/begin MEASUREMENT ac_fan_startup_hold_timer "A/C fan startup hold timer. Log to see A/C clutch engagement and its load/idle impact. (ms; raw*100)" UWORD CM_u8_time_100ms 0 0 0 6553500 ECU_ADDRESS 0x4000243E /end MEASUREMENT
/begin MEASUREMENT ac_clutch_engage_request "A/C clutch engage request. Log to see A/C clutch engagement and its load/idle impact." UBYTE NO_COMPU_METHOD 0 0 0 255 ECU_ADDRESS 0x4000244E /end MEASUREMENT
/begin MEASUREMENT ac_evap_pid_update_period "u8_time_5ms" UBYTE CM_u8_time_5ms 0 0 0 1275 ECU_ADDRESS 0x4000244F /end MEASUREMENT
/begin MEASUREMENT ac_compressor_load_power "undefined2" UWORD NO_COMPU_METHOD 0 0 0 65535 ECU_ADDRESS 0x40002452 /end MEASUREMENT
/begin MEASUREMENT ac_rpm_inhibit_delay_timer "A/C RPM inhibit delay timer. Log to see A/C clutch engagement and its load/idle impact. (ms; raw*100)" UBYTE CM_u8_time_100ms 0 0 0 25500 ECU_ADDRESS 0x40002456 /end MEASUREMENT
/begin MEASUREMENT ac_evap_freeze_inhibit_timer "u16_time_5ms" UWORD CM_u8_time_5ms 0 0 0 327675 ECU_ADDRESS 0x40002458 /end MEASUREMENT
/begin MEASUREMENT ac_rpm_cutoff_on_delay_timer "undefined2" UWORD NO_COMPU_METHOD 0 0 0 65535 ECU_ADDRESS 0x40002460 /end MEASUREMENT
/begin MEASUREMENT ac_rpm_cutoff_min_hold_timer "undefined2" UWORD NO_COMPU_METHOD 0 0 0 65535 ECU_ADDRESS 0x40002462 /end MEASUREMENT
/begin MEASUREMENT etb_driver_diag_latched "undefined1" UBYTE NO_COMPU_METHOD 0 0 0 255 ECU_ADDRESS 0x40002478 /end MEASUREMENT
/begin MEASUREMENT tps_sensor_fault_active "Throttle position sensor fault active. Log to see throttle/pedal demand and throttle response." UBYTE NO_COMPU_METHOD 0 0 0 255 ECU_ADDRESS 0x40002479 /end MEASUREMENT
/begin MEASUREMENT tps_feedback_position "undefined2" UWORD NO_COMPU_METHOD 0 0 0 65535 ECU_ADDRESS 0x4000247A /end MEASUREMENT
/begin MEASUREMENT tps_system_state "Throttle position system state. Log to see throttle/pedal demand and throttle response." UBYTE NO_COMPU_METHOD 0 0 0 255 ECU_ADDRESS 0x400024A8 /end MEASUREMENT
/begin MEASUREMENT accel_pedal_system_state "uint8_t" UBYTE NO_COMPU_METHOD 0 0 0 255 ECU_ADDRESS 0x400024A9 /end MEASUREMENT
/begin MEASUREMENT accel_pedal_track_d_selected "Accelerator pedal track d selected. Runtime state -- log to observe this behavior." UBYTE NO_COMPU_METHOD 0 0 0 255 ECU_ADDRESS 0x400024AA /end MEASUREMENT
/begin MEASUREMENT accel_pedal_track_d_selected_400024AB "undefined1" UBYTE NO_COMPU_METHOD 0 0 0 255 ECU_ADDRESS 0x400024AB /end MEASUREMENT
/begin MEASUREMENT coding_cmd "Coding cmd. Internal/infrastructure state -- not a typical data-logging channel." UBYTE NO_COMPU_METHOD 0 0 0 255 ECU_ADDRESS 0x400024B0 /end MEASUREMENT
/begin MEASUREMENT coding_cmd_inline_buf "undefined" ULONG NO_COMPU_METHOD 0 0 0 4294967295 ECU_ADDRESS 0x400024B8 /end MEASUREMENT
/begin MEASUREMENT bootloader_can_diag_write_ptr "undefined2" UWORD NO_COMPU_METHOD 0 0 0 65535 ECU_ADDRESS 0x400024C0 /end MEASUREMENT
/begin MEASUREMENT bootloader_can_diag_read_ptr "undefined2" UWORD NO_COMPU_METHOD 0 0 0 65535 ECU_ADDRESS 0x400024C2 /end MEASUREMENT
/begin MEASUREMENT bootloader_can_arb_id "undefined2" UWORD NO_COMPU_METHOD 0 0 0 65535 ECU_ADDRESS 0x400024C4 /end MEASUREMENT
/begin MEASUREMENT eeprom_update_flags "undefined1" UBYTE NO_COMPU_METHOD 0 0 0 255 ECU_ADDRESS 0x400024CE /end MEASUREMENT
/begin MEASUREMENT prog_version_mismatch "Prog version mismatch. Internal/infrastructure state -- not a typical data-logging channel." UBYTE NO_COMPU_METHOD 0 0 0 255 ECU_ADDRESS 0x400024CF /end MEASUREMENT
/begin MEASUREMENT vin_type "VIN type. Runtime state -- log to observe this behavior." UBYTE NO_COMPU_METHOD 0 0 0 255 ECU_ADDRESS 0x400024D0 /end MEASUREMENT
/begin MEASUREMENT vin_assigned_mask "undefined4" ULONG NO_COMPU_METHOD 0 0 0 4294967295 ECU_ADDRESS 0x400024D4 /end MEASUREMENT
/begin MEASUREMENT revlimit_state_flags "undefined2" UWORD NO_COMPU_METHOD 0 0 0 65535 ECU_ADDRESS 0x400024D8 /end MEASUREMENT
/begin MEASUREMENT revlimit_rpm_error "Revlimit RPM error. Log to confirm where and how the rev limiter intervenes. (RPM)" UWORD CM_u8_rspeed_rpm 0 0 0 65535 ECU_ADDRESS 0x400024DA /end MEASUREMENT
/begin MEASUREMENT revlimit_tps_max "Revlimit throttle cap (u16, 1/1023): written by revlimit_200hz (0 = no limit), read by the TPS-target code which clamps tps_target to it. Same as 0278 revlimit_tps_max." UWORD NO_COMPU_METHOD 0 0 0 65535 ECU_ADDRESS 0x400024DC /end MEASUREMENT
/begin MEASUREMENT revlimit_tps_max_remapped_unused "revlimit_tps_max converted to pedal scale and passed through CAL_tpstarget_* (pedal->throttle) at the end of revlimit(). Write-only: nothing reads it." UWORD NO_COMPU_METHOD 0 0 0 65535 ECU_ADDRESS 0x400024DE /end MEASUREMENT
/begin MEASUREMENT revlimit_flow_setpoint "Revlimit flow setpoint. Log to confirm where and how the rev limiter intervenes. (mg/s; raw*10)" UWORD CM_u16_flow_10mg_s 0 0 0 655350 ECU_ADDRESS 0x400024E0 /end MEASUREMENT
/begin MEASUREMENT revlimit_load_setpoint "undefined2" UWORD NO_COMPU_METHOD 0 0 0 65535 ECU_ADDRESS 0x400024E2 /end MEASUREMENT
/begin MEASUREMENT revlimit_hard_exit_rpm "Revlimit hard exit RPM. Log to confirm where and how the rev limiter intervenes. (RPM)" UWORD CM_u8_rspeed_rpm 0 0 0 65535 ECU_ADDRESS 0x400024E4 /end MEASUREMENT
/begin MEASUREMENT revlimit_hard "Hard rev-limit RPM. Log to confirm the hard cut point. (RPM)" UWORD CM_u8_rspeed_rpm 0 0 0 65535 ECU_ADDRESS 0x400024E6 /end MEASUREMENT
/begin MEASUREMENT ips_enforce_speed_limit "IPS enforce speed limit. Log to follow IPS automated-manual shift behavior." UBYTE NO_COMPU_METHOD 0 0 0 255 ECU_ADDRESS 0x400024E8 /end MEASUREMENT
/begin MEASUREMENT ips_throttle_restrict "IPS throttle restrict. Log to follow IPS automated-manual shift behavior." UBYTE NO_COMPU_METHOD 0 0 0 255 ECU_ADDRESS 0x400024EA /end MEASUREMENT
/begin MEASUREMENT revlimit_soft_rpm "Soft rev-limit RPM (where intervention begins). Log to see the limiter ramp in." UWORD CM_u8_rspeed_rpm 0 0 0 65535 ECU_ADDRESS 0x400024EC /end MEASUREMENT
/begin MEASUREMENT revlimit_timed_base_rpm "Rev limit after timer expiration. Log RPM -- the key reference axis for nearly every other channel. (RPM)" UWORD CM_u8_rspeed_rpm 0 0 0 65535 ECU_ADDRESS 0x400024EE /end MEASUREMENT
/begin MEASUREMENT limp_mode_active "Flag: ECU is in limp/limited mode. Log it -- immediately explains power loss." UBYTE NO_COMPU_METHOD 0 0 0 255 ECU_ADDRESS 0x400024F0 /end MEASUREMENT
/begin MEASUREMENT revlimit_rpm_error_integral "undefined2" UWORD NO_COMPU_METHOD 0 0 0 65535 ECU_ADDRESS 0x400024F2 /end MEASUREMENT
/begin MEASUREMENT revlimit_rpm_approach_rate "undefined2" UWORD NO_COMPU_METHOD 0 0 0 65535 ECU_ADDRESS 0x400024F4 /end MEASUREMENT
/begin MEASUREMENT revlimit_flow_correction_p "Revlimit flow correction p. Log to confirm where and how the rev limiter intervenes. (mg/s; raw*10)" UWORD CM_u16_flow_10mg_s 0 0 0 655350 ECU_ADDRESS 0x400024F6 /end MEASUREMENT
/begin MEASUREMENT revlimit_flow_correction_i "Revlimit flow correction i. Log to confirm where and how the rev limiter intervenes. (mg/s; raw*10)" UWORD CM_u16_flow_10mg_s 0 0 0 655350 ECU_ADDRESS 0x400024F8 /end MEASUREMENT
/begin MEASUREMENT revlimit_flow_correction_d "Revlimit flow correction d. Log to confirm where and how the rev limiter intervenes. (mg/s; raw*10)" UWORD CM_u16_flow_10mg_s 0 0 0 655350 ECU_ADDRESS 0x400024FA /end MEASUREMENT
/begin MEASUREMENT revlimit_flow_update_divider "u8_time_5ms" UBYTE CM_u8_time_5ms 0 0 0 1275 ECU_ADDRESS 0x400024FC /end MEASUREMENT
/begin MEASUREMENT revlimit_integral_update_divider "u8_time_5ms" UBYTE CM_u8_time_5ms 0 0 0 1275 ECU_ADDRESS 0x400024FD /end MEASUREMENT
/begin MEASUREMENT revlimit_approach_rate_divider "undefined1" UBYTE NO_COMPU_METHOD 0 0 0 255 ECU_ADDRESS 0x400024FE /end MEASUREMENT
/begin MEASUREMENT revlimit_flow_base "Revlimit flow base. Log to confirm where and how the rev limiter intervenes. (mg/s; raw*10)" UWORD CM_u16_flow_10mg_s 0 0 0 655350 ECU_ADDRESS 0x40002500 /end MEASUREMENT
/begin MEASUREMENT revlimit_rpm_error_prev "u16_rspeed_rpm" UWORD CM_u8_rspeed_rpm 0 0 0 65535 ECU_ADDRESS 0x40002502 /end MEASUREMENT
/begin MEASUREMENT revlimit_i_term_step "undefined2" UWORD NO_COMPU_METHOD 0 0 0 65535 ECU_ADDRESS 0x40002504 /end MEASUREMENT
/begin MEASUREMENT speed_limit_rpm_ceiling "RPM speed estimated clipped tomax. Log RPM -- the key reference axis for nearly every other channel. (RPM)" UWORD CM_u8_rspeed_rpm 0 0 0 65535 ECU_ADDRESS 0x40002506 /end MEASUREMENT
/begin MEASUREMENT revlimit_gear_offset "Revlimit compensation gear. Log to confirm where and how the rev limiter intervenes. (RPM; raw*2)" UBYTE CM_u8_rspeed_2rpm 0 0 0 510 ECU_ADDRESS 0x40002508 /end MEASUREMENT
/begin MEASUREMENT revlimit_time_above_soft "Revlimit time above soft. Log to confirm where and how the rev limiter intervenes. (ms; raw*5)" UWORD CM_u8_time_5ms 0 0 0 327675 ECU_ADDRESS 0x4000250A /end MEASUREMENT
/begin MEASUREMENT rev_limit_max_maf_by_gear "u8_flow_2g/s" UBYTE CM_u8_flow_2g_s 0 0 0 510 ECU_ADDRESS 0x4000250C /end MEASUREMENT
/begin MEASUREMENT revlimit_speed_limit_mode_max "Revlimit max. Log to confirm where and how the rev limiter intervenes. (RPM)" UWORD CM_u8_rspeed_rpm 0 0 0 65535 ECU_ADDRESS 0x4000250E /end MEASUREMENT
/begin MEASUREMENT speed_limit_equiv_rpm "Estimated engine speed. Log to compare against measured RPM. (RPM)" UWORD CM_u8_rspeed_rpm 0 0 0 65535 ECU_ADDRESS 0x40002510 /end MEASUREMENT
/begin MEASUREMENT revlimit_entry_gear_ips "enum_t6e_gear" UBYTE NO_COMPU_METHOD 0 0 0 255 ECU_ADDRESS 0x40002512 /end MEASUREMENT
/begin MEASUREMENT tcu_can_status_flags "undefined2" UWORD NO_COMPU_METHOD 0 0 0 65535 ECU_ADDRESS 0x4000251E /end MEASUREMENT
/begin MEASUREMENT abs_esp_can_torque_request_flags "undefined2" UWORD NO_COMPU_METHOD 0 0 0 65535 ECU_ADDRESS 0x40002520 /end MEASUREMENT
/begin MEASUREMENT can_b7_failure_counter "undefined1" UBYTE NO_COMPU_METHOD 0 0 0 255 ECU_ADDRESS 0x40002527 /end MEASUREMENT
/begin MEASUREMENT slip_power_index "undefined2" UWORD NO_COMPU_METHOD 0 0 0 65535 ECU_ADDRESS 0x40002548 /end MEASUREMENT
/begin MEASUREMENT slip_advisory_inhibit_margin "undefined1" UBYTE NO_COMPU_METHOD 0 0 0 255 ECU_ADDRESS 0x4000254A /end MEASUREMENT
/begin MEASUREMENT slip_power_based_rpm_limit "undefined2" UWORD NO_COMPU_METHOD 0 0 0 65535 ECU_ADDRESS 0x4000254C /end MEASUREMENT
/begin MEASUREMENT slip_threshold_maf_offset "undefined2" UWORD NO_COMPU_METHOD 0 0 0 65535 ECU_ADDRESS 0x4000254E /end MEASUREMENT
/begin MEASUREMENT gsi_max_usable_gear "enum_t6e_gear" UBYTE NO_COMPU_METHOD 0 0 0 255 ECU_ADDRESS 0x40002550 /end MEASUREMENT
/begin MEASUREMENT gsi_max_gear_at_power "undefined1" UBYTE NO_COMPU_METHOD 0 0 0 255 ECU_ADDRESS 0x40002551 /end MEASUREMENT
/begin MEASUREMENT gsi_driven_off_latch "bool" UBYTE NO_COMPU_METHOD 0 0 0 255 ECU_ADDRESS 0x40002552 /end MEASUREMENT
/begin MEASUREMENT steering_angle_deadband_ref "u16_angle_1/10deg" UWORD CM_u16_angle_1_10deg 0 0 0 6553.5 ECU_ADDRESS 0x40002554 /end MEASUREMENT
/begin MEASUREMENT steering_excess_ema_state "undefined4" ULONG NO_COMPU_METHOD 0 0 0 4294967295 ECU_ADDRESS 0x40002558 /end MEASUREMENT
/begin MEASUREMENT steering_angle_excess_raw "u16_angle_1/10deg" UWORD CM_u16_angle_1_10deg 0 0 0 6553.5 ECU_ADDRESS 0x4000255C /end MEASUREMENT
/begin MEASUREMENT steering_angle_excess_filtered "u8_angle_1/10deg" UBYTE CM_u16_angle_1_10deg 0 0 0 25.5 ECU_ADDRESS 0x4000255E /end MEASUREMENT
/begin MEASUREMENT slip_gear_change_holdoff_timer "undefined1" UBYTE NO_COMPU_METHOD 0 0 0 255 ECU_ADDRESS 0x4000255F /end MEASUREMENT
/begin MEASUREMENT accel_pedal_applied_timer "Accelerator pedal applied timer. Timer/counter -- log to measure how long a condition persists. (ms; raw*100)" UBYTE CM_u8_time_100ms 0 0 0 25500 ECU_ADDRESS 0x40002560 /end MEASUREMENT
/begin MEASUREMENT gsi_downshift_advisory_timer "undefined1" UBYTE NO_COMPU_METHOD 0 0 0 255 ECU_ADDRESS 0x40002561 /end MEASUREMENT
/begin MEASUREMENT gsi_upshift_advisory_timer "undefined1" UBYTE NO_COMPU_METHOD 0 0 0 255 ECU_ADDRESS 0x40002562 /end MEASUREMENT
/begin MEASUREMENT gsi_displayed_gear "Slip engaged gear IPS. Log to see wheel slip and traction-control intervention." UBYTE NO_COMPU_METHOD 0 0 0 255 ECU_ADDRESS 0x4000256A /end MEASUREMENT
/begin MEASUREMENT gsi_suggested_gear "Slip output suggested gear. Log to see wheel slip and traction-control intervention." UBYTE NO_COMPU_METHOD 0 0 0 255 ECU_ADDRESS 0x4000256B /end MEASUREMENT
/begin MEASUREMENT gear_advisory_state "undefined1" UBYTE NO_COMPU_METHOD 0 0 0 255 ECU_ADDRESS 0x4000256C /end MEASUREMENT
/begin MEASUREMENT ADC_TSCR "undefined4" ULONG NO_COMPU_METHOD 0 0 0 4294967295 ECU_ADDRESS 0x40002990 /end MEASUREMENT
/begin MEASUREMENT ADC_TBCR "undefined4" ULONG NO_COMPU_METHOD 0 0 0 4294967295 ECU_ADDRESS 0x40002994 /end MEASUREMENT
/begin MEASUREMENT ADC0_CR "undefined4" ULONG NO_COMPU_METHOD 0 0 0 4294967295 ECU_ADDRESS 0x40002998 /end MEASUREMENT
/begin MEASUREMENT ADC_TSCR_4000299C "undefined4" ULONG NO_COMPU_METHOD 0 0 0 4294967295 ECU_ADDRESS 0x4000299C /end MEASUREMENT
/begin MEASUREMENT ADC_TBCR_400029A0 "undefined4" ULONG NO_COMPU_METHOD 0 0 0 4294967295 ECU_ADDRESS 0x400029A0 /end MEASUREMENT
/begin MEASUREMENT ADC1_CR "undefined4" ULONG NO_COMPU_METHOD 0 0 0 4294967295 ECU_ADDRESS 0x400029A4 /end MEASUREMENT
/begin MEASUREMENT etpu_elapsed_time "uint32_t" ULONG NO_COMPU_METHOD 0 0 0 4294967295 ECU_ADDRESS 0x40002B54 /end MEASUREMENT
/begin MEASUREMENT timer_main_start1 "undefined4" ULONG NO_COMPU_METHOD 0 0 0 4294967295 ECU_ADDRESS 0x40002B58 /end MEASUREMENT
/begin MEASUREMENT timer_main3 "undefined4" ULONG NO_COMPU_METHOD 0 0 0 4294967295 ECU_ADDRESS 0x40002B5C /end MEASUREMENT
/begin MEASUREMENT loop_duration_main_ticks_unknown2 "undefined4" ULONG NO_COMPU_METHOD 0 0 0 4294967295 ECU_ADDRESS 0x40002B60 /end MEASUREMENT
/begin MEASUREMENT loop_duration_main_ticks_unknown "undefined4" ULONG NO_COMPU_METHOD 0 0 0 4294967295 ECU_ADDRESS 0x40002B64 /end MEASUREMENT
/begin MEASUREMENT timer_main_start1_40002B68 "undefined4" ULONG NO_COMPU_METHOD 0 0 0 4294967295 ECU_ADDRESS 0x40002B68 /end MEASUREMENT
/begin MEASUREMENT timer_main_start2_40002B6C "undefined4" ULONG NO_COMPU_METHOD 0 0 0 4294967295 ECU_ADDRESS 0x40002B6C /end MEASUREMENT
/begin MEASUREMENT loop_duration_main_pretask_ticks "undefined4" ULONG NO_COMPU_METHOD 0 0 0 4294967295 ECU_ADDRESS 0x40002B70 /end MEASUREMENT
/begin MEASUREMENT loop_duration_main_pretask_ticks_max "undefined4" ULONG NO_COMPU_METHOD 0 0 0 4294967295 ECU_ADDRESS 0x40002B74 /end MEASUREMENT
/begin MEASUREMENT etb_driver_spi_diag "undefined1" UBYTE NO_COMPU_METHOD 0 0 0 255 ECU_ADDRESS 0x40002C89 /end MEASUREMENT
/begin MEASUREMENT ign_torque_margin_cyl1 "i16_angle_1/4deg" SWORD CM_u8_angle_1_4deg 0 0 -8192 8191.75 ECU_ADDRESS 0x40002CC6 /end MEASUREMENT
/begin MEASUREMENT ign_torque_margin_cyl2 "i16_angle_1/4deg" SWORD CM_u8_angle_1_4deg 0 0 -8192 8191.75 ECU_ADDRESS 0x40002CC8 /end MEASUREMENT
/begin MEASUREMENT ign_torque_margin_cyl3 "i16_angle_1/4deg" SWORD CM_u8_angle_1_4deg 0 0 -8192 8191.75 ECU_ADDRESS 0x40002CCA /end MEASUREMENT
/begin MEASUREMENT ign_torque_margin_cyl4 "i16_angle_1/4deg" SWORD CM_u8_angle_1_4deg 0 0 -8192 8191.75 ECU_ADDRESS 0x40002CCC /end MEASUREMENT
/begin MEASUREMENT ign_torque_margin_cyl5 "i16_angle_1/4deg" SWORD CM_u8_angle_1_4deg 0 0 -8192 8191.75 ECU_ADDRESS 0x40002CCE /end MEASUREMENT
/begin MEASUREMENT LEA_inj_fuel_learn_zone_2_bank1 "u8_percent_100/256-50" UBYTE CM_u8_percent_100_256_50 0 0 -50 49.609375 ECU_ADDRESS 0x40002FA0 /end MEASUREMENT
/begin MEASUREMENT LEA_inj_fuel_learn_zone_3_bank1 "u8_percent_100/256-50" UBYTE CM_u8_percent_100_256_50 0 0 -50 49.609375 ECU_ADDRESS 0x40002FA1 /end MEASUREMENT
/begin MEASUREMENT LEA_inj_fuel_learn_zone_2_bank2 "Fuel learn zone 2 bank2. Log to follow fuel delivery and mixture control." UBYTE CM_u8_percent_100_256_50 0 0 -50 49.609375 ECU_ADDRESS 0x40002FA2 /end MEASUREMENT
/begin MEASUREMENT LEA_inj_fuel_learn_zone_3_bank2 "u8_percent_100/256-50" UBYTE CM_u8_percent_100_256_50 0 0 -50 49.609375 ECU_ADDRESS 0x40002FA3 /end MEASUREMENT
/begin MEASUREMENT LEA_inj_offset_learn_off_idle_bank1 "i16_time_us" SWORD CM_u8_time_us 0 0 -32768 32767 ECU_ADDRESS 0x40002FB0 /end MEASUREMENT
/begin MEASUREMENT LEA_inj_offset_learn_off_idle_bank2 "Learned value: fuel learn lean time bank2. A value the ECU learns over time -- log it to track adaptation and spot a developing fault. (us)" SWORD CM_u8_time_us 0 0 -32768 32767 ECU_ADDRESS 0x40002FB2 /end MEASUREMENT
/begin MEASUREMENT LEA_obd_ii_idle_learn "Idle learn. Log to diagnose idle quality, hunting, and stalls." SWORD CM_i16_flow_100_1024mg_s 0 0 -3200 3199.90234375 ECU_ADDRESS 0x400032B4 /end MEASUREMENT
/begin MEASUREMENT LEA_idle_learn_ac_on "u16_flow_mg/s" UWORD CM_u16_flow_mg_s 0 0 0 65535 ECU_ADDRESS 0x400032B6 /end MEASUREMENT
/begin MEASUREMENT LEA_inj_offset_learn_idle_bank1 "i16_time_us" SWORD CM_u8_time_us 0 0 -32768 32767 ECU_ADDRESS 0x400036C0 /end MEASUREMENT
/begin MEASUREMENT LEA_inj_offset_learn_idle_bank2 "Learned value: fuel learn unknown bank2. A value the ECU learns over time -- log it to track adaptation and spot a developing fault. (us)" SWORD CM_u8_time_us 0 0 -32768 32767 ECU_ADDRESS 0x400036C2 /end MEASUREMENT
/begin MEASUREMENT LEA_idle_cold_learning_coolant "i16_flow_100/1024mg/s" SWORD CM_i16_flow_100_1024mg_s 0 0 -3200 3199.90234375 ECU_ADDRESS 0x400036C4 /end MEASUREMENT
/begin MEASUREMENT LEA_idle_cold_learning_coolant_ac_on "u16_flow_mg/s" UWORD CM_u16_flow_mg_s 0 0 0 65535 ECU_ADDRESS 0x400036C6 /end MEASUREMENT
/begin MEASUREMENT LEA_time_at_tps "Time at tps1. Runtime state -- log to observe this behavior." ULONG NO_COMPU_METHOD 0 0 0 4294967295 ECU_ADDRESS 0x400039C8 /end MEASUREMENT
/begin MEASUREMENT LEA_time_at_tps2 "Time at tps2. Runtime state -- log to observe this behavior." ULONG NO_COMPU_METHOD 0 0 0 4294967295 ECU_ADDRESS 0x400039CC /end MEASUREMENT
/begin MEASUREMENT LEA_time_at_tps3 "Time at tps3. Runtime state -- log to observe this behavior." ULONG NO_COMPU_METHOD 0 0 0 4294967295 ECU_ADDRESS 0x400039D0 /end MEASUREMENT
/begin MEASUREMENT LEA_time_at_tps4 "Time at tps4. Runtime state -- log to observe this behavior." ULONG NO_COMPU_METHOD 0 0 0 4294967295 ECU_ADDRESS 0x400039D4 /end MEASUREMENT
/begin MEASUREMENT LEA_time_at_rpm "Time at rpm1. Runtime state -- log to observe this behavior." ULONG NO_COMPU_METHOD 0 0 0 4294967295 ECU_ADDRESS 0x400039E8 /end MEASUREMENT
/begin MEASUREMENT LEA_time_at_rpm7 "Time at rpm7. Runtime state -- log to observe this behavior." ULONG NO_COMPU_METHOD 0 0 0 4294967295 ECU_ADDRESS 0x40003A00 /end MEASUREMENT
/begin MEASUREMENT LEA_time_at_kmh1 "Time at kmh1. Runtime state -- log to observe this behavior." ULONG NO_COMPU_METHOD 0 0 0 4294967295 ECU_ADDRESS 0x40003A04 /end MEASUREMENT
/begin MEASUREMENT LEA_time_at_speed "uint32_t" ULONG NO_COMPU_METHOD 0 0 0 4294967295 ECU_ADDRESS 0x40003A08 /end MEASUREMENT
/begin MEASUREMENT LEA_time_at_temp "uint32_t" ULONG NO_COMPU_METHOD 0 0 0 4294967295 ECU_ADDRESS 0x40003A28 /end MEASUREMENT
/begin MEASUREMENT LEA_engine_run_timer_total "Engine run timer total. Log to follow core engine state." ULONG NO_COMPU_METHOD 0 0 0 4294967295 ECU_ADDRESS 0x40003A38 /end MEASUREMENT
/begin MEASUREMENT LEA_perf_stat_sentinel_max1 "uchar" UBYTE NO_COMPU_METHOD 0 0 0 255 ECU_ADDRESS 0x40003A3C /end MEASUREMENT
/begin MEASUREMENT LEA_perf_stat_sentinel_max2 "uchar" UBYTE NO_COMPU_METHOD 0 0 0 255 ECU_ADDRESS 0x40003A3D /end MEASUREMENT
/begin MEASUREMENT LEA_obd_ii_last_standing_start_0_100kmh "uint8_t" UBYTE NO_COMPU_METHOD 0 0 0 255 ECU_ADDRESS 0x40003A3E /end MEASUREMENT
/begin MEASUREMENT LEA_obd_ii_last_standing_start_0_160kmh "uint8_t" UBYTE NO_COMPU_METHOD 0 0 0 255 ECU_ADDRESS 0x40003A3F /end MEASUREMENT
/begin MEASUREMENT LEA_number_standing_starts "Number standing starts. Runtime state -- log to observe this behavior." UWORD NO_COMPU_METHOD 0 0 0 65535 ECU_ADDRESS 0x40003A40 /end MEASUREMENT
/begin MEASUREMENT LEA_obd_ii_max_vehicle_speed "Max vehicle speed. Runtime state -- log to observe this behavior." UWORD NO_COMPU_METHOD 0 0 0 65535 ECU_ADDRESS 0x40003A42 /end MEASUREMENT
/begin MEASUREMENT LEA_perf_stat_gear1_hi "u16_rspeed_rpm" UWORD CM_u8_rspeed_rpm 0 0 0 65535 ECU_ADDRESS 0x40003A4C /end MEASUREMENT
/begin MEASUREMENT LEA_perf_stat_gear1_lo "u8_temp_5/8-40c" UBYTE CM_u8_temp_5_8_40c 0 0 -40 119.375 ECU_ADDRESS 0x40003A4E /end MEASUREMENT
/begin MEASUREMENT LEA_perf_stat_gear1_val "u32_time_5ms" ULONG CM_u8_time_5ms 0 0 0 21474836475 ECU_ADDRESS 0x40003A50 /end MEASUREMENT
/begin MEASUREMENT LEA_perf_stat_gear2_hi "u16_rspeed_rpm" UWORD CM_u8_rspeed_rpm 0 0 0 65535 ECU_ADDRESS 0x40003A54 /end MEASUREMENT
/begin MEASUREMENT LEA_perf_stat_gear2_lo "u8_temp_5/8-40c" UBYTE CM_u8_temp_5_8_40c 0 0 -40 119.375 ECU_ADDRESS 0x40003A56 /end MEASUREMENT
/begin MEASUREMENT LEA_perf_stat_gear2_val "u32_time_5ms" ULONG CM_u8_time_5ms 0 0 0 21474836475 ECU_ADDRESS 0x40003A58 /end MEASUREMENT
/begin MEASUREMENT LEA_perf_stat_gear3_hi "u16_rspeed_rpm" UWORD CM_u8_rspeed_rpm 0 0 0 65535 ECU_ADDRESS 0x40003A5C /end MEASUREMENT
/begin MEASUREMENT LEA_perf_stat_gear3_lo "u8_temp_5/8-40c" UBYTE CM_u8_temp_5_8_40c 0 0 -40 119.375 ECU_ADDRESS 0x40003A5E /end MEASUREMENT
/begin MEASUREMENT LEA_perf_stat_gear3_val "u32_time_5ms" ULONG CM_u8_time_5ms 0 0 0 21474836475 ECU_ADDRESS 0x40003A60 /end MEASUREMENT
/begin MEASUREMENT LEA_perf_stat_gear4_hi "u16_rspeed_rpm" UWORD CM_u8_rspeed_rpm 0 0 0 65535 ECU_ADDRESS 0x40003A64 /end MEASUREMENT
/begin MEASUREMENT LEA_perf_stat_gear4_lo "u8_temp_5/8-40c" UBYTE CM_u8_temp_5_8_40c 0 0 -40 119.375 ECU_ADDRESS 0x40003A66 /end MEASUREMENT
/begin MEASUREMENT LEA_perf_stat_gear4_val "u32_time_5ms" ULONG CM_u8_time_5ms 0 0 0 21474836475 ECU_ADDRESS 0x40003A68 /end MEASUREMENT
/begin MEASUREMENT LEA_perf_stat_gear5_hi "u16_rspeed_rpm" UWORD CM_u8_rspeed_rpm 0 0 0 65535 ECU_ADDRESS 0x40003A6C /end MEASUREMENT
/begin MEASUREMENT LEA_perf_stat_gear5_lo "u8_temp_5/8-40c" UBYTE CM_u8_temp_5_8_40c 0 0 -40 119.375 ECU_ADDRESS 0x40003A6E /end MEASUREMENT
/begin MEASUREMENT LEA_perf_stat_gear5_val "u32_time_5ms" ULONG CM_u8_time_5ms 0 0 0 21474836475 ECU_ADDRESS 0x40003A70 /end MEASUREMENT
/begin MEASUREMENT LEA_tps_fault_ff_engine_runtime "u32_time_5ms" ULONG CM_u8_time_5ms 0 0 0 21474836475 ECU_ADDRESS 0x40003A74 /end MEASUREMENT
/begin MEASUREMENT LEA_perf_stat_extra2 "ushort" UWORD NO_COMPU_METHOD 0 0 0 65535 ECU_ADDRESS 0x40003A78 /end MEASUREMENT
/begin MEASUREMENT LEA_tps_fault_ff_ecu_runtime "ushort" UWORD NO_COMPU_METHOD 0 0 0 65535 ECU_ADDRESS 0x40003B7C /end MEASUREMENT
/begin MEASUREMENT LEA_tps_fault_ff_ecu_voltage "u16_voltage_18/1023v" UWORD CM_u16_voltage_18_1023v 0 0 0 1153.10850439883 ECU_ADDRESS 0x40003B7E /end MEASUREMENT
/begin MEASUREMENT LEA_tps_fault_ff_adc_ch3 "uint16_t" UWORD NO_COMPU_METHOD 0 0 0 65535 ECU_ADDRESS 0x40003B80 /end MEASUREMENT
/begin MEASUREMENT LEA_tps_calib_retry_count "uint16_t" UWORD NO_COMPU_METHOD 0 0 0 65535 ECU_ADDRESS 0x40003B82 /end MEASUREMENT
/begin MEASUREMENT LEA_tps_fault_event_count "uint16_t" UWORD NO_COMPU_METHOD 0 0 0 65535 ECU_ADDRESS 0x40003B84 /end MEASUREMENT
/begin MEASUREMENT LEA_tps_fault_recovery_count "uint16_t" UWORD NO_COMPU_METHOD 0 0 0 65535 ECU_ADDRESS 0x40003B86 /end MEASUREMENT
/begin MEASUREMENT LEA_tps_fault_count "TPS fault captures (is_fault), saturates 0xFFFF; index into LEA_tps_fault_event_index[32]" UWORD NO_COMPU_METHOD 0 0 0 65535 ECU_ADDRESS 0x40003B88 /end MEASUREMENT
/begin MEASUREMENT LEA_tps_calib_pass_first_attempt "uint16_t" UWORD NO_COMPU_METHOD 0 0 0 65535 ECU_ADDRESS 0x40003B8A /end MEASUREMENT
/begin MEASUREMENT LEA_tps_calib_pass_after_retry "non-fault captures with calib attempt count != 1 (pairs with LEA_tps_calib_pass_first_attempt)" UWORD NO_COMPU_METHOD 0 0 0 65535 ECU_ADDRESS 0x40003B8C /end MEASUREMENT
/begin MEASUREMENT LEA_tps_fault_ff_etb_duty_pct "freeze frame: ETB motor PWM duty % at fault (from DAT_400021ae)" UBYTE NO_COMPU_METHOD 0 0 0 255 ECU_ADDRESS 0x40003B8E /end MEASUREMENT
/begin MEASUREMENT LEA_tps_fault_log_count "filled entries (0-31) in LEA_tps_fault_log_track_a/b" UBYTE NO_COMPU_METHOD 0 0 0 255 ECU_ADDRESS 0x40003B8F /end MEASUREMENT
/begin MEASUREMENT LEA_num_low_oil_pressure_events "uint8_t" UBYTE NO_COMPU_METHOD 0 0 0 255 ECU_ADDRESS 0x40003B90 /end MEASUREMENT
/begin MEASUREMENT LEA_perf_monitor_0 "uint" ULONG NO_COMPU_METHOD 0 0 0 4294967295 ECU_ADDRESS 0x40003B94 /end MEASUREMENT
/begin MEASUREMENT LEA_perf_monitor_1 "uint" ULONG NO_COMPU_METHOD 0 0 0 4294967295 ECU_ADDRESS 0x40003B98 /end MEASUREMENT
/begin MEASUREMENT LEA_perf_monitor_2 "uint" ULONG NO_COMPU_METHOD 0 0 0 4294967295 ECU_ADDRESS 0x40003B9C /end MEASUREMENT
/begin MEASUREMENT LEA_perf_monitor_3 "uint" ULONG NO_COMPU_METHOD 0 0 0 4294967295 ECU_ADDRESS 0x40003BA0 /end MEASUREMENT
/begin MEASUREMENT LEA_perf_monitor_4 "uint" ULONG NO_COMPU_METHOD 0 0 0 4294967295 ECU_ADDRESS 0x40003BA4 /end MEASUREMENT
/begin MEASUREMENT LEA_perf_monitor_5 "Lifetime distance accumulator (odometer-style)." ULONG NO_COMPU_METHOD 0 0 0 4294967295 ECU_ADDRESS 0x40003BA8 /end MEASUREMENT
/begin MEASUREMENT LEA_perf_struct_A_byte0 "uchar" UBYTE NO_COMPU_METHOD 0 0 0 255 ECU_ADDRESS 0x40003BAC /end MEASUREMENT
/begin MEASUREMENT LEA_perf_struct_A_byte1 "u8_speed_kph" UBYTE CM_u8_speed_kph 0 0 0 255 ECU_ADDRESS 0x40003BAD /end MEASUREMENT
/begin MEASUREMENT LEA_perf_struct_A_word0 "u16_rspeed_rpm" UWORD CM_u8_rspeed_rpm 0 0 0 65535 ECU_ADDRESS 0x40003BAE /end MEASUREMENT
/begin MEASUREMENT LEA_perf_struct_A_word1 "ushort" UWORD NO_COMPU_METHOD 0 0 0 65535 ECU_ADDRESS 0x40003BB0 /end MEASUREMENT
/begin MEASUREMENT LEA_perf_struct_A_dword "u32_time_5ms" ULONG CM_u8_time_5ms 0 0 0 21474836475 ECU_ADDRESS 0x40003BB4 /end MEASUREMENT
/begin MEASUREMENT LEA_perf_struct_B_byte0 "uchar" UBYTE NO_COMPU_METHOD 0 0 0 255 ECU_ADDRESS 0x40003BB8 /end MEASUREMENT
/begin MEASUREMENT LEA_perf_struct_B_byte1 "u8_speed_kph" UBYTE CM_u8_speed_kph 0 0 0 255 ECU_ADDRESS 0x40003BB9 /end MEASUREMENT
/begin MEASUREMENT LEA_perf_struct_B_word0 "u16_rspeed_rpm" UWORD CM_u8_rspeed_rpm 0 0 0 65535 ECU_ADDRESS 0x40003BBA /end MEASUREMENT
/begin MEASUREMENT LEA_perf_struct_B_word1 "ushort" UWORD NO_COMPU_METHOD 0 0 0 65535 ECU_ADDRESS 0x40003BBC /end MEASUREMENT
/begin MEASUREMENT LEA_perf_struct_B_dword "u32_time_5ms" ULONG CM_u8_time_5ms 0 0 0 21474836475 ECU_ADDRESS 0x40003BC0 /end MEASUREMENT
/begin MEASUREMENT LEA_perf_struct_C_byte0 "uchar" UBYTE NO_COMPU_METHOD 0 0 0 255 ECU_ADDRESS 0x40003BC4 /end MEASUREMENT
/begin MEASUREMENT LEA_perf_struct_C_byte1 "u8_speed_kph" UBYTE CM_u8_speed_kph 0 0 0 255 ECU_ADDRESS 0x40003BC5 /end MEASUREMENT
/begin MEASUREMENT LEA_perf_struct_C_word0 "u16_rspeed_rpm" UWORD CM_u8_rspeed_rpm 0 0 0 65535 ECU_ADDRESS 0x40003BC6 /end MEASUREMENT
/begin MEASUREMENT LEA_perf_struct_C_word1 "ushort" UWORD NO_COMPU_METHOD 0 0 0 65535 ECU_ADDRESS 0x40003BC8 /end MEASUREMENT
/begin MEASUREMENT LEA_perf_struct_C_dword "u32_time_5ms" ULONG CM_u8_time_5ms 0 0 0 21474836475 ECU_ADDRESS 0x40003BCC /end MEASUREMENT
/begin MEASUREMENT LEA_perf_struct_A_b_byte0 "uchar" UBYTE NO_COMPU_METHOD 0 0 0 255 ECU_ADDRESS 0x40003BD0 /end MEASUREMENT
/begin MEASUREMENT LEA_perf_struct_A_b_byte1 "u8_speed_kph" UBYTE CM_u8_speed_kph 0 0 0 255 ECU_ADDRESS 0x40003BD1 /end MEASUREMENT
/begin MEASUREMENT LEA_perf_struct_A_b_word0 "u16_rspeed_rpm" UWORD CM_u8_rspeed_rpm 0 0 0 65535 ECU_ADDRESS 0x40003BD2 /end MEASUREMENT
/begin MEASUREMENT LEA_perf_struct_A_b_word1 "ushort" UWORD NO_COMPU_METHOD 0 0 0 65535 ECU_ADDRESS 0x40003BD4 /end MEASUREMENT
/begin MEASUREMENT LEA_perf_struct_A_b_dword "u32_time_5ms" ULONG CM_u8_time_5ms 0 0 0 21474836475 ECU_ADDRESS 0x40003BD8 /end MEASUREMENT
/begin MEASUREMENT LEA_perf_struct_B_b_byte0 "uchar" UBYTE NO_COMPU_METHOD 0 0 0 255 ECU_ADDRESS 0x40003BDC /end MEASUREMENT
/begin MEASUREMENT LEA_perf_struct_B_b_byte1 "u8_speed_kph" UBYTE CM_u8_speed_kph 0 0 0 255 ECU_ADDRESS 0x40003BDD /end MEASUREMENT
/begin MEASUREMENT LEA_perf_struct_B_b_word0 "u16_rspeed_rpm" UWORD CM_u8_rspeed_rpm 0 0 0 65535 ECU_ADDRESS 0x40003BDE /end MEASUREMENT
/begin MEASUREMENT LEA_perf_struct_B_b_word1 "ushort" UWORD NO_COMPU_METHOD 0 0 0 65535 ECU_ADDRESS 0x40003BE0 /end MEASUREMENT
/begin MEASUREMENT LEA_perf_struct_B_b_dword "u32_time_5ms" ULONG CM_u8_time_5ms 0 0 0 21474836475 ECU_ADDRESS 0x40003BE4 /end MEASUREMENT
/begin MEASUREMENT LEA_perf_struct_C_b_byte0 "uchar" UBYTE NO_COMPU_METHOD 0 0 0 255 ECU_ADDRESS 0x40003BE8 /end MEASUREMENT
/begin MEASUREMENT LEA_perf_struct_C_b_byte1 "u8_speed_kph" UBYTE CM_u8_speed_kph 0 0 0 255 ECU_ADDRESS 0x40003BE9 /end MEASUREMENT
/begin MEASUREMENT LEA_perf_struct_C_b_word0 "u16_rspeed_rpm" UWORD CM_u8_rspeed_rpm 0 0 0 65535 ECU_ADDRESS 0x40003BEA /end MEASUREMENT
/begin MEASUREMENT LEA_perf_struct_C_b_word1 "ushort" UWORD NO_COMPU_METHOD 0 0 0 65535 ECU_ADDRESS 0x40003BEC /end MEASUREMENT
/begin MEASUREMENT LEA_perf_struct_C_b_dword "u32_time_5ms" ULONG CM_u8_time_5ms 0 0 0 21474836475 ECU_ADDRESS 0x40003BF0 /end MEASUREMENT
/begin MEASUREMENT LEA_tps_both_sensors_invalid_count "uint16_t" UWORD NO_COMPU_METHOD 0 0 0 65535 ECU_ADDRESS 0x40003BF4 /end MEASUREMENT
/begin MEASUREMENT lea_cal_version_stamp "undefined2" UWORD NO_COMPU_METHOD 0 0 0 65535 ECU_ADDRESS 0x40004242 /end MEASUREMENT
/begin MEASUREMENT lea_base_size "undefined4" ULONG NO_COMPU_METHOD 0 0 0 4294967295 ECU_ADDRESS 0x40004244 /end MEASUREMENT
/begin MEASUREMENT LEA_crc_core "uint16_t" UWORD NO_COMPU_METHOD 0 0 0 65535 ECU_ADDRESS 0x40004248 /end MEASUREMENT
/begin MEASUREMENT LEA_obd_iumpr_ignition_cycle_counter "uint16_t" UWORD NO_COMPU_METHOD 0 0 0 65535 ECU_ADDRESS 0x40004298 /end MEASUREMENT
/begin MEASUREMENT LEA_obd_iumpr_conditions_encountered_counter "uint16_t" UWORD NO_COMPU_METHOD 0 0 0 65535 ECU_ADDRESS 0x4000429A /end MEASUREMENT
/begin MEASUREMENT LEA_obd_monitor_flag_A "u16_flow_mg/s" UWORD CM_u16_flow_mg_s 0 0 0 65535 ECU_ADDRESS 0x400042EC /end MEASUREMENT
/begin MEASUREMENT LEA_obd_monitor_flag_B "u16_flow_mg/s" UWORD CM_u16_flow_mg_s 0 0 0 65535 ECU_ADDRESS 0x400042EE /end MEASUREMENT
/begin MEASUREMENT LEA_obd_monitor_flag_C "ushort" UWORD NO_COMPU_METHOD 0 0 0 65535 ECU_ADDRESS 0x400042F0 /end MEASUREMENT
/begin MEASUREMENT LEA_obd_monitor_flag_D "u16_flow_mg/s" UWORD CM_u16_flow_mg_s 0 0 0 65535 ECU_ADDRESS 0x400042F2 /end MEASUREMENT
/begin MEASUREMENT LEA_obd_monitor_flag_E "u16_flow_mg/s" UWORD CM_u16_flow_mg_s 0 0 0 65535 ECU_ADDRESS 0x400042F4 /end MEASUREMENT
/begin MEASUREMENT LEA_obd_monitor_flag_F "u16_flow_mg/s" UWORD CM_u16_flow_mg_s 0 0 0 65535 ECU_ADDRESS 0x400042F6 /end MEASUREMENT
/begin MEASUREMENT LEA_obd_monitor_flag_G "ushort" UWORD NO_COMPU_METHOD 0 0 0 65535 ECU_ADDRESS 0x400042F8 /end MEASUREMENT
/begin MEASUREMENT LEA_obd_monitor_flag_H "i16_flow_100/1024mg/s" SWORD CM_i16_flow_100_1024mg_s 0 0 -3200 3199.90234375 ECU_ADDRESS 0x400042FA /end MEASUREMENT
/begin MEASUREMENT LEA_obd_monitor_sentinel "uchar" UBYTE NO_COMPU_METHOD 0 0 0 255 ECU_ADDRESS 0x400043C4 /end MEASUREMENT
/begin MEASUREMENT LEA_tps_track_a_closed_count "uint16_t" UWORD NO_COMPU_METHOD 0 0 0 65535 ECU_ADDRESS 0x400043C6 /end MEASUREMENT
/begin MEASUREMENT LEA_tps_track_b_closed_count "uint16_t" UWORD NO_COMPU_METHOD 0 0 0 65535 ECU_ADDRESS 0x400043C8 /end MEASUREMENT
/begin MEASUREMENT LEA_hc08_sf_mode_event_count "u8_count" UBYTE NO_COMPU_METHOD 0 0 0 255 ECU_ADDRESS 0x400043CE /end MEASUREMENT
/begin MEASUREMENT LEA_hc08_sf_mode_max_duration "uint16_t" UWORD NO_COMPU_METHOD 0 0 0 65535 ECU_ADDRESS 0x400043D0 /end MEASUREMENT
/begin MEASUREMENT LEA_cod_changed "Learned value: cod changed. A value the ECU learns over time -- log it to track adaptation and spot a developing fault." UBYTE NO_COMPU_METHOD 0 0 0 255 ECU_ADDRESS 0x400043D2 /end MEASUREMENT
/begin MEASUREMENT obd_ii_DTC_causing_FF "undefined2" UWORD NO_COMPU_METHOD 0 0 0 65535 ECU_ADDRESS 0x40004416 /end MEASUREMENT
/begin MEASUREMENT obd_FF_fuel_system_status "undefined2" UWORD NO_COMPU_METHOD 0 0 0 65535 ECU_ADDRESS 0x4000441A /end MEASUREMENT
/begin MEASUREMENT obd_FF_calc_engine_load "undefined1" UBYTE NO_COMPU_METHOD 0 0 0 255 ECU_ADDRESS 0x4000441C /end MEASUREMENT
/begin MEASUREMENT obd_FF_engine_coolant_temp_C "undefined1" UBYTE NO_COMPU_METHOD 0 0 0 255 ECU_ADDRESS 0x4000441D /end MEASUREMENT
/begin MEASUREMENT obd_FF_stft_bank1 "undefined1" UBYTE NO_COMPU_METHOD 0 0 0 255 ECU_ADDRESS 0x4000441E /end MEASUREMENT
/begin MEASUREMENT obd_FF_ltft_bank1 "undefined1" UBYTE NO_COMPU_METHOD 0 0 0 255 ECU_ADDRESS 0x4000441F /end MEASUREMENT
/begin MEASUREMENT obd_FF_stft_bank2 "undefined1" UBYTE NO_COMPU_METHOD 0 0 0 255 ECU_ADDRESS 0x40004420 /end MEASUREMENT
/begin MEASUREMENT obd_FF_ltft_bank2 "undefined1" UBYTE NO_COMPU_METHOD 0 0 0 255 ECU_ADDRESS 0x40004421 /end MEASUREMENT
/begin MEASUREMENT obd_FF_engine_speed "undefined2" UWORD NO_COMPU_METHOD 0 0 0 65535 ECU_ADDRESS 0x40004422 /end MEASUREMENT
/begin MEASUREMENT obd_FF_car_speed "undefined1" UBYTE NO_COMPU_METHOD 0 0 0 255 ECU_ADDRESS 0x40004424 /end MEASUREMENT
/begin MEASUREMENT obd_FF_ign_advance "undefined1" UBYTE NO_COMPU_METHOD 0 0 0 255 ECU_ADDRESS 0x40004425 /end MEASUREMENT
/begin MEASUREMENT obd_FF_iat "undefined1" UBYTE NO_COMPU_METHOD 0 0 0 255 ECU_ADDRESS 0x40004426 /end MEASUREMENT
/begin MEASUREMENT obd_FF_maf_flow_1 "undefined2" UWORD NO_COMPU_METHOD 0 0 0 65535 ECU_ADDRESS 0x40004428 /end MEASUREMENT
/begin MEASUREMENT obd_FF_tps_x4 "undefined1" UBYTE NO_COMPU_METHOD 0 0 0 255 ECU_ADDRESS 0x4000442A /end MEASUREMENT
/begin MEASUREMENT obd_FF_runtime_since_start "undefined2" UWORD NO_COMPU_METHOD 0 0 0 65535 ECU_ADDRESS 0x4000442C /end MEASUREMENT
/begin MEASUREMENT obd_ff_commanded_evap_purge "undefined1" UBYTE NO_COMPU_METHOD 0 0 0 255 ECU_ADDRESS 0x4000442E /end MEASUREMENT
/begin MEASUREMENT obd_FF_fuel_level "undefined1" UBYTE NO_COMPU_METHOD 0 0 0 255 ECU_ADDRESS 0x4000442F /end MEASUREMENT
/begin MEASUREMENT obd_FF_atmo_pressure "undefined1" UBYTE NO_COMPU_METHOD 0 0 0 255 ECU_ADDRESS 0x40004430 /end MEASUREMENT
/begin MEASUREMENT obd_FF_ecu_voltage "undefined2" UWORD NO_COMPU_METHOD 0 0 0 65535 ECU_ADDRESS 0x40004432 /end MEASUREMENT
/begin MEASUREMENT obd_FF_load_abs_percentage "undefined2" UWORD NO_COMPU_METHOD 0 0 0 65535 ECU_ADDRESS 0x40004434 /end MEASUREMENT
/begin MEASUREMENT obd_FF_afr_commanded "undefined2" UWORD NO_COMPU_METHOD 0 0 0 65535 ECU_ADDRESS 0x40004436 /end MEASUREMENT
/begin MEASUREMENT obd_FF_tps_relative "undefined1" UBYTE NO_COMPU_METHOD 0 0 0 255 ECU_ADDRESS 0x40004438 /end MEASUREMENT
/begin MEASUREMENT obd_FF_tps_pos_b "undefined1" UBYTE NO_COMPU_METHOD 0 0 0 255 ECU_ADDRESS 0x40004439 /end MEASUREMENT
/begin MEASUREMENT obd_FF_pps_d "undefined1" UBYTE NO_COMPU_METHOD 0 0 0 255 ECU_ADDRESS 0x4000443A /end MEASUREMENT
/begin MEASUREMENT obd_FF_pps_e "undefined1" UBYTE NO_COMPU_METHOD 0 0 0 255 ECU_ADDRESS 0x4000443B /end MEASUREMENT
/begin MEASUREMENT obd_FF_throttle_target_pos "undefined1" UBYTE NO_COMPU_METHOD 0 0 0 255 ECU_ADDRESS 0x4000443C /end MEASUREMENT
/begin MEASUREMENT obd_engine_tests_completeness "undefined1" UBYTE NO_COMPU_METHOD 0 0 0 255 ECU_ADDRESS 0x4000446D /end MEASUREMENT
/begin MEASUREMENT obd_ii_car_speed_freeze_frame "undefined2" UWORD NO_COMPU_METHOD 0 0 0 65535 ECU_ADDRESS 0x40004470 /end MEASUREMENT
/begin MEASUREMENT obd_ii_maf_flow_freeze_frame "undefined2" UWORD NO_COMPU_METHOD 0 0 0 65535 ECU_ADDRESS 0x40004472 /end MEASUREMENT
/begin MEASUREMENT obd_ii_car_speed_FF__ "undefined1" UBYTE NO_COMPU_METHOD 0 0 0 255 ECU_ADDRESS 0x40004490 /end MEASUREMENT
/begin MEASUREMENT obd_ii_distance_traveled_with_MIL "u32_distance_10cm" ULONG CM_u32_distance_10cm 0 0 0 42949672950 ECU_ADDRESS 0x40004494 /end MEASUREMENT
/begin MEASUREMENT warmups_since_code_cleared "u8_count" UBYTE NO_COMPU_METHOD 0 0 0 255 ECU_ADDRESS 0x40004498 /end MEASUREMENT
/begin MEASUREMENT distance_since_codes_cleared_km "uint16_t" UWORD NO_COMPU_METHOD 0 0 0 65535 ECU_ADDRESS 0x4000449A /end MEASUREMENT
/begin MEASUREMENT LEA_obd_monitor_counter "ushort" UWORD NO_COMPU_METHOD 0 0 0 65535 ECU_ADDRESS 0x400044CA /end MEASUREMENT
/begin MEASUREMENT lea_misfire_baseline_set "undefined1" UBYTE NO_COMPU_METHOD 0 0 0 255 ECU_ADDRESS 0x400044E4 /end MEASUREMENT
/begin MEASUREMENT LEA_obd_ii_P0011_flags "Stored monitor/maturation state for P0011 (intake cam (VVT) bank1 over-advanced). Log it to catch this fault maturing during a drive." UBYTE NO_COMPU_METHOD 0 0 0 255 ECU_ADDRESS 0x40004512 /end MEASUREMENT
/begin MEASUREMENT LEA_obd_ii_P0011_fail_counter "uint8_t" UBYTE NO_COMPU_METHOD 0 0 0 255 ECU_ADDRESS 0x40004513 /end MEASUREMENT
/begin MEASUREMENT LEA_obd_ii_P0011_pass_counter "uint8_t" UBYTE NO_COMPU_METHOD 0 0 0 255 ECU_ADDRESS 0x40004514 /end MEASUREMENT
/begin MEASUREMENT LEA_obd_ii_P0012_flags "Stored monitor/maturation state for P0012 (intake cam bank1 retarded). Log it to catch this fault maturing during a drive." UBYTE NO_COMPU_METHOD 0 0 0 255 ECU_ADDRESS 0x40004515 /end MEASUREMENT
/begin MEASUREMENT LEA_obd_ii_P0012_fail_counter "uint8_t" UBYTE NO_COMPU_METHOD 0 0 0 255 ECU_ADDRESS 0x40004516 /end MEASUREMENT
/begin MEASUREMENT LEA_obd_ii_P0012_pass_counter "uint8_t" UBYTE NO_COMPU_METHOD 0 0 0 255 ECU_ADDRESS 0x40004517 /end MEASUREMENT
/begin MEASUREMENT LEA_obd_ii_P0021_flags "Stored monitor/maturation state for P0021 (intake cam bank2 over-advanced). Log it to catch this fault maturing during a drive." UBYTE NO_COMPU_METHOD 0 0 0 255 ECU_ADDRESS 0x40004518 /end MEASUREMENT
/begin MEASUREMENT LEA_obd_ii_P0021_fail_counter "uint8_t" UBYTE NO_COMPU_METHOD 0 0 0 255 ECU_ADDRESS 0x40004519 /end MEASUREMENT
/begin MEASUREMENT LEA_obd_ii_P0021_pass_counter "uint8_t" UBYTE NO_COMPU_METHOD 0 0 0 255 ECU_ADDRESS 0x4000451A /end MEASUREMENT
/begin MEASUREMENT LEA_obd_ii_P0022_flags "Stored monitor/maturation state for P0022 (intake cam bank2 retarded). Log it to catch this fault maturing during a drive." UBYTE NO_COMPU_METHOD 0 0 0 255 ECU_ADDRESS 0x4000451B /end MEASUREMENT
/begin MEASUREMENT LEA_obd_ii_P0022_fail_counter "uint8_t" UBYTE NO_COMPU_METHOD 0 0 0 255 ECU_ADDRESS 0x4000451C /end MEASUREMENT
/begin MEASUREMENT LEA_obd_ii_P0022_pass_counter "uint8_t" UBYTE NO_COMPU_METHOD 0 0 0 255 ECU_ADDRESS 0x4000451D /end MEASUREMENT
/begin MEASUREMENT LEA_obd_ii_P0014_flags "Stored monitor/maturation state for P0014 (exhaust cam bank1 over-advanced). Log it to catch this fault maturing during a drive." UBYTE NO_COMPU_METHOD 0 0 0 255 ECU_ADDRESS 0x4000451E /end MEASUREMENT
/begin MEASUREMENT LEA_obd_ii_P0014_fail_counter "uint8_t" UBYTE NO_COMPU_METHOD 0 0 0 255 ECU_ADDRESS 0x4000451F /end MEASUREMENT
/begin MEASUREMENT LEA_obd_ii_P0014_pass_counter "uint8_t" UBYTE NO_COMPU_METHOD 0 0 0 255 ECU_ADDRESS 0x40004520 /end MEASUREMENT
/begin MEASUREMENT LEA_obd_ii_P0015_flags "Stored monitor/maturation state for P0015 (exhaust cam bank1 retarded). Log it to catch this fault maturing during a drive." UBYTE NO_COMPU_METHOD 0 0 0 255 ECU_ADDRESS 0x40004521 /end MEASUREMENT
/begin MEASUREMENT LEA_obd_ii_P0015_fail_counter "uint8_t" UBYTE NO_COMPU_METHOD 0 0 0 255 ECU_ADDRESS 0x40004522 /end MEASUREMENT
/begin MEASUREMENT LEA_obd_ii_P0015_pass_counter "uint8_t" UBYTE NO_COMPU_METHOD 0 0 0 255 ECU_ADDRESS 0x40004523 /end MEASUREMENT
/begin MEASUREMENT LEA_obd_ii_P0024_flags "Stored monitor/maturation state for P0024 (exhaust cam bank2 over-advanced). Log it to catch this fault maturing during a drive." UBYTE NO_COMPU_METHOD 0 0 0 255 ECU_ADDRESS 0x40004524 /end MEASUREMENT
/begin MEASUREMENT LEA_obd_ii_P0024_fail_counter "uint8_t" UBYTE NO_COMPU_METHOD 0 0 0 255 ECU_ADDRESS 0x40004525 /end MEASUREMENT
/begin MEASUREMENT LEA_obd_ii_P0024_pass_counter "uint8_t" UBYTE NO_COMPU_METHOD 0 0 0 255 ECU_ADDRESS 0x40004526 /end MEASUREMENT
/begin MEASUREMENT LEA_obd_ii_P0025_flags "Stored monitor/maturation state for P0025 (exhaust cam bank2 retarded). Log it to catch this fault maturing during a drive." UBYTE NO_COMPU_METHOD 0 0 0 255 ECU_ADDRESS 0x40004527 /end MEASUREMENT
/begin MEASUREMENT LEA_obd_ii_P0025_fail_counter "uint8_t" UBYTE NO_COMPU_METHOD 0 0 0 255 ECU_ADDRESS 0x40004528 /end MEASUREMENT
/begin MEASUREMENT LEA_obd_ii_P0025_pass_counter "uint8_t" UBYTE NO_COMPU_METHOD 0 0 0 255 ECU_ADDRESS 0x40004529 /end MEASUREMENT
/begin MEASUREMENT LEA_obd_ii_P0016_flags "Stored monitor/maturation state for P0016 (crank/intake-cam bank1 correlation). Log it to catch this fault maturing during a drive." UBYTE NO_COMPU_METHOD 0 0 0 255 ECU_ADDRESS 0x4000452A /end MEASUREMENT
/begin MEASUREMENT LEA_obd_ii_P0016_fail_counter "uint8_t" UBYTE NO_COMPU_METHOD 0 0 0 255 ECU_ADDRESS 0x4000452B /end MEASUREMENT
/begin MEASUREMENT LEA_obd_ii_P0016_pass_counter "uint8_t" UBYTE NO_COMPU_METHOD 0 0 0 255 ECU_ADDRESS 0x4000452C /end MEASUREMENT
/begin MEASUREMENT LEA_obd_ii_P0017_flags "Stored monitor/maturation state for P0017 (crank/exhaust-cam bank1 correlation). Log it to catch this fault maturing during a drive." UBYTE NO_COMPU_METHOD 0 0 0 255 ECU_ADDRESS 0x4000452D /end MEASUREMENT
/begin MEASUREMENT LEA_obd_ii_P0017_fail_counter "uint8_t" UBYTE NO_COMPU_METHOD 0 0 0 255 ECU_ADDRESS 0x4000452E /end MEASUREMENT
/begin MEASUREMENT LEA_obd_ii_P0017_pass_counter "uint8_t" UBYTE NO_COMPU_METHOD 0 0 0 255 ECU_ADDRESS 0x4000452F /end MEASUREMENT
/begin MEASUREMENT LEA_obd_ii_P0018_flags "Stored monitor/maturation state for P0018 (crank/intake-cam bank2 correlation). Log it to catch this fault maturing during a drive." UBYTE NO_COMPU_METHOD 0 0 0 255 ECU_ADDRESS 0x40004530 /end MEASUREMENT
/begin MEASUREMENT LEA_obd_ii_P0018_fail_counter "uint8_t" UBYTE NO_COMPU_METHOD 0 0 0 255 ECU_ADDRESS 0x40004531 /end MEASUREMENT
/begin MEASUREMENT LEA_obd_ii_P0018_pass_counter "uint8_t" UBYTE NO_COMPU_METHOD 0 0 0 255 ECU_ADDRESS 0x40004532 /end MEASUREMENT
/begin MEASUREMENT LEA_obd_ii_P0019_flags "Stored monitor/maturation state for P0019 (crank/exhaust-cam bank2 correlation). Log it to catch this fault maturing during a drive." UBYTE NO_COMPU_METHOD 0 0 0 255 ECU_ADDRESS 0x40004533 /end MEASUREMENT
/begin MEASUREMENT LEA_obd_ii_P0019_fail_counter "uint8_t" UBYTE NO_COMPU_METHOD 0 0 0 255 ECU_ADDRESS 0x40004534 /end MEASUREMENT
/begin MEASUREMENT LEA_obd_ii_P0019_pass_counter "uint8_t" UBYTE NO_COMPU_METHOD 0 0 0 255 ECU_ADDRESS 0x40004535 /end MEASUREMENT
/begin MEASUREMENT LEA_obd_ii_P0076_flags "Stored monitor/maturation state for P0076 (intake VVT solenoid bank1 low). Log it to catch this fault maturing during a drive." UBYTE NO_COMPU_METHOD 0 0 0 255 ECU_ADDRESS 0x40004536 /end MEASUREMENT
/begin MEASUREMENT LEA_obd_ii_P0076_fail_counter "uint8_t" UBYTE NO_COMPU_METHOD 0 0 0 255 ECU_ADDRESS 0x40004537 /end MEASUREMENT
/begin MEASUREMENT LEA_obd_ii_P0076_pass_counter "uint8_t" UBYTE NO_COMPU_METHOD 0 0 0 255 ECU_ADDRESS 0x40004538 /end MEASUREMENT
/begin MEASUREMENT LEA_obd_ii_P0077_flags "Stored monitor/maturation state for P0077 (intake VVT solenoid bank1 high). Log it to catch this fault maturing during a drive." UBYTE NO_COMPU_METHOD 0 0 0 255 ECU_ADDRESS 0x40004539 /end MEASUREMENT
/begin MEASUREMENT LEA_obd_ii_P0077_fail_counter "uint8_t" UBYTE NO_COMPU_METHOD 0 0 0 255 ECU_ADDRESS 0x4000453A /end MEASUREMENT
/begin MEASUREMENT LEA_obd_ii_P0077_pass_counter "uint8_t" UBYTE NO_COMPU_METHOD 0 0 0 255 ECU_ADDRESS 0x4000453B /end MEASUREMENT
/begin MEASUREMENT LEA_obd_ii_P0079_flags "Stored monitor/maturation state for P0079 (exhaust VVT solenoid bank1 low). Log it to catch this fault maturing during a drive." UBYTE NO_COMPU_METHOD 0 0 0 255 ECU_ADDRESS 0x4000453C /end MEASUREMENT
/begin MEASUREMENT LEA_obd_ii_P0079_fail_counter "uint8_t" UBYTE NO_COMPU_METHOD 0 0 0 255 ECU_ADDRESS 0x4000453D /end MEASUREMENT
/begin MEASUREMENT LEA_obd_ii_P0079_pass_counter "uint8_t" UBYTE NO_COMPU_METHOD 0 0 0 255 ECU_ADDRESS 0x4000453E /end MEASUREMENT
/begin MEASUREMENT LEA_obd_ii_P0080_flags "Stored monitor/maturation state for P0080 (exhaust VVT solenoid bank1 high). Log it to catch this fault maturing during a drive." UBYTE NO_COMPU_METHOD 0 0 0 255 ECU_ADDRESS 0x4000453F /end MEASUREMENT
/begin MEASUREMENT LEA_obd_ii_P0080_fail_counter "uint8_t" UBYTE NO_COMPU_METHOD 0 0 0 255 ECU_ADDRESS 0x40004540 /end MEASUREMENT
/begin MEASUREMENT LEA_obd_ii_P0080_pass_counter "uint8_t" UBYTE NO_COMPU_METHOD 0 0 0 255 ECU_ADDRESS 0x40004541 /end MEASUREMENT
/begin MEASUREMENT LEA_obd_ii_P0082_flags "Stored monitor/maturation state for P0082 (intake VVT solenoid bank2 low). Log it to catch this fault maturing during a drive." UBYTE NO_COMPU_METHOD 0 0 0 255 ECU_ADDRESS 0x40004542 /end MEASUREMENT
/begin MEASUREMENT LEA_obd_ii_P0082_fail_counter "uint8_t" UBYTE NO_COMPU_METHOD 0 0 0 255 ECU_ADDRESS 0x40004543 /end MEASUREMENT
/begin MEASUREMENT LEA_obd_ii_P0082_pass_counter "uint8_t" UBYTE NO_COMPU_METHOD 0 0 0 255 ECU_ADDRESS 0x40004544 /end MEASUREMENT
/begin MEASUREMENT LEA_obd_ii_P0083_flags "Stored monitor/maturation state for P0083 (intake VVT solenoid bank2 high). Log it to catch this fault maturing during a drive." UBYTE NO_COMPU_METHOD 0 0 0 255 ECU_ADDRESS 0x40004545 /end MEASUREMENT
/begin MEASUREMENT LEA_obd_ii_P0083_fail_counter "uint8_t" UBYTE NO_COMPU_METHOD 0 0 0 255 ECU_ADDRESS 0x40004546 /end MEASUREMENT
/begin MEASUREMENT LEA_obd_ii_P0083_pass_counter "uint8_t" UBYTE NO_COMPU_METHOD 0 0 0 255 ECU_ADDRESS 0x40004547 /end MEASUREMENT
/begin MEASUREMENT LEA_obd_ii_P0085_flags "Stored monitor/maturation state for P0085 (exhaust VVT solenoid bank2 low). Log it to catch this fault maturing during a drive." UBYTE NO_COMPU_METHOD 0 0 0 255 ECU_ADDRESS 0x40004548 /end MEASUREMENT
/begin MEASUREMENT LEA_obd_ii_P0085_fail_counter "uint8_t" UBYTE NO_COMPU_METHOD 0 0 0 255 ECU_ADDRESS 0x40004549 /end MEASUREMENT
/begin MEASUREMENT LEA_obd_ii_P0085_pass_counter "uint8_t" UBYTE NO_COMPU_METHOD 0 0 0 255 ECU_ADDRESS 0x4000454A /end MEASUREMENT
/begin MEASUREMENT LEA_obd_ii_P0086_flags "Stored monitor/maturation state for P0086 (exhaust VVT solenoid bank2 high). Log it to catch this fault maturing during a drive." UBYTE NO_COMPU_METHOD 0 0 0 255 ECU_ADDRESS 0x4000454B /end MEASUREMENT
/begin MEASUREMENT LEA_obd_ii_P0086_fail_counter "uint8_t" UBYTE NO_COMPU_METHOD 0 0 0 255 ECU_ADDRESS 0x4000454C /end MEASUREMENT
/begin MEASUREMENT LEA_obd_ii_P0086_pass_counter "uint8_t" UBYTE NO_COMPU_METHOD 0 0 0 255 ECU_ADDRESS 0x4000454D /end MEASUREMENT
/begin MEASUREMENT LEA_obd_ii_P0101_flags "Stored monitor/maturation state for P0101 (MAF rationality). Log it to catch this fault maturing during a drive." UBYTE NO_COMPU_METHOD 0 0 0 255 ECU_ADDRESS 0x4000454E /end MEASUREMENT
/begin MEASUREMENT LEA_obd_ii_P0101_fail_counter "uint8_t" UBYTE NO_COMPU_METHOD 0 0 0 255 ECU_ADDRESS 0x4000454F /end MEASUREMENT
/begin MEASUREMENT LEA_obd_ii_P0101_pass_counter "uint8_t" UBYTE NO_COMPU_METHOD 0 0 0 255 ECU_ADDRESS 0x40004550 /end MEASUREMENT
/begin MEASUREMENT LEA_obd_ii_P0102_flags "Stored monitor/maturation state for P0102 (MAF circuit low). Log it to catch this fault maturing during a drive." UBYTE NO_COMPU_METHOD 0 0 0 255 ECU_ADDRESS 0x40004551 /end MEASUREMENT
/begin MEASUREMENT LEA_obd_ii_P0102_fail_counter "uint8_t" UBYTE NO_COMPU_METHOD 0 0 0 255 ECU_ADDRESS 0x40004552 /end MEASUREMENT
/begin MEASUREMENT LEA_obd_ii_P0102_pass_counter "uint8_t" UBYTE NO_COMPU_METHOD 0 0 0 255 ECU_ADDRESS 0x40004553 /end MEASUREMENT
/begin MEASUREMENT LEA_obd_ii_P0103_flags "Stored monitor/maturation state for P0103 (MAF circuit high). Log it to catch this fault maturing during a drive." UBYTE NO_COMPU_METHOD 0 0 0 255 ECU_ADDRESS 0x40004554 /end MEASUREMENT
/begin MEASUREMENT LEA_obd_ii_P0103_fail_counter "uint8_t" UBYTE NO_COMPU_METHOD 0 0 0 255 ECU_ADDRESS 0x40004555 /end MEASUREMENT
/begin MEASUREMENT LEA_obd_ii_P0103_pass_counter "uint8_t" UBYTE NO_COMPU_METHOD 0 0 0 255 ECU_ADDRESS 0x40004556 /end MEASUREMENT
/begin MEASUREMENT LEA_obd_ii_P0106_flags "Stored monitor/maturation state for P0106 (MAP/baro rationality). Log it to catch this fault maturing during a drive." UBYTE NO_COMPU_METHOD 0 0 0 255 ECU_ADDRESS 0x40004557 /end MEASUREMENT
/begin MEASUREMENT LEA_obd_ii_P0106_fail_counter "uint8_t" UBYTE NO_COMPU_METHOD 0 0 0 255 ECU_ADDRESS 0x40004558 /end MEASUREMENT
/begin MEASUREMENT LEA_obd_ii_P0106_pass_counter "uint8_t" UBYTE NO_COMPU_METHOD 0 0 0 255 ECU_ADDRESS 0x40004559 /end MEASUREMENT
/begin MEASUREMENT LEA_obd_ii_P0107_flags "Stored monitor/maturation state for P0107 (MAP/baro circuit low). Log it to catch this fault maturing during a drive." UBYTE NO_COMPU_METHOD 0 0 0 255 ECU_ADDRESS 0x4000455A /end MEASUREMENT
/begin MEASUREMENT LEA_obd_ii_P0107_fail_counter "uint8_t" UBYTE NO_COMPU_METHOD 0 0 0 255 ECU_ADDRESS 0x4000455B /end MEASUREMENT
/begin MEASUREMENT LEA_obd_ii_P0107_pass_counter "uint8_t" UBYTE NO_COMPU_METHOD 0 0 0 255 ECU_ADDRESS 0x4000455C /end MEASUREMENT
/begin MEASUREMENT LEA_obd_ii_P0108_flags "Stored monitor/maturation state for P0108 (MAP/baro circuit high). Log it to catch this fault maturing during a drive." UBYTE NO_COMPU_METHOD 0 0 0 255 ECU_ADDRESS 0x4000455D /end MEASUREMENT
/begin MEASUREMENT LEA_obd_ii_P0108_fail_counter "uint8_t" UBYTE NO_COMPU_METHOD 0 0 0 255 ECU_ADDRESS 0x4000455E /end MEASUREMENT
/begin MEASUREMENT LEA_obd_ii_P0108_pass_counter "uint8_t" UBYTE NO_COMPU_METHOD 0 0 0 255 ECU_ADDRESS 0x4000455F /end MEASUREMENT
/begin MEASUREMENT LEA_obd_ii_P0111_flags "Stored monitor/maturation state for P0111 (IAT rationality). Log it to catch this fault maturing during a drive." UBYTE NO_COMPU_METHOD 0 0 0 255 ECU_ADDRESS 0x40004560 /end MEASUREMENT
/begin MEASUREMENT LEA_obd_ii_P0111_fail_counter "uint8_t" UBYTE NO_COMPU_METHOD 0 0 0 255 ECU_ADDRESS 0x40004561 /end MEASUREMENT
/begin MEASUREMENT LEA_obd_ii_P0111_pass_counter "uint8_t" UBYTE NO_COMPU_METHOD 0 0 0 255 ECU_ADDRESS 0x40004562 /end MEASUREMENT
/begin MEASUREMENT LEA_obd_ii_P0112_flags "Stored monitor/maturation state for P0112 (IAT circuit low). Log it to catch this fault maturing during a drive." UBYTE NO_COMPU_METHOD 0 0 0 255 ECU_ADDRESS 0x40004563 /end MEASUREMENT
/begin MEASUREMENT LEA_obd_ii_P0112_fail_counter "uint8_t" UBYTE NO_COMPU_METHOD 0 0 0 255 ECU_ADDRESS 0x40004564 /end MEASUREMENT
/begin MEASUREMENT LEA_obd_ii_P0112_pass_counter "uint8_t" UBYTE NO_COMPU_METHOD 0 0 0 255 ECU_ADDRESS 0x40004565 /end MEASUREMENT
/begin MEASUREMENT LEA_obd_ii_P0113_flags "Stored monitor/maturation state for P0113 (IAT circuit high). Log it to catch this fault maturing during a drive." UBYTE NO_COMPU_METHOD 0 0 0 255 ECU_ADDRESS 0x40004566 /end MEASUREMENT
/begin MEASUREMENT LEA_obd_ii_P0113_fail_counter "uint8_t" UBYTE NO_COMPU_METHOD 0 0 0 255 ECU_ADDRESS 0x40004567 /end MEASUREMENT
/begin MEASUREMENT LEA_obd_ii_P0113_pass_counter "uint8_t" UBYTE NO_COMPU_METHOD 0 0 0 255 ECU_ADDRESS 0x40004568 /end MEASUREMENT
/begin MEASUREMENT LEA_obd_ii_P0071_flags "Stored monitor/maturation state for P0071 (ambient air temp sensor rationality). Log it to catch this fault maturing during a drive." UBYTE NO_COMPU_METHOD 0 0 0 255 ECU_ADDRESS 0x40004569 /end MEASUREMENT
/begin MEASUREMENT LEA_obd_ii_P0071_fail_counter "uint8_t" UBYTE NO_COMPU_METHOD 0 0 0 255 ECU_ADDRESS 0x4000456A /end MEASUREMENT
/begin MEASUREMENT LEA_obd_ii_P0071_pass_counter "uint8_t" UBYTE NO_COMPU_METHOD 0 0 0 255 ECU_ADDRESS 0x4000456B /end MEASUREMENT
/begin MEASUREMENT LEA_obd_ii_P0116_flags "Stored monitor/maturation state for P0116 (coolant-temp rationality). Log it to catch this fault maturing during a drive." UBYTE NO_COMPU_METHOD 0 0 0 255 ECU_ADDRESS 0x4000456C /end MEASUREMENT
/begin MEASUREMENT LEA_obd_ii_P0116_fail_counter "uint8_t" UBYTE NO_COMPU_METHOD 0 0 0 255 ECU_ADDRESS 0x4000456D /end MEASUREMENT
/begin MEASUREMENT LEA_obd_ii_P0116_pass_counter "uint8_t" UBYTE NO_COMPU_METHOD 0 0 0 255 ECU_ADDRESS 0x4000456E /end MEASUREMENT
/begin MEASUREMENT LEA_obd_ii_P0117_flags "Stored monitor/maturation state for P0117 (coolant-temp circuit low). Log it to catch this fault maturing during a drive." UBYTE NO_COMPU_METHOD 0 0 0 255 ECU_ADDRESS 0x4000456F /end MEASUREMENT
/begin MEASUREMENT LEA_obd_ii_P0117_fail_counter "uint8_t" UBYTE NO_COMPU_METHOD 0 0 0 255 ECU_ADDRESS 0x40004570 /end MEASUREMENT
/begin MEASUREMENT LEA_obd_ii_P0117_pass_counter "uint8_t" UBYTE NO_COMPU_METHOD 0 0 0 255 ECU_ADDRESS 0x40004571 /end MEASUREMENT
/begin MEASUREMENT LEA_obd_ii_P0118_flags "Stored monitor/maturation state for P0118 (coolant-temp circuit high). Log it to catch this fault maturing during a drive." UBYTE NO_COMPU_METHOD 0 0 0 255 ECU_ADDRESS 0x40004572 /end MEASUREMENT
/begin MEASUREMENT LEA_obd_ii_P0118_fail_counter "uint8_t" UBYTE NO_COMPU_METHOD 0 0 0 255 ECU_ADDRESS 0x40004573 /end MEASUREMENT
/begin MEASUREMENT LEA_obd_ii_P0118_pass_counter "uint8_t" UBYTE NO_COMPU_METHOD 0 0 0 255 ECU_ADDRESS 0x40004574 /end MEASUREMENT
/begin MEASUREMENT LEA_obd_ii_P0122_flags "Stored monitor/maturation state for P0122 (TPS/pedal A circuit low). Log it to catch this fault maturing during a drive." UBYTE NO_COMPU_METHOD 0 0 0 255 ECU_ADDRESS 0x40004575 /end MEASUREMENT
/begin MEASUREMENT LEA_obd_ii_P0122_fail_counter "uint8_t" UBYTE NO_COMPU_METHOD 0 0 0 255 ECU_ADDRESS 0x40004576 /end MEASUREMENT
/begin MEASUREMENT LEA_obd_ii_P0122_pass_counter "uint8_t" UBYTE NO_COMPU_METHOD 0 0 0 255 ECU_ADDRESS 0x40004577 /end MEASUREMENT
/begin MEASUREMENT LEA_obd_ii_P0123_flags "Stored monitor/maturation state for P0123 (TPS/pedal A circuit high). Log it to catch this fault maturing during a drive." UBYTE NO_COMPU_METHOD 0 0 0 255 ECU_ADDRESS 0x40004578 /end MEASUREMENT
/begin MEASUREMENT LEA_obd_ii_P0123_fail_counter "uint8_t" UBYTE NO_COMPU_METHOD 0 0 0 255 ECU_ADDRESS 0x40004579 /end MEASUREMENT
/begin MEASUREMENT LEA_obd_ii_P0123_pass_counter "uint8_t" UBYTE NO_COMPU_METHOD 0 0 0 255 ECU_ADDRESS 0x4000457A /end MEASUREMENT
/begin MEASUREMENT LEA_obd_ii_P0128_flags "Stored monitor/maturation state for P0128 (coolant below thermostat regulating temp). Log it to catch this fault maturing during a drive." UBYTE NO_COMPU_METHOD 0 0 0 255 ECU_ADDRESS 0x4000457B /end MEASUREMENT
/begin MEASUREMENT LEA_obd_ii_P0128_fail_counter "uint8_t" UBYTE NO_COMPU_METHOD 0 0 0 255 ECU_ADDRESS 0x4000457C /end MEASUREMENT
/begin MEASUREMENT LEA_obd_ii_P0128_pass_counter "uint8_t" UBYTE NO_COMPU_METHOD 0 0 0 255 ECU_ADDRESS 0x4000457D /end MEASUREMENT
/begin MEASUREMENT LEA_obd_ii_P0131_flags "Stored monitor/maturation state for P0131 (O2 B1S1 low). Log it to catch this fault maturing during a drive." UBYTE NO_COMPU_METHOD 0 0 0 255 ECU_ADDRESS 0x4000457E /end MEASUREMENT
/begin MEASUREMENT LEA_obd_ii_P0131_fail_counter "uint8_t" UBYTE NO_COMPU_METHOD 0 0 0 255 ECU_ADDRESS 0x4000457F /end MEASUREMENT
/begin MEASUREMENT LEA_obd_ii_P0131_pass_counter "uint8_t" UBYTE NO_COMPU_METHOD 0 0 0 255 ECU_ADDRESS 0x40004580 /end MEASUREMENT
/begin MEASUREMENT LEA_obd_ii_P0132_flags "Stored monitor/maturation state for P0132 (O2 B1S1 high). Log it to catch this fault maturing during a drive." UBYTE NO_COMPU_METHOD 0 0 0 255 ECU_ADDRESS 0x40004581 /end MEASUREMENT
/begin MEASUREMENT LEA_obd_ii_P0132_fail_counter "uint8_t" UBYTE NO_COMPU_METHOD 0 0 0 255 ECU_ADDRESS 0x40004582 /end MEASUREMENT
/begin MEASUREMENT LEA_obd_ii_P0132_pass_counter "uint8_t" UBYTE NO_COMPU_METHOD 0 0 0 255 ECU_ADDRESS 0x40004583 /end MEASUREMENT
/begin MEASUREMENT LEA_obd_ii_P0133_flags "Stored monitor/maturation state for P0133 (O2 B1S1 slow response). Log it to catch this fault maturing during a drive." UBYTE NO_COMPU_METHOD 0 0 0 255 ECU_ADDRESS 0x40004584 /end MEASUREMENT
/begin MEASUREMENT LEA_obd_ii_P0133_fail_counter "uint8_t" UBYTE NO_COMPU_METHOD 0 0 0 255 ECU_ADDRESS 0x40004585 /end MEASUREMENT
/begin MEASUREMENT LEA_obd_ii_P0133_pass_counter "uint8_t" UBYTE NO_COMPU_METHOD 0 0 0 255 ECU_ADDRESS 0x40004586 /end MEASUREMENT
/begin MEASUREMENT LEA_obd_ii_P0134_flags "Stored monitor/maturation state for P0134 (O2 B1S1 inactive). Log it to catch this fault maturing during a drive." UBYTE NO_COMPU_METHOD 0 0 0 255 ECU_ADDRESS 0x40004587 /end MEASUREMENT
/begin MEASUREMENT LEA_obd_ii_P0134_fail_counter "uint8_t" UBYTE NO_COMPU_METHOD 0 0 0 255 ECU_ADDRESS 0x40004588 /end MEASUREMENT
/begin MEASUREMENT LEA_obd_ii_P0134_pass_counter "uint8_t" UBYTE NO_COMPU_METHOD 0 0 0 255 ECU_ADDRESS 0x40004589 /end MEASUREMENT
/begin MEASUREMENT LEA_obd_ii_P0135_flags "Stored monitor/maturation state for P0135 (O2 B1S1 heater). Log it to catch this fault maturing during a drive." UBYTE NO_COMPU_METHOD 0 0 0 255 ECU_ADDRESS 0x4000458A /end MEASUREMENT
/begin MEASUREMENT LEA_obd_ii_P0135_fail_counter "uint8_t" UBYTE NO_COMPU_METHOD 0 0 0 255 ECU_ADDRESS 0x4000458B /end MEASUREMENT
/begin MEASUREMENT LEA_obd_ii_P0135_pass_counter "uint8_t" UBYTE NO_COMPU_METHOD 0 0 0 255 ECU_ADDRESS 0x4000458C /end MEASUREMENT
/begin MEASUREMENT LEA_obd_ii_P0137_flags "Stored monitor/maturation state for P0137 (O2 B1S2 low). Log it to catch this fault maturing during a drive." UBYTE NO_COMPU_METHOD 0 0 0 255 ECU_ADDRESS 0x4000458D /end MEASUREMENT
/begin MEASUREMENT LEA_obd_ii_P0137_fail_counter "uint8_t" UBYTE NO_COMPU_METHOD 0 0 0 255 ECU_ADDRESS 0x4000458E /end MEASUREMENT
/begin MEASUREMENT LEA_obd_ii_P0137_pass_counter "uint8_t" UBYTE NO_COMPU_METHOD 0 0 0 255 ECU_ADDRESS 0x4000458F /end MEASUREMENT
/begin MEASUREMENT LEA_obd_ii_P0138_flags "Stored monitor/maturation state for P0138 (O2 B1S2 high). Log it to catch this fault maturing during a drive." UBYTE NO_COMPU_METHOD 0 0 0 255 ECU_ADDRESS 0x40004590 /end MEASUREMENT
/begin MEASUREMENT LEA_obd_ii_P0138_fail_counter "uint8_t" UBYTE NO_COMPU_METHOD 0 0 0 255 ECU_ADDRESS 0x40004591 /end MEASUREMENT
/begin MEASUREMENT LEA_obd_ii_P0138_pass_counter "uint8_t" UBYTE NO_COMPU_METHOD 0 0 0 255 ECU_ADDRESS 0x40004592 /end MEASUREMENT
/begin MEASUREMENT LEA_obd_ii_P0139_flags "Stored monitor/maturation state for P0139 (O2 B1S2 slow response). Log it to catch this fault maturing during a drive." UBYTE NO_COMPU_METHOD 0 0 0 255 ECU_ADDRESS 0x40004593 /end MEASUREMENT
/begin MEASUREMENT LEA_obd_ii_P0139_fail_counter "uint8_t" UBYTE NO_COMPU_METHOD 0 0 0 255 ECU_ADDRESS 0x40004594 /end MEASUREMENT
/begin MEASUREMENT LEA_obd_ii_P0139_pass_counter "uint8_t" UBYTE NO_COMPU_METHOD 0 0 0 255 ECU_ADDRESS 0x40004595 /end MEASUREMENT
/begin MEASUREMENT LEA_obd_ii_P0140_flags "Stored monitor/maturation state for P0140 (O2 B1S2 inactive). Log it to catch this fault maturing during a drive." UBYTE NO_COMPU_METHOD 0 0 0 255 ECU_ADDRESS 0x40004596 /end MEASUREMENT
/begin MEASUREMENT LEA_obd_ii_P0140_fail_counter "uint8_t" UBYTE NO_COMPU_METHOD 0 0 0 255 ECU_ADDRESS 0x40004597 /end MEASUREMENT
/begin MEASUREMENT LEA_obd_ii_P0140_pass_counter "uint8_t" UBYTE NO_COMPU_METHOD 0 0 0 255 ECU_ADDRESS 0x40004598 /end MEASUREMENT
/begin MEASUREMENT LEA_obd_ii_P0141_flags "Stored monitor/maturation state for P0141 (O2 B1S2 heater). Log it to catch this fault maturing during a drive." UBYTE NO_COMPU_METHOD 0 0 0 255 ECU_ADDRESS 0x40004599 /end MEASUREMENT
/begin MEASUREMENT LEA_obd_ii_P0141_fail_counter "uint8_t" UBYTE NO_COMPU_METHOD 0 0 0 255 ECU_ADDRESS 0x4000459A /end MEASUREMENT
/begin MEASUREMENT LEA_obd_ii_P0141_pass_counter "uint8_t" UBYTE NO_COMPU_METHOD 0 0 0 255 ECU_ADDRESS 0x4000459B /end MEASUREMENT
/begin MEASUREMENT LEA_obd_ii_P0151_flags "Stored monitor/maturation state for P0151 (O2 B2S1 low). Log it to catch this fault maturing during a drive." UBYTE NO_COMPU_METHOD 0 0 0 255 ECU_ADDRESS 0x4000459C /end MEASUREMENT
/begin MEASUREMENT LEA_obd_ii_P0151_fail_counter "uint8_t" UBYTE NO_COMPU_METHOD 0 0 0 255 ECU_ADDRESS 0x4000459D /end MEASUREMENT
/begin MEASUREMENT LEA_obd_ii_P0151_pass_counter "uint8_t" UBYTE NO_COMPU_METHOD 0 0 0 255 ECU_ADDRESS 0x4000459E /end MEASUREMENT
/begin MEASUREMENT LEA_obd_ii_P0152_flags "Stored monitor/maturation state for P0152 (O2 B2S1 high). Log it to catch this fault maturing during a drive." UBYTE NO_COMPU_METHOD 0 0 0 255 ECU_ADDRESS 0x4000459F /end MEASUREMENT
/begin MEASUREMENT LEA_obd_ii_P0152_fail_counter "uint8_t" UBYTE NO_COMPU_METHOD 0 0 0 255 ECU_ADDRESS 0x400045A0 /end MEASUREMENT
/begin MEASUREMENT LEA_obd_ii_P0152_pass_counter "uint8_t" UBYTE NO_COMPU_METHOD 0 0 0 255 ECU_ADDRESS 0x400045A1 /end MEASUREMENT
/begin MEASUREMENT LEA_obd_ii_P0153_flags "Stored monitor/maturation state for P0153 (O2 B2S1 slow response). Log it to catch this fault maturing during a drive." UBYTE NO_COMPU_METHOD 0 0 0 255 ECU_ADDRESS 0x400045A2 /end MEASUREMENT
/begin MEASUREMENT LEA_obd_ii_P0153_fail_counter "uint8_t" UBYTE NO_COMPU_METHOD 0 0 0 255 ECU_ADDRESS 0x400045A3 /end MEASUREMENT
/begin MEASUREMENT LEA_obd_ii_P0153_pass_counter "uint8_t" UBYTE NO_COMPU_METHOD 0 0 0 255 ECU_ADDRESS 0x400045A4 /end MEASUREMENT
/begin MEASUREMENT LEA_obd_ii_P0154_flags "Stored monitor/maturation state for P0154 (O2 B2S1 inactive). Log it to catch this fault maturing during a drive." UBYTE NO_COMPU_METHOD 0 0 0 255 ECU_ADDRESS 0x400045A5 /end MEASUREMENT
/begin MEASUREMENT LEA_obd_ii_P0154_fail_counter "uint8_t" UBYTE NO_COMPU_METHOD 0 0 0 255 ECU_ADDRESS 0x400045A6 /end MEASUREMENT
/begin MEASUREMENT LEA_obd_ii_P0154_pass_counter "uint8_t" UBYTE NO_COMPU_METHOD 0 0 0 255 ECU_ADDRESS 0x400045A7 /end MEASUREMENT
/begin MEASUREMENT LEA_obd_ii_P0155_flags "Stored monitor/maturation state for P0155 (O2 B2S1 heater). Log it to catch this fault maturing during a drive." UBYTE NO_COMPU_METHOD 0 0 0 255 ECU_ADDRESS 0x400045A8 /end MEASUREMENT
/begin MEASUREMENT LEA_obd_ii_P0155_fail_counter "uint8_t" UBYTE NO_COMPU_METHOD 0 0 0 255 ECU_ADDRESS 0x400045A9 /end MEASUREMENT
/begin MEASUREMENT LEA_obd_ii_P0155_pass_counter "uint8_t" UBYTE NO_COMPU_METHOD 0 0 0 255 ECU_ADDRESS 0x400045AA /end MEASUREMENT
/begin MEASUREMENT LEA_obd_ii_P0157_flags "Stored monitor/maturation state for P0157 (O2 B2S2 low). Log it to catch this fault maturing during a drive." UBYTE NO_COMPU_METHOD 0 0 0 255 ECU_ADDRESS 0x400045AB /end MEASUREMENT
/begin MEASUREMENT LEA_obd_ii_P0157_fail_counter "uint8_t" UBYTE NO_COMPU_METHOD 0 0 0 255 ECU_ADDRESS 0x400045AC /end MEASUREMENT
/begin MEASUREMENT LEA_obd_ii_P0157_pass_counter "uint8_t" UBYTE NO_COMPU_METHOD 0 0 0 255 ECU_ADDRESS 0x400045AD /end MEASUREMENT
/begin MEASUREMENT LEA_obd_ii_P0158_flags "Stored monitor/maturation state for P0158 (O2 B2S2 high). Log it to catch this fault maturing during a drive." UBYTE NO_COMPU_METHOD 0 0 0 255 ECU_ADDRESS 0x400045AE /end MEASUREMENT
/begin MEASUREMENT LEA_obd_ii_P0158_fail_counter "uint8_t" UBYTE NO_COMPU_METHOD 0 0 0 255 ECU_ADDRESS 0x400045AF /end MEASUREMENT
/begin MEASUREMENT LEA_obd_ii_P0158_pass_counter "uint8_t" UBYTE NO_COMPU_METHOD 0 0 0 255 ECU_ADDRESS 0x400045B0 /end MEASUREMENT
/begin MEASUREMENT LEA_obd_ii_P0159_flags "Stored monitor/maturation state for P0159 (O2 B2S2 slow response). Log it to catch this fault maturing during a drive." UBYTE NO_COMPU_METHOD 0 0 0 255 ECU_ADDRESS 0x400045B1 /end MEASUREMENT
/begin MEASUREMENT LEA_obd_ii_P0159_fail_counter "uint8_t" UBYTE NO_COMPU_METHOD 0 0 0 255 ECU_ADDRESS 0x400045B2 /end MEASUREMENT
/begin MEASUREMENT LEA_obd_ii_P0159_pass_counter "uint8_t" UBYTE NO_COMPU_METHOD 0 0 0 255 ECU_ADDRESS 0x400045B3 /end MEASUREMENT
/begin MEASUREMENT LEA_obd_ii_P0160_flags "Stored monitor/maturation state for P0160 (O2 B2S2 inactive). Log it to catch this fault maturing during a drive." UBYTE NO_COMPU_METHOD 0 0 0 255 ECU_ADDRESS 0x400045B4 /end MEASUREMENT
/begin MEASUREMENT LEA_obd_ii_P0160_fail_counter "uint8_t" UBYTE NO_COMPU_METHOD 0 0 0 255 ECU_ADDRESS 0x400045B5 /end MEASUREMENT
/begin MEASUREMENT LEA_obd_ii_P0160_pass_counter "uint8_t" UBYTE NO_COMPU_METHOD 0 0 0 255 ECU_ADDRESS 0x400045B6 /end MEASUREMENT
/begin MEASUREMENT LEA_obd_ii_P0161_flags "Stored monitor/maturation state for P0161 (O2 B2S2 heater). Log it to catch this fault maturing during a drive." UBYTE NO_COMPU_METHOD 0 0 0 255 ECU_ADDRESS 0x400045B7 /end MEASUREMENT
/begin MEASUREMENT LEA_obd_ii_P0161_fail_counter "uint8_t" UBYTE NO_COMPU_METHOD 0 0 0 255 ECU_ADDRESS 0x400045B8 /end MEASUREMENT
/begin MEASUREMENT LEA_obd_ii_P0161_pass_counter "uint8_t" UBYTE NO_COMPU_METHOD 0 0 0 255 ECU_ADDRESS 0x400045B9 /end MEASUREMENT
/begin MEASUREMENT LEA_obd_ii_P0171_flags "Stored monitor/maturation state for P0171 (bank1 too lean). Log it to catch this fault maturing during a drive." UBYTE NO_COMPU_METHOD 0 0 0 255 ECU_ADDRESS 0x400045BA /end MEASUREMENT
/begin MEASUREMENT LEA_obd_ii_P0171_fail_counter "uint8_t" UBYTE NO_COMPU_METHOD 0 0 0 255 ECU_ADDRESS 0x400045BB /end MEASUREMENT
/begin MEASUREMENT LEA_obd_ii_P0171_pass_counter "uint8_t" UBYTE NO_COMPU_METHOD 0 0 0 255 ECU_ADDRESS 0x400045BC /end MEASUREMENT
/begin MEASUREMENT LEA_obd_ii_P0172_flags "Stored monitor/maturation state for P0172 (bank1 too rich). Log it to catch this fault maturing during a drive." UBYTE NO_COMPU_METHOD 0 0 0 255 ECU_ADDRESS 0x400045BD /end MEASUREMENT
/begin MEASUREMENT LEA_obd_ii_P0172_fail_counter "uint8_t" UBYTE NO_COMPU_METHOD 0 0 0 255 ECU_ADDRESS 0x400045BE /end MEASUREMENT
/begin MEASUREMENT LEA_obd_ii_P0172_pass_counter "uint8_t" UBYTE NO_COMPU_METHOD 0 0 0 255 ECU_ADDRESS 0x400045BF /end MEASUREMENT
/begin MEASUREMENT LEA_obd_ii_P0174_flags "Stored monitor/maturation state for P0174 (bank2 too lean). Log it to catch this fault maturing during a drive." UBYTE NO_COMPU_METHOD 0 0 0 255 ECU_ADDRESS 0x400045C0 /end MEASUREMENT
/begin MEASUREMENT LEA_obd_ii_P0174_fail_counter "uint8_t" UBYTE NO_COMPU_METHOD 0 0 0 255 ECU_ADDRESS 0x400045C1 /end MEASUREMENT
/begin MEASUREMENT LEA_obd_ii_P0174_pass_counter "uint8_t" UBYTE NO_COMPU_METHOD 0 0 0 255 ECU_ADDRESS 0x400045C2 /end MEASUREMENT
/begin MEASUREMENT LEA_obd_ii_P0175_flags "Stored monitor/maturation state for P0175 (bank2 too rich). Log it to catch this fault maturing during a drive." UBYTE NO_COMPU_METHOD 0 0 0 255 ECU_ADDRESS 0x400045C3 /end MEASUREMENT
/begin MEASUREMENT LEA_obd_ii_P0175_fail_counter "uint8_t" UBYTE NO_COMPU_METHOD 0 0 0 255 ECU_ADDRESS 0x400045C4 /end MEASUREMENT
/begin MEASUREMENT LEA_obd_ii_P0175_pass_counter "uint8_t" UBYTE NO_COMPU_METHOD 0 0 0 255 ECU_ADDRESS 0x400045C5 /end MEASUREMENT
/begin MEASUREMENT LEA_obd_ii_P0222_flags "Stored monitor/maturation state for P0222 (TPS/pedal B circuit low). Log it to catch this fault maturing during a drive." UBYTE NO_COMPU_METHOD 0 0 0 255 ECU_ADDRESS 0x400045C6 /end MEASUREMENT
/begin MEASUREMENT LEA_obd_ii_P0222_fail_counter "uint8_t" UBYTE NO_COMPU_METHOD 0 0 0 255 ECU_ADDRESS 0x400045C7 /end MEASUREMENT
/begin MEASUREMENT LEA_obd_ii_P0222_pass_counter "uint8_t" UBYTE NO_COMPU_METHOD 0 0 0 255 ECU_ADDRESS 0x400045C8 /end MEASUREMENT
/begin MEASUREMENT LEA_obd_ii_P0223_flags "Stored monitor/maturation state for P0223 (TPS/pedal B circuit high). Log it to catch this fault maturing during a drive." UBYTE NO_COMPU_METHOD 0 0 0 255 ECU_ADDRESS 0x400045C9 /end MEASUREMENT
/begin MEASUREMENT LEA_obd_ii_P0223_fail_counter "uint8_t" UBYTE NO_COMPU_METHOD 0 0 0 255 ECU_ADDRESS 0x400045CA /end MEASUREMENT
/begin MEASUREMENT LEA_obd_ii_P0223_pass_counter "uint8_t" UBYTE NO_COMPU_METHOD 0 0 0 255 ECU_ADDRESS 0x400045CB /end MEASUREMENT
/begin MEASUREMENT LEA_obd_ii_P0261_flags "Stored monitor/maturation state for P0261 (injector cyl1 low). Log it to catch this fault maturing during a drive." UBYTE NO_COMPU_METHOD 0 0 0 255 ECU_ADDRESS 0x400045CC /end MEASUREMENT
/begin MEASUREMENT LEA_obd_ii_P0261_fail_counter "uint8_t" UBYTE NO_COMPU_METHOD 0 0 0 255 ECU_ADDRESS 0x400045CD /end MEASUREMENT
/begin MEASUREMENT LEA_obd_ii_P0261_pass_counter "uint8_t" UBYTE NO_COMPU_METHOD 0 0 0 255 ECU_ADDRESS 0x400045CE /end MEASUREMENT
/begin MEASUREMENT LEA_obd_ii_P0262_flags "Stored monitor/maturation state for P0262 (injector cyl1 high). Log it to catch this fault maturing during a drive." UBYTE NO_COMPU_METHOD 0 0 0 255 ECU_ADDRESS 0x400045CF /end MEASUREMENT
/begin MEASUREMENT LEA_obd_ii_P0262_fail_counter "uint8_t" UBYTE NO_COMPU_METHOD 0 0 0 255 ECU_ADDRESS 0x400045D0 /end MEASUREMENT
/begin MEASUREMENT LEA_obd_ii_P0262_pass_counter "uint8_t" UBYTE NO_COMPU_METHOD 0 0 0 255 ECU_ADDRESS 0x400045D1 /end MEASUREMENT
/begin MEASUREMENT LEA_obd_ii_P0264_flags "Stored monitor/maturation state for P0264 (injector cyl2 low). Log it to catch this fault maturing during a drive." UBYTE NO_COMPU_METHOD 0 0 0 255 ECU_ADDRESS 0x400045D2 /end MEASUREMENT
/begin MEASUREMENT LEA_obd_ii_P0264_fail_counter "uint8_t" UBYTE NO_COMPU_METHOD 0 0 0 255 ECU_ADDRESS 0x400045D3 /end MEASUREMENT
/begin MEASUREMENT LEA_obd_ii_P0264_pass_counter "uint8_t" UBYTE NO_COMPU_METHOD 0 0 0 255 ECU_ADDRESS 0x400045D4 /end MEASUREMENT
/begin MEASUREMENT LEA_obd_ii_P0265_flags "Stored monitor/maturation state for P0265 (injector cyl2 high). Log it to catch this fault maturing during a drive." UBYTE NO_COMPU_METHOD 0 0 0 255 ECU_ADDRESS 0x400045D5 /end MEASUREMENT
/begin MEASUREMENT LEA_obd_ii_P0265_fail_counter "uint8_t" UBYTE NO_COMPU_METHOD 0 0 0 255 ECU_ADDRESS 0x400045D6 /end MEASUREMENT
/begin MEASUREMENT LEA_obd_ii_P0265_pass_counter "uint8_t" UBYTE NO_COMPU_METHOD 0 0 0 255 ECU_ADDRESS 0x400045D7 /end MEASUREMENT
/begin MEASUREMENT LEA_obd_ii_P0267_flags "Stored monitor/maturation state for P0267 (injector cyl3 low). Log it to catch this fault maturing during a drive." UBYTE NO_COMPU_METHOD 0 0 0 255 ECU_ADDRESS 0x400045D8 /end MEASUREMENT
/begin MEASUREMENT LEA_obd_ii_P0267_fail_counter "uint8_t" UBYTE NO_COMPU_METHOD 0 0 0 255 ECU_ADDRESS 0x400045D9 /end MEASUREMENT
/begin MEASUREMENT LEA_obd_ii_P0267_pass_counter "uint8_t" UBYTE NO_COMPU_METHOD 0 0 0 255 ECU_ADDRESS 0x400045DA /end MEASUREMENT
/begin MEASUREMENT LEA_obd_ii_P0268_flags "Stored monitor/maturation state for P0268 (injector cyl3 high). Log it to catch this fault maturing during a drive." UBYTE NO_COMPU_METHOD 0 0 0 255 ECU_ADDRESS 0x400045DB /end MEASUREMENT
/begin MEASUREMENT LEA_obd_ii_P0268_fail_counter "uint8_t" UBYTE NO_COMPU_METHOD 0 0 0 255 ECU_ADDRESS 0x400045DC /end MEASUREMENT
/begin MEASUREMENT LEA_obd_ii_P0268_pass_counter "uint8_t" UBYTE NO_COMPU_METHOD 0 0 0 255 ECU_ADDRESS 0x400045DD /end MEASUREMENT
/begin MEASUREMENT LEA_obd_ii_P0270_flags "Stored monitor/maturation state for P0270 (injector cyl4 low). Log it to catch this fault maturing during a drive." UBYTE NO_COMPU_METHOD 0 0 0 255 ECU_ADDRESS 0x400045DE /end MEASUREMENT
/begin MEASUREMENT LEA_obd_ii_P0270_fail_counter "uint8_t" UBYTE NO_COMPU_METHOD 0 0 0 255 ECU_ADDRESS 0x400045DF /end MEASUREMENT
/begin MEASUREMENT LEA_obd_ii_P0270_pass_counter "uint8_t" UBYTE NO_COMPU_METHOD 0 0 0 255 ECU_ADDRESS 0x400045E0 /end MEASUREMENT
/begin MEASUREMENT LEA_obd_ii_P0271_flags "Stored monitor/maturation state for P0271 (injector cyl4 high). Log it to catch this fault maturing during a drive." UBYTE NO_COMPU_METHOD 0 0 0 255 ECU_ADDRESS 0x400045E1 /end MEASUREMENT
/begin MEASUREMENT LEA_obd_ii_P0271_fail_counter "uint8_t" UBYTE NO_COMPU_METHOD 0 0 0 255 ECU_ADDRESS 0x400045E2 /end MEASUREMENT
/begin MEASUREMENT LEA_obd_ii_P0271_pass_counter "uint8_t" UBYTE NO_COMPU_METHOD 0 0 0 255 ECU_ADDRESS 0x400045E3 /end MEASUREMENT
/begin MEASUREMENT LEA_obd_ii_P0273_flags "Stored monitor/maturation state for P0273 (injector cyl5 low). Log it to catch this fault maturing during a drive." UBYTE NO_COMPU_METHOD 0 0 0 255 ECU_ADDRESS 0x400045E4 /end MEASUREMENT
/begin MEASUREMENT LEA_obd_ii_P0273_fail_counter "uint8_t" UBYTE NO_COMPU_METHOD 0 0 0 255 ECU_ADDRESS 0x400045E5 /end MEASUREMENT
/begin MEASUREMENT LEA_obd_ii_P0273_pass_counter "uint8_t" UBYTE NO_COMPU_METHOD 0 0 0 255 ECU_ADDRESS 0x400045E6 /end MEASUREMENT
/begin MEASUREMENT LEA_obd_ii_P0274_flags "Stored monitor/maturation state for P0274 (injector cyl5 high). Log it to catch this fault maturing during a drive." UBYTE NO_COMPU_METHOD 0 0 0 255 ECU_ADDRESS 0x400045E7 /end MEASUREMENT
/begin MEASUREMENT LEA_obd_ii_P0274_fail_counter "uint8_t" UBYTE NO_COMPU_METHOD 0 0 0 255 ECU_ADDRESS 0x400045E8 /end MEASUREMENT
/begin MEASUREMENT LEA_obd_ii_P0274_pass_counter "uint8_t" UBYTE NO_COMPU_METHOD 0 0 0 255 ECU_ADDRESS 0x400045E9 /end MEASUREMENT
/begin MEASUREMENT LEA_obd_ii_P0276_flags "Stored monitor/maturation state for P0276 (injector cyl6 low). Log it to catch this fault maturing during a drive." UBYTE NO_COMPU_METHOD 0 0 0 255 ECU_ADDRESS 0x400045EA /end MEASUREMENT
/begin MEASUREMENT LEA_obd_ii_P0276_fail_counter "uint8_t" UBYTE NO_COMPU_METHOD 0 0 0 255 ECU_ADDRESS 0x400045EB /end MEASUREMENT
/begin MEASUREMENT LEA_obd_ii_P0276_pass_counter "uint8_t" UBYTE NO_COMPU_METHOD 0 0 0 255 ECU_ADDRESS 0x400045EC /end MEASUREMENT
/begin MEASUREMENT LEA_obd_ii_P0277_flags "Stored monitor/maturation state for P0277 (injector cyl6 high). Log it to catch this fault maturing during a drive." UBYTE NO_COMPU_METHOD 0 0 0 255 ECU_ADDRESS 0x400045ED /end MEASUREMENT
/begin MEASUREMENT LEA_obd_ii_P0277_fail_counter "uint8_t" UBYTE NO_COMPU_METHOD 0 0 0 255 ECU_ADDRESS 0x400045EE /end MEASUREMENT
/begin MEASUREMENT LEA_obd_ii_P0277_pass_counter "uint8_t" UBYTE NO_COMPU_METHOD 0 0 0 255 ECU_ADDRESS 0x400045EF /end MEASUREMENT
/begin MEASUREMENT LEA_obd_ii_P0300_flags "Stored monitor/maturation state for P0300 (random/multiple misfire). Log it to catch this fault maturing during a drive." UBYTE NO_COMPU_METHOD 0 0 0 255 ECU_ADDRESS 0x400045FF /end MEASUREMENT
/begin MEASUREMENT LEA_obd_ii_P0300_fail_counter "uint8_t" UBYTE NO_COMPU_METHOD 0 0 0 255 ECU_ADDRESS 0x40004600 /end MEASUREMENT
/begin MEASUREMENT LEA_obd_ii_P0300_pass_counter "uint8_t" UBYTE NO_COMPU_METHOD 0 0 0 255 ECU_ADDRESS 0x40004601 /end MEASUREMENT
/begin MEASUREMENT LEA_obd_ii_P0301_flags "Stored monitor/maturation state for P0301 (cyl1 misfire). Log it to catch this fault maturing during a drive." UBYTE NO_COMPU_METHOD 0 0 0 255 ECU_ADDRESS 0x40004602 /end MEASUREMENT
/begin MEASUREMENT LEA_obd_ii_P0301_fail_counter "uint8_t" UBYTE NO_COMPU_METHOD 0 0 0 255 ECU_ADDRESS 0x40004603 /end MEASUREMENT
/begin MEASUREMENT LEA_obd_ii_P0301_pass_counter "uint8_t" UBYTE NO_COMPU_METHOD 0 0 0 255 ECU_ADDRESS 0x40004604 /end MEASUREMENT
/begin MEASUREMENT LEA_obd_ii_P0302_flags "Stored monitor/maturation state for P0302 (cyl2 misfire). Log it to catch this fault maturing during a drive." UBYTE NO_COMPU_METHOD 0 0 0 255 ECU_ADDRESS 0x40004605 /end MEASUREMENT
/begin MEASUREMENT LEA_obd_ii_P0302_fail_counter "uint8_t" UBYTE NO_COMPU_METHOD 0 0 0 255 ECU_ADDRESS 0x40004606 /end MEASUREMENT
/begin MEASUREMENT LEA_obd_ii_P0302_pass_counter "uint8_t" UBYTE NO_COMPU_METHOD 0 0 0 255 ECU_ADDRESS 0x40004607 /end MEASUREMENT
/begin MEASUREMENT LEA_obd_ii_P0303_flags "Stored monitor/maturation state for P0303 (cyl3 misfire). Log it to catch this fault maturing during a drive." UBYTE NO_COMPU_METHOD 0 0 0 255 ECU_ADDRESS 0x40004608 /end MEASUREMENT
/begin MEASUREMENT LEA_obd_ii_P0303_fail_counter "uint8_t" UBYTE NO_COMPU_METHOD 0 0 0 255 ECU_ADDRESS 0x40004609 /end MEASUREMENT
/begin MEASUREMENT LEA_obd_ii_P0303_pass_counter "uint8_t" UBYTE NO_COMPU_METHOD 0 0 0 255 ECU_ADDRESS 0x4000460A /end MEASUREMENT
/begin MEASUREMENT LEA_obd_ii_P0304_flags "Stored monitor/maturation state for P0304 (cyl4 misfire). Log it to catch this fault maturing during a drive." UBYTE NO_COMPU_METHOD 0 0 0 255 ECU_ADDRESS 0x4000460B /end MEASUREMENT
/begin MEASUREMENT LEA_obd_ii_P0304_fail_counter "uint8_t" UBYTE NO_COMPU_METHOD 0 0 0 255 ECU_ADDRESS 0x4000460C /end MEASUREMENT
/begin MEASUREMENT LEA_obd_ii_P0304_pass_counter "uint8_t" UBYTE NO_COMPU_METHOD 0 0 0 255 ECU_ADDRESS 0x4000460D /end MEASUREMENT
/begin MEASUREMENT LEA_obd_ii_P0305_flags "Stored monitor/maturation state for P0305 (cyl5 misfire). Log it to catch this fault maturing during a drive." UBYTE NO_COMPU_METHOD 0 0 0 255 ECU_ADDRESS 0x4000460E /end MEASUREMENT
/begin MEASUREMENT LEA_obd_ii_P0305_fail_counter "uint8_t" UBYTE NO_COMPU_METHOD 0 0 0 255 ECU_ADDRESS 0x4000460F /end MEASUREMENT
/begin MEASUREMENT LEA_obd_ii_P0305_pass_counter "uint8_t" UBYTE NO_COMPU_METHOD 0 0 0 255 ECU_ADDRESS 0x40004610 /end MEASUREMENT
/begin MEASUREMENT LEA_obd_ii_P0306_flags "Stored monitor/maturation state for P0306 (cyl6 misfire). Log it to catch this fault maturing during a drive." UBYTE NO_COMPU_METHOD 0 0 0 255 ECU_ADDRESS 0x40004611 /end MEASUREMENT
/begin MEASUREMENT LEA_obd_ii_P0306_fail_counter "uint8_t" UBYTE NO_COMPU_METHOD 0 0 0 255 ECU_ADDRESS 0x40004612 /end MEASUREMENT
/begin MEASUREMENT LEA_obd_ii_P0306_pass_counter "uint8_t" UBYTE NO_COMPU_METHOD 0 0 0 255 ECU_ADDRESS 0x40004613 /end MEASUREMENT
/begin MEASUREMENT LEA_obd_ii_P0327_flags "Stored monitor/maturation state for P0327 (knock sensor1 low). Log it to catch this fault maturing during a drive." UBYTE NO_COMPU_METHOD 0 0 0 255 ECU_ADDRESS 0x40004614 /end MEASUREMENT
/begin MEASUREMENT LEA_obd_ii_P0327_fail_counter "uint8_t" UBYTE NO_COMPU_METHOD 0 0 0 255 ECU_ADDRESS 0x40004615 /end MEASUREMENT
/begin MEASUREMENT LEA_obd_ii_P0327_pass_counter "uint8_t" UBYTE NO_COMPU_METHOD 0 0 0 255 ECU_ADDRESS 0x40004616 /end MEASUREMENT
/begin MEASUREMENT LEA_obd_ii_P0328_flags "Stored monitor/maturation state for P0328 (knock sensor1 high). Log it to catch this fault maturing during a drive." UBYTE NO_COMPU_METHOD 0 0 0 255 ECU_ADDRESS 0x40004617 /end MEASUREMENT
/begin MEASUREMENT LEA_obd_ii_P0328_fail_counter "uint8_t" UBYTE NO_COMPU_METHOD 0 0 0 255 ECU_ADDRESS 0x40004618 /end MEASUREMENT
/begin MEASUREMENT LEA_obd_ii_P0328_pass_counter "uint8_t" UBYTE NO_COMPU_METHOD 0 0 0 255 ECU_ADDRESS 0x40004619 /end MEASUREMENT
/begin MEASUREMENT LEA_obd_ii_P0332_flags "Stored monitor/maturation state for P0332 (knock sensor2 low). Log it to catch this fault maturing during a drive." UBYTE NO_COMPU_METHOD 0 0 0 255 ECU_ADDRESS 0x4000461A /end MEASUREMENT
/begin MEASUREMENT LEA_obd_ii_P0332_fail_counter "uint8_t" UBYTE NO_COMPU_METHOD 0 0 0 255 ECU_ADDRESS 0x4000461B /end MEASUREMENT
/begin MEASUREMENT LEA_obd_ii_P0332_pass_counter "uint8_t" UBYTE NO_COMPU_METHOD 0 0 0 255 ECU_ADDRESS 0x4000461C /end MEASUREMENT
/begin MEASUREMENT LEA_obd_ii_P0333_flags "Stored monitor/maturation state for P0333 (knock sensor2 high). Log it to catch this fault maturing during a drive." UBYTE NO_COMPU_METHOD 0 0 0 255 ECU_ADDRESS 0x4000461D /end MEASUREMENT
/begin MEASUREMENT LEA_obd_ii_P0333_fail_counter "uint8_t" UBYTE NO_COMPU_METHOD 0 0 0 255 ECU_ADDRESS 0x4000461E /end MEASUREMENT
/begin MEASUREMENT LEA_obd_ii_P0333_pass_counter "uint8_t" UBYTE NO_COMPU_METHOD 0 0 0 255 ECU_ADDRESS 0x4000461F /end MEASUREMENT
/begin MEASUREMENT LEA_obd_ii_P0335_flags "Stored monitor/maturation state for P0335 (crank position sensor). Log it to catch this fault maturing during a drive." UBYTE NO_COMPU_METHOD 0 0 0 255 ECU_ADDRESS 0x40004620 /end MEASUREMENT
/begin MEASUREMENT LEA_obd_ii_P0335_fail_counter "uint8_t" UBYTE NO_COMPU_METHOD 0 0 0 255 ECU_ADDRESS 0x40004621 /end MEASUREMENT
/begin MEASUREMENT LEA_obd_ii_P0335_pass_counter "uint8_t" UBYTE NO_COMPU_METHOD 0 0 0 255 ECU_ADDRESS 0x40004622 /end MEASUREMENT
/begin MEASUREMENT LEA_obd_ii_P0341_flags "Stored monitor/maturation state for P0341 (cam position sensor A rationality). Log it to catch this fault maturing during a drive." UBYTE NO_COMPU_METHOD 0 0 0 255 ECU_ADDRESS 0x40004623 /end MEASUREMENT
/begin MEASUREMENT LEA_obd_ii_P0341_fail_counter "uint8_t" UBYTE NO_COMPU_METHOD 0 0 0 255 ECU_ADDRESS 0x40004624 /end MEASUREMENT
/begin MEASUREMENT LEA_obd_ii_P0341_pass_counter "uint8_t" UBYTE NO_COMPU_METHOD 0 0 0 255 ECU_ADDRESS 0x40004625 /end MEASUREMENT
/begin MEASUREMENT LEA_obd_ii_P0346_flags "Stored monitor/maturation state for P0346 (cam position sensor bank2 rationality). Log it to catch this fault maturing during a drive." UBYTE NO_COMPU_METHOD 0 0 0 255 ECU_ADDRESS 0x40004626 /end MEASUREMENT
/begin MEASUREMENT LEA_obd_ii_P0346_fail_counter "uint8_t" UBYTE NO_COMPU_METHOD 0 0 0 255 ECU_ADDRESS 0x40004627 /end MEASUREMENT
/begin MEASUREMENT LEA_obd_ii_P0346_pass_counter "uint8_t" UBYTE NO_COMPU_METHOD 0 0 0 255 ECU_ADDRESS 0x40004628 /end MEASUREMENT
/begin MEASUREMENT LEA_obd_ii_P0366_flags "Stored monitor/maturation state for P0366 (cam position sensor B bank1). Log it to catch this fault maturing during a drive." UBYTE NO_COMPU_METHOD 0 0 0 255 ECU_ADDRESS 0x40004629 /end MEASUREMENT
/begin MEASUREMENT LEA_obd_ii_P0366_fail_counter "uint8_t" UBYTE NO_COMPU_METHOD 0 0 0 255 ECU_ADDRESS 0x4000462A /end MEASUREMENT
/begin MEASUREMENT LEA_obd_ii_P0366_pass_counter "uint8_t" UBYTE NO_COMPU_METHOD 0 0 0 255 ECU_ADDRESS 0x4000462B /end MEASUREMENT
/begin MEASUREMENT LEA_obd_ii_P0391_flags "Stored monitor/maturation state for P0391 (cam position sensor B bank2). Log it to catch this fault maturing during a drive." UBYTE NO_COMPU_METHOD 0 0 0 255 ECU_ADDRESS 0x4000462C /end MEASUREMENT
/begin MEASUREMENT LEA_obd_ii_P0391_fail_counter "uint8_t" UBYTE NO_COMPU_METHOD 0 0 0 255 ECU_ADDRESS 0x4000462D /end MEASUREMENT
/begin MEASUREMENT LEA_obd_ii_P0391_pass_counter "uint8_t" UBYTE NO_COMPU_METHOD 0 0 0 255 ECU_ADDRESS 0x4000462E /end MEASUREMENT
/begin MEASUREMENT LEA_obd_ii_P0351_flags "Stored monitor/maturation state for P0351 (ignition coil 1). Log it to catch this fault maturing during a drive." UBYTE NO_COMPU_METHOD 0 0 0 255 ECU_ADDRESS 0x4000462F /end MEASUREMENT
/begin MEASUREMENT LEA_obd_ii_P0351_fail_counter "uint8_t" UBYTE NO_COMPU_METHOD 0 0 0 255 ECU_ADDRESS 0x40004630 /end MEASUREMENT
/begin MEASUREMENT LEA_obd_ii_P0351_pass_counter "uint8_t" UBYTE NO_COMPU_METHOD 0 0 0 255 ECU_ADDRESS 0x40004631 /end MEASUREMENT
/begin MEASUREMENT LEA_obd_ii_P0352_flags "Stored monitor/maturation state for P0352 (ignition coil 2). Log it to catch this fault maturing during a drive." UBYTE NO_COMPU_METHOD 0 0 0 255 ECU_ADDRESS 0x40004632 /end MEASUREMENT
/begin MEASUREMENT LEA_obd_ii_P0352_fail_counter "uint8_t" UBYTE NO_COMPU_METHOD 0 0 0 255 ECU_ADDRESS 0x40004633 /end MEASUREMENT
/begin MEASUREMENT LEA_obd_ii_P0352_pass_counter "uint8_t" UBYTE NO_COMPU_METHOD 0 0 0 255 ECU_ADDRESS 0x40004634 /end MEASUREMENT
/begin MEASUREMENT LEA_obd_ii_P0353_flags "Stored monitor/maturation state for P0353 (ignition coil 3). Log it to catch this fault maturing during a drive." UBYTE NO_COMPU_METHOD 0 0 0 255 ECU_ADDRESS 0x40004635 /end MEASUREMENT
/begin MEASUREMENT LEA_obd_ii_P0353_fail_counter "uint8_t" UBYTE NO_COMPU_METHOD 0 0 0 255 ECU_ADDRESS 0x40004636 /end MEASUREMENT
/begin MEASUREMENT LEA_obd_ii_P0353_pass_counter "uint8_t" UBYTE NO_COMPU_METHOD 0 0 0 255 ECU_ADDRESS 0x40004637 /end MEASUREMENT
/begin MEASUREMENT LEA_obd_ii_P0354_flags "Stored monitor/maturation state for P0354 (ignition coil 4). Log it to catch this fault maturing during a drive." UBYTE NO_COMPU_METHOD 0 0 0 255 ECU_ADDRESS 0x40004638 /end MEASUREMENT
/begin MEASUREMENT LEA_obd_ii_P0354_fail_counter "uint8_t" UBYTE NO_COMPU_METHOD 0 0 0 255 ECU_ADDRESS 0x40004639 /end MEASUREMENT
/begin MEASUREMENT LEA_obd_ii_P0354_pass_counter "uint8_t" UBYTE NO_COMPU_METHOD 0 0 0 255 ECU_ADDRESS 0x4000463A /end MEASUREMENT
/begin MEASUREMENT LEA_obd_ii_P0355_flags "Stored monitor/maturation state for P0355 (ignition coil 5). Log it to catch this fault maturing during a drive." UBYTE NO_COMPU_METHOD 0 0 0 255 ECU_ADDRESS 0x4000463B /end MEASUREMENT
/begin MEASUREMENT LEA_obd_ii_P0355_fail_counter "uint8_t" UBYTE NO_COMPU_METHOD 0 0 0 255 ECU_ADDRESS 0x4000463C /end MEASUREMENT
/begin MEASUREMENT LEA_obd_ii_P0355_pass_counter "uint8_t" UBYTE NO_COMPU_METHOD 0 0 0 255 ECU_ADDRESS 0x4000463D /end MEASUREMENT
/begin MEASUREMENT LEA_obd_ii_P0356_flags "Stored monitor/maturation state for P0356 (ignition coil 6). Log it to catch this fault maturing during a drive." UBYTE NO_COMPU_METHOD 0 0 0 255 ECU_ADDRESS 0x4000463E /end MEASUREMENT
/begin MEASUREMENT LEA_obd_ii_P0356_fail_counter "uint8_t" UBYTE NO_COMPU_METHOD 0 0 0 255 ECU_ADDRESS 0x4000463F /end MEASUREMENT
/begin MEASUREMENT LEA_obd_ii_P0356_pass_counter "uint8_t" UBYTE NO_COMPU_METHOD 0 0 0 255 ECU_ADDRESS 0x40004640 /end MEASUREMENT
/begin MEASUREMENT LEA_obd_ii_P1301_flags "Stored monitor/maturation state for P1301 (mfr misfire (cat/igniter)). Log it to catch this fault maturing during a drive." UBYTE NO_COMPU_METHOD 0 0 0 255 ECU_ADDRESS 0x40004641 /end MEASUREMENT
/begin MEASUREMENT LEA_obd_ii_P1301_fail_counter "uint8_t" UBYTE NO_COMPU_METHOD 0 0 0 255 ECU_ADDRESS 0x40004642 /end MEASUREMENT
/begin MEASUREMENT LEA_obd_ii_P1301_pass_counter "uint8_t" UBYTE NO_COMPU_METHOD 0 0 0 255 ECU_ADDRESS 0x40004643 /end MEASUREMENT
/begin MEASUREMENT LEA_obd_ii_P1302_flags "Stored monitor/maturation state for P1302 (mfr misfire). Log it to catch this fault maturing during a drive." UBYTE NO_COMPU_METHOD 0 0 0 255 ECU_ADDRESS 0x40004644 /end MEASUREMENT
/begin MEASUREMENT LEA_obd_ii_P1302_fail_counter "uint8_t" UBYTE NO_COMPU_METHOD 0 0 0 255 ECU_ADDRESS 0x40004645 /end MEASUREMENT
/begin MEASUREMENT LEA_obd_ii_P1302_pass_counter "uint8_t" UBYTE NO_COMPU_METHOD 0 0 0 255 ECU_ADDRESS 0x40004646 /end MEASUREMENT
/begin MEASUREMENT LEA_obd_ii_P0420_flags "Stored monitor/maturation state for P0420 (catalyst efficiency bank1). Log it to catch this fault maturing during a drive." UBYTE NO_COMPU_METHOD 0 0 0 255 ECU_ADDRESS 0x40004647 /end MEASUREMENT
/begin MEASUREMENT LEA_obd_ii_P0420_fail_counter "uint8_t" UBYTE NO_COMPU_METHOD 0 0 0 255 ECU_ADDRESS 0x40004648 /end MEASUREMENT
/begin MEASUREMENT LEA_obd_ii_P0420_pass_counter "uint8_t" UBYTE NO_COMPU_METHOD 0 0 0 255 ECU_ADDRESS 0x40004649 /end MEASUREMENT
/begin MEASUREMENT LEA_obd_ii_P0430_flags "Stored monitor/maturation state for P0430 (catalyst efficiency bank2). Log it to catch this fault maturing during a drive." UBYTE NO_COMPU_METHOD 0 0 0 255 ECU_ADDRESS 0x4000464A /end MEASUREMENT
/begin MEASUREMENT LEA_obd_ii_P0430_fail_counter "uint8_t" UBYTE NO_COMPU_METHOD 0 0 0 255 ECU_ADDRESS 0x4000464B /end MEASUREMENT
/begin MEASUREMENT LEA_obd_ii_P0430_pass_counter "uint8_t" UBYTE NO_COMPU_METHOD 0 0 0 255 ECU_ADDRESS 0x4000464C /end MEASUREMENT
/begin MEASUREMENT LEA_obd_ii_P0441_flags "Stored monitor/maturation state for P0441 (EVAP purge flow). Log it to catch this fault maturing during a drive." UBYTE NO_COMPU_METHOD 0 0 0 255 ECU_ADDRESS 0x4000464D /end MEASUREMENT
/begin MEASUREMENT LEA_obd_ii_P0441_fail_counter "uint8_t" UBYTE NO_COMPU_METHOD 0 0 0 255 ECU_ADDRESS 0x4000464E /end MEASUREMENT
/begin MEASUREMENT LEA_obd_ii_P0441_pass_counter "uint8_t" UBYTE NO_COMPU_METHOD 0 0 0 255 ECU_ADDRESS 0x4000464F /end MEASUREMENT
/begin MEASUREMENT LEA_obd_ii_P0442_flags "Stored monitor/maturation state for P0442 (EVAP small leak). Log it to catch this fault maturing during a drive." UBYTE NO_COMPU_METHOD 0 0 0 255 ECU_ADDRESS 0x40004650 /end MEASUREMENT
/begin MEASUREMENT LEA_obd_ii_P0442_fail_counter "uint8_t" UBYTE NO_COMPU_METHOD 0 0 0 255 ECU_ADDRESS 0x40004651 /end MEASUREMENT
/begin MEASUREMENT LEA_obd_ii_P0442_pass_counter "uint8_t" UBYTE NO_COMPU_METHOD 0 0 0 255 ECU_ADDRESS 0x40004652 /end MEASUREMENT
/begin MEASUREMENT LEA_obd_ii_P0444_flags "Stored monitor/maturation state for P0444 (EVAP purge valve open). Log it to catch this fault maturing during a drive." UBYTE NO_COMPU_METHOD 0 0 0 255 ECU_ADDRESS 0x40004653 /end MEASUREMENT
/begin MEASUREMENT LEA_obd_ii_P0444_fail_counter "uint8_t" UBYTE NO_COMPU_METHOD 0 0 0 255 ECU_ADDRESS 0x40004654 /end MEASUREMENT
/begin MEASUREMENT LEA_obd_ii_P0444_pass_counter "uint8_t" UBYTE NO_COMPU_METHOD 0 0 0 255 ECU_ADDRESS 0x40004655 /end MEASUREMENT
/begin MEASUREMENT LEA_obd_ii_P0445_flags "Stored monitor/maturation state for P0445 (EVAP purge valve shorted). Log it to catch this fault maturing during a drive." UBYTE NO_COMPU_METHOD 0 0 0 255 ECU_ADDRESS 0x40004656 /end MEASUREMENT
/begin MEASUREMENT LEA_obd_ii_P0445_fail_counter "uint8_t" UBYTE NO_COMPU_METHOD 0 0 0 255 ECU_ADDRESS 0x40004657 /end MEASUREMENT
/begin MEASUREMENT LEA_obd_ii_P0445_pass_counter "uint8_t" UBYTE NO_COMPU_METHOD 0 0 0 255 ECU_ADDRESS 0x40004658 /end MEASUREMENT
/begin MEASUREMENT LEA_obd_ii_P0446_flags "Stored monitor/maturation state for P0446 (EVAP vent control). Log it to catch this fault maturing during a drive." UBYTE NO_COMPU_METHOD 0 0 0 255 ECU_ADDRESS 0x40004659 /end MEASUREMENT
/begin MEASUREMENT LEA_obd_ii_P0446_fail_counter "uint8_t" UBYTE NO_COMPU_METHOD 0 0 0 255 ECU_ADDRESS 0x4000465A /end MEASUREMENT
/begin MEASUREMENT LEA_obd_ii_P0446_pass_counter "uint8_t" UBYTE NO_COMPU_METHOD 0 0 0 255 ECU_ADDRESS 0x4000465B /end MEASUREMENT
/begin MEASUREMENT LEA_obd_ii_P0447_flags "Stored monitor/maturation state for P0447 (EVAP vent open). Log it to catch this fault maturing during a drive." UBYTE NO_COMPU_METHOD 0 0 0 255 ECU_ADDRESS 0x4000465C /end MEASUREMENT
/begin MEASUREMENT LEA_obd_ii_P0447_fail_counter "uint8_t" UBYTE NO_COMPU_METHOD 0 0 0 255 ECU_ADDRESS 0x4000465D /end MEASUREMENT
/begin MEASUREMENT LEA_obd_ii_P0447_pass_counter "uint8_t" UBYTE NO_COMPU_METHOD 0 0 0 255 ECU_ADDRESS 0x4000465E /end MEASUREMENT
/begin MEASUREMENT LEA_obd_ii_P0448_flags "Stored monitor/maturation state for P0448 (EVAP vent shorted). Log it to catch this fault maturing during a drive." UBYTE NO_COMPU_METHOD 0 0 0 255 ECU_ADDRESS 0x4000465F /end MEASUREMENT
/begin MEASUREMENT LEA_obd_ii_P0448_fail_counter "uint8_t" UBYTE NO_COMPU_METHOD 0 0 0 255 ECU_ADDRESS 0x40004660 /end MEASUREMENT
/begin MEASUREMENT LEA_obd_ii_P0448_pass_counter "uint8_t" UBYTE NO_COMPU_METHOD 0 0 0 255 ECU_ADDRESS 0x40004661 /end MEASUREMENT
/begin MEASUREMENT LEA_obd_ii_P0451_flags "Stored monitor/maturation state for P0451 (EVAP pressure sensor rationality). Log it to catch this fault maturing during a drive." UBYTE NO_COMPU_METHOD 0 0 0 255 ECU_ADDRESS 0x40004662 /end MEASUREMENT
/begin MEASUREMENT LEA_obd_ii_P0451_fail_counter "uint8_t" UBYTE NO_COMPU_METHOD 0 0 0 255 ECU_ADDRESS 0x40004663 /end MEASUREMENT
/begin MEASUREMENT LEA_obd_ii_P0451_pass_counter "uint8_t" UBYTE NO_COMPU_METHOD 0 0 0 255 ECU_ADDRESS 0x40004664 /end MEASUREMENT
/begin MEASUREMENT LEA_obd_ii_P0452_flags "Stored monitor/maturation state for P0452 (EVAP pressure sensor low). Log it to catch this fault maturing during a drive." UBYTE NO_COMPU_METHOD 0 0 0 255 ECU_ADDRESS 0x40004665 /end MEASUREMENT
/begin MEASUREMENT LEA_obd_ii_P0452_fail_counter "uint8_t" UBYTE NO_COMPU_METHOD 0 0 0 255 ECU_ADDRESS 0x40004666 /end MEASUREMENT
/begin MEASUREMENT LEA_obd_ii_P0452_pass_counter "uint8_t" UBYTE NO_COMPU_METHOD 0 0 0 255 ECU_ADDRESS 0x40004667 /end MEASUREMENT
/begin MEASUREMENT LEA_obd_ii_P0453_flags "Stored monitor/maturation state for P0453 (EVAP pressure sensor high). Log it to catch this fault maturing during a drive." UBYTE NO_COMPU_METHOD 0 0 0 255 ECU_ADDRESS 0x40004668 /end MEASUREMENT
/begin MEASUREMENT LEA_obd_ii_P0453_fail_counter "uint8_t" UBYTE NO_COMPU_METHOD 0 0 0 255 ECU_ADDRESS 0x40004669 /end MEASUREMENT
/begin MEASUREMENT LEA_obd_ii_P0453_pass_counter "uint8_t" UBYTE NO_COMPU_METHOD 0 0 0 255 ECU_ADDRESS 0x4000466A /end MEASUREMENT
/begin MEASUREMENT LEA_obd_ii_P0455_flags "Stored monitor/maturation state for P0455 (EVAP large leak). Log it to catch this fault maturing during a drive." UBYTE NO_COMPU_METHOD 0 0 0 255 ECU_ADDRESS 0x4000466B /end MEASUREMENT
/begin MEASUREMENT LEA_obd_ii_P0455_fail_counter "uint8_t" UBYTE NO_COMPU_METHOD 0 0 0 255 ECU_ADDRESS 0x4000466C /end MEASUREMENT
/begin MEASUREMENT LEA_obd_ii_P0455_pass_counter "uint8_t" UBYTE NO_COMPU_METHOD 0 0 0 255 ECU_ADDRESS 0x4000466D /end MEASUREMENT
/begin MEASUREMENT LEA_obd_ii_P0456_flags "Stored monitor/maturation state for P0456 (EVAP very small leak). Log it to catch this fault maturing during a drive." UBYTE NO_COMPU_METHOD 0 0 0 255 ECU_ADDRESS 0x4000466E /end MEASUREMENT
/begin MEASUREMENT LEA_obd_ii_P0456_fail_counter "uint8_t" UBYTE NO_COMPU_METHOD 0 0 0 255 ECU_ADDRESS 0x4000466F /end MEASUREMENT
/begin MEASUREMENT LEA_obd_ii_P0456_pass_counter "uint8_t" UBYTE NO_COMPU_METHOD 0 0 0 255 ECU_ADDRESS 0x40004670 /end MEASUREMENT
/begin MEASUREMENT LEA_obd_ii_P0461_flags "Stored monitor/maturation state for P0461 (fuel level sensor rationality). Log it to catch this fault maturing during a drive." UBYTE NO_COMPU_METHOD 0 0 0 255 ECU_ADDRESS 0x40004671 /end MEASUREMENT
/begin MEASUREMENT LEA_obd_ii_P0461_fail_counter "uint8_t" UBYTE NO_COMPU_METHOD 0 0 0 255 ECU_ADDRESS 0x40004672 /end MEASUREMENT
/begin MEASUREMENT LEA_obd_ii_P0461_pass_counter "uint8_t" UBYTE NO_COMPU_METHOD 0 0 0 255 ECU_ADDRESS 0x40004673 /end MEASUREMENT
/begin MEASUREMENT LEA_obd_ii_P0462_flags "Stored monitor/maturation state for P0462 (fuel level sensor low). Log it to catch this fault maturing during a drive." UBYTE NO_COMPU_METHOD 0 0 0 255 ECU_ADDRESS 0x40004674 /end MEASUREMENT
/begin MEASUREMENT LEA_obd_ii_P0462_fail_counter "uint8_t" UBYTE NO_COMPU_METHOD 0 0 0 255 ECU_ADDRESS 0x40004675 /end MEASUREMENT
/begin MEASUREMENT LEA_obd_ii_P0462_pass_counter "uint8_t" UBYTE NO_COMPU_METHOD 0 0 0 255 ECU_ADDRESS 0x40004676 /end MEASUREMENT
/begin MEASUREMENT LEA_obd_ii_P0463_flags "Stored monitor/maturation state for P0463 (fuel level sensor high). Log it to catch this fault maturing during a drive." UBYTE NO_COMPU_METHOD 0 0 0 255 ECU_ADDRESS 0x40004677 /end MEASUREMENT
/begin MEASUREMENT LEA_obd_ii_P0463_fail_counter "uint8_t" UBYTE NO_COMPU_METHOD 0 0 0 255 ECU_ADDRESS 0x40004678 /end MEASUREMENT
/begin MEASUREMENT LEA_obd_ii_P0463_pass_counter "uint8_t" UBYTE NO_COMPU_METHOD 0 0 0 255 ECU_ADDRESS 0x40004679 /end MEASUREMENT
/begin MEASUREMENT LEA_obd_ii_P0480_flags "Stored monitor/maturation state for P0480 (cooling fan1 relay). Log it to catch this fault maturing during a drive." UBYTE NO_COMPU_METHOD 0 0 0 255 ECU_ADDRESS 0x4000467A /end MEASUREMENT
/begin MEASUREMENT LEA_obd_ii_P0480_fail_counter "uint8_t" UBYTE NO_COMPU_METHOD 0 0 0 255 ECU_ADDRESS 0x4000467B /end MEASUREMENT
/begin MEASUREMENT LEA_obd_ii_P0480_pass_counter "uint8_t" UBYTE NO_COMPU_METHOD 0 0 0 255 ECU_ADDRESS 0x4000467C /end MEASUREMENT
/begin MEASUREMENT LEA_obd_ii_P0481_flags "Stored monitor/maturation state for P0481 (cooling fan2 relay). Log it to catch this fault maturing during a drive." UBYTE NO_COMPU_METHOD 0 0 0 255 ECU_ADDRESS 0x4000467D /end MEASUREMENT
/begin MEASUREMENT LEA_obd_ii_P0481_fail_counter "uint8_t" UBYTE NO_COMPU_METHOD 0 0 0 255 ECU_ADDRESS 0x4000467E /end MEASUREMENT
/begin MEASUREMENT LEA_obd_ii_P0481_pass_counter "uint8_t" UBYTE NO_COMPU_METHOD 0 0 0 255 ECU_ADDRESS 0x4000467F /end MEASUREMENT
/begin MEASUREMENT LEA_obd_ii_P0482_flags "Stored monitor/maturation state for P0482 (cooling fan3 relay). Log it to catch this fault maturing during a drive." UBYTE NO_COMPU_METHOD 0 0 0 255 ECU_ADDRESS 0x40004680 /end MEASUREMENT
/begin MEASUREMENT LEA_obd_ii_P0482_fail_counter "uint8_t" UBYTE NO_COMPU_METHOD 0 0 0 255 ECU_ADDRESS 0x40004681 /end MEASUREMENT
/begin MEASUREMENT LEA_obd_ii_P0482_pass_counter "uint8_t" UBYTE NO_COMPU_METHOD 0 0 0 255 ECU_ADDRESS 0x40004682 /end MEASUREMENT
/begin MEASUREMENT LEA_obd_ii_P0500_flags "Stored monitor/maturation state for P0500 (vehicle speed sensor). Log it to catch this fault maturing during a drive." UBYTE NO_COMPU_METHOD 0 0 0 255 ECU_ADDRESS 0x40004683 /end MEASUREMENT
/begin MEASUREMENT LEA_obd_ii_P0500_fail_counter "uint8_t" UBYTE NO_COMPU_METHOD 0 0 0 255 ECU_ADDRESS 0x40004684 /end MEASUREMENT
/begin MEASUREMENT LEA_obd_ii_P0500_pass_counter "uint8_t" UBYTE NO_COMPU_METHOD 0 0 0 255 ECU_ADDRESS 0x40004685 /end MEASUREMENT
/begin MEASUREMENT LEA_obd_ii_P0506_flags "Stored monitor/maturation state for P0506 (idle speed too low). Log it to catch this fault maturing during a drive." UBYTE NO_COMPU_METHOD 0 0 0 255 ECU_ADDRESS 0x40004686 /end MEASUREMENT
/begin MEASUREMENT LEA_obd_ii_P0506_fail_counter "uint8_t" UBYTE NO_COMPU_METHOD 0 0 0 255 ECU_ADDRESS 0x40004687 /end MEASUREMENT
/begin MEASUREMENT LEA_obd_ii_P0506_pass_counter "uint8_t" UBYTE NO_COMPU_METHOD 0 0 0 255 ECU_ADDRESS 0x40004688 /end MEASUREMENT
/begin MEASUREMENT LEA_obd_ii_P0507_flags "Stored monitor/maturation state for P0507 (idle speed too high). Log it to catch this fault maturing during a drive." UBYTE NO_COMPU_METHOD 0 0 0 255 ECU_ADDRESS 0x40004689 /end MEASUREMENT
/begin MEASUREMENT LEA_obd_ii_P0507_fail_counter "uint8_t" UBYTE NO_COMPU_METHOD 0 0 0 255 ECU_ADDRESS 0x4000468A /end MEASUREMENT
/begin MEASUREMENT LEA_obd_ii_P0507_pass_counter "uint8_t" UBYTE NO_COMPU_METHOD 0 0 0 255 ECU_ADDRESS 0x4000468B /end MEASUREMENT
/begin MEASUREMENT LEA_obd_ii_P050A_flags "Learned value: P050A flags. A value the ECU learns over time -- log it to track adaptation and spot a developing fault." UBYTE NO_COMPU_METHOD 0 0 0 255 ECU_ADDRESS 0x4000468C /end MEASUREMENT
/begin MEASUREMENT LEA_obd_ii_P050A_fail_counter "uint8_t" UBYTE NO_COMPU_METHOD 0 0 0 255 ECU_ADDRESS 0x4000468D /end MEASUREMENT
/begin MEASUREMENT LEA_obd_ii_P050A_pass_counter "uint8_t" UBYTE NO_COMPU_METHOD 0 0 0 255 ECU_ADDRESS 0x4000468E /end MEASUREMENT
/begin MEASUREMENT LEA_obd_ii_P050B_flags "Learned value: P050B flags. A value the ECU learns over time -- log it to track adaptation and spot a developing fault." UBYTE NO_COMPU_METHOD 0 0 0 255 ECU_ADDRESS 0x4000468F /end MEASUREMENT
/begin MEASUREMENT LEA_obd_ii_P050B_fail_counter "uint8_t" UBYTE NO_COMPU_METHOD 0 0 0 255 ECU_ADDRESS 0x40004690 /end MEASUREMENT
/begin MEASUREMENT LEA_obd_ii_P050B_pass_counter "uint8_t" UBYTE NO_COMPU_METHOD 0 0 0 255 ECU_ADDRESS 0x40004691 /end MEASUREMENT
/begin MEASUREMENT LEA_obd_ii_P0523_flags "Stored monitor/maturation state for P0523 (oil pressure sensor/switch high). Log it to catch this fault maturing during a drive." UBYTE NO_COMPU_METHOD 0 0 0 255 ECU_ADDRESS 0x40004692 /end MEASUREMENT
/begin MEASUREMENT LEA_obd_ii_P0523_fail_counter "uint8_t" UBYTE NO_COMPU_METHOD 0 0 0 255 ECU_ADDRESS 0x40004693 /end MEASUREMENT
/begin MEASUREMENT LEA_obd_ii_P0523_pass_counter "uint8_t" UBYTE NO_COMPU_METHOD 0 0 0 255 ECU_ADDRESS 0x40004694 /end MEASUREMENT
/begin MEASUREMENT LEA_obd_ii_P0537_flags "Stored monitor/maturation state for P0537 (A/C evap temp sensor low). Log it to catch this fault maturing during a drive." UBYTE NO_COMPU_METHOD 0 0 0 255 ECU_ADDRESS 0x40004695 /end MEASUREMENT
/begin MEASUREMENT LEA_obd_ii_P0537_fail_counter "uint8_t" UBYTE NO_COMPU_METHOD 0 0 0 255 ECU_ADDRESS 0x40004696 /end MEASUREMENT
/begin MEASUREMENT LEA_obd_ii_P0537_pass_counter "uint8_t" UBYTE NO_COMPU_METHOD 0 0 0 255 ECU_ADDRESS 0x40004697 /end MEASUREMENT
/begin MEASUREMENT LEA_obd_ii_P0538_flags "Stored monitor/maturation state for P0538 (A/C evap temp sensor high). Log it to catch this fault maturing during a drive." UBYTE NO_COMPU_METHOD 0 0 0 255 ECU_ADDRESS 0x40004698 /end MEASUREMENT
/begin MEASUREMENT LEA_obd_ii_P0538_fail_counter "uint8_t" UBYTE NO_COMPU_METHOD 0 0 0 255 ECU_ADDRESS 0x40004699 /end MEASUREMENT
/begin MEASUREMENT LEA_obd_ii_P0538_pass_counter "uint8_t" UBYTE NO_COMPU_METHOD 0 0 0 255 ECU_ADDRESS 0x4000469A /end MEASUREMENT
/begin MEASUREMENT LEA_obd_ii_P0562_flags "Stored monitor/maturation state for P0562 (system voltage low). Log it to catch this fault maturing during a drive." UBYTE NO_COMPU_METHOD 0 0 0 255 ECU_ADDRESS 0x4000469B /end MEASUREMENT
/begin MEASUREMENT LEA_obd_ii_P0562_fail_counter "uint8_t" UBYTE NO_COMPU_METHOD 0 0 0 255 ECU_ADDRESS 0x4000469C /end MEASUREMENT
/begin MEASUREMENT LEA_obd_ii_P0562_pass_counter "uint8_t" UBYTE NO_COMPU_METHOD 0 0 0 255 ECU_ADDRESS 0x4000469D /end MEASUREMENT
/begin MEASUREMENT LEA_obd_ii_P0563_flags "Stored monitor/maturation state for P0563 (system voltage high). Log it to catch this fault maturing during a drive." UBYTE NO_COMPU_METHOD 0 0 0 255 ECU_ADDRESS 0x4000469E /end MEASUREMENT
/begin MEASUREMENT LEA_obd_ii_P0563_fail_counter "uint8_t" UBYTE NO_COMPU_METHOD 0 0 0 255 ECU_ADDRESS 0x4000469F /end MEASUREMENT
/begin MEASUREMENT LEA_obd_ii_P0563_pass_counter "uint8_t" UBYTE NO_COMPU_METHOD 0 0 0 255 ECU_ADDRESS 0x400046A0 /end MEASUREMENT
/begin MEASUREMENT LEA_obd_ii_P0571_flags "Stored monitor/maturation state for P0571 (brake switch). Log it to catch this fault maturing during a drive." UBYTE NO_COMPU_METHOD 0 0 0 255 ECU_ADDRESS 0x400046A1 /end MEASUREMENT
/begin MEASUREMENT LEA_obd_ii_P0571_fail_counter "uint8_t" UBYTE NO_COMPU_METHOD 0 0 0 255 ECU_ADDRESS 0x400046A2 /end MEASUREMENT
/begin MEASUREMENT LEA_obd_ii_P0571_pass_counter "uint8_t" UBYTE NO_COMPU_METHOD 0 0 0 255 ECU_ADDRESS 0x400046A3 /end MEASUREMENT
/begin MEASUREMENT LEA_obd_ii_P0578_flags "Stored monitor/maturation state for P0578 (cruise switch stuck). Log it to catch this fault maturing during a drive." UBYTE NO_COMPU_METHOD 0 0 0 255 ECU_ADDRESS 0x400046A4 /end MEASUREMENT
/begin MEASUREMENT LEA_obd_ii_P0578_fail_counter "uint8_t" UBYTE NO_COMPU_METHOD 0 0 0 255 ECU_ADDRESS 0x400046A5 /end MEASUREMENT
/begin MEASUREMENT LEA_obd_ii_P0578_pass_counter "uint8_t" UBYTE NO_COMPU_METHOD 0 0 0 255 ECU_ADDRESS 0x400046A6 /end MEASUREMENT
/begin MEASUREMENT LEA_obd_ii_P0579_flags "Stored monitor/maturation state for P0579 (cruise switch rationality). Log it to catch this fault maturing during a drive." UBYTE NO_COMPU_METHOD 0 0 0 255 ECU_ADDRESS 0x400046A7 /end MEASUREMENT
/begin MEASUREMENT LEA_obd_ii_P0579_fail_counter "uint8_t" UBYTE NO_COMPU_METHOD 0 0 0 255 ECU_ADDRESS 0x400046A8 /end MEASUREMENT
/begin MEASUREMENT LEA_obd_ii_P0579_pass_counter "uint8_t" UBYTE NO_COMPU_METHOD 0 0 0 255 ECU_ADDRESS 0x400046A9 /end MEASUREMENT
/begin MEASUREMENT LEA_obd_ii_P0564_flags "Stored monitor/maturation state for P0564 (cruise control input). Log it to catch this fault maturing during a drive." UBYTE NO_COMPU_METHOD 0 0 0 255 ECU_ADDRESS 0x400046AA /end MEASUREMENT
/begin MEASUREMENT LEA_obd_ii_P0564_fail_counter "uint8_t" UBYTE NO_COMPU_METHOD 0 0 0 255 ECU_ADDRESS 0x400046AB /end MEASUREMENT
/begin MEASUREMENT LEA_obd_ii_P0564_pass_counter "uint8_t" UBYTE NO_COMPU_METHOD 0 0 0 255 ECU_ADDRESS 0x400046AC /end MEASUREMENT
/begin MEASUREMENT LEA_obd_ii_P0601_flags "Stored monitor/maturation state for P0601 (ECU memory checksum). Log it to catch this fault maturing during a drive." UBYTE NO_COMPU_METHOD 0 0 0 255 ECU_ADDRESS 0x400046AD /end MEASUREMENT
/begin MEASUREMENT LEA_obd_ii_P0601_fail_counter "uint8_t" UBYTE NO_COMPU_METHOD 0 0 0 255 ECU_ADDRESS 0x400046AE /end MEASUREMENT
/begin MEASUREMENT LEA_obd_ii_P0601_pass_counter "uint8_t" UBYTE NO_COMPU_METHOD 0 0 0 255 ECU_ADDRESS 0x400046AF /end MEASUREMENT
/begin MEASUREMENT LEA_obd_ii_P0606_flags "Stored monitor/maturation state for P0606 (ECU processor fault). Log it to catch this fault maturing during a drive." UBYTE NO_COMPU_METHOD 0 0 0 255 ECU_ADDRESS 0x400046B0 /end MEASUREMENT
/begin MEASUREMENT LEA_obd_ii_P0606_fail_counter "uint8_t" UBYTE NO_COMPU_METHOD 0 0 0 255 ECU_ADDRESS 0x400046B1 /end MEASUREMENT
/begin MEASUREMENT LEA_obd_ii_P0606_pass_counter "uint8_t" UBYTE NO_COMPU_METHOD 0 0 0 255 ECU_ADDRESS 0x400046B2 /end MEASUREMENT
/begin MEASUREMENT LEA_obd_ii_P0610_flags "Stored monitor/maturation state for P0610 (vehicle options error). Log it to catch this fault maturing during a drive." UBYTE NO_COMPU_METHOD 0 0 0 255 ECU_ADDRESS 0x400046B3 /end MEASUREMENT
/begin MEASUREMENT LEA_obd_ii_P0610_fail_counter "uint8_t" UBYTE NO_COMPU_METHOD 0 0 0 255 ECU_ADDRESS 0x400046B4 /end MEASUREMENT
/begin MEASUREMENT LEA_obd_ii_P0610_pass_counter "uint8_t" UBYTE NO_COMPU_METHOD 0 0 0 255 ECU_ADDRESS 0x400046B5 /end MEASUREMENT
/begin MEASUREMENT LEA_obd_ii_P0141_flags_400046B6 "Stored monitor/maturation state for P0141 (O2 B1S2 heater). Log it to catch this fault maturing during a drive." UBYTE NO_COMPU_METHOD 0 0 0 255 ECU_ADDRESS 0x400046B6 /end MEASUREMENT
/begin MEASUREMENT LEA_obd_ii_P0141_fail_counter_400046B7 "uint8_t" UBYTE NO_COMPU_METHOD 0 0 0 255 ECU_ADDRESS 0x400046B7 /end MEASUREMENT
/begin MEASUREMENT LEA_obd_ii_P0141_pass_counter_400046B8 "uint8_t" UBYTE NO_COMPU_METHOD 0 0 0 255 ECU_ADDRESS 0x400046B8 /end MEASUREMENT
/begin MEASUREMENT LEA_obd_ii_P0628_flags "Stored monitor/maturation state for P0628 (fuel pump control low). Log it to catch this fault maturing during a drive." UBYTE NO_COMPU_METHOD 0 0 0 255 ECU_ADDRESS 0x400046B9 /end MEASUREMENT
/begin MEASUREMENT LEA_obd_ii_P0628_fail_counter "uint8_t" UBYTE NO_COMPU_METHOD 0 0 0 255 ECU_ADDRESS 0x400046BA /end MEASUREMENT
/begin MEASUREMENT LEA_obd_ii_P0628_pass_counter "uint8_t" UBYTE NO_COMPU_METHOD 0 0 0 255 ECU_ADDRESS 0x400046BB /end MEASUREMENT
/begin MEASUREMENT LEA_obd_ii_P0629_flags "Stored monitor/maturation state for P0629 (fuel pump control high). Log it to catch this fault maturing during a drive." UBYTE NO_COMPU_METHOD 0 0 0 255 ECU_ADDRESS 0x400046BC /end MEASUREMENT
/begin MEASUREMENT LEA_obd_ii_P0629_fail_counter "uint8_t" UBYTE NO_COMPU_METHOD 0 0 0 255 ECU_ADDRESS 0x400046BD /end MEASUREMENT
/begin MEASUREMENT LEA_obd_ii_P0629_pass_counter "uint8_t" UBYTE NO_COMPU_METHOD 0 0 0 255 ECU_ADDRESS 0x400046BE /end MEASUREMENT
/begin MEASUREMENT LEA_obd_ii_P0630_flags "Stored monitor/maturation state for P0630 (VIN not programmed). Log it to catch this fault maturing during a drive." UBYTE NO_COMPU_METHOD 0 0 0 255 ECU_ADDRESS 0x400046BF /end MEASUREMENT
/begin MEASUREMENT LEA_obd_ii_P0630_fail_counter "uint8_t" UBYTE NO_COMPU_METHOD 0 0 0 255 ECU_ADDRESS 0x400046C0 /end MEASUREMENT
/begin MEASUREMENT LEA_obd_ii_P0630_pass_counter "uint8_t" UBYTE NO_COMPU_METHOD 0 0 0 255 ECU_ADDRESS 0x400046C1 /end MEASUREMENT
/begin MEASUREMENT LEA_obd_ii_P0638_flags "Stored monitor/maturation state for P0638 (throttle actuator control rationality bank1). Log it to catch this fault maturing during a drive." UBYTE NO_COMPU_METHOD 0 0 0 255 ECU_ADDRESS 0x400046C2 /end MEASUREMENT
/begin MEASUREMENT LEA_obd_ii_P0638_fail_counter "uint8_t" UBYTE NO_COMPU_METHOD 0 0 0 255 ECU_ADDRESS 0x400046C3 /end MEASUREMENT
/begin MEASUREMENT LEA_obd_ii_P0638_pass_counter "uint8_t" UBYTE NO_COMPU_METHOD 0 0 0 255 ECU_ADDRESS 0x400046C4 /end MEASUREMENT
/begin MEASUREMENT LEA_obd_ii_P0647_flags "Stored monitor/maturation state for P0647 (A/C clutch relay high). Log it to catch this fault maturing during a drive." UBYTE NO_COMPU_METHOD 0 0 0 255 ECU_ADDRESS 0x400046C5 /end MEASUREMENT
/begin MEASUREMENT LEA_obd_ii_P0647_fail_counter "uint8_t" UBYTE NO_COMPU_METHOD 0 0 0 255 ECU_ADDRESS 0x400046C6 /end MEASUREMENT
/begin MEASUREMENT LEA_obd_ii_P0647_pass_counter "uint8_t" UBYTE NO_COMPU_METHOD 0 0 0 255 ECU_ADDRESS 0x400046C7 /end MEASUREMENT
/begin MEASUREMENT LEA_obd_ii_P0646_flags "Stored monitor/maturation state for P0646 (A/C clutch relay low). Log it to catch this fault maturing during a drive." UBYTE NO_COMPU_METHOD 0 0 0 255 ECU_ADDRESS 0x400046C8 /end MEASUREMENT
/begin MEASUREMENT LEA_obd_ii_P0646_fail_counter "uint8_t" UBYTE NO_COMPU_METHOD 0 0 0 255 ECU_ADDRESS 0x400046C9 /end MEASUREMENT
/begin MEASUREMENT LEA_obd_ii_P0646_pass_counter "uint8_t" UBYTE NO_COMPU_METHOD 0 0 0 255 ECU_ADDRESS 0x400046CA /end MEASUREMENT
/begin MEASUREMENT LEA_obd_ii_P0685_flags "Stored monitor/maturation state for P0685 (ECU power relay). Log it to catch this fault maturing during a drive." UBYTE NO_COMPU_METHOD 0 0 0 255 ECU_ADDRESS 0x400046CB /end MEASUREMENT
/begin MEASUREMENT LEA_obd_ii_P0685_fail_counter "uint8_t" UBYTE NO_COMPU_METHOD 0 0 0 255 ECU_ADDRESS 0x400046CC /end MEASUREMENT
/begin MEASUREMENT LEA_obd_ii_P0685_pass_counter "uint8_t" UBYTE NO_COMPU_METHOD 0 0 0 255 ECU_ADDRESS 0x400046CD /end MEASUREMENT
/begin MEASUREMENT LEA_obd_ii_P0700_flags "Stored monitor/maturation state for P0700 (transmission MIL request). Log it to catch this fault maturing during a drive." UBYTE NO_COMPU_METHOD 0 0 0 255 ECU_ADDRESS 0x400046CE /end MEASUREMENT
/begin MEASUREMENT LEA_obd_ii_P0700_fail_counter "uint8_t" UBYTE NO_COMPU_METHOD 0 0 0 255 ECU_ADDRESS 0x400046CF /end MEASUREMENT
/begin MEASUREMENT LEA_obd_ii_P0700_pass_counter "uint8_t" UBYTE NO_COMPU_METHOD 0 0 0 255 ECU_ADDRESS 0x400046D0 /end MEASUREMENT
/begin MEASUREMENT LEA_obd_ii_P0806_flags "Stored monitor/maturation state for P0806 (clutch position sensor rationality). Log it to catch this fault maturing during a drive." UBYTE NO_COMPU_METHOD 0 0 0 255 ECU_ADDRESS 0x400046D1 /end MEASUREMENT
/begin MEASUREMENT LEA_obd_ii_P0806_fail_counter "uint8_t" UBYTE NO_COMPU_METHOD 0 0 0 255 ECU_ADDRESS 0x400046D2 /end MEASUREMENT
/begin MEASUREMENT LEA_obd_ii_P0806_pass_counter "uint8_t" UBYTE NO_COMPU_METHOD 0 0 0 255 ECU_ADDRESS 0x400046D3 /end MEASUREMENT
/begin MEASUREMENT LEA_obd_ii_P1809_flags "Stored monitor/maturation state for P1809 (mfr transmission). Log it to catch this fault maturing during a drive." UBYTE NO_COMPU_METHOD 0 0 0 255 ECU_ADDRESS 0x400046D4 /end MEASUREMENT
/begin MEASUREMENT LEA_obd_ii_P1809_fail_counter "uint8_t" UBYTE NO_COMPU_METHOD 0 0 0 255 ECU_ADDRESS 0x400046D5 /end MEASUREMENT
/begin MEASUREMENT LEA_obd_ii_P1809_pass_counter "uint8_t" UBYTE NO_COMPU_METHOD 0 0 0 255 ECU_ADDRESS 0x400046D6 /end MEASUREMENT
/begin MEASUREMENT LEA_obd_ii_P0807_flags "Stored monitor/maturation state for P0807 (clutch position sensor low). Log it to catch this fault maturing during a drive." UBYTE NO_COMPU_METHOD 0 0 0 255 ECU_ADDRESS 0x400046D7 /end MEASUREMENT
/begin MEASUREMENT LEA_obd_ii_P0807_fail_counter "uint8_t" UBYTE NO_COMPU_METHOD 0 0 0 255 ECU_ADDRESS 0x400046D8 /end MEASUREMENT
/begin MEASUREMENT LEA_obd_ii_P0807_pass_counter "uint8_t" UBYTE NO_COMPU_METHOD 0 0 0 255 ECU_ADDRESS 0x400046D9 /end MEASUREMENT
/begin MEASUREMENT LEA_obd_ii_P0808_flags "Stored monitor/maturation state for P0808 (clutch position sensor high). Log it to catch this fault maturing during a drive." UBYTE NO_COMPU_METHOD 0 0 0 255 ECU_ADDRESS 0x400046DA /end MEASUREMENT
/begin MEASUREMENT LEA_obd_ii_P0808_fail_counter "uint8_t" UBYTE NO_COMPU_METHOD 0 0 0 255 ECU_ADDRESS 0x400046DB /end MEASUREMENT
/begin MEASUREMENT LEA_obd_ii_P0808_pass_counter "uint8_t" UBYTE NO_COMPU_METHOD 0 0 0 255 ECU_ADDRESS 0x400046DC /end MEASUREMENT
/begin MEASUREMENT LEA_obd_ii_P1106_flags "Stored monitor/maturation state for P1106 (mfr MAP/baro intermittent). Log it to catch this fault maturing during a drive." UBYTE NO_COMPU_METHOD 0 0 0 255 ECU_ADDRESS 0x400046DD /end MEASUREMENT
/begin MEASUREMENT LEA_obd_ii_P1106_fail_counter "uint8_t" UBYTE NO_COMPU_METHOD 0 0 0 255 ECU_ADDRESS 0x400046DE /end MEASUREMENT
/begin MEASUREMENT LEA_obd_ii_P1106_pass_counter "uint8_t" UBYTE NO_COMPU_METHOD 0 0 0 255 ECU_ADDRESS 0x400046DF /end MEASUREMENT
/begin MEASUREMENT LEA_obd_ii_P1562_flags "Stored monitor/maturation state for P1562 (mfr ECU supply voltage). Log it to catch this fault maturing during a drive." UBYTE NO_COMPU_METHOD 0 0 0 255 ECU_ADDRESS 0x400046E0 /end MEASUREMENT
/begin MEASUREMENT LEA_obd_ii_P1562_fail_counter "uint8_t" UBYTE NO_COMPU_METHOD 0 0 0 255 ECU_ADDRESS 0x400046E1 /end MEASUREMENT
/begin MEASUREMENT LEA_obd_ii_P1562_pass_counter "uint8_t" UBYTE NO_COMPU_METHOD 0 0 0 255 ECU_ADDRESS 0x400046E2 /end MEASUREMENT
/begin MEASUREMENT LEA_obd_ii_P2122_flags "Stored monitor/maturation state for P2122 (pedal D low). Log it to catch this fault maturing during a drive." UBYTE NO_COMPU_METHOD 0 0 0 255 ECU_ADDRESS 0x400046E3 /end MEASUREMENT
/begin MEASUREMENT LEA_obd_ii_P2122_fail_counter "uint8_t" UBYTE NO_COMPU_METHOD 0 0 0 255 ECU_ADDRESS 0x400046E4 /end MEASUREMENT
/begin MEASUREMENT LEA_obd_ii_P2122_pass_counter "uint8_t" UBYTE NO_COMPU_METHOD 0 0 0 255 ECU_ADDRESS 0x400046E5 /end MEASUREMENT
/begin MEASUREMENT LEA_obd_ii_P2123_flags "Stored monitor/maturation state for P2123 (pedal D high). Log it to catch this fault maturing during a drive." UBYTE NO_COMPU_METHOD 0 0 0 255 ECU_ADDRESS 0x400046E6 /end MEASUREMENT
/begin MEASUREMENT LEA_obd_ii_P2123_fail_counter "uint8_t" UBYTE NO_COMPU_METHOD 0 0 0 255 ECU_ADDRESS 0x400046E7 /end MEASUREMENT
/begin MEASUREMENT LEA_obd_ii_P2123_pass_counter "uint8_t" UBYTE NO_COMPU_METHOD 0 0 0 255 ECU_ADDRESS 0x400046E8 /end MEASUREMENT
/begin MEASUREMENT LEA_obd_ii_P2127_flags "Stored monitor/maturation state for P2127 (pedal E low). Log it to catch this fault maturing during a drive." UBYTE NO_COMPU_METHOD 0 0 0 255 ECU_ADDRESS 0x400046E9 /end MEASUREMENT
/begin MEASUREMENT LEA_obd_ii_P2127_fail_counter "uint8_t" UBYTE NO_COMPU_METHOD 0 0 0 255 ECU_ADDRESS 0x400046EA /end MEASUREMENT
/begin MEASUREMENT LEA_obd_ii_P2127_pass_counter "uint8_t" UBYTE NO_COMPU_METHOD 0 0 0 255 ECU_ADDRESS 0x400046EB /end MEASUREMENT
/begin MEASUREMENT LEA_obd_ii_P2128_flags "Stored monitor/maturation state for P2128 (pedal E high). Log it to catch this fault maturing during a drive." UBYTE NO_COMPU_METHOD 0 0 0 255 ECU_ADDRESS 0x400046EC /end MEASUREMENT
/begin MEASUREMENT LEA_obd_ii_P2128_fail_counter "uint8_t" UBYTE NO_COMPU_METHOD 0 0 0 255 ECU_ADDRESS 0x400046ED /end MEASUREMENT
/begin MEASUREMENT LEA_obd_ii_P2128_pass_counter "uint8_t" UBYTE NO_COMPU_METHOD 0 0 0 255 ECU_ADDRESS 0x400046EE /end MEASUREMENT
/begin MEASUREMENT LEA_obd_ii_P2135_flags "Stored monitor/maturation state for P2135 (TPS A/B correlation). Log it to catch this fault maturing during a drive." UBYTE NO_COMPU_METHOD 0 0 0 255 ECU_ADDRESS 0x400046EF /end MEASUREMENT
/begin MEASUREMENT LEA_obd_ii_P2135_fail_counter "uint8_t" UBYTE NO_COMPU_METHOD 0 0 0 255 ECU_ADDRESS 0x400046F0 /end MEASUREMENT
/begin MEASUREMENT LEA_obd_ii_P2135_pass_counter "uint8_t" UBYTE NO_COMPU_METHOD 0 0 0 255 ECU_ADDRESS 0x400046F1 /end MEASUREMENT
/begin MEASUREMENT LEA_obd_ii_P2138_flags "Stored monitor/maturation state for P2138 (pedal D/E correlation). Log it to catch this fault maturing during a drive." UBYTE NO_COMPU_METHOD 0 0 0 255 ECU_ADDRESS 0x400046F2 /end MEASUREMENT
/begin MEASUREMENT LEA_obd_ii_P2138_fail_counter "uint8_t" UBYTE NO_COMPU_METHOD 0 0 0 255 ECU_ADDRESS 0x400046F3 /end MEASUREMENT
/begin MEASUREMENT LEA_obd_ii_P2138_pass_counter "uint8_t" UBYTE NO_COMPU_METHOD 0 0 0 255 ECU_ADDRESS 0x400046F4 /end MEASUREMENT
/begin MEASUREMENT LEA_obd_ii_P2173_flags "Stored monitor/maturation state for P2173 (high airflow / throttle). Log it to catch this fault maturing during a drive." UBYTE NO_COMPU_METHOD 0 0 0 255 ECU_ADDRESS 0x400046F5 /end MEASUREMENT
/begin MEASUREMENT LEA_obd_ii_P2173_fail_counter "uint8_t" UBYTE NO_COMPU_METHOD 0 0 0 255 ECU_ADDRESS 0x400046F6 /end MEASUREMENT
/begin MEASUREMENT LEA_obd_ii_P2173_pass_counter "uint8_t" UBYTE NO_COMPU_METHOD 0 0 0 255 ECU_ADDRESS 0x400046F7 /end MEASUREMENT
/begin MEASUREMENT LEA_obd_ii_P2602_flags "Stored monitor/maturation state for P2602 (coolant pump control low). Log it to catch this fault maturing during a drive." UBYTE NO_COMPU_METHOD 0 0 0 255 ECU_ADDRESS 0x400046F8 /end MEASUREMENT
/begin MEASUREMENT LEA_obd_ii_P2602_fail_counter "uint8_t" UBYTE NO_COMPU_METHOD 0 0 0 255 ECU_ADDRESS 0x400046F9 /end MEASUREMENT
/begin MEASUREMENT LEA_obd_ii_P2602_pass_counter "uint8_t" UBYTE NO_COMPU_METHOD 0 0 0 255 ECU_ADDRESS 0x400046FA /end MEASUREMENT
/begin MEASUREMENT LEA_obd_ii_P2603_flags "Stored monitor/maturation state for P2603 (coolant pump control high). Log it to catch this fault maturing during a drive." UBYTE NO_COMPU_METHOD 0 0 0 255 ECU_ADDRESS 0x400046FB /end MEASUREMENT
/begin MEASUREMENT LEA_obd_ii_P2603_fail_counter "uint8_t" UBYTE NO_COMPU_METHOD 0 0 0 255 ECU_ADDRESS 0x400046FC /end MEASUREMENT
/begin MEASUREMENT LEA_obd_ii_P2603_pass_counter "uint8_t" UBYTE NO_COMPU_METHOD 0 0 0 255 ECU_ADDRESS 0x400046FD /end MEASUREMENT
/begin MEASUREMENT LEA_obd_ii_P2104_flags "Stored monitor/maturation state for P2104 (throttle forced idle). Log it to catch this fault maturing during a drive." UBYTE NO_COMPU_METHOD 0 0 0 255 ECU_ADDRESS 0x4000470A /end MEASUREMENT
/begin MEASUREMENT LEA_obd_ii_P2104_fail_counter "uint8_t" UBYTE NO_COMPU_METHOD 0 0 0 255 ECU_ADDRESS 0x4000470B /end MEASUREMENT
/begin MEASUREMENT LEA_obd_ii_P2104_pass_counter "uint8_t" UBYTE NO_COMPU_METHOD 0 0 0 255 ECU_ADDRESS 0x4000470C /end MEASUREMENT
/begin MEASUREMENT LEA_obd_ii_P1104_flags "Stored monitor/maturation state for P1104 (mfr MAF/intake). Log it to catch this fault maturing during a drive." UBYTE NO_COMPU_METHOD 0 0 0 255 ECU_ADDRESS 0x4000470D /end MEASUREMENT
/begin MEASUREMENT LEA_obd_ii_P1104_fail_counter "uint8_t" UBYTE NO_COMPU_METHOD 0 0 0 255 ECU_ADDRESS 0x4000470E /end MEASUREMENT
/begin MEASUREMENT LEA_obd_ii_P1104_pass_counter "uint8_t" UBYTE NO_COMPU_METHOD 0 0 0 255 ECU_ADDRESS 0x4000470F /end MEASUREMENT
/begin MEASUREMENT LEA_obd_ii_P2105_flags "Stored monitor/maturation state for P2105 (throttle forced shutdown). Log it to catch this fault maturing during a drive." UBYTE NO_COMPU_METHOD 0 0 0 255 ECU_ADDRESS 0x40004710 /end MEASUREMENT
/begin MEASUREMENT LEA_obd_ii_P2105_fail_counter "uint8_t" UBYTE NO_COMPU_METHOD 0 0 0 255 ECU_ADDRESS 0x40004711 /end MEASUREMENT
/begin MEASUREMENT LEA_obd_ii_P2105_pass_counter "uint8_t" UBYTE NO_COMPU_METHOD 0 0 0 255 ECU_ADDRESS 0x40004712 /end MEASUREMENT
/begin MEASUREMENT LEA_obd_ii_P2106_flags "Stored monitor/maturation state for P2106 (throttle performance limited). Log it to catch this fault maturing during a drive." UBYTE NO_COMPU_METHOD 0 0 0 255 ECU_ADDRESS 0x40004713 /end MEASUREMENT
/begin MEASUREMENT LEA_obd_ii_P2106_fail_counter "uint8_t" UBYTE NO_COMPU_METHOD 0 0 0 255 ECU_ADDRESS 0x40004714 /end MEASUREMENT
/begin MEASUREMENT LEA_obd_ii_P2106_pass_counter "uint8_t" UBYTE NO_COMPU_METHOD 0 0 0 255 ECU_ADDRESS 0x40004715 /end MEASUREMENT
/begin MEASUREMENT LEA_obd_ii_P2107_flags "Stored monitor/maturation state for P2107 (throttle actuator processor). Log it to catch this fault maturing during a drive." UBYTE NO_COMPU_METHOD 0 0 0 255 ECU_ADDRESS 0x40004716 /end MEASUREMENT
/begin MEASUREMENT LEA_obd_ii_P2107_fail_counter "uint8_t" UBYTE NO_COMPU_METHOD 0 0 0 255 ECU_ADDRESS 0x40004717 /end MEASUREMENT
/begin MEASUREMENT LEA_obd_ii_P2107_pass_counter "uint8_t" UBYTE NO_COMPU_METHOD 0 0 0 255 ECU_ADDRESS 0x40004718 /end MEASUREMENT
/begin MEASUREMENT LEA_obd_ii_P2100_flags "Stored monitor/maturation state for P2100 (throttle actuator motor open). Log it to catch this fault maturing during a drive." UBYTE NO_COMPU_METHOD 0 0 0 255 ECU_ADDRESS 0x40004719 /end MEASUREMENT
/begin MEASUREMENT LEA_obd_ii_P2100_fail_counter "uint8_t" UBYTE NO_COMPU_METHOD 0 0 0 255 ECU_ADDRESS 0x4000471A /end MEASUREMENT
/begin MEASUREMENT LEA_obd_ii_P2100_pass_counter "uint8_t" UBYTE NO_COMPU_METHOD 0 0 0 255 ECU_ADDRESS 0x4000471B /end MEASUREMENT
/begin MEASUREMENT LEA_obd_ii_P2102_flags "Stored monitor/maturation state for P2102 (throttle actuator motor low). Log it to catch this fault maturing during a drive." UBYTE NO_COMPU_METHOD 0 0 0 255 ECU_ADDRESS 0x4000471C /end MEASUREMENT
/begin MEASUREMENT LEA_obd_ii_P2102_fail_counter "uint8_t" UBYTE NO_COMPU_METHOD 0 0 0 255 ECU_ADDRESS 0x4000471D /end MEASUREMENT
/begin MEASUREMENT LEA_obd_ii_P2102_pass_counter "uint8_t" UBYTE NO_COMPU_METHOD 0 0 0 255 ECU_ADDRESS 0x4000471E /end MEASUREMENT
/begin MEASUREMENT LEA_obd_ii_P2103_flags "Stored monitor/maturation state for P2103 (throttle actuator motor high). Log it to catch this fault maturing during a drive." UBYTE NO_COMPU_METHOD 0 0 0 255 ECU_ADDRESS 0x4000471F /end MEASUREMENT
/begin MEASUREMENT LEA_obd_ii_P2103_fail_counter "uint8_t" UBYTE NO_COMPU_METHOD 0 0 0 255 ECU_ADDRESS 0x40004720 /end MEASUREMENT
/begin MEASUREMENT LEA_obd_ii_P2103_pass_counter "uint8_t" UBYTE NO_COMPU_METHOD 0 0 0 255 ECU_ADDRESS 0x40004721 /end MEASUREMENT
/begin MEASUREMENT LEA_obd_ii_P2108_flags "Stored monitor/maturation state for P2108 (throttle actuator performance). Log it to catch this fault maturing during a drive." UBYTE NO_COMPU_METHOD 0 0 0 255 ECU_ADDRESS 0x40004722 /end MEASUREMENT
/begin MEASUREMENT LEA_obd_ii_P2108_fail_counter "uint8_t" UBYTE NO_COMPU_METHOD 0 0 0 255 ECU_ADDRESS 0x40004723 /end MEASUREMENT
/begin MEASUREMENT LEA_obd_ii_P2108_pass_counter "uint8_t" UBYTE NO_COMPU_METHOD 0 0 0 255 ECU_ADDRESS 0x40004724 /end MEASUREMENT
/begin MEASUREMENT LEA_obd_ii_P1113_flags "Stored monitor/maturation state for P1113 (mfr IAT). Log it to catch this fault maturing during a drive." UBYTE NO_COMPU_METHOD 0 0 0 255 ECU_ADDRESS 0x40004725 /end MEASUREMENT
/begin MEASUREMENT LEA_obd_ii_P1113_fail_counter "uint8_t" UBYTE NO_COMPU_METHOD 0 0 0 255 ECU_ADDRESS 0x40004726 /end MEASUREMENT
/begin MEASUREMENT LEA_obd_ii_P1113_pass_counter "uint8_t" UBYTE NO_COMPU_METHOD 0 0 0 255 ECU_ADDRESS 0x40004727 /end MEASUREMENT
/begin MEASUREMENT LEA_obd_ii_P0661_flags "Stored monitor/maturation state for P0661 (intake manifold runner (VIMS) control low). Log it to catch this fault maturing during a drive." UBYTE NO_COMPU_METHOD 0 0 0 255 ECU_ADDRESS 0x40004728 /end MEASUREMENT
/begin MEASUREMENT LEA_obd_ii_P0661_fail_counter "uint8_t" UBYTE NO_COMPU_METHOD 0 0 0 255 ECU_ADDRESS 0x40004729 /end MEASUREMENT
/begin MEASUREMENT LEA_obd_ii_P0661_pass_counter "uint8_t" UBYTE NO_COMPU_METHOD 0 0 0 255 ECU_ADDRESS 0x4000472A /end MEASUREMENT
/begin MEASUREMENT LEA_obd_ii_P0662_flags "Stored monitor/maturation state for P0662 (intake manifold runner (VIMS) control high). Log it to catch this fault maturing during a drive." UBYTE NO_COMPU_METHOD 0 0 0 255 ECU_ADDRESS 0x4000472B /end MEASUREMENT
/begin MEASUREMENT LEA_obd_ii_P0662_fail_counter "uint8_t" UBYTE NO_COMPU_METHOD 0 0 0 255 ECU_ADDRESS 0x4000472C /end MEASUREMENT
/begin MEASUREMENT LEA_obd_ii_P0662_pass_counter "uint8_t" UBYTE NO_COMPU_METHOD 0 0 0 255 ECU_ADDRESS 0x4000472D /end MEASUREMENT
/begin MEASUREMENT LEA_obd_ii_P2612_flags "Stored monitor/maturation state for P2612 (A/C refrigerant valve low). Log it to catch this fault maturing during a drive." UBYTE NO_COMPU_METHOD 0 0 0 255 ECU_ADDRESS 0x4000472E /end MEASUREMENT
/begin MEASUREMENT LEA_obd_ii_P2612_fail_counter "uint8_t" UBYTE NO_COMPU_METHOD 0 0 0 255 ECU_ADDRESS 0x4000472F /end MEASUREMENT
/begin MEASUREMENT LEA_obd_ii_P2612_pass_counter "uint8_t" UBYTE NO_COMPU_METHOD 0 0 0 255 ECU_ADDRESS 0x40004730 /end MEASUREMENT
/begin MEASUREMENT LEA_obd_ii_P2613_flags "Stored monitor/maturation state for P2613 (A/C refrigerant valve high). Log it to catch this fault maturing during a drive." UBYTE NO_COMPU_METHOD 0 0 0 255 ECU_ADDRESS 0x40004731 /end MEASUREMENT
/begin MEASUREMENT LEA_obd_ii_P2613_fail_counter "uint8_t" UBYTE NO_COMPU_METHOD 0 0 0 255 ECU_ADDRESS 0x40004732 /end MEASUREMENT
/begin MEASUREMENT LEA_obd_ii_P2613_pass_counter "uint8_t" UBYTE NO_COMPU_METHOD 0 0 0 255 ECU_ADDRESS 0x40004733 /end MEASUREMENT
/begin MEASUREMENT LEA_obd_ii_P0616_flags "Stored monitor/maturation state for P0616 (starter relay low). Log it to catch this fault maturing during a drive." UBYTE NO_COMPU_METHOD 0 0 0 255 ECU_ADDRESS 0x40004734 /end MEASUREMENT
/begin MEASUREMENT LEA_obd_ii_P0616_fail_counter "uint8_t" UBYTE NO_COMPU_METHOD 0 0 0 255 ECU_ADDRESS 0x40004735 /end MEASUREMENT
/begin MEASUREMENT LEA_obd_ii_P0616_pass_counter "uint8_t" UBYTE NO_COMPU_METHOD 0 0 0 255 ECU_ADDRESS 0x40004736 /end MEASUREMENT
/begin MEASUREMENT LEA_obd_ii_P0617_flags "Stored monitor/maturation state for P0617 (starter relay high). Log it to catch this fault maturing during a drive." UBYTE NO_COMPU_METHOD 0 0 0 255 ECU_ADDRESS 0x40004737 /end MEASUREMENT
/begin MEASUREMENT LEA_obd_ii_P0617_fail_counter "uint8_t" UBYTE NO_COMPU_METHOD 0 0 0 255 ECU_ADDRESS 0x40004738 /end MEASUREMENT
/begin MEASUREMENT LEA_obd_ii_P0617_pass_counter "uint8_t" UBYTE NO_COMPU_METHOD 0 0 0 255 ECU_ADDRESS 0x40004739 /end MEASUREMENT
/begin MEASUREMENT LEA_obd_ii_P2119_flags "Stored monitor/maturation state for P2119 (throttle body rationality). Log it to catch this fault maturing during a drive." UBYTE NO_COMPU_METHOD 0 0 0 255 ECU_ADDRESS 0x4000473A /end MEASUREMENT
/begin MEASUREMENT LEA_obd_ii_P2119_fail_counter "uint8_t" UBYTE NO_COMPU_METHOD 0 0 0 255 ECU_ADDRESS 0x4000473B /end MEASUREMENT
/begin MEASUREMENT LEA_obd_ii_P2119_pass_counter "uint8_t" UBYTE NO_COMPU_METHOD 0 0 0 255 ECU_ADDRESS 0x4000473C /end MEASUREMENT
/begin MEASUREMENT LEA_obd_ii_P2170_flags "Stored monitor/maturation state for P2170 (exhaust bypass valve stuck). Log it to catch this fault maturing during a drive." UBYTE NO_COMPU_METHOD 0 0 0 255 ECU_ADDRESS 0x4000473D /end MEASUREMENT
/begin MEASUREMENT LEA_obd_ii_P2170_fail_counter "uint8_t" UBYTE NO_COMPU_METHOD 0 0 0 255 ECU_ADDRESS 0x4000473E /end MEASUREMENT
/begin MEASUREMENT LEA_obd_ii_P2170_pass_counter "uint8_t" UBYTE NO_COMPU_METHOD 0 0 0 255 ECU_ADDRESS 0x4000473F /end MEASUREMENT
/begin MEASUREMENT LEA_obd_ii_P2171_flags "Stored monitor/maturation state for P2171 (exhaust bypass valve). Log it to catch this fault maturing during a drive." UBYTE NO_COMPU_METHOD 0 0 0 255 ECU_ADDRESS 0x40004740 /end MEASUREMENT
/begin MEASUREMENT LEA_obd_ii_P2171_fail_counter "uint8_t" UBYTE NO_COMPU_METHOD 0 0 0 255 ECU_ADDRESS 0x40004741 /end MEASUREMENT
/begin MEASUREMENT LEA_obd_ii_P2171_pass_counter "uint8_t" UBYTE NO_COMPU_METHOD 0 0 0 255 ECU_ADDRESS 0x40004742 /end MEASUREMENT
/begin MEASUREMENT LEA_obd_ii_P0826_flags "Stored monitor/maturation state for P0826 (shift switch). Log it to catch this fault maturing during a drive." UBYTE NO_COMPU_METHOD 0 0 0 255 ECU_ADDRESS 0x40004743 /end MEASUREMENT
/begin MEASUREMENT LEA_obd_ii_P0826_fail_counter "uint8_t" UBYTE NO_COMPU_METHOD 0 0 0 255 ECU_ADDRESS 0x40004744 /end MEASUREMENT
/begin MEASUREMENT LEA_obd_ii_P0826_pass_counter "uint8_t" UBYTE NO_COMPU_METHOD 0 0 0 255 ECU_ADDRESS 0x40004745 /end MEASUREMENT
/begin MEASUREMENT LEA_obd_ii_P0827_flags "Stored monitor/maturation state for P0827 (shift switch low). Log it to catch this fault maturing during a drive." UBYTE NO_COMPU_METHOD 0 0 0 255 ECU_ADDRESS 0x40004746 /end MEASUREMENT
/begin MEASUREMENT LEA_obd_ii_P0827_fail_counter "uint8_t" UBYTE NO_COMPU_METHOD 0 0 0 255 ECU_ADDRESS 0x40004747 /end MEASUREMENT
/begin MEASUREMENT LEA_obd_ii_P0827_pass_counter "uint8_t" UBYTE NO_COMPU_METHOD 0 0 0 255 ECU_ADDRESS 0x40004748 /end MEASUREMENT
/begin MEASUREMENT LEA_obd_ii_P0828_flags "Stored monitor/maturation state for P0828 (shift switch high). Log it to catch this fault maturing during a drive." UBYTE NO_COMPU_METHOD 0 0 0 255 ECU_ADDRESS 0x40004749 /end MEASUREMENT
/begin MEASUREMENT LEA_obd_ii_P0828_fail_counter "uint8_t" UBYTE NO_COMPU_METHOD 0 0 0 255 ECU_ADDRESS 0x4000474A /end MEASUREMENT
/begin MEASUREMENT LEA_obd_ii_P0828_pass_counter "uint8_t" UBYTE NO_COMPU_METHOD 0 0 0 255 ECU_ADDRESS 0x4000474B /end MEASUREMENT
/begin MEASUREMENT LEA_obd_ii_P2191_flags "Stored monitor/maturation state for P2191 (bank1 lean at load). Log it to catch this fault maturing during a drive." UBYTE NO_COMPU_METHOD 0 0 0 255 ECU_ADDRESS 0x4000474C /end MEASUREMENT
/begin MEASUREMENT LEA_obd_ii_P2191_fail_counter "uint8_t" UBYTE NO_COMPU_METHOD 0 0 0 255 ECU_ADDRESS 0x4000474D /end MEASUREMENT
/begin MEASUREMENT LEA_obd_ii_P2191_pass_counter "uint8_t" UBYTE NO_COMPU_METHOD 0 0 0 255 ECU_ADDRESS 0x4000474E /end MEASUREMENT
/begin MEASUREMENT LEA_obd_ii_P2193_flags "Stored monitor/maturation state for P2193 (bank2 lean at load). Log it to catch this fault maturing during a drive." UBYTE NO_COMPU_METHOD 0 0 0 255 ECU_ADDRESS 0x4000474F /end MEASUREMENT
/begin MEASUREMENT LEA_obd_ii_P2193_fail_counter "uint8_t" UBYTE NO_COMPU_METHOD 0 0 0 255 ECU_ADDRESS 0x40004750 /end MEASUREMENT
/begin MEASUREMENT LEA_obd_ii_P2193_pass_counter "uint8_t" UBYTE NO_COMPU_METHOD 0 0 0 255 ECU_ADDRESS 0x40004751 /end MEASUREMENT
/begin MEASUREMENT LEA_obd_ii_P219A_flags "Learned value: P219A flags. A value the ECU learns over time -- log it to track adaptation and spot a developing fault." UBYTE NO_COMPU_METHOD 0 0 0 255 ECU_ADDRESS 0x40004752 /end MEASUREMENT
/begin MEASUREMENT LEA_obd_ii_P219A_fail_counter "uint8_t" UBYTE NO_COMPU_METHOD 0 0 0 255 ECU_ADDRESS 0x40004753 /end MEASUREMENT
/begin MEASUREMENT LEA_obd_ii_P219A_pass_counter "uint8_t" UBYTE NO_COMPU_METHOD 0 0 0 255 ECU_ADDRESS 0x40004754 /end MEASUREMENT
/begin MEASUREMENT LEA_obd_ii_P219B_flags "Learned value: P219B flags. A value the ECU learns over time -- log it to track adaptation and spot a developing fault." UBYTE NO_COMPU_METHOD 0 0 0 255 ECU_ADDRESS 0x40004755 /end MEASUREMENT
/begin MEASUREMENT LEA_obd_ii_P219B_fail_counter "uint8_t" UBYTE NO_COMPU_METHOD 0 0 0 255 ECU_ADDRESS 0x40004756 /end MEASUREMENT
/begin MEASUREMENT LEA_obd_ii_P219B_pass_counter "uint8_t" UBYTE NO_COMPU_METHOD 0 0 0 255 ECU_ADDRESS 0x40004757 /end MEASUREMENT
/begin MEASUREMENT LEA_obd_ii_P2336_flags "Stored monitor/maturation state for P2336 (cyl1 over knock threshold). Log it to catch this fault maturing during a drive." UBYTE NO_COMPU_METHOD 0 0 0 255 ECU_ADDRESS 0x40004758 /end MEASUREMENT
/begin MEASUREMENT LEA_obd_ii_P2336_fail_counter "uint8_t" UBYTE NO_COMPU_METHOD 0 0 0 255 ECU_ADDRESS 0x40004759 /end MEASUREMENT
/begin MEASUREMENT LEA_obd_ii_P2336_pass_counter "uint8_t" UBYTE NO_COMPU_METHOD 0 0 0 255 ECU_ADDRESS 0x4000475A /end MEASUREMENT
/begin MEASUREMENT LEA_obd_ii_P2337_flags "Stored monitor/maturation state for P2337 (cyl2 over knock threshold). Log it to catch this fault maturing during a drive." UBYTE NO_COMPU_METHOD 0 0 0 255 ECU_ADDRESS 0x4000475B /end MEASUREMENT
/begin MEASUREMENT LEA_obd_ii_P2337_fail_counter "uint8_t" UBYTE NO_COMPU_METHOD 0 0 0 255 ECU_ADDRESS 0x4000475C /end MEASUREMENT
/begin MEASUREMENT LEA_obd_ii_P2337_pass_counter "uint8_t" UBYTE NO_COMPU_METHOD 0 0 0 255 ECU_ADDRESS 0x4000475D /end MEASUREMENT
/begin MEASUREMENT LEA_obd_ii_P2338_flags "Stored monitor/maturation state for P2338 (cyl3 over knock threshold). Log it to catch this fault maturing during a drive." UBYTE NO_COMPU_METHOD 0 0 0 255 ECU_ADDRESS 0x4000475E /end MEASUREMENT
/begin MEASUREMENT LEA_obd_ii_P2338_fail_counter "uint8_t" UBYTE NO_COMPU_METHOD 0 0 0 255 ECU_ADDRESS 0x4000475F /end MEASUREMENT
/begin MEASUREMENT LEA_obd_ii_P2338_pass_counter "uint8_t" UBYTE NO_COMPU_METHOD 0 0 0 255 ECU_ADDRESS 0x40004760 /end MEASUREMENT
/begin MEASUREMENT LEA_obd_ii_P2339_flags "Stored monitor/maturation state for P2339 (cyl4 over knock threshold). Log it to catch this fault maturing during a drive." UBYTE NO_COMPU_METHOD 0 0 0 255 ECU_ADDRESS 0x40004761 /end MEASUREMENT
/begin MEASUREMENT LEA_obd_ii_P2339_fail_counter "uint8_t" UBYTE NO_COMPU_METHOD 0 0 0 255 ECU_ADDRESS 0x40004762 /end MEASUREMENT
/begin MEASUREMENT LEA_obd_ii_P2339_pass_counter "uint8_t" UBYTE NO_COMPU_METHOD 0 0 0 255 ECU_ADDRESS 0x40004763 /end MEASUREMENT
/begin MEASUREMENT LEA_obd_ii_P2340_flags "Stored monitor/maturation state for P2340 (cyl5 over knock threshold). Log it to catch this fault maturing during a drive." UBYTE NO_COMPU_METHOD 0 0 0 255 ECU_ADDRESS 0x40004764 /end MEASUREMENT
/begin MEASUREMENT LEA_obd_ii_P2340_fail_counter "uint8_t" UBYTE NO_COMPU_METHOD 0 0 0 255 ECU_ADDRESS 0x40004765 /end MEASUREMENT
/begin MEASUREMENT LEA_obd_ii_P2340_pass_counter "uint8_t" UBYTE NO_COMPU_METHOD 0 0 0 255 ECU_ADDRESS 0x40004766 /end MEASUREMENT
/begin MEASUREMENT LEA_obd_ii_P2341_flags "Stored monitor/maturation state for P2341 (cyl6 over knock threshold). Log it to catch this fault maturing during a drive." UBYTE NO_COMPU_METHOD 0 0 0 255 ECU_ADDRESS 0x40004767 /end MEASUREMENT
/begin MEASUREMENT LEA_obd_ii_P2341_fail_counter "uint8_t" UBYTE NO_COMPU_METHOD 0 0 0 255 ECU_ADDRESS 0x40004768 /end MEASUREMENT
/begin MEASUREMENT LEA_obd_ii_P2341_pass_counter "uint8_t" UBYTE NO_COMPU_METHOD 0 0 0 255 ECU_ADDRESS 0x40004769 /end MEASUREMENT
/begin MEASUREMENT LEA_obd_ii_P1422_flags "Stored monitor/maturation state for P1422 (mfr emissions). Log it to catch this fault maturing during a drive." UBYTE NO_COMPU_METHOD 0 0 0 255 ECU_ADDRESS 0x4000476A /end MEASUREMENT
/begin MEASUREMENT LEA_obd_ii_P1422_fail_counter "uint8_t" UBYTE NO_COMPU_METHOD 0 0 0 255 ECU_ADDRESS 0x4000476B /end MEASUREMENT
/begin MEASUREMENT LEA_obd_ii_P1422_pass_counter "uint8_t" UBYTE NO_COMPU_METHOD 0 0 0 255 ECU_ADDRESS 0x4000476C /end MEASUREMENT
/begin MEASUREMENT LEA_obd_ii_U0101_flags "Stored monitor/maturation state for U0101 (lost comms with TCM). Log it to catch this fault maturing during a drive." UBYTE NO_COMPU_METHOD 0 0 0 255 ECU_ADDRESS 0x4000476D /end MEASUREMENT
/begin MEASUREMENT LEA_obd_ii_U0122_flags "Stored monitor/maturation state for U0122 (lost comms with ABS/ESP). Log it to catch this fault maturing during a drive." UBYTE NO_COMPU_METHOD 0 0 0 255 ECU_ADDRESS 0x40004770 /end MEASUREMENT
/begin MEASUREMENT LEA_obd_ii_U0123_flags "Stored monitor/maturation state for U0123 (lost comms with yaw sensor). Log it to catch this fault maturing during a drive." UBYTE NO_COMPU_METHOD 0 0 0 255 ECU_ADDRESS 0x40004773 /end MEASUREMENT
/begin MEASUREMENT LEA_obd_ii_P0127_flags "Stored monitor/maturation state for P0127 (intake air too hot). Log it to catch this fault maturing during a drive." UBYTE NO_COMPU_METHOD 0 0 0 255 ECU_ADDRESS 0x40004776 /end MEASUREMENT
/begin MEASUREMENT LEA_obd_ii_P0127_fail_counter "uint8_t" UBYTE NO_COMPU_METHOD 0 0 0 255 ECU_ADDRESS 0x40004777 /end MEASUREMENT
/begin MEASUREMENT LEA_obd_ii_P0127_pass_counter "uint8_t" UBYTE NO_COMPU_METHOD 0 0 0 255 ECU_ADDRESS 0x40004778 /end MEASUREMENT
/begin MEASUREMENT LEA_obd_ii_U0302_flags "Stored monitor/maturation state for U0302 (software mismatch with TCM). Log it to catch this fault maturing during a drive." UBYTE NO_COMPU_METHOD 0 0 0 255 ECU_ADDRESS 0x40004779 /end MEASUREMENT
/begin MEASUREMENT LEA_obd_ii_U0316_flags "Stored monitor/maturation state for U0316 (software mismatch with VDC). Log it to catch this fault maturing during a drive." UBYTE NO_COMPU_METHOD 0 0 0 255 ECU_ADDRESS 0x4000477C /end MEASUREMENT
/begin MEASUREMENT LEA_obd_ii_U0416_flags "Stored monitor/maturation state for U0416 (bad data from ABS/ESP). Log it to catch this fault maturing during a drive." UBYTE NO_COMPU_METHOD 0 0 0 255 ECU_ADDRESS 0x4000477F /end MEASUREMENT
/begin MEASUREMENT LEA_obd_ii_U0513_flags "Stored monitor/maturation state for U0513 (bad data from convenience module). Log it to catch this fault maturing during a drive." UBYTE NO_COMPU_METHOD 0 0 0 255 ECU_ADDRESS 0x40004782 /end MEASUREMENT
/begin MEASUREMENT lea_write_size "undefined4" ULONG NO_COMPU_METHOD 0 0 0 4294967295 ECU_ADDRESS 0x40004788 /end MEASUREMENT
/begin MEASUREMENT LEA_crc_full "uint16_t" UWORD NO_COMPU_METHOD 0 0 0 65535 ECU_ADDRESS 0x4000478C /end MEASUREMENT
/begin MEASUREMENT hc08_crc16 "undefined2" UWORD NO_COMPU_METHOD 0 0 0 65535 ECU_ADDRESS 0x400049B8 /end MEASUREMENT
/begin MEASUREMENT throttle_actuator_state "Throttle actuator state. Runtime state -- log to observe this behavior." UBYTE NO_COMPU_METHOD 0 0 0 255 ECU_ADDRESS 0x400049BA /end MEASUREMENT
/begin MEASUREMENT hc08_status_flags "undefined1" UBYTE NO_COMPU_METHOD 0 0 0 255 ECU_ADDRESS 0x400049BB /end MEASUREMENT
/begin MEASUREMENT tps_track_b_smoothing_state "struct_adc_smoothing_state" ULONG NO_COMPU_METHOD 0 0 0 4294967295 ECU_ADDRESS 0x40005E54 /end MEASUREMENT
/begin MEASUREMENT tps_track_a_smoothing_state "struct_adc_smoothing_state" ULONG NO_COMPU_METHOD 0 0 0 4294967295 ECU_ADDRESS 0x40005E78 /end MEASUREMENT
/begin MEASUREMENT flexcan_tx_queue_state_flags "undefined1" UBYTE NO_COMPU_METHOD 0 0 0 255 ECU_ADDRESS 0x40006528 /end MEASUREMENT
/begin MEASUREMENT queue_len "undefined1" UBYTE NO_COMPU_METHOD 0 0 0 255 ECU_ADDRESS 0x40006534 /end MEASUREMENT
/begin MEASUREMENT queue_head "undefined1" UBYTE NO_COMPU_METHOD 0 0 0 255 ECU_ADDRESS 0x40006535 /end MEASUREMENT
/begin MEASUREMENT queue_buffer "undefined1" UBYTE NO_COMPU_METHOD 0 0 0 255 ECU_ADDRESS 0x40006536 /end MEASUREMENT
/begin MEASUREMENT obd_payload_byte1 "byte" UBYTE NO_COMPU_METHOD 0 0 0 255 ECU_ADDRESS 0x40008543 /end MEASUREMENT
/begin MEASUREMENT obd_payload_byte2 "byte" UBYTE NO_COMPU_METHOD 0 0 0 255 ECU_ADDRESS 0x40008544 /end MEASUREMENT
/begin MEASUREMENT obd_payload_byte3 "byte" UBYTE NO_COMPU_METHOD 0 0 0 255 ECU_ADDRESS 0x40008545 /end MEASUREMENT
/begin MEASUREMENT obd_payload_byte4 "byte" UBYTE NO_COMPU_METHOD 0 0 0 255 ECU_ADDRESS 0x40008546 /end MEASUREMENT
/begin MEASUREMENT etb_driver_fault_debounce "undefined1" UBYTE NO_COMPU_METHOD 0 0 0 255 ECU_ADDRESS 0x40008768 /end MEASUREMENT
/begin MEASUREMENT accel_pedal_pos_d_clipped "Accelerator pedal position d clipped. Runtime state -- log to observe this behavior." ULONG NO_COMPU_METHOD 0 0 0 4294967295 ECU_ADDRESS 0x4000877C /end MEASUREMENT
/begin MEASUREMENT accel_pedal_pos_e_clipped "Accelerator pedal position e clipped. Runtime state -- log to observe this behavior." ULONG NO_COMPU_METHOD 0 0 0 4294967295 ECU_ADDRESS 0x40008790 /end MEASUREMENT
/begin MEASUREMENT COD_base "COD base. Internal/infrastructure state -- not a typical data-logging channel." ULONG NO_COMPU_METHOD 0 0 0 4294967295 ECU_ADDRESS 0x400087E0 /end MEASUREMENT
/begin MEASUREMENT COD_VIN "char" UBYTE NO_COMPU_METHOD 0 0 0 255 ECU_ADDRESS 0x400087E8 /end MEASUREMENT
/begin MEASUREMENT COD_model_name "char" UBYTE NO_COMPU_METHOD 0 0 0 255 ECU_ADDRESS 0x40008800 /end MEASUREMENT
/begin MEASUREMENT COD_CRC "uint16_t" UWORD NO_COMPU_METHOD 0 0 0 65535 ECU_ADDRESS 0x40008820 /end MEASUREMENT
/begin MEASUREMENT ips_shift_state "undefined" ULONG NO_COMPU_METHOD 0 0 0 4294967295 ECU_ADDRESS 0x40008848 /end MEASUREMENT
/end MODULE
/end PROJECT
