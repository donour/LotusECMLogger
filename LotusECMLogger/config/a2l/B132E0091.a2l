ASAP2_VERSION 1 61
/begin PROJECT B132E0091 "Lotus T6 B132E0091"
/begin HEADER "" VERSION "generated v1" /end HEADER
/begin MODULE B132E0091 ""
/begin MOD_COMMON "" BYTE_ORDER MSB_FIRST ALIGNMENT_BYTE 1 ALIGNMENT_WORD 2 ALIGNMENT_LONG 4 /end MOD_COMMON
/begin RECORD_LAYOUT RL_VALUE_UBYTE FNC_VALUES 1 UBYTE ROW_DIR DIRECT /end RECORD_LAYOUT
/begin RECORD_LAYOUT RL_AXIS_UBYTE AXIS_PTS_X 1 UBYTE INDEX_INCR DIRECT /end RECORD_LAYOUT
/begin RECORD_LAYOUT RL_VALUE_UWORD FNC_VALUES 1 UWORD ROW_DIR DIRECT /end RECORD_LAYOUT
/begin RECORD_LAYOUT RL_AXIS_UWORD AXIS_PTS_X 1 UWORD INDEX_INCR DIRECT /end RECORD_LAYOUT
/begin RECORD_LAYOUT RL_VALUE_SWORD FNC_VALUES 1 SWORD ROW_DIR DIRECT /end RECORD_LAYOUT
/begin COMPU_METHOD CM_i16_pressure_mbar "i16_pressure_mbar" RAT_FUNC "%8.0" "mbar" COEFFS 0 1 0 0 0 1 /end COMPU_METHOD
/begin COMPU_METHOD CM_u16_factor_1_10000 "u16_factor_1/10000" RAT_FUNC "%10.2" "%" COEFFS 0 1 0 0 0 0.01 /end COMPU_METHOD
/begin COMPU_METHOD CM_u16_factor_1_1023 "u16_factor_1/1023" RAT_FUNC "%12.4" "%" COEFFS 0 1 0 0 0 0.0977517106549365 /end COMPU_METHOD
/begin COMPU_METHOD CM_u16_flow_100_256mg_s "u16_flow_100/256mg/s" RAT_FUNC "%12.4" "mg/s" COEFFS 0 1 0 0 0 0.390625 /end COMPU_METHOD
/begin COMPU_METHOD CM_u16_flow_10mg_s "u16_flow_10mg/s" RAT_FUNC "%8.0" "mg/s" COEFFS 0 1 0 0 0 10 /end COMPU_METHOD
/begin COMPU_METHOD CM_u16_load_mg_stroke "u16_load_mg/stroke" RAT_FUNC "%8.0" "mg/stroke" COEFFS 0 1 0 0 0 1 /end COMPU_METHOD
/begin COMPU_METHOD CM_u16_mass_g "u16_mass_g" RAT_FUNC "%8.0" "g" COEFFS 0 1 0 0 0 1 /end COMPU_METHOD
/begin COMPU_METHOD CM_u16_mass_mg "u16_mass_mg" RAT_FUNC "%8.0" "mg" COEFFS 0 1 0 0 0 1 /end COMPU_METHOD
/begin COMPU_METHOD CM_u16_rspeed_1_4rpm "u16_rspeed_1/4rpm" RAT_FUNC "%10.2" "rpm" COEFFS 0 1 0 0 0 0.25 /end COMPU_METHOD
/begin COMPU_METHOD CM_u16_voltage_18_1023v "u16_voltage_18/1023v" RAT_FUNC "%12.4" "V" COEFFS 0 1 0 0 0 0.0175953079178886 /end COMPU_METHOD
/begin COMPU_METHOD CM_u8_angle_1_4_64deg "u8_angle_1/4-64deg" RAT_FUNC "%10.2" "deg" COEFFS 0 1 64 0 0 0.25 /end COMPU_METHOD
/begin COMPU_METHOD CM_u8_angle_1_4deg "u8_angle_1/4deg" RAT_FUNC "%10.2" "deg" COEFFS 0 1 0 0 0 0.25 /end COMPU_METHOD
/begin COMPU_METHOD CM_u8_factor_1_100 "u8_factor_1/100" RAT_FUNC "%8.0" "%" COEFFS 0 1 0 0 0 1 /end COMPU_METHOD
/begin COMPU_METHOD CM_u8_factor_1_255 "u8_factor_1/255" RAT_FUNC "%12.4" "%" COEFFS 0 1 0 0 0 0.392156862745098 /end COMPU_METHOD
/begin COMPU_METHOD CM_u8_factor_1_256 "u8_factor_1/256" RAT_FUNC "%12.4" "%" COEFFS 0 1 0 0 0 0.390625 /end COMPU_METHOD
/begin COMPU_METHOD CM_u8_factor_1_64 "u8_factor_1/64" RAT_FUNC "%12.4" "%" COEFFS 0 1 0 0 0 1.5625 /end COMPU_METHOD
/begin COMPU_METHOD CM_u8_flow_100mg_s "u8_flow_100mg/s" RAT_FUNC "%8.0" "mg/s" COEFFS 0 1 0 0 0 100 /end COMPU_METHOD
/begin COMPU_METHOD CM_u8_flow_2g_s "u8_flow_2g/s" RAT_FUNC "%8.0" "g/s" COEFFS 0 1 0 0 0 2 /end COMPU_METHOD
/begin COMPU_METHOD CM_u8_flow_g_s "u8_flow_g/s" RAT_FUNC "%8.0" "g/s" COEFFS 0 1 0 0 0 1 /end COMPU_METHOD
/begin COMPU_METHOD CM_u8_gain__x_104_26 "u8_gain_(x-104)/26" RAT_FUNC "%12.4" "" COEFFS 0 1 4 0 0 0.0384615384615385 /end COMPU_METHOD
/begin COMPU_METHOD CM_u8_load_4mg_stroke "u8_load_4mg/stroke" RAT_FUNC "%8.0" "mg/stroke" COEFFS 0 1 0 0 0 4 /end COMPU_METHOD
/begin COMPU_METHOD CM_u8_pressure_4mbar "u8_pressure_4mbar" RAT_FUNC "%8.0" "mbar" COEFFS 0 1 0 0 0 4 /end COMPU_METHOD
/begin COMPU_METHOD CM_u8_rspeed_10_6000rpm "u8_rspeed_10+6000rpm" RAT_FUNC "%8.0" "rpm" COEFFS 0 1 -6000 0 0 10 /end COMPU_METHOD
/begin COMPU_METHOD CM_u8_rspeed_10rpm "u8_rspeed_10rpm" RAT_FUNC "%8.0" "rpm" COEFFS 0 1 0 0 0 10 /end COMPU_METHOD
/begin COMPU_METHOD CM_u8_rspeed_125_4_500rpm "u8_rspeed_125/4+500rpm" RAT_FUNC "%10.2" "rpm" COEFFS 0 1 -500 0 0 31.25 /end COMPU_METHOD
/begin COMPU_METHOD CM_u8_rspeed_2rpm "u8_rspeed_2rpm" RAT_FUNC "%8.0" "rpm" COEFFS 0 1 0 0 0 2 /end COMPU_METHOD
/begin COMPU_METHOD CM_u8_rspeed_4_500rpm "u8_rspeed_4+500rpm" RAT_FUNC "%8.0" "rpm" COEFFS 0 1 -500 0 0 4 /end COMPU_METHOD
/begin COMPU_METHOD CM_u8_rspeed_4rpm "u8_rspeed_4rpm" RAT_FUNC "%8.0" "rpm" COEFFS 0 1 0 0 0 4 /end COMPU_METHOD
/begin COMPU_METHOD CM_u8_rspeed_50rpm "u8_rspeed_50rpm" RAT_FUNC "%8.0" "rpm" COEFFS 0 1 0 0 0 50 /end COMPU_METHOD
/begin COMPU_METHOD CM_u8_rspeed_8rpm "u8_rspeed_8rpm" RAT_FUNC "%8.0" "rpm" COEFFS 0 1 0 0 0 8 /end COMPU_METHOD
/begin COMPU_METHOD CM_u8_rspeed_accel_1_168 "u8_rspeed_accel_1/168" RAT_FUNC "%8.0" "accel_1/168" COEFFS 0 1 0 0 0 1 /end COMPU_METHOD
/begin COMPU_METHOD CM_u8_rspeed_rpm "u8_rspeed_rpm" RAT_FUNC "%8.0" "rpm" COEFFS 0 1 0 0 0 1 /end COMPU_METHOD
/begin COMPU_METHOD CM_u8_slip_1_8pct "u8_slip_1/8pct" RAT_FUNC "%11.3" "%" COEFFS 0 1 0 0 0 0.125 /end COMPU_METHOD
/begin COMPU_METHOD CM_u8_speed_1_100kph "u8_speed_1/100kph" RAT_FUNC "%10.2" "km/h" COEFFS 0 1 0 0 0 0.01 /end COMPU_METHOD
/begin COMPU_METHOD CM_u8_speed_kph "u8_speed_kph" RAT_FUNC "%8.0" "km/h" COEFFS 0 1 0 0 0 1 /end COMPU_METHOD
/begin COMPU_METHOD CM_u8_temp_5_8_40c "u8_temp_5/8-40c" RAT_FUNC "%11.3" "°C" COEFFS 0 1 40 0 0 0.625 /end COMPU_METHOD
/begin COMPU_METHOD CM_u8_time_100ms "u8_time_100ms" RAT_FUNC "%8.0" "ms" COEFFS 0 1 0 0 0 100 /end COMPU_METHOD
/begin COMPU_METHOD CM_u8_time_10ms "u8_time_10ms" RAT_FUNC "%8.0" "ms" COEFFS 0 1 0 0 0 10 /end COMPU_METHOD
/begin COMPU_METHOD CM_u8_time_250ms "u8_time_250ms" RAT_FUNC "%8.0" "ms" COEFFS 0 1 0 0 0 250 /end COMPU_METHOD
/begin COMPU_METHOD CM_u8_time_2s "u8_time_2s" RAT_FUNC "%8.0" "s" COEFFS 0 1 0 0 0 2 /end COMPU_METHOD
/begin COMPU_METHOD CM_u8_time_50ms "u8_time_50ms" RAT_FUNC "%8.0" "ms" COEFFS 0 1 0 0 0 50 /end COMPU_METHOD
/begin COMPU_METHOD CM_u8_time_5ms "u8_time_5ms" RAT_FUNC "%8.0" "ms" COEFFS 0 1 0 0 0 5 /end COMPU_METHOD
/begin COMPU_METHOD CM_u8_time_5s "u8_time_5s" RAT_FUNC "%8.0" "s" COEFFS 0 1 0 0 0 5 /end COMPU_METHOD
/begin COMPU_METHOD CM_u8_time_8us "u8_time_8us" RAT_FUNC "%8.0" "us" COEFFS 0 1 0 0 0 8 /end COMPU_METHOD
/begin COMPU_METHOD CM_u8_time_ms "u8_time_ms" RAT_FUNC "%8.0" "ms" COEFFS 0 1 0 0 0 1 /end COMPU_METHOD
/begin COMPU_METHOD CM_u8_time_s "u8_time_s" RAT_FUNC "%8.0" "s" COEFFS 0 1 0 0 0 1 /end COMPU_METHOD
/begin COMPU_METHOD CM_u8_torque_2nm "u8_torque_2nm" RAT_FUNC "%8.0" "Nm" COEFFS 0 1 0 0 0 2 /end COMPU_METHOD
/begin COMPU_METHOD CM_u8_torque_nm "u8_torque_nm" RAT_FUNC "%8.0" "Nm" COEFFS 0 1 0 0 0 1 /end COMPU_METHOD
/begin COMPU_METHOD CM_u8_voltage_5_255v "u8_voltage_5/255v" RAT_FUNC "%12.4" "V" COEFFS 0 1 0 0 0 0.0196078431372549 /end COMPU_METHOD
/begin COMPU_METHOD CM_u8_volume_1_10gallon "u8_volume_1/10gallon" RAT_FUNC "%9.1" "gallon" COEFFS 0 1 0 0 0 0.1 /end COMPU_METHOD
/begin CHARACTERISTIC CAL_cooling_fan_carspeed_min_1 "Calibration: cooling fan carspeed min 1. Tunable map/constant (not a live channel); log to confirm fans/pumps switch at the right temperatures. (km/h)" VALUE 0x40008E58 RL_VALUE_UBYTE 0 CM_u8_speed_kph 0 255 /end CHARACTERISTIC
/begin CHARACTERISTIC CAL_cooling_fan_bay_off_temp_3min "Calibration: cooling fan bay off temperature 3min. Tunable map/constant (not a live channel); log to confirm fans/pumps switch at the right temperatures. (deg C; raw*5/8-40)" VALUE 0x40008E59 RL_VALUE_UBYTE 0 CM_u8_temp_5_8_40c -40 119.375 /end CHARACTERISTIC
/begin CHARACTERISTIC CAL_cooling_fan_bay_off_temp_2min "Calibration: cooling fan bay off temperature 2min. Tunable map/constant (not a live channel); log to confirm fans/pumps switch at the right temperatures. (deg C; raw*5/8-40)" VALUE 0x40008E5A RL_VALUE_UBYTE 0 CM_u8_temp_5_8_40c -40 119.375 /end CHARACTERISTIC
/begin CHARACTERISTIC CAL_cooling_fan_bay_afterrun_shutdown_duration "u8_time_2s" VALUE 0x40008E5B RL_VALUE_UBYTE 0 CM_u8_time_2s 0 510 /end CHARACTERISTIC
/begin CHARACTERISTIC CAL_cooling_fan_bay_afterrun_heatsoak_duration "u8_time_2s" VALUE 0x40008E5C RL_VALUE_UBYTE 0 CM_u8_time_2s 0 510 /end CHARACTERISTIC
/begin CHARACTERISTIC CAL_cooling_fan_bay_afterrun_heatsoak_window "u8_time_2s" VALUE 0x40008E5D RL_VALUE_UBYTE 0 CM_u8_time_2s 0 510 /end CHARACTERISTIC
/begin CHARACTERISTIC CAL_cooling_fan_coolant_temp_threshold "Coolant temperature above which cooling fan activates" VALUE 0x40008E5E RL_VALUE_UBYTE 0 CM_u8_temp_5_8_40c -40 119.375 /end CHARACTERISTIC
/begin CHARACTERISTIC CAL_cooling_fan_engine_bay_run_duration "uint8_t" VALUE 0x40008E5F RL_VALUE_UBYTE 0 NO_COMPU_METHOD 0 255 /end CHARACTERISTIC
/begin CHARACTERISTIC CAL_cooling_fan_bay_idle_stationary_dwell "Calibration: cooling fan bay idle stationary dwell. Tunable map/constant (not a live channel); log to confirm fans/pumps switch at the right temperatures. (s)" VALUE 0x40008E60 RL_VALUE_UBYTE 0 CM_u8_time_s 0 255 /end CHARACTERISTIC
/begin CHARACTERISTIC CAL_cooling_fan_bay_idle_temp_low "Calibration: cooling fan bay idle temperature low. Tunable map/constant (not a live channel); log to confirm fans/pumps switch at the right temperatures. (deg C; raw*5/8-40)" VALUE 0x40008E61 RL_VALUE_UBYTE 0 CM_u8_temp_5_8_40c -40 119.375 /end CHARACTERISTIC
/begin CHARACTERISTIC CAL_cooling_fan_bay_restart_inhibit "Calibration: cooling fan bay restart inhibit. Tunable map/constant (not a live channel); log to confirm fans/pumps switch at the right temperatures. (s)" VALUE 0x40008E62 RL_VALUE_UBYTE 0 CM_u8_time_s 0 255 /end CHARACTERISTIC
/begin CHARACTERISTIC CAL_tpssmooth_rate_calc_window_size "Calibration: tpssmooth rate calculated window size. Tunable map/constant (not a live channel); log to see throttle-signal smoothing/filtering behavior." VALUE 0x40008E6B RL_VALUE_UBYTE 0 NO_COMPU_METHOD 0 255 /end CHARACTERISTIC
/begin CHARACTERISTIC CAL_wheel_speed_vss_tire_circumference "Calibration: vss tire circumference. Tunable map/constant (not a live channel); adjust to change this behavior." VALUE 0x40008E6C RL_VALUE_UWORD 0 NO_COMPU_METHOD 0 65535 /end CHARACTERISTIC
/begin CHARACTERISTIC CAL_wheel_speed_vss_pulses_per_rev "Calibration: vss pulses per rev. Tunable map/constant (not a live channel); adjust to change this behavior." VALUE 0x40008E6E RL_VALUE_UBYTE 0 NO_COMPU_METHOD 0 255 /end CHARACTERISTIC
/begin CHARACTERISTIC CAL_torque_ext_torque_limit_hold_count "u8_time_10ms" VALUE 0x40008E74 RL_VALUE_UBYTE 0 CM_u8_time_10ms 0 2550 /end CHARACTERISTIC
/begin CHARACTERISTIC CAL_engine_accel_lookback_teeth "Calibration: engine accelerator lookback teeth. Tunable map/constant (not a live channel); log to follow core engine state." VALUE 0x40008E7B RL_VALUE_UBYTE 0 NO_COMPU_METHOD 0 255 /end CHARACTERISTIC
/begin CHARACTERISTIC CAL_cooling_fan_low_on_engine_on "Calibration: cooling fan low on engine on. Tunable map/constant (not a live channel); log to confirm fans/pumps switch at the right temperatures. (deg C; raw*5/8-40)" VALUE 0x40008E89 RL_VALUE_UBYTE 0 CM_u8_temp_5_8_40c -40 119.375 /end CHARACTERISTIC
/begin CHARACTERISTIC CAL_cooling_fan_low_off_engine_on "Calibration: cooling fan low off engine on. Tunable map/constant (not a live channel); log to confirm fans/pumps switch at the right temperatures. (deg C; raw*5/8-40)" VALUE 0x40008E8A RL_VALUE_UBYTE 0 CM_u8_temp_5_8_40c -40 119.375 /end CHARACTERISTIC
/begin CHARACTERISTIC CAL_cooling_fan_low_on_engine_off "Calibration: cooling fan low on engine off. Tunable map/constant (not a live channel); log to confirm fans/pumps switch at the right temperatures. (deg C; raw*5/8-40)" VALUE 0x40008E8B RL_VALUE_UBYTE 0 CM_u8_temp_5_8_40c -40 119.375 /end CHARACTERISTIC
/begin CHARACTERISTIC CAL_cooling_fan_low_off_engine_off "Calibration: cooling fan low off engine off. Tunable map/constant (not a live channel); log to confirm fans/pumps switch at the right temperatures. (deg C; raw*5/8-40)" VALUE 0x40008E8C RL_VALUE_UBYTE 0 CM_u8_temp_5_8_40c -40 119.375 /end CHARACTERISTIC
/begin CHARACTERISTIC CAL_cooling_fan_high_on_coolant "Calibration: cooling fan high on coolant. Tunable map/constant (not a live channel); log to confirm fans/pumps switch at the right temperatures. (deg C; raw*5/8-40)" VALUE 0x40008E8D RL_VALUE_UBYTE 0 CM_u8_temp_5_8_40c -40 119.375 /end CHARACTERISTIC
/begin CHARACTERISTIC CAL_cooling_fan_high_off_coolant "Calibration: cooling fan high off coolant. Tunable map/constant (not a live channel); log to confirm fans/pumps switch at the right temperatures. (deg C; raw*5/8-40)" VALUE 0x40008E8E RL_VALUE_UBYTE 0 CM_u8_temp_5_8_40c -40 119.375 /end CHARACTERISTIC
/begin CHARACTERISTIC CAL_cooling_fan_disable_carspeed "Calibration: cooling fan disable carspeed. Tunable map/constant (not a live channel); log to confirm fans/pumps switch at the right temperatures. (km/h)" VALUE 0x40008E8F RL_VALUE_UBYTE 0 CM_u8_speed_kph 0 255 /end CHARACTERISTIC
/begin CHARACTERISTIC CAL_idle_flow_integral_adj_max "Calibration: idle flow integral adj max. Tunable map/constant (not a live channel); log to diagnose idle quality, hunting, and stalls. (mg/s; raw*100)" VALUE 0x40008E90 RL_VALUE_UBYTE 0 CM_u8_flow_100mg_s 0 25500 /end CHARACTERISTIC
/begin CHARACTERISTIC CAL_idle_flow_integral_adj_max_40008E91 "Calibration: idle flow integral adj max. Tunable map/constant (not a live channel); log to diagnose idle quality, hunting, and stalls. (mg/s; raw*100)" VALUE 0x40008E91 RL_VALUE_UBYTE 0 CM_u8_flow_100mg_s 0 25500 /end CHARACTERISTIC
/begin CHARACTERISTIC CAL_idle_learn_integral_max "uint8_t" VALUE 0x40008E92 RL_VALUE_UBYTE 0 NO_COMPU_METHOD 0 255 /end CHARACTERISTIC
/begin CHARACTERISTIC CAL_idle_learn_integral_min "uint8_t" VALUE 0x40008E93 RL_VALUE_UBYTE 0 NO_COMPU_METHOD 0 255 /end CHARACTERISTIC
/begin CHARACTERISTIC CAL_cooling_recirc_pump_enable_temp "Calibration: cooling recirc pump enable temperature. Tunable map/constant (not a live channel); log to confirm fans/pumps switch at the right temperatures. (deg C; raw*5/8-40)" VALUE 0x40008E9D RL_VALUE_UBYTE 0 CM_u8_temp_5_8_40c -40 119.375 /end CHARACTERISTIC
/begin CHARACTERISTIC CAL_wheel_speed_smoothing "Calibration: unused wheelspeed smoothing. Tunable map/constant (not a live channel); adjust to change this behavior. (0-1; raw/255)" VALUE 0x40008EA3 RL_VALUE_UBYTE 0 CM_u8_factor_1_255 0 100 /end CHARACTERISTIC
/begin CHARACTERISTIC CAL_evap_purge_idle_duty_max "u8_dutycycle_100/255" VALUE 0x40008EAE RL_VALUE_UBYTE 0 CM_u8_factor_1_255 0 100 /end CHARACTERISTIC
/begin CHARACTERISTIC CAL_evap_purge_conditioning_timer_100ms "uint8_t" VALUE 0x40008EC8 RL_VALUE_UBYTE 0 NO_COMPU_METHOD 0 255 /end CHARACTERISTIC
/begin CHARACTERISTIC CAL_evap_purge_min_inj_pulse_enter "u8_time_8us" VALUE 0x40008EC9 RL_VALUE_UBYTE 0 CM_u8_time_8us 0 2040 /end CHARACTERISTIC
/begin CHARACTERISTIC CAL_evap_purge_min_inj_pulse_exit "u8_time_8us" VALUE 0x40008ECA RL_VALUE_UBYTE 0 CM_u8_time_8us 0 2040 /end CHARACTERISTIC
/begin CHARACTERISTIC CAL_evap_purge_duty_ramp_up_min "uint8_t" VALUE 0x40008ECB RL_VALUE_UBYTE 0 NO_COMPU_METHOD 0 255 /end CHARACTERISTIC
/begin CHARACTERISTIC CAL_evap_purge_duty_ramp_down_conditioning "uchar" VALUE 0x40008ECC RL_VALUE_UBYTE 0 NO_COMPU_METHOD 0 255 /end CHARACTERISTIC
/begin CHARACTERISTIC CAL_evap_purge_filter_alpha "Evap purge vacuum filter coefficient (alpha/256 per 100 ms update)." VALUE 0x40008ECE RL_VALUE_UBYTE 0 CM_u8_factor_1_256 0 99.609375 /end CHARACTERISTIC
/begin CHARACTERISTIC CAL_cooling_fan_high_on_coolant_with_ac "Calibration: cooling fan high on coolant with A/C. Tunable map/constant (not a live channel); log to confirm fans/pumps switch at the right temperatures. (deg C; raw*5/8-40)" VALUE 0x40008ED1 RL_VALUE_UBYTE 0 CM_u8_temp_5_8_40c -40 119.375 /end CHARACTERISTIC
/begin CHARACTERISTIC CAL_cooling_fan_high_off_coolant_with_ac "Calibration: cooling fan high off coolant with A/C. Tunable map/constant (not a live channel); log to confirm fans/pumps switch at the right temperatures. (deg C; raw*5/8-40)" VALUE 0x40008ED2 RL_VALUE_UBYTE 0 CM_u8_temp_5_8_40c -40 119.375 /end CHARACTERISTIC
/begin CHARACTERISTIC CAL_engine_speed_3_threshold "uchar" VALUE 0x40008ED4 RL_VALUE_UBYTE 0 NO_COMPU_METHOD 0 255 /end CHARACTERISTIC
/begin CHARACTERISTIC CAL_engine_speed_avg_samples "Calibration: engine speed avg samples. Tunable map/constant (not a live channel); log to follow core engine state." VALUE 0x40008ED6 RL_VALUE_UBYTE 0 NO_COMPU_METHOD 0 255 /end CHARACTERISTIC
/begin CHARACTERISTIC CAL_idle_bypass_airflow_factor "u8_factor_1/255" VALUE 0x40008EDC RL_VALUE_UBYTE 0 CM_u8_factor_1_255 0 100 /end CHARACTERISTIC
/begin CHARACTERISTIC CAL_tps_accel_pedal_zero_calibrate_timer "uint8_t" VALUE 0x40008EE5 RL_VALUE_UBYTE 0 NO_COMPU_METHOD 0 255 /end CHARACTERISTIC
/begin CHARACTERISTIC CAL_cooling_fan_air_temp_threshold "Air temperature threshold for fan activation" VALUE 0x40008EF8 RL_VALUE_UBYTE 0 CM_u8_temp_5_8_40c -40 119.375 /end CHARACTERISTIC
/begin CHARACTERISTIC CAL_idle_exit_rpm_offset "u8_rspeed_rpm" VALUE 0x40008EFC RL_VALUE_UBYTE 0 CM_u8_rspeed_rpm 0 255 /end CHARACTERISTIC
/begin CHARACTERISTIC CAL_idle_dashpot_decel_threshold "u8_rspeed_accel_1/168" VALUE 0x40008EFD RL_VALUE_UBYTE 0 CM_u8_rspeed_accel_1_168 0 255 /end CHARACTERISTIC
/begin CHARACTERISTIC CAL_idle_high_rpm_transient_air_comp "u8_flow_100mg/s" VALUE 0x40008EFF RL_VALUE_UBYTE 0 CM_u8_flow_100mg_s 0 25500 /end CHARACTERISTIC
/begin CHARACTERISTIC CAL_idle_air_hi_rpm_adder_speed_min "u8_speed_kph" VALUE 0x40008F02 RL_VALUE_UBYTE 0 CM_u8_speed_kph 0 255 /end CHARACTERISTIC
/begin CHARACTERISTIC CAL_idle_comp_decay_period_ac "u8_time_ms" VALUE 0x40008F03 RL_VALUE_UBYTE 0 CM_u8_time_ms 0 255 /end CHARACTERISTIC
/begin CHARACTERISTIC CAL_cooling_recirc_pump_run_ambient_min "Calibration: cooling recirc pump run ambient min. Tunable map/constant (not a live channel); log to confirm fans/pumps switch at the right temperatures. (deg C; raw*5/8-40)" VALUE 0x40008F07 RL_VALUE_UBYTE 0 CM_u8_temp_5_8_40c -40 119.375 /end CHARACTERISTIC
/begin CHARACTERISTIC CAL_etb_pid_kd "uint16_t" VALUE 0x40008F0A RL_VALUE_UWORD 0 NO_COMPU_METHOD 0 65535 /end CHARACTERISTIC
/begin CHARACTERISTIC CAL_etb_tps1_max_count "ushort" VALUE 0x40008F0E RL_VALUE_UWORD 0 NO_COMPU_METHOD 0 65535 /end CHARACTERISTIC
/begin CHARACTERISTIC CAL_etb_tps2_max_count "ushort" VALUE 0x40008F12 RL_VALUE_UWORD 0 NO_COMPU_METHOD 0 65535 /end CHARACTERISTIC
/begin CHARACTERISTIC CAL_etb_pwm_period "ushort" VALUE 0x40008F14 RL_VALUE_UWORD 0 NO_COMPU_METHOD 0 65535 /end CHARACTERISTIC
/begin CHARACTERISTIC CAL_torque_limit_low_speed_min_torque "u8_torque_nm" VALUE 0x40008F16 RL_VALUE_UBYTE 0 CM_u8_torque_nm 0 255 /end CHARACTERISTIC
/begin CHARACTERISTIC CAL_temp_engine_air_threshold "uchar" VALUE 0x40008F19 RL_VALUE_UBYTE 0 NO_COMPU_METHOD 0 255 /end CHARACTERISTIC
/begin CHARACTERISTIC CAL_etb_pid_kp "u16_factor_1/100" VALUE 0x40008F1A RL_VALUE_UWORD 0 CM_u8_factor_1_100 0 65535 /end CHARACTERISTIC
/begin CHARACTERISTIC CAL_torque_limit_low_speed_rpm_threshold "u16_rspeed_rpm" VALUE 0x40008F1C RL_VALUE_UWORD 0 CM_u8_rspeed_rpm 0 65535 /end CHARACTERISTIC
/begin CHARACTERISTIC CAL_etb_pid_ki "u16_factor_1/10000" VALUE 0x40008F1E RL_VALUE_UWORD 0 CM_u16_factor_1_10000 0 655.35 /end CHARACTERISTIC
/begin CHARACTERISTIC CAL_throttle_model_torque_gain "ushort" VALUE 0x40008F22 RL_VALUE_UWORD 0 NO_COMPU_METHOD 0 65535 /end CHARACTERISTIC
/begin CHARACTERISTIC CAL_tps1_normalize_full_frac "ushort" VALUE 0x40008F24 RL_VALUE_UWORD 0 NO_COMPU_METHOD 0 65535 /end CHARACTERISTIC
/begin CHARACTERISTIC CAL_etb_tps2_range_lo_frac "ushort" VALUE 0x40008F26 RL_VALUE_UWORD 0 NO_COMPU_METHOD 0 65535 /end CHARACTERISTIC
/begin CHARACTERISTIC CAL_tpssmooth_step_timer "uint16_t" VALUE 0x40008F28 RL_VALUE_UWORD 0 NO_COMPU_METHOD 0 65535 /end CHARACTERISTIC
/begin CHARACTERISTIC CAL_etb_pid_i_clamp "u16_factor_1/10000" VALUE 0x40008F2A RL_VALUE_UWORD 0 CM_u16_factor_1_10000 0 655.35 /end CHARACTERISTIC
/begin CHARACTERISTIC CAL_tps_decrement_base "Calibration: throttle position decrement base. Tunable map/constant (not a live channel); log to see throttle/pedal demand and throttle response. (0-1; raw/1023)" VALUE 0x40008F2C RL_VALUE_UWORD 0 CM_u16_factor_1_1023 0 6406.15835777126 /end CHARACTERISTIC
/begin CHARACTERISTIC CAL_cooling_fan_coolant_fall_window "u8_time_250ms" VALUE 0x40008F2F RL_VALUE_UBYTE 0 CM_u8_time_250ms 0 63750 /end CHARACTERISTIC
/begin CHARACTERISTIC CAL_cooling_recirc_pump_run_time_sec "Calibration: cooling recirc pump run time sec. Tunable map/constant (not a live channel); log to confirm fans/pumps switch at the right temperatures." VALUE 0x40008F30 RL_VALUE_UBYTE 0 NO_COMPU_METHOD 0 255 /end CHARACTERISTIC
/begin CHARACTERISTIC CAL_cooling_fan_coolant_fall_threshold "Calibration: cooling fan thermostat open temperature drop. Tunable map/constant (not a live channel); log to confirm fans/pumps switch at the right temperatures. (deg C; raw*5/8-40)" VALUE 0x40008F32 RL_VALUE_UBYTE 0 CM_u8_temp_5_8_40c -40 119.375 /end CHARACTERISTIC
/begin CHARACTERISTIC CAL_cooling_fan_coolant_fall_check_period "u8_time_100ms" VALUE 0x40008F33 RL_VALUE_UBYTE 0 CM_u8_time_100ms 0 25500 /end CHARACTERISTIC
/begin CHARACTERISTIC CAL_idle_ign_control_entry_offset "u8_rspeed_8rpm" VALUE 0x40008F34 RL_VALUE_UBYTE 0 CM_u8_rspeed_8rpm 0 2040 /end CHARACTERISTIC
/begin CHARACTERISTIC CAL_idle_ign_control_exit_offset "u8_rspeed_8rpm" VALUE 0x40008F35 RL_VALUE_UBYTE 0 CM_u8_rspeed_8rpm 0 2040 /end CHARACTERISTIC
/begin CHARACTERISTIC CAL_cooling_fan_start_inhibit_time "u8_time_250ms" VALUE 0x40008F36 RL_VALUE_UBYTE 0 CM_u8_time_250ms 0 63750 /end CHARACTERISTIC
/begin CHARACTERISTIC CAL_idle_carspeed_comp_decay_step_ac "u8_rspeed_rpm" VALUE 0x40008F37 RL_VALUE_UBYTE 0 CM_u8_rspeed_rpm 0 255 /end CHARACTERISTIC
/begin CHARACTERISTIC CAL_cooling_recirc_pump_stopped_dwell "u8_time_100ms" VALUE 0x40008F3C RL_VALUE_UBYTE 0 CM_u8_time_100ms 0 25500 /end CHARACTERISTIC
/begin CHARACTERISTIC CAL_tpssmooth_decrement_comp_gears_manual "Calibration: tpssmooth decrement compensation gears manual. Tunable map/constant (not a live channel); log to see throttle-signal smoothing/filtering behavior. (0-1; raw/255)" VAL_BLK 0x40008F3D RL_VALUE_UBYTE 0 CM_u8_factor_1_255 0 100 NUMBER 7 /end CHARACTERISTIC
/begin CHARACTERISTIC CAL_evap_purge_pwm_freq "Calibration: EVAP purge pwm freq. Tunable map/constant (not a live channel); adjust to change this behavior." VALUE 0x40008F46 RL_VALUE_UWORD 0 NO_COMPU_METHOD 0 65535 /end CHARACTERISTIC
/begin CHARACTERISTIC CAL_revlimit_hard_hysteresis "Calibration: revlimit hard hysteresis. Tunable map/constant (not a live channel); log to confirm where and how the rev limiter intervenes. (RPM)" VALUE 0x40008F4C RL_VALUE_UWORD 0 CM_u8_rspeed_rpm 0 65535 /end CHARACTERISTIC
/begin CHARACTERISTIC CAL_cooling_fan_high_off_min_time "Calibration: cooling fan high off min time. Tunable map/constant (not a live channel); log to confirm fans/pumps switch at the right temperatures. (ms; raw*5)" VALUE 0x40008F52 RL_VALUE_UWORD 0 CM_u8_time_5ms 0 327675 /end CHARACTERISTIC
/begin CHARACTERISTIC CAL_cooling_fan_1_afterrun_timer "Calibration: cooling fan 1 afterrun timer. Tunable map/constant (not a live channel); log to confirm fans/pumps switch at the right temperatures. (s)" VALUE 0x40008F74 RL_VALUE_UWORD 0 CM_u8_time_s 0 65535 /end CHARACTERISTIC
/begin CHARACTERISTIC CAL_cooling_fan_engine_bay_aux_afterrun_timer "Calibration: cooling fan engine bay aux afterrun timer. Tunable map/constant (not a live channel); log to confirm fans/pumps switch at the right temperatures. (s)" VALUE 0x40008F7C RL_VALUE_UWORD 0 CM_u8_time_s 0 65535 /end CHARACTERISTIC
/begin CHARACTERISTIC CAL_idle_unknown3 "uint8_t" VALUE 0x40008F92 RL_VALUE_UBYTE 0 NO_COMPU_METHOD 0 255 /end CHARACTERISTIC
/begin CHARACTERISTIC CAL_idle_air_control_unknown "uint8_t" VALUE 0x40008F93 RL_VALUE_UBYTE 0 NO_COMPU_METHOD 0 255 /end CHARACTERISTIC
/begin CHARACTERISTIC CAL_tpssmooth_decrement_cruise_scale "u8_factor_1/255" VALUE 0x40008F96 RL_VALUE_UBYTE 0 CM_u8_factor_1_255 0 100 /end CHARACTERISTIC
/begin CHARACTERISTIC CAL_idle_control_entry_offset "u8_rspeed_8rpm" VALUE 0x40008F97 RL_VALUE_UBYTE 0 CM_u8_rspeed_8rpm 0 2040 /end CHARACTERISTIC
/begin CHARACTERISTIC CAL_idle_unknown2 "u8_rspeed_8rpm" VALUE 0x40008F98 RL_VALUE_UBYTE 0 CM_u8_rspeed_8rpm 0 2040 /end CHARACTERISTIC
/begin CHARACTERISTIC CAL_tps_delta_rate_window_size "Calibration: throttle position delta rate window size. Tunable map/constant (not a live channel); log to see throttle/pedal demand and throttle response." VALUE 0x40008F9F RL_VALUE_UBYTE 0 NO_COMPU_METHOD 0 255 /end CHARACTERISTIC
/begin CHARACTERISTIC CAL_tps_delta_neg_clamp "uint16_t" VALUE 0x40008FA6 RL_VALUE_UWORD 0 NO_COMPU_METHOD 0 65535 /end CHARACTERISTIC
/begin CHARACTERISTIC CAL_tps_delta_neg_threshold "uint16_t" VALUE 0x40008FA8 RL_VALUE_UWORD 0 NO_COMPU_METHOD 0 65535 /end CHARACTERISTIC
/begin CHARACTERISTIC CAL_tps_warmup_max "u16_factor_1/1023" VALUE 0x40008FB0 RL_VALUE_UWORD 0 CM_u16_factor_1_1023 0 6406.15835777126 /end CHARACTERISTIC
/begin CHARACTERISTIC CAL_tps_commanded_wamup_min "Calibration: throttle position commanded wamup min. Tunable map/constant (not a live channel); log to see throttle/pedal demand and throttle response. (0-1; raw/1023)" VALUE 0x40008FB2 RL_VALUE_UWORD 0 CM_u16_factor_1_1023 0 6406.15835777126 /end CHARACTERISTIC
/begin CHARACTERISTIC CAL_idle_tps_max "Calibration: idle throttle position max. Tunable map/constant (not a live channel); log to diagnose idle quality, hunting, and stalls. (0-1; raw/1023)" VALUE 0x40008FB4 RL_VALUE_UWORD 0 CM_u16_factor_1_1023 0 6406.15835777126 /end CHARACTERISTIC
/begin CHARACTERISTIC CAL_idle_comp_decay_period "uint8_t" VALUE 0x40008FBF RL_VALUE_UBYTE 0 NO_COMPU_METHOD 0 255 /end CHARACTERISTIC
/begin CHARACTERISTIC CAL_evap_vapor_conc_max_for_fuel_learn "uint16_t" VALUE 0x40008FC6 RL_VALUE_UWORD 0 NO_COMPU_METHOD 0 65535 /end CHARACTERISTIC
/begin CHARACTERISTIC CAL_evap_purge_flow_vapor_min_leaktest "uint16_t" VALUE 0x40008FC8 RL_VALUE_UWORD 0 NO_COMPU_METHOD 0 65535 /end CHARACTERISTIC
/begin CHARACTERISTIC CAL_evap_commanded_purge_unknown "uint8_t" VALUE 0x40008FCF RL_VALUE_UBYTE 0 NO_COMPU_METHOD 0 255 /end CHARACTERISTIC
/begin CHARACTERISTIC CAL_vvt_pwm_driver_divisor "Calibration: VVT pwm driver divisor. Tunable map/constant (not a live channel); log commanded vs actual cam timing to verify VVT response." VALUE 0x40008FD4 RL_VALUE_UWORD 0 NO_COMPU_METHOD 0 65535 /end CHARACTERISTIC
/begin CHARACTERISTIC CAL_idle_carspeed_comp_decay_step "u8_rspeed_rpm" VALUE 0x40008FDC RL_VALUE_UBYTE 0 CM_u8_rspeed_rpm 0 255 /end CHARACTERISTIC
/begin CHARACTERISTIC CAL_vvt_p_gain "u16_factor_1/255" VALUE 0x40008FE2 RL_VALUE_UWORD 0 CM_u8_factor_1_255 0 25700 /end CHARACTERISTIC
/begin CHARACTERISTIC CAL_vvt_integral_gain "Calibration: VVT integral gain. Tunable map/constant (not a live channel); log commanded vs actual cam timing to verify VVT response." VALUE 0x40008FE4 RL_VALUE_UWORD 0 NO_COMPU_METHOD 0 65535 /end CHARACTERISTIC
/begin CHARACTERISTIC CAL_idle_flow_adj1_maf_accum_max "Calibration: idle flow adj1 MAF accum max. Tunable map/constant (not a live channel); log to diagnose idle quality, hunting, and stalls. (g)" VALUE 0x40008FE6 RL_VALUE_UWORD 0 CM_u16_mass_g 0 65535 /end CHARACTERISTIC
/begin CHARACTERISTIC CAL_cooling_recirc_pump_rpm_max_disable "Calibration: cooling recirc pump RPM max disable. Tunable map/constant (not a live channel); log to confirm fans/pumps switch at the right temperatures. (RPM)" VALUE 0x40008FEA RL_VALUE_UWORD 0 CM_u8_rspeed_rpm 0 65535 /end CHARACTERISTIC
/begin CHARACTERISTIC CAL_evap_purge_flow_vapor_min "uint16_t" VALUE 0x40008FEE RL_VALUE_UWORD 0 NO_COMPU_METHOD 0 65535 /end CHARACTERISTIC
/begin CHARACTERISTIC CAL_revlimit_offset_reset_timer "Calibration: revlimit offset reset timer. Tunable map/constant (not a live channel); log to confirm where and how the rev limiter intervenes. (RPM)" VALUE 0x40008FF0 RL_VALUE_UWORD 0 CM_u8_rspeed_rpm 0 65535 /end CHARACTERISTIC
/begin CHARACTERISTIC CAL_evap_purge_power_enrich_suspend_hold "It sets how long evap purge stays suspended after power enrichment ends" VALUE 0x40008FF8 RL_VALUE_UBYTE 0 CM_u8_time_100ms 0 25500 /end CHARACTERISTIC
/begin CHARACTERISTIC CAL_evap_purge_power_enrich_suspend_timeout "timeout in the purge state machine" VALUE 0x40008FF9 RL_VALUE_UBYTE 0 CM_u8_time_100ms 0 25500 /end CHARACTERISTIC
/begin CHARACTERISTIC CAL_revlimit_startup_offset_decrement "uint16_t" VALUE 0x40009022 RL_VALUE_UWORD 0 NO_COMPU_METHOD 0 65535 /end CHARACTERISTIC
/begin CHARACTERISTIC CAL_tps_limit_idle_request_max "Calibration: throttle position idle request max. Tunable map/constant (not a live channel); log to diagnose idle quality, hunting, and stalls. (0-1; raw/1023)" VALUE 0x40009026 RL_VALUE_UWORD 0 CM_u16_factor_1_1023 0 6406.15835777126 /end CHARACTERISTIC
/begin CHARACTERISTIC CAL_idle_rpm_ramp_step "u8_rspeed_rpm" VALUE 0x40009028 RL_VALUE_UBYTE 0 CM_u8_rspeed_rpm 0 255 /end CHARACTERISTIC
/begin CHARACTERISTIC CAL_tps_limit_misfire_single_bank "Calibration: throttle position limit misfire single bank. Tunable map/constant (not a live channel); log to find misfires and which cylinder is responsible. (0-1; raw/255)" VALUE 0x40009029 RL_VALUE_UBYTE 0 CM_u8_factor_1_255 0 100 /end CHARACTERISTIC
/begin CHARACTERISTIC CAL_torque_tps_gain "Calibration: torque throttle position gain. Tunable map/constant (not a live channel); log to see throttle/pedal demand and throttle response. (0-1; raw/255)" VALUE 0x4000902F RL_VALUE_UBYTE 0 CM_u8_factor_1_255 0 100 /end CHARACTERISTIC
/begin CHARACTERISTIC CAL_tps_limit_severe_misfire_multi_cut "Calibration: throttle position limit severe misfire multi cut. Tunable map/constant (not a live channel); log to find misfires and which cylinder is responsible. (0-1; raw/255)" VALUE 0x40009037 RL_VALUE_UBYTE 0 CM_u8_factor_1_255 0 100 /end CHARACTERISTIC
/begin CHARACTERISTIC CAL_tps_limit_severe_misfire_1_cut "Calibration: throttle position limit severe misfire 1 cut. Tunable map/constant (not a live channel); log to find misfires and which cylinder is responsible. (0-1; raw/255)" VALUE 0x40009038 RL_VALUE_UBYTE 0 CM_u8_factor_1_255 0 100 /end CHARACTERISTIC
/begin CHARACTERISTIC CAL_tps_limit_severe_misfire_no_cut "Calibration: throttle position limit severe misfire no cut. Tunable map/constant (not a live channel); log to find misfires and which cylinder is responsible. (0-1; raw/255)" VALUE 0x40009039 RL_VALUE_UBYTE 0 CM_u8_factor_1_255 0 100 /end CHARACTERISTIC
/begin CHARACTERISTIC CAL_cooling_recirc_airtemp_disable_engine_on "uint8_t" VALUE 0x4000903F RL_VALUE_UBYTE 0 NO_COMPU_METHOD 0 255 /end CHARACTERISTIC
/begin CHARACTERISTIC CAL_tps_limit_warmup_coolant_max "u8_temp_5/8-40c" VALUE 0x40009040 RL_VALUE_UBYTE 0 CM_u8_temp_5_8_40c -40 119.375 /end CHARACTERISTIC
/begin CHARACTERISTIC CAL_tps_limit_warmup_stepsize "Calibration: throttle position limit warmup stepsize. Tunable map/constant (not a live channel); log to see throttle/pedal demand and throttle response. (0-1; raw/1023)" VALUE 0x40009041 RL_VALUE_UBYTE 0 CM_u16_factor_1_1023 0 24.9266862170088 /end CHARACTERISTIC
/begin CHARACTERISTIC CAL_cooling_recirc_rpm_enable_engine_on "uint8_t" VALUE 0x40009044 RL_VALUE_UBYTE 0 NO_COMPU_METHOD 0 255 /end CHARACTERISTIC
/begin CHARACTERISTIC CAL_cooling_afterrun_fan_timer_unknown "Calibration: cooling afterrun fan timer unknown. Tunable map/constant (not a live channel); log to confirm fans/pumps switch at the right temperatures." VALUE 0x40009045 RL_VALUE_UBYTE 0 NO_COMPU_METHOD 0 255 /end CHARACTERISTIC
/begin CHARACTERISTIC CAL_cooling_recirc_pump_run_ambient_max "Calibration: cooling recirc pump run ambient max. Tunable map/constant (not a live channel); log to confirm fans/pumps switch at the right temperatures. (deg C; raw*5/8-40)" VALUE 0x4000904A RL_VALUE_UBYTE 0 CM_u8_temp_5_8_40c -40 119.375 /end CHARACTERISTIC
/begin CHARACTERISTIC CAL_cooling_recirc_pump_rpm_max_enable "Calibration: cooling recirc pump RPM max enable. Tunable map/constant (not a live channel); log to confirm fans/pumps switch at the right temperatures. (RPM)" VALUE 0x4000904C RL_VALUE_UWORD 0 CM_u8_rspeed_rpm 0 65535 /end CHARACTERISTIC
/begin CHARACTERISTIC CAL_tpssmooth_decrement_comp_gears_ips "Calibration: tpssmooth decrement compensation gears IPS. Tunable map/constant (not a live channel); log to see throttle-signal smoothing/filtering behavior. (0-1; raw/255)" VAL_BLK 0x4000904E RL_VALUE_UBYTE 0 CM_u8_factor_1_255 0 100 NUMBER 7 /end CHARACTERISTIC
/begin CHARACTERISTIC CAL_idle_air_fast_decay_period "u8_time_ms" VALUE 0x40009059 RL_VALUE_UBYTE 0 CM_u8_time_ms 0 255 /end CHARACTERISTIC
/begin CHARACTERISTIC CAL_exhaust_flap_rpm1 "Calibration: exhaust flap rpm1. Tunable map/constant (not a live channel); log to see exhaust bypass valve position (sound/backpressure). (RPM)" VALUE 0x4000905A RL_VALUE_UWORD 0 CM_u8_rspeed_rpm 0 65535 /end CHARACTERISTIC
/begin CHARACTERISTIC CAL_exhaust_flap_rpm2 "Calibration: exhaust flap rpm2. Tunable map/constant (not a live channel); log to see exhaust bypass valve position (sound/backpressure). (RPM)" VALUE 0x4000905C RL_VALUE_UWORD 0 CM_u8_rspeed_rpm 0 65535 /end CHARACTERISTIC
/begin CHARACTERISTIC CAL_exhaust_flap_startup_delay "Calibration: exhaust flap startup delay. Tunable map/constant (not a live channel); log to see exhaust bypass valve position (sound/backpressure). (ms; raw*100)" VALUE 0x40009063 RL_VALUE_UBYTE 0 CM_u8_time_100ms 0 25500 /end CHARACTERISTIC
/begin CHARACTERISTIC CAL_revlimit_flow_correction_p_limit "u8_flow_g/s" VALUE 0x40009064 RL_VALUE_UBYTE 0 CM_u8_flow_g_s 0 255 /end CHARACTERISTIC
/begin CHARACTERISTIC CAL_revlimit_flow_correction_i_limit "uint8_t" VALUE 0x40009065 RL_VALUE_UBYTE 0 NO_COMPU_METHOD 0 255 /end CHARACTERISTIC
/begin CHARACTERISTIC CAL_revlimit_flow_slew_step "u8_flow_10mg/s" VALUE 0x40009066 RL_VALUE_UBYTE 0 CM_u16_flow_10mg_s 0 2550 /end CHARACTERISTIC
/begin CHARACTERISTIC CAL_revlimit_rpm_integral_limit "uint8_t" VALUE 0x40009067 RL_VALUE_UBYTE 0 NO_COMPU_METHOD 0 255 /end CHARACTERISTIC
/begin CHARACTERISTIC CAL_revlimit_flow_integral_limit "uint8_t" VALUE 0x40009068 RL_VALUE_UBYTE 0 NO_COMPU_METHOD 0 255 /end CHARACTERISTIC
/begin CHARACTERISTIC CAL_revlimit_maf_error_max "u8_flow_100mg/s" VALUE 0x40009069 RL_VALUE_UBYTE 0 CM_u8_flow_100mg_s 0 25500 /end CHARACTERISTIC
/begin CHARACTERISTIC CAL_wheel_speed_front_dvdt_scaling "u8_factor_1/256" VALUE 0x4000907D RL_VALUE_UBYTE 0 CM_u8_factor_1_256 0 99.609375 /end CHARACTERISTIC
/begin CHARACTERISTIC CAL_wheel_speed_front_accel_update_interval "uint8_t" VALUE 0x4000907E RL_VALUE_UBYTE 0 NO_COMPU_METHOD 0 255 /end CHARACTERISTIC
/begin CHARACTERISTIC CAL_revlimit_tps_cut_enable "Calibration: revlimit throttle position cut enable. Tunable map/constant (not a live channel); log to confirm where and how the rev limiter intervenes." VALUE 0x40009081 RL_VALUE_UBYTE 0 NO_COMPU_METHOD 0 255 /end CHARACTERISTIC
/begin CHARACTERISTIC CAL_revlimit_exit_margin "RPM margin below the soft limit required to fully exit rev limit mode and reset all state" VALUE 0x40009082 RL_VALUE_UBYTE 0 CM_u8_rspeed_10rpm 0 2550 /end CHARACTERISTIC
/begin CHARACTERISTIC CAL_revlimit_time_above_soft_threshold "Calibration: revlimit time above soft threshold. Tunable map/constant (not a live channel); log to confirm where and how the rev limiter intervenes. (ms; raw*100)" VALUE 0x40009083 RL_VALUE_UBYTE 0 CM_u8_time_100ms 0 25500 /end CHARACTERISTIC
/begin CHARACTERISTIC CAL_revlimit_max_with_speedlimit "Calibration: revlimit max with speedlimit. Tunable map/constant (not a live channel); log to confirm where and how the rev limiter intervenes. (RPM)" VALUE 0x40009084 RL_VALUE_UWORD 0 CM_u8_rspeed_rpm 0 65535 /end CHARACTERISTIC
/begin CHARACTERISTIC CAL_revlimit_bounce_count_threshold "The number of rev limit bounces before sustained rev limit mode and aggressive throttle management engage." VALUE 0x40009087 RL_VALUE_UBYTE 0 NO_COMPU_METHOD 0 255 /end CHARACTERISTIC
/begin CHARACTERISTIC CAL_idle_rpm_ramp_step_ips "uint8_t" VALUE 0x4000908E RL_VALUE_UBYTE 0 NO_COMPU_METHOD 0 255 /end CHARACTERISTIC
/begin CHARACTERISTIC CAL_tps_brake_wheeldecel_threshold "undefined1" VALUE 0x400090A8 RL_VALUE_UBYTE 0 NO_COMPU_METHOD 0 255 /end CHARACTERISTIC
/begin CHARACTERISTIC CAL_tps_brake_safety_floor "Calibration: throttle position brake safety floor. Tunable map/constant (not a live channel); log to see throttle/pedal demand and throttle response. (0-1; raw/100)" VALUE 0x400090A9 RL_VALUE_UBYTE 0 CM_u8_factor_1_100 0 255 /end CHARACTERISTIC
/begin CHARACTERISTIC CAL_tps_brake_wheeldecel_tps_cut_threshold "uint8_t" VALUE 0x400090AC RL_VALUE_UBYTE 0 NO_COMPU_METHOD 0 255 /end CHARACTERISTIC
/begin CHARACTERISTIC CAL_tpssmooth_parking_threshold_carspeed "uint8_t" VALUE 0x400090B4 RL_VALUE_UBYTE 0 NO_COMPU_METHOD 0 255 /end CHARACTERISTIC
/begin CHARACTERISTIC CAL_vvt_low_load_disable "Calibration: VVT low load disable. Tunable map/constant (not a live channel); log commanded vs actual cam timing to verify VVT response." VALUE 0x400090B5 RL_VALUE_UBYTE 0 NO_COMPU_METHOD 0 255 /end CHARACTERISTIC
/begin CHARACTERISTIC CAL_vvt_low_load_map_enable_temp "Calibration: VVT low load MAP enable temperature. Tunable map/constant (not a live channel); log commanded vs actual cam timing to verify VVT response. (deg C; raw*5/8-40)" VALUE 0x400090B7 RL_VALUE_UBYTE 0 CM_u8_temp_5_8_40c -40 119.375 /end CHARACTERISTIC
/begin CHARACTERISTIC CAL_tpssmooth_parking_threshold_tps "uint8_t" VALUE 0x400090B8 RL_VALUE_UBYTE 0 NO_COMPU_METHOD 0 255 /end CHARACTERISTIC
/begin CHARACTERISTIC CAL_tpssmooth_accel_pedal_modes_enable "Calibration: tpssmooth accelerator pedal modes enable. Tunable map/constant (not a live channel); log to see throttle-signal smoothing/filtering behavior." VALUE 0x400090B9 RL_VALUE_UBYTE 0 NO_COMPU_METHOD 0 255 /end CHARACTERISTIC
/begin CHARACTERISTIC CAL_tpssmooth_parking_pedal_max "Calibration: tpssmooth parking pedal max. Tunable map/constant (not a live channel); log to see throttle-signal smoothing/filtering behavior. (0-1; raw/255)" VALUE 0x400090BD RL_VALUE_UBYTE 0 CM_u8_factor_1_255 0 100 /end CHARACTERISTIC
/begin CHARACTERISTIC CAL_tpssmooth_parking_speed_max "Calibration: tpssmooth parking speed max. Tunable map/constant (not a live channel); log to see throttle-signal smoothing/filtering behavior. (km/h)" VALUE 0x400090BE RL_VALUE_UBYTE 0 CM_u8_speed_kph 0 255 /end CHARACTERISTIC
/begin CHARACTERISTIC CAL_tpssmooth_parking_gear_max "Calibration: tpssmooth parking gear max. Tunable map/constant (not a live channel); log to see throttle-signal smoothing/filtering behavior." VALUE 0x400090BF RL_VALUE_UBYTE 0 NO_COMPU_METHOD 0 255 /end CHARACTERISTIC
/begin CHARACTERISTIC CAL_torque_estimate_min_ips "short" VALUE 0x400090DE RL_VALUE_SWORD 0 NO_COMPU_METHOD -32768 32767 /end CHARACTERISTIC
/begin CHARACTERISTIC CAL_idle_learn_coolant_min "u8_temp_5/8-40c" VALUE 0x400090E2 RL_VALUE_UBYTE 0 CM_u8_temp_5_8_40c -40 119.375 /end CHARACTERISTIC
/begin CHARACTERISTIC CAL_idle_learn_temp_range "Calibration: idle learn temperature range. Tunable map/constant (not a live channel); log to diagnose idle quality, hunting, and stalls. (deg C; raw*5/8-40)" VAL_BLK 0x400090E3 RL_VALUE_UBYTE 0 CM_u8_temp_5_8_40c -40 119.375 NUMBER 2 /end CHARACTERISTIC
/begin CHARACTERISTIC CAL_vvt_low_load_ips_enable "Calibration: VVT low load IPS enable. Tunable map/constant (not a live channel); log commanded vs actual cam timing to verify VVT response." VALUE 0x400090EE RL_VALUE_UBYTE 0 NO_COMPU_METHOD 0 255 /end CHARACTERISTIC
/begin CHARACTERISTIC CAL_engine_speed_coolant_temp_unknown7 "u8_temp_5/8-40c" VALUE 0x400090F2 RL_VALUE_UBYTE 0 CM_u8_temp_5_8_40c -40 119.375 /end CHARACTERISTIC
/begin CHARACTERISTIC CAL_revlimit_enforce_delay_after_start "Calibration: revlimit enforce delay after start. Tunable map/constant (not a live channel); log to confirm where and how the rev limiter intervenes. (ms; raw*50)" VALUE 0x400090F3 RL_VALUE_UBYTE 0 CM_u8_time_50ms 0 12750 /end CHARACTERISTIC
/begin CHARACTERISTIC CAL_engine_speed_calc_unknown2 "u16_rspeed_1/4rpm" VALUE 0x400090F4 RL_VALUE_UWORD 0 CM_u16_rspeed_1_4rpm 0 16383.75 /end CHARACTERISTIC
/begin CHARACTERISTIC CAL_idle_underspeed_latch_rpm_delta "u16_rspeed_1/4rpm" VALUE 0x400090F6 RL_VALUE_UWORD 0 CM_u16_rspeed_1_4rpm 0 16383.75 /end CHARACTERISTIC
/begin CHARACTERISTIC CAL_exhaust_flap_load1 "Calibration: exhaust flap load1. Tunable map/constant (not a live channel); log to see exhaust bypass valve position (sound/backpressure). (mg/stroke; raw*4)" VALUE 0x400090FA RL_VALUE_UBYTE 0 CM_u8_load_4mg_stroke 0 1020 /end CHARACTERISTIC
/begin CHARACTERISTIC CAL_exhaust_flap_load2 "Calibration: exhaust flap load2. Tunable map/constant (not a live channel); log to see exhaust bypass valve position (sound/backpressure). (mg/stroke; raw*4)" VALUE 0x400090FB RL_VALUE_UBYTE 0 CM_u8_load_4mg_stroke 0 1020 /end CHARACTERISTIC
/begin CHARACTERISTIC CAL_torque_hysteresis_threshold1 "Calibration: torque hysteresis threshold1. Tunable map/constant (not a live channel); log to follow the ECU torque estimate and any torque limiting. (Nm)" VALUE 0x400090FC RL_VALUE_UBYTE 0 CM_u8_torque_nm 0 255 /end CHARACTERISTIC
/begin CHARACTERISTIC CAL_tpssmooth_parking_clutch_threshold "uint8_t" VALUE 0x40009106 RL_VALUE_UBYTE 0 NO_COMPU_METHOD 0 255 /end CHARACTERISTIC
/begin CHARACTERISTIC CAL_cooling_fan_iat_mid_timer_threshold "uint8_t" VALUE 0x4000910F RL_VALUE_UBYTE 0 NO_COMPU_METHOD 0 255 /end CHARACTERISTIC
/begin CHARACTERISTIC CAL_cooling_fan_high_iat "Calibration: cooling fan high intake-air temp. Tunable map/constant (not a live channel); log to confirm fans/pumps switch at the right temperatures. (deg C; raw*5/8-40)" VALUE 0x40009110 RL_VALUE_UBYTE 0 CM_u8_temp_5_8_40c -40 119.375 /end CHARACTERISTIC
/begin CHARACTERISTIC CAL_cooling_fan_iat_mid "Calibration: cooling fan intake-air temp mid. Tunable map/constant (not a live channel); log to confirm fans/pumps switch at the right temperatures. (deg C; raw*5/8-40)" VALUE 0x40009111 RL_VALUE_UBYTE 0 CM_u8_temp_5_8_40c -40 119.375 /end CHARACTERISTIC
/begin CHARACTERISTIC CAL_cooling_fan_iat_low "Calibration: cooling fan intake-air temp low. Tunable map/constant (not a live channel); log to confirm fans/pumps switch at the right temperatures. (deg C; raw*5/8-40)" VALUE 0x40009112 RL_VALUE_UBYTE 0 CM_u8_temp_5_8_40c -40 119.375 /end CHARACTERISTIC
/begin CHARACTERISTIC CAL_cooling_fan_carspeed_min "Calibration: cooling fan carspeed min. Tunable map/constant (not a live channel); log to confirm fans/pumps switch at the right temperatures. (km/h)" VALUE 0x40009113 RL_VALUE_UBYTE 0 CM_u8_speed_kph 0 255 /end CHARACTERISTIC
/begin CHARACTERISTIC CAL_idle_low_car_speed_exit "u8_speed_kph" VALUE 0x40009114 RL_VALUE_UBYTE 0 CM_u8_speed_kph 0 255 /end CHARACTERISTIC
/begin CHARACTERISTIC CAL_idle_low_car_speed_enter "u8_speed_kph" VALUE 0x40009115 RL_VALUE_UBYTE 0 CM_u8_speed_kph 0 255 /end CHARACTERISTIC
/begin CHARACTERISTIC CAL_oil_pressure_switch_voltage_scaling "u16_voltage_18/1023v" VALUE 0x4000911A RL_VALUE_UWORD 0 CM_u16_voltage_18_1023v 0 1153.10850439883 /end CHARACTERISTIC
/begin CHARACTERISTIC CAL_cooling_fan_rpm_inhibit_off "Calibration: cooling fan RPM inhibit off. Tunable map/constant (not a live channel); log to confirm fans/pumps switch at the right temperatures. (RPM; raw*4)" VALUE 0x40009122 RL_VALUE_UBYTE 0 CM_u8_rspeed_4rpm 0 1020 /end CHARACTERISTIC
/begin CHARACTERISTIC CAL_cooling_fan_rpm_inhibit_on "Calibration: cooling fan RPM inhibit on. Tunable map/constant (not a live channel); log to confirm fans/pumps switch at the right temperatures. (RPM; raw*4)" VALUE 0x40009123 RL_VALUE_UBYTE 0 CM_u8_rspeed_4rpm 0 1020 /end CHARACTERISTIC
/begin CHARACTERISTIC CAL_cooling_fan_low_rpm_hysteresis_threshold "uint16_t" VALUE 0x40009124 RL_VALUE_UWORD 0 NO_COMPU_METHOD 0 65535 /end CHARACTERISTIC
/begin CHARACTERISTIC CAL_oil_pressure_switch_offset "uint16_t" VALUE 0x40009126 RL_VALUE_UWORD 0 NO_COMPU_METHOD 0 65535 /end CHARACTERISTIC
/begin CHARACTERISTIC CAL_evap_purge_idle_speed_error_deadband "uint8_t" VALUE 0x4000912A RL_VALUE_UBYTE 0 NO_COMPU_METHOD 0 255 /end CHARACTERISTIC
/begin CHARACTERISTIC CAL_evap_purge_idle_lean_recovery_holdoff_ticks "uint8_t" VALUE 0x4000912B RL_VALUE_UBYTE 0 NO_COMPU_METHOD 0 255 /end CHARACTERISTIC
/begin CHARACTERISTIC CAL_evap_purge_mass_ratio_stft_inhibit_threshold "uint8_t" VALUE 0x4000912C RL_VALUE_UBYTE 0 NO_COMPU_METHOD 0 255 /end CHARACTERISTIC
/begin CHARACTERISTIC CAL_evap_purge_idle_speed_error_deadband_alt "uint8_t" VALUE 0x4000912D RL_VALUE_UBYTE 0 NO_COMPU_METHOD 0 255 /end CHARACTERISTIC
/begin CHARACTERISTIC CAL_cooling_fan_2_after_run_counter_threshold "uint8_t" VALUE 0x4000912F RL_VALUE_UBYTE 0 NO_COMPU_METHOD 0 255 /end CHARACTERISTIC
/begin AXIS_PTS CAL_racetc_slip_target_base_X_dpm_level "Slip target: used for RaceTC patch only." 0x40009132 NO_INPUT_QUANTITY RL_AXIS_UBYTE 0 NO_COMPU_METHOD 16 0 255 /end AXIS_PTS
/begin CHARACTERISTIC CAL_racetc_slip_target_base "Slip target: used for RaceTC patch only." CURVE 0x40009142 RL_VALUE_UBYTE 0 CM_u8_slip_1_8pct 0 31.875
 /begin AXIS_DESCR COM_AXIS NO_INPUT_QUANTITY NO_COMPU_METHOD 16 0 255 AXIS_PTS_REF CAL_racetc_slip_target_base_X_dpm_level /end AXIS_DESCR
/end CHARACTERISTIC
/begin AXIS_PTS CAL_idle_air_decay_period_X_phase "uint8_t[5]" 0x400094D4 idle_air_decay_phase RL_AXIS_UBYTE 0 NO_COMPU_METHOD 5 0 255 /end AXIS_PTS
/begin CHARACTERISTIC CAL_idle_air_decay_period "u8_time_ms[5]" CURVE 0x400094D9 RL_VALUE_UBYTE 0 CM_u8_time_ms 0 255
 /begin AXIS_DESCR COM_AXIS idle_air_decay_phase NO_COMPU_METHOD 5 0 255 AXIS_PTS_REF CAL_idle_air_decay_period_X_phase /end AXIS_DESCR
/end CHARACTERISTIC
/begin AXIS_PTS CAL_idle_comp_iat_X_iat "X-axis breakpoints for the 'idle compensation intake-air temp' table. Defines the lookup grid (not a live channel); change only when re-axing the map. (deg C; raw*5/8-40)" 0x40009526 airtemp_tmaf RL_AXIS_UBYTE 0 CM_u8_temp_5_8_40c 8 -40 119.375 /end AXIS_PTS
/begin CHARACTERISTIC CAL_idle_comp_iat "Calibration: idle compensation intake-air temp. Tunable map/constant (not a live channel); log to diagnose idle quality, hunting, and stalls. (RPM)" CURVE 0x4000952E RL_VALUE_UBYTE 0 CM_u8_rspeed_rpm 0 255
 /begin AXIS_DESCR COM_AXIS airtemp_tmaf CM_u8_temp_5_8_40c 8 -40 119.375 AXIS_PTS_REF CAL_idle_comp_iat_X_iat /end AXIS_DESCR
/end CHARACTERISTIC
/begin AXIS_PTS CAL_idle_comp_baro_X_baro "X-axis breakpoints for the 'idle compensation barometric' table. Defines the lookup grid (not a live channel); change only when re-axing the map. (mbar; raw*4)" 0x40009618 NO_INPUT_QUANTITY RL_AXIS_UBYTE 0 CM_u8_pressure_4mbar 8 0 1020 /end AXIS_PTS
/begin CHARACTERISTIC CAL_idle_comp_baro "Calibration: idle compensation barometric. Tunable map/constant (not a live channel); log to diagnose idle quality, hunting, and stalls. (RPM; raw-128)" CURVE 0x40009620 RL_VALUE_UBYTE 0 NO_COMPU_METHOD 0 255
 /begin AXIS_DESCR COM_AXIS NO_INPUT_QUANTITY CM_u8_pressure_4mbar 8 0 1020 AXIS_PTS_REF CAL_idle_comp_baro_X_baro /end AXIS_DESCR
/end CHARACTERISTIC
/begin AXIS_PTS CAL_engine_speed_filter_coeff_by_coolant_X_coolant "u8_temp_5/8-40c[4]" 0x40009628 coolant_temp RL_AXIS_UBYTE 0 CM_u8_temp_5_8_40c 4 -40 119.375 /end AXIS_PTS
/begin CHARACTERISTIC CAL_engine_speed_filter_coeff_by_coolant "u8_factor_1/255[4]" CURVE 0x4000962C RL_VALUE_UBYTE 0 CM_u8_factor_1_255 0 100
 /begin AXIS_DESCR COM_AXIS coolant_temp CM_u8_temp_5_8_40c 4 -40 119.375 AXIS_PTS_REF CAL_engine_speed_filter_coeff_by_coolant_X_coolant /end AXIS_DESCR
/end CHARACTERISTIC
/begin AXIS_PTS CAL_vvt_intake_advance_base_X_rpm "X-axis breakpoints for the 'VVT intake advance base' table. Defines the lookup grid (not a live channel); change only when re-axing the map. (RPM; raw*125/4+500)" 0x4000964A engine_speed_3 RL_AXIS_UBYTE 0 CM_u8_rspeed_125_4_500rpm 16 500 8468.75 /end AXIS_PTS
/begin AXIS_PTS CAL_vvt_intake_advance_base_Y_load "Y-axis breakpoints for the 'VVT intake advance base' table. Defines the lookup grid (not a live channel); change only when re-axing the map. (mg/stroke; raw*4)" 0x4000965A load_mass_per_stroke RL_AXIS_UBYTE 0 CM_u8_load_4mg_stroke 16 0 1020 /end AXIS_PTS
/begin CHARACTERISTIC CAL_vvt_intake_advance_base "Calibration: VVT intake advance base. Tunable map/constant (not a live channel); log commanded vs actual cam timing to verify VVT response. (deg; raw/4)" MAP 0x4000966A RL_VALUE_UBYTE 0 CM_u8_angle_1_4deg 0 63.75
 /begin AXIS_DESCR COM_AXIS engine_speed_3 CM_u8_rspeed_125_4_500rpm 16 500 8468.75 AXIS_PTS_REF CAL_vvt_intake_advance_base_X_rpm /end AXIS_DESCR
 /begin AXIS_DESCR COM_AXIS load_mass_per_stroke CM_u8_load_4mg_stroke 16 0 1020 AXIS_PTS_REF CAL_vvt_intake_advance_base_Y_load /end AXIS_DESCR
/end CHARACTERISTIC
/begin AXIS_PTS CAL_vvt_intake_advance_coolant_offset_X_coolant_temp "X-axis breakpoints for the 'VVT intake advance coolant offset' table. Defines the lookup grid (not a live channel); change only when re-axing the map. (deg C; raw*5/8-40)" 0x4000976A coolant_temp RL_AXIS_UBYTE 0 CM_u8_temp_5_8_40c 16 -40 119.375 /end AXIS_PTS
/begin CHARACTERISTIC CAL_vvt_intake_advance_coolant_offset "Calibration: VVT intake advance coolant offset. Tunable map/constant (not a live channel); log commanded vs actual cam timing to verify VVT response. (deg; raw/4)" CURVE 0x4000977A RL_VALUE_UBYTE 0 CM_u8_angle_1_4deg 0 63.75
 /begin AXIS_DESCR COM_AXIS coolant_temp CM_u8_temp_5_8_40c 16 -40 119.375 AXIS_PTS_REF CAL_vvt_intake_advance_coolant_offset_X_coolant_temp /end AXIS_DESCR
/end CHARACTERISTIC
/begin AXIS_PTS CAL_torque_engine_ac_load_base_X_ac "X-axis breakpoints for the 'torque engine A/C load base' table. Defines the lookup grid (not a live channel); change only when re-axing the map." 0x4000990E V_CAL_torque_engine_ac_load_base_X_ac RL_AXIS_UBYTE 0 NO_COMPU_METHOD 16 0 255 /end AXIS_PTS
/begin CHARACTERISTIC CAL_torque_engine_ac_load_base "Calibration: torque engine A/C load base. Tunable map/constant (not a live channel); log to follow the ECU torque estimate and any torque limiting." CURVE 0x4000991E RL_VALUE_UBYTE 0 NO_COMPU_METHOD 0 255
 /begin AXIS_DESCR COM_AXIS V_CAL_torque_engine_ac_load_base_X_ac NO_COMPU_METHOD 16 0 255 AXIS_PTS_REF CAL_torque_engine_ac_load_base_X_ac /end AXIS_DESCR
/end CHARACTERISTIC
/begin AXIS_PTS CAL_idle_target_manual_tour_X_coolant_temp "X-axis breakpoints for the 'idle target manual tour' table. Defines the lookup grid (not a live channel); change only when re-axing the map. (deg C; raw*5/8-40)" 0x40009992 NO_INPUT_QUANTITY RL_AXIS_UBYTE 0 CM_u8_temp_5_8_40c 16 -40 119.375 /end AXIS_PTS
/begin CHARACTERISTIC CAL_idle_target_manual_tour "Calibration: idle target manual tour. Tunable map/constant (not a live channel); log to diagnose idle quality, hunting, and stalls. (RPM; raw*4+500)" CURVE 0x400099A2 RL_VALUE_UBYTE 0 CM_u8_rspeed_4_500rpm 500 1520
 /begin AXIS_DESCR COM_AXIS NO_INPUT_QUANTITY CM_u8_temp_5_8_40c 16 -40 119.375 AXIS_PTS_REF CAL_idle_target_manual_tour_X_coolant_temp /end AXIS_DESCR
/end CHARACTERISTIC
/begin AXIS_PTS CAL_idle_air_warmup_factor_manual_X_coolant_temp "u8_temp_5/8-40c[16]" 0x400099B2 coolant_temp RL_AXIS_UBYTE 0 CM_u8_temp_5_8_40c 16 -40 119.375 /end AXIS_PTS
/begin AXIS_PTS CAL_idle_air_warmup_factor_manual_Y_maf_accumulated "uint8_t[8]" 0x400099C2 NO_INPUT_QUANTITY RL_AXIS_UBYTE 0 NO_COMPU_METHOD 8 0 255 /end AXIS_PTS
/begin CHARACTERISTIC CAL_idle_air_warmup_factor_manual "u8_factor_1/64[128]" MAP 0x400099CA RL_VALUE_UBYTE 0 CM_u8_factor_1_64 0 398.4375
 /begin AXIS_DESCR COM_AXIS coolant_temp CM_u8_temp_5_8_40c 16 -40 119.375 AXIS_PTS_REF CAL_idle_air_warmup_factor_manual_X_coolant_temp /end AXIS_DESCR
 /begin AXIS_DESCR COM_AXIS NO_INPUT_QUANTITY NO_COMPU_METHOD 8 0 255 AXIS_PTS_REF CAL_idle_air_warmup_factor_manual_Y_maf_accumulated /end AXIS_DESCR
/end CHARACTERISTIC
/begin AXIS_PTS CAL_idle_comp_ecu_voltage_X_voltage "X-axis breakpoints for the 'idle compensation ECU voltage' table. Defines the lookup grid (not a live channel); change only when re-axing the map. (V; raw*5/255)" 0x40009A4A V_CAL_idle_comp_ecu_voltage_X_voltage RL_AXIS_UBYTE 0 CM_u8_voltage_5_255v 8 0 5 /end AXIS_PTS
/begin CHARACTERISTIC CAL_idle_comp_ecu_voltage "Calibration: idle compensation ECU voltage. Tunable map/constant (not a live channel); log to diagnose idle quality, hunting, and stalls." CURVE 0x40009A52 RL_VALUE_UBYTE 0 NO_COMPU_METHOD 0 255
 /begin AXIS_DESCR COM_AXIS V_CAL_idle_comp_ecu_voltage_X_voltage CM_u8_voltage_5_255v 8 0 5 AXIS_PTS_REF CAL_idle_comp_ecu_voltage_X_voltage /end AXIS_DESCR
/end CHARACTERISTIC
/begin AXIS_PTS CAL_tpssmooth_increment_sport_driving_X_tps_rate "X-axis breakpoints for the 'tpssmooth increment sport driving' table. Defines the lookup grid (not a live channel); change only when re-axing the map. (0-1; raw/255)" 0x40009A5A NO_INPUT_QUANTITY RL_AXIS_UBYTE 0 CM_u8_factor_1_255 8 0 100 /end AXIS_PTS
/begin CHARACTERISTIC CAL_tpssmooth_increment_sport_driving "Calibration: tpssmooth increment sport driving. Tunable map/constant (not a live channel); log to see throttle-signal smoothing/filtering behavior. (0-1; raw/1023)" CURVE 0x40009A62 RL_VALUE_UBYTE 0 CM_u16_factor_1_1023 0 24.9266862170088
 /begin AXIS_DESCR COM_AXIS NO_INPUT_QUANTITY CM_u8_factor_1_255 8 0 100 AXIS_PTS_REF CAL_tpssmooth_increment_sport_driving_X_tps_rate /end AXIS_DESCR
/end CHARACTERISTIC
/begin AXIS_PTS CAL_idle_air_prop_gain_X_speed_error "X-axis breakpoints for the 'idle air prop gain' table. Defines the lookup grid (not a live channel); change only when re-axing the map." 0x40009A6A NO_INPUT_QUANTITY RL_AXIS_UBYTE 0 NO_COMPU_METHOD 16 0 255 /end AXIS_PTS
/begin CHARACTERISTIC CAL_idle_air_prop_gain "Calibration: idle air prop gain. Tunable map/constant (not a live channel); log to diagnose idle quality, hunting, and stalls. (0-1; raw/255)" CURVE 0x40009A7A RL_VALUE_UBYTE 0 CM_u8_factor_1_255 0 100
 /begin AXIS_DESCR COM_AXIS NO_INPUT_QUANTITY NO_COMPU_METHOD 16 0 255 AXIS_PTS_REF CAL_idle_air_prop_gain_X_speed_error /end AXIS_DESCR
/end CHARACTERISTIC
/begin AXIS_PTS CAL_idle_air_integral_step_X_speed_error "X-axis breakpoints for the 'idle air integral step' table. Defines the lookup grid (not a live channel); change only when re-axing the map. (0-1; raw/255)" 0x40009A8A NO_INPUT_QUANTITY RL_AXIS_UBYTE 0 CM_u8_factor_1_255 16 0 100 /end AXIS_PTS
/begin CHARACTERISTIC CAL_idle_air_integral_step "Calibration: idle air integral step. Tunable map/constant (not a live channel); log to diagnose idle quality, hunting, and stalls. (0-1; raw/255)" CURVE 0x40009A9A RL_VALUE_UBYTE 0 CM_u8_factor_1_255 0 100
 /begin AXIS_DESCR COM_AXIS NO_INPUT_QUANTITY CM_u8_factor_1_255 16 0 100 AXIS_PTS_REF CAL_idle_air_integral_step_X_speed_error /end AXIS_DESCR
/end CHARACTERISTIC
/begin AXIS_PTS CAL_idle_dashpot_rpm_lift_max_X_rpm "u8_rspeed_125/4+500rpm[8]" 0x40009BCA engine_speed_3 RL_AXIS_UBYTE 0 CM_u8_rspeed_125_4_500rpm 8 500 8468.75 /end AXIS_PTS
/begin CHARACTERISTIC CAL_idle_dashpot_rpm_lift_max "u8_rspeed_10rpm[8]" CURVE 0x40009BD2 RL_VALUE_UBYTE 0 CM_u8_rspeed_10rpm 0 2550
 /begin AXIS_DESCR COM_AXIS engine_speed_3 CM_u8_rspeed_125_4_500rpm 8 500 8468.75 AXIS_PTS_REF CAL_idle_dashpot_rpm_lift_max_X_rpm /end AXIS_DESCR
/end CHARACTERISTIC
/begin AXIS_PTS CAL_tpssmooth_increment_sport_shifting_X_tps_rate "X-axis breakpoints for the 'tpssmooth increment sport shifting' table. Defines the lookup grid (not a live channel); change only when re-axing the map. (0-1; raw/255)" 0x40009BDA NO_INPUT_QUANTITY RL_AXIS_UBYTE 0 CM_u8_factor_1_255 8 0 100 /end AXIS_PTS
/begin CHARACTERISTIC CAL_tpssmooth_increment_sport_shifting "Calibration: tpssmooth increment sport shifting. Tunable map/constant (not a live channel); log to see throttle-signal smoothing/filtering behavior. (0-1; raw/1023)" CURVE 0x40009BE2 RL_VALUE_UBYTE 0 CM_u16_factor_1_1023 0 24.9266862170088
 /begin AXIS_DESCR COM_AXIS NO_INPUT_QUANTITY CM_u8_factor_1_255 8 0 100 AXIS_PTS_REF CAL_tpssmooth_increment_sport_shifting_X_tps_rate /end AXIS_DESCR
/end CHARACTERISTIC
/begin AXIS_PTS CAL_idle_tps_from_air_demand_X_idle_air "X-axis breakpoints for the 'throttle position idle target' table. Defines the lookup grid (not a live channel); change only when re-axing the map. (g/s)" 0x40009BEA idle_air_decay_phase RL_AXIS_UBYTE 0 CM_u8_flow_100mg_s 8 0 25500 /end AXIS_PTS
/begin AXIS_PTS CAL_idle_tps_from_air_demand_Y_vacuum "Y-axis breakpoints for the 'throttle position idle target' table. Defines the lookup grid (not a live channel); change only when re-axing the map. (mbar; raw*4)" 0x40009BF2 V_CAL_idle_tps_from_air_demand_Y_vacuum RL_AXIS_UBYTE 0 CM_u8_pressure_4mbar 8 0 1020 /end AXIS_PTS
/begin CHARACTERISTIC CAL_idle_tps_from_air_demand "Calibration: throttle position idle target. Tunable map/constant (not a live channel); log to diagnose idle quality, hunting, and stalls. (0-1; raw/255)" MAP 0x40009BFA RL_VALUE_UBYTE 0 CM_u8_factor_1_255 0 100
 /begin AXIS_DESCR COM_AXIS idle_air_decay_phase CM_u8_flow_100mg_s 8 0 25500 AXIS_PTS_REF CAL_idle_tps_from_air_demand_X_idle_air /end AXIS_DESCR
 /begin AXIS_DESCR COM_AXIS V_CAL_idle_tps_from_air_demand_Y_vacuum CM_u8_pressure_4mbar 8 0 1020 AXIS_PTS_REF CAL_idle_tps_from_air_demand_Y_vacuum /end AXIS_DESCR
/end CHARACTERISTIC
/begin AXIS_PTS CAL_tps_scaling_factor_rpm_X_rpm "X-axis breakpoints for the 'throttle position scaling factor RPM' table. Defines the lookup grid (not a live channel); change only when re-axing the map. (RPM; raw*125/4+500)" 0x40009C52 engine_speed_3 RL_AXIS_UBYTE 0 CM_u8_rspeed_125_4_500rpm 16 500 8468.75 /end AXIS_PTS
/begin CHARACTERISTIC CAL_tps_scaling_factor_rpm "Calibration: throttle position scaling factor RPM. Tunable map/constant (not a live channel); log to see throttle/pedal demand and throttle response. (0-1; raw/255)" CURVE 0x40009C62 RL_VALUE_UBYTE 0 CM_u8_factor_1_255 0 100
 /begin AXIS_DESCR COM_AXIS engine_speed_3 CM_u8_rspeed_125_4_500rpm 16 500 8468.75 AXIS_PTS_REF CAL_tps_scaling_factor_rpm_X_rpm /end AXIS_DESCR
/end CHARACTERISTIC
/begin AXIS_PTS CAL_tpssmooth_increment_tour_shifting_X_tps_rate "X-axis breakpoints for the 'tpssmooth increment tour shifting' table. Defines the lookup grid (not a live channel); change only when re-axing the map. (0-1; raw/255)" 0x40009C72 NO_INPUT_QUANTITY RL_AXIS_UBYTE 0 CM_u8_factor_1_255 8 0 100 /end AXIS_PTS
/begin CHARACTERISTIC CAL_tpssmooth_increment_tour_shifting "Calibration: tpssmooth increment tour shifting. Tunable map/constant (not a live channel); log to see throttle-signal smoothing/filtering behavior. (0-1; raw/1023)" CURVE 0x40009C7A RL_VALUE_UBYTE 0 CM_u16_factor_1_1023 0 24.9266862170088
 /begin AXIS_DESCR COM_AXIS NO_INPUT_QUANTITY CM_u8_factor_1_255 8 0 100 AXIS_PTS_REF CAL_tpssmooth_increment_tour_shifting_X_tps_rate /end AXIS_DESCR
/end CHARACTERISTIC
/begin AXIS_PTS CAL_idle_target_manual_sport_X_coolant_temp "X-axis breakpoints for the 'idle target manual sport' table. Defines the lookup grid (not a live channel); change only when re-axing the map. (deg C; raw*5/8-40)" 0x4000A20A NO_INPUT_QUANTITY RL_AXIS_UBYTE 0 CM_u8_temp_5_8_40c 16 -40 119.375 /end AXIS_PTS
/begin CHARACTERISTIC CAL_idle_target_manual_sport "Calibration: idle target manual sport. Tunable map/constant (not a live channel); log to diagnose idle quality, hunting, and stalls. (RPM; raw*4+500)" CURVE 0x4000A21A RL_VALUE_UBYTE 0 CM_u8_rspeed_4_500rpm 500 1520
 /begin AXIS_DESCR COM_AXIS NO_INPUT_QUANTITY CM_u8_temp_5_8_40c 16 -40 119.375 AXIS_PTS_REF CAL_idle_target_manual_sport_X_coolant_temp /end AXIS_DESCR
/end CHARACTERISTIC
/begin AXIS_PTS CAL_vvt_exhaust_advance_base_X_rpm "X-axis breakpoints for the 'VVT exhaust advance base' table. Defines the lookup grid (not a live channel); change only when re-axing the map. (RPM; raw*125/4+500)" 0x4000A24A engine_speed_3 RL_AXIS_UBYTE 0 CM_u8_rspeed_125_4_500rpm 16 500 8468.75 /end AXIS_PTS
/begin AXIS_PTS CAL_vvt_exhaust_advance_base_Y_load "Y-axis breakpoints for the 'VVT exhaust advance base' table. Defines the lookup grid (not a live channel); change only when re-axing the map. (mg/stroke; raw*4)" 0x4000A25A load_mass_per_stroke RL_AXIS_UBYTE 0 CM_u8_load_4mg_stroke 16 0 1020 /end AXIS_PTS
/begin CHARACTERISTIC CAL_vvt_exhaust_advance_base "Calibration: VVT exhaust advance base. Tunable map/constant (not a live channel); log commanded vs actual cam timing to verify VVT response. (deg; raw/4)" MAP 0x4000A26A RL_VALUE_UBYTE 0 CM_u8_angle_1_4deg 0 63.75
 /begin AXIS_DESCR COM_AXIS engine_speed_3 CM_u8_rspeed_125_4_500rpm 16 500 8468.75 AXIS_PTS_REF CAL_vvt_exhaust_advance_base_X_rpm /end AXIS_DESCR
 /begin AXIS_DESCR COM_AXIS load_mass_per_stroke CM_u8_load_4mg_stroke 16 0 1020 AXIS_PTS_REF CAL_vvt_exhaust_advance_base_Y_load /end AXIS_DESCR
/end CHARACTERISTIC
/begin AXIS_PTS CAL_tpssmooth_increment_tour_driving_X_tps_rate "X-axis breakpoints for the 'tpssmooth increment tour driving' table. Defines the lookup grid (not a live channel); change only when re-axing the map. (0-1; raw/255)" 0x4000A39A NO_INPUT_QUANTITY RL_AXIS_UBYTE 0 CM_u8_factor_1_255 8 0 100 /end AXIS_PTS
/begin CHARACTERISTIC CAL_tpssmooth_increment_tour_driving "Calibration: tpssmooth increment tour driving. Tunable map/constant (not a live channel); log to see throttle-signal smoothing/filtering behavior. (0-1; raw/1023)" CURVE 0x4000A3A2 RL_VALUE_UBYTE 0 CM_u16_factor_1_1023 0 24.9266862170088
 /begin AXIS_DESCR COM_AXIS NO_INPUT_QUANTITY CM_u8_factor_1_255 8 0 100 AXIS_PTS_REF CAL_tpssmooth_increment_tour_driving_X_tps_rate /end AXIS_DESCR
/end CHARACTERISTIC
/begin AXIS_PTS CAL_torque_engine_ac_load_scaler_X_rpm "X-axis breakpoints for the 'torque engine A/C load scaler' table. Defines the lookup grid (not a live channel); change only when re-axing the map." 0x4000A4A6 engine_speed_3 RL_AXIS_UBYTE 0 NO_COMPU_METHOD 8 0 255 /end AXIS_PTS
/begin CHARACTERISTIC CAL_torque_engine_ac_load_scaler "Calibration: torque engine A/C load scaler. Tunable map/constant (not a live channel); log to follow the ECU torque estimate and any torque limiting. (0-1; raw/255)" CURVE 0x4000A4AE RL_VALUE_UBYTE 0 CM_u8_factor_1_255 0 100
 /begin AXIS_DESCR COM_AXIS engine_speed_3 NO_COMPU_METHOD 8 0 255 AXIS_PTS_REF CAL_torque_engine_ac_load_scaler_X_rpm /end AXIS_DESCR
/end CHARACTERISTIC
/begin AXIS_PTS CAL_tps_idle_target_cranking_X_baro "X-axis breakpoints for the 'throttle position idle target cranking' table. Defines the lookup grid (not a live channel); change only when re-axing the map. (mbar; raw*4)" 0x4000A5A2 NO_INPUT_QUANTITY RL_AXIS_UBYTE 0 CM_u8_pressure_4mbar 4 0 1020 /end AXIS_PTS
/begin AXIS_PTS CAL_tps_idle_target_cranking_Y_coolant "Y-axis breakpoints for the 'throttle position idle target cranking' table. Defines the lookup grid (not a live channel); change only when re-axing the map. (deg C; raw*5/8-40)" 0x4000A5A6 coolant_temp RL_AXIS_UBYTE 0 CM_u8_temp_5_8_40c 16 -40 119.375 /end AXIS_PTS
/begin CHARACTERISTIC CAL_tps_idle_target_cranking "Calibration: throttle position idle target cranking. Tunable map/constant (not a live channel); log to diagnose idle quality, hunting, and stalls. (0-1; raw/1023)" MAP 0x4000A5B6 RL_VALUE_UBYTE 0 CM_u16_factor_1_1023 0 24.9266862170088
 /begin AXIS_DESCR COM_AXIS NO_INPUT_QUANTITY CM_u8_pressure_4mbar 4 0 1020 AXIS_PTS_REF CAL_tps_idle_target_cranking_X_baro /end AXIS_DESCR
 /begin AXIS_DESCR COM_AXIS coolant_temp CM_u8_temp_5_8_40c 16 -40 119.375 AXIS_PTS_REF CAL_tps_idle_target_cranking_Y_coolant /end AXIS_DESCR
/end CHARACTERISTIC
/begin AXIS_PTS CAL_idle_air_base_manual_X_rpm "u16_rspeed_rpm[16]" 0x4000A61A obd_ii_idle_speed_target_total RL_AXIS_UWORD 0 CM_u8_rspeed_rpm 16 0 65535 /end AXIS_PTS
/begin CHARACTERISTIC CAL_idle_air_base_manual "u16_flow_100/256mg/s[16]" CURVE 0x4000A63A RL_VALUE_UWORD 0 CM_u16_flow_100_256mg_s 0 25599.609375
 /begin AXIS_DESCR COM_AXIS obd_ii_idle_speed_target_total CM_u8_rspeed_rpm 16 0 65535 AXIS_PTS_REF CAL_idle_air_base_manual_X_rpm /end AXIS_DESCR
/end CHARACTERISTIC
/begin AXIS_PTS CAL_cooling_fan_afterrun_X_air_temp "X-axis breakpoints for the 'cooling fan afterrun' table. Defines the lookup grid (not a live channel); change only when re-axing the map. (deg C; raw*5/8-40)" 0x4000A65A airtemp_tmaf RL_AXIS_UBYTE 0 CM_u8_temp_5_8_40c 8 -40 119.375 /end AXIS_PTS
/begin AXIS_PTS CAL_cooling_fan_afterrun_Y_coolant_temp "Y-axis breakpoints for the 'cooling fan afterrun' table. Defines the lookup grid (not a live channel); change only when re-axing the map. (deg C; raw*5/8-40)" 0x4000A662 coolant_temp RL_AXIS_UBYTE 0 CM_u8_temp_5_8_40c 8 -40 119.375 /end AXIS_PTS
/begin CHARACTERISTIC CAL_cooling_fan_afterrun "Calibration: cooling fan afterrun. Tunable map/constant (not a live channel); log to confirm fans/pumps switch at the right temperatures. (ms; raw*250)" MAP 0x4000A66A RL_VALUE_UBYTE 0 CM_u8_time_5s 0 1275
 /begin AXIS_DESCR COM_AXIS airtemp_tmaf CM_u8_temp_5_8_40c 8 -40 119.375 AXIS_PTS_REF CAL_cooling_fan_afterrun_X_air_temp /end AXIS_DESCR
 /begin AXIS_DESCR COM_AXIS coolant_temp CM_u8_temp_5_8_40c 8 -40 119.375 AXIS_PTS_REF CAL_cooling_fan_afterrun_Y_coolant_temp /end AXIS_DESCR
/end CHARACTERISTIC
/begin AXIS_PTS CAL_idle_comp_ac_load_X_ac_load "X-axis breakpoints for the 'idle compensation A/C load' table. Defines the lookup grid (not a live channel); change only when re-axing the map." 0x4000A6AA V_CAL_idle_comp_ac_load_X_ac_load RL_AXIS_UBYTE 0 NO_COMPU_METHOD 8 0 255 /end AXIS_PTS
/begin CHARACTERISTIC CAL_idle_comp_ac_load "Calibration: idle compensation A/C load. Tunable map/constant (not a live channel); log to diagnose idle quality, hunting, and stalls." CURVE 0x4000A6B2 RL_VALUE_UBYTE 0 CM_u8_flow_100mg_s 0 25500
 /begin AXIS_DESCR COM_AXIS V_CAL_idle_comp_ac_load_X_ac_load NO_COMPU_METHOD 8 0 255 AXIS_PTS_REF CAL_idle_comp_ac_load_X_ac_load /end AXIS_DESCR
/end CHARACTERISTIC
/begin AXIS_PTS CAL_idle_air_comp_fan_1_X_time "uint8_t[8]" 0x4000A6BA fan_1_on_timer RL_AXIS_UBYTE 0 NO_COMPU_METHOD 8 0 255 /end AXIS_PTS
/begin CHARACTERISTIC CAL_idle_air_comp_fan_1 "u8_flow_100mg/s[8]" CURVE 0x4000A6C2 RL_VALUE_UBYTE 0 CM_u8_flow_100mg_s 0 25500
 /begin AXIS_DESCR COM_AXIS fan_1_on_timer NO_COMPU_METHOD 8 0 255 AXIS_PTS_REF CAL_idle_air_comp_fan_1_X_time /end AXIS_DESCR
/end CHARACTERISTIC
/begin AXIS_PTS CAL_idle_air_comp_fan_2_X_time "uint8_t[8]" 0x4000A6CA fan_2_on_timer RL_AXIS_UBYTE 0 NO_COMPU_METHOD 8 0 255 /end AXIS_PTS
/begin CHARACTERISTIC CAL_idle_air_comp_fan_2 "u8_flow_100mg/s[8]" CURVE 0x4000A6D2 RL_VALUE_UBYTE 0 CM_u8_flow_100mg_s 0 25500
 /begin AXIS_DESCR COM_AXIS fan_2_on_timer NO_COMPU_METHOD 8 0 255 AXIS_PTS_REF CAL_idle_air_comp_fan_2_X_time /end AXIS_DESCR
/end CHARACTERISTIC
/begin AXIS_PTS CAL_idle_comp_carspeed_manual_X_carspeed "X-axis breakpoints for the 'idle compensation carspeed manual' table. Defines the lookup grid (not a live channel); change only when re-axing the map. (km/h)" 0x4000A6FA car_speed_u8 RL_AXIS_UBYTE 0 CM_u8_speed_kph 8 0 255 /end AXIS_PTS
/begin CHARACTERISTIC CAL_idle_comp_carspeed_manual "Calibration: idle compensation carspeed manual. Tunable map/constant (not a live channel); log to diagnose idle quality, hunting, and stalls. (RPM; raw*4)" CURVE 0x4000A702 RL_VALUE_UBYTE 0 CM_u8_rspeed_4rpm 0 1020
 /begin AXIS_DESCR COM_AXIS car_speed_u8 CM_u8_speed_kph 8 0 255 AXIS_PTS_REF CAL_idle_comp_carspeed_manual_X_carspeed /end AXIS_DESCR
/end CHARACTERISTIC
/begin AXIS_PTS CAL_idle_comp_car_speed_manual_X_carspeed "X-axis breakpoints for the 'idle compensation car speed manual' table. Defines the lookup grid (not a live channel); change only when re-axing the map. (km/h)" 0x4000A70A car_speed_u8 RL_AXIS_UBYTE 0 CM_u8_speed_kph 8 0 255 /end AXIS_PTS
/begin CHARACTERISTIC CAL_idle_comp_car_speed_manual "Calibration: idle compensation car speed manual. Tunable map/constant (not a live channel); log to diagnose idle quality, hunting, and stalls. (RPM)" CURVE 0x4000A712 RL_VALUE_UBYTE 0 CM_u8_flow_100mg_s 0 25500
 /begin AXIS_DESCR COM_AXIS car_speed_u8 CM_u8_speed_kph 8 0 255 AXIS_PTS_REF CAL_idle_comp_car_speed_manual_X_carspeed /end AXIS_DESCR
/end CHARACTERISTIC
/begin AXIS_PTS CAL_idle_comp_timer_carspeed_manual_X_airtemp "X-axis breakpoints for the 'idle compensation timer carspeed manual' table. Defines the lookup grid (not a live channel); change only when re-axing the map. (deg C; raw*5/8-40)" 0x4000A71A NO_INPUT_QUANTITY RL_AXIS_UBYTE 0 CM_u8_temp_5_8_40c 8 -40 119.375 /end AXIS_PTS
/begin AXIS_PTS CAL_idle_comp_timer_carspeed_manual_Y_time_above_speed "Y-axis breakpoints for the 'idle compensation timer carspeed manual' table. Defines the lookup grid (not a live channel); change only when re-axing the map." 0x4000A722 timer_above_min_carspeed RL_AXIS_UBYTE 0 NO_COMPU_METHOD 8 0 255 /end AXIS_PTS
/begin CHARACTERISTIC CAL_idle_comp_timer_carspeed_manual "Calibration: idle compensation timer carspeed manual. Tunable map/constant (not a live channel); log to diagnose idle quality, hunting, and stalls. (RPM; raw*8)" MAP 0x4000A72A RL_VALUE_UBYTE 0 CM_u8_rspeed_8rpm 0 2040
 /begin AXIS_DESCR COM_AXIS NO_INPUT_QUANTITY CM_u8_temp_5_8_40c 8 -40 119.375 AXIS_PTS_REF CAL_idle_comp_timer_carspeed_manual_X_airtemp /end AXIS_DESCR
 /begin AXIS_DESCR COM_AXIS timer_above_min_carspeed NO_COMPU_METHOD 8 0 255 AXIS_PTS_REF CAL_idle_comp_timer_carspeed_manual_Y_time_above_speed /end AXIS_DESCR
/end CHARACTERISTIC
/begin AXIS_PTS CAL_idle_air_hi_rpm_adder_X_rpm "u8_rspeed_125/4+500rpm[16]" 0x4000B112 engine_speed_3 RL_AXIS_UBYTE 0 CM_u8_rspeed_125_4_500rpm 16 500 8468.75 /end AXIS_PTS
/begin CHARACTERISTIC CAL_idle_air_hi_rpm_adder "u8_flow_100mg/s[16]" CURVE 0x4000B122 RL_VALUE_UBYTE 0 CM_u8_flow_100mg_s 0 25500
 /begin AXIS_DESCR COM_AXIS engine_speed_3 CM_u8_rspeed_125_4_500rpm 16 500 8468.75 AXIS_PTS_REF CAL_idle_air_hi_rpm_adder_X_rpm /end AXIS_DESCR
/end CHARACTERISTIC
/begin AXIS_PTS CAL_tpssmooth_decrement_by_delta_X_tps_delta "X-axis breakpoints for the 'tpssmooth decrement by delta' table. Defines the lookup grid (not a live channel); change only when re-axing the map. (0-1; raw/255)" 0x4000B132 NO_INPUT_QUANTITY RL_AXIS_UBYTE 0 CM_u8_factor_1_255 8 0 100 /end AXIS_PTS
/begin CHARACTERISTIC CAL_tpssmooth_decrement_by_delta "Calibration: tpssmooth decrement by delta. Tunable map/constant (not a live channel); log to see throttle-signal smoothing/filtering behavior. (0-1; raw/255)" CURVE 0x4000B13A RL_VALUE_UBYTE 0 CM_u8_factor_1_255 0 100
 /begin AXIS_DESCR COM_AXIS NO_INPUT_QUANTITY CM_u8_factor_1_255 8 0 100 AXIS_PTS_REF CAL_tpssmooth_decrement_by_delta_X_tps_delta /end AXIS_DESCR
/end CHARACTERISTIC
/begin AXIS_PTS CAL_revlimit_speed_base_manual_gearbox_tour_X_coolant "X-axis breakpoints for the 'revlimit speed base manual gearbox tour' table. Defines the lookup grid (not a live channel); change only when re-axing the map. (deg C; raw*5/8-40)" 0x4000B142 coolant_temp RL_AXIS_UBYTE 0 CM_u8_temp_5_8_40c 8 -40 119.375 /end AXIS_PTS
/begin AXIS_PTS CAL_revlimit_speed_base_manual_gearbox_tour_Y_timer "Y-axis breakpoints for the 'revlimit speed base manual gearbox tour' table. Defines the lookup grid (not a live channel); change only when re-axing the map. (ms; raw*100)" 0x4000B14A NO_INPUT_QUANTITY RL_AXIS_UBYTE 0 CM_u8_time_100ms 8 0 25500 /end AXIS_PTS
/begin CHARACTERISTIC CAL_revlimit_speed_base_manual_gearbox_tour "Calibration: revlimit speed base manual gearbox tour. Tunable map/constant (not a live channel); log to confirm where and how the rev limiter intervenes. (RPM; raw*10+6000)" MAP 0x4000B152 RL_VALUE_UBYTE 0 CM_u8_rspeed_10_6000rpm 6000 8550
 /begin AXIS_DESCR COM_AXIS coolant_temp CM_u8_temp_5_8_40c 8 -40 119.375 AXIS_PTS_REF CAL_revlimit_speed_base_manual_gearbox_tour_X_coolant /end AXIS_DESCR
 /begin AXIS_DESCR COM_AXIS NO_INPUT_QUANTITY CM_u8_time_100ms 8 0 25500 AXIS_PTS_REF CAL_revlimit_speed_base_manual_gearbox_tour_Y_timer /end AXIS_DESCR
/end CHARACTERISTIC
/begin AXIS_PTS CAL_vvt_start_timer_X_coolant_temp "X-axis breakpoints for the 'VVT start timer' table. Defines the lookup grid (not a live channel); change only when re-axing the map. (deg C; raw*5/8-40)" 0x4000B1E2 coolant_temp_engine_stopped RL_AXIS_UBYTE 0 CM_u8_temp_5_8_40c 8 -40 119.375 /end AXIS_PTS
/begin CHARACTERISTIC CAL_vvt_start_timer "Calibration: VVT start timer. Tunable map/constant (not a live channel); log commanded vs actual cam timing to verify VVT response. (ms; raw*100)" CURVE 0x4000B1EA RL_VALUE_UBYTE 0 CM_u8_time_100ms 0 25500
 /begin AXIS_DESCR COM_AXIS coolant_temp_engine_stopped CM_u8_temp_5_8_40c 8 -40 119.375 AXIS_PTS_REF CAL_vvt_start_timer_X_coolant_temp /end AXIS_DESCR
/end CHARACTERISTIC
/begin AXIS_PTS CAL_revlimit_speed_base_manual_gearbox_sport_X_coolant "X-axis breakpoints for the 'revlimit speed base manual gearbox sport' table. Defines the lookup grid (not a live channel); change only when re-axing the map. (deg C; raw*5/8-40)" 0x4000B452 coolant_temp RL_AXIS_UBYTE 0 CM_u8_temp_5_8_40c 8 -40 119.375 /end AXIS_PTS
/begin AXIS_PTS CAL_revlimit_speed_base_manual_gearbox_sport_Y_timer "Y-axis breakpoints for the 'revlimit speed base manual gearbox sport' table. Defines the lookup grid (not a live channel); change only when re-axing the map. (ms; raw*100)" 0x4000B45A NO_INPUT_QUANTITY RL_AXIS_UBYTE 0 CM_u8_time_100ms 8 0 25500 /end AXIS_PTS
/begin CHARACTERISTIC CAL_revlimit_speed_base_manual_gearbox_sport "Calibration: revlimit speed base manual gearbox sport. Tunable map/constant (not a live channel); log to confirm where and how the rev limiter intervenes. (RPM; raw*10+6000)" MAP 0x4000B462 RL_VALUE_UBYTE 0 CM_u8_rspeed_10_6000rpm 6000 8550
 /begin AXIS_DESCR COM_AXIS coolant_temp CM_u8_temp_5_8_40c 8 -40 119.375 AXIS_PTS_REF CAL_revlimit_speed_base_manual_gearbox_sport_X_coolant /end AXIS_DESCR
 /begin AXIS_DESCR COM_AXIS NO_INPUT_QUANTITY CM_u8_time_100ms 8 0 25500 AXIS_PTS_REF CAL_revlimit_speed_base_manual_gearbox_sport_Y_timer /end AXIS_DESCR
/end CHARACTERISTIC
/begin AXIS_PTS CAL_idle_air_comp_bay_fan_X_time "uint8_t[8]" 0x4000B532 fan_engine_bay_ramp_timer RL_AXIS_UBYTE 0 NO_COMPU_METHOD 8 0 255 /end AXIS_PTS
/begin CHARACTERISTIC CAL_idle_air_comp_bay_fan "u8_flow_100mg/s[8]" CURVE 0x4000B53A RL_VALUE_UBYTE 0 CM_u8_flow_100mg_s 0 25500
 /begin AXIS_DESCR COM_AXIS fan_engine_bay_ramp_timer NO_COMPU_METHOD 8 0 255 AXIS_PTS_REF CAL_idle_air_comp_bay_fan_X_time /end AXIS_DESCR
/end CHARACTERISTIC
/begin AXIS_PTS CAL_revlimit_escalation_integrator_step_X_gear "X-axis breakpoints for the 'revlimit escalation integrator step' table. Defines the lookup grid (not a live channel); change only when re-axing the map." 0x4000B562 car_gear_current RL_AXIS_UBYTE 0 NO_COMPU_METHOD 7 0 255 /end AXIS_PTS
/begin CHARACTERISTIC CAL_revlimit_escalation_integrator_step "Calibration: revlimit escalation integrator step. Tunable map/constant (not a live channel); log to confirm where and how the rev limiter intervenes." CURVE 0x4000B569 RL_VALUE_UBYTE 0 NO_COMPU_METHOD 0 255
 /begin AXIS_DESCR COM_AXIS car_gear_current NO_COMPU_METHOD 7 0 255 AXIS_PTS_REF CAL_revlimit_escalation_integrator_step_X_gear /end AXIS_DESCR
/end CHARACTERISTIC
/begin AXIS_PTS CAL_idle_target_ips_ingear_tour_X_coolant_temp "X-axis breakpoints for the 'idle target IPS ingear tour' table. Defines the lookup grid (not a live channel); change only when re-axing the map. (deg C; raw*5/8-40)" 0x4000B5A2 NO_INPUT_QUANTITY RL_AXIS_UBYTE 0 CM_u8_temp_5_8_40c 16 -40 119.375 /end AXIS_PTS
/begin CHARACTERISTIC CAL_idle_target_ips_ingear_tour "Calibration: idle target IPS ingear tour. Tunable map/constant (not a live channel); log to diagnose idle quality, hunting, and stalls. (RPM; raw*4+500)" CURVE 0x4000B5B2 RL_VALUE_UBYTE 0 CM_u8_rspeed_4_500rpm 500 1520
 /begin AXIS_DESCR COM_AXIS NO_INPUT_QUANTITY CM_u8_temp_5_8_40c 16 -40 119.375 AXIS_PTS_REF CAL_idle_target_ips_ingear_tour_X_coolant_temp /end AXIS_DESCR
/end CHARACTERISTIC
/begin AXIS_PTS CAL_tpstarget_low_gear_tour_ips_X_pps "X-axis breakpoints for the 'tpstarget low gear tour IPS' table. Defines the lookup grid (not a live channel); change only when re-axing the map. (0-1; raw/1023)" 0x4000B802 NO_INPUT_QUANTITY RL_AXIS_UWORD 0 CM_u16_factor_1_1023 16 0 6406.15835777126 /end AXIS_PTS
/begin CHARACTERISTIC CAL_tpstarget_low_gear_tour_ips "Calibration: tpstarget low gear tour IPS. Tunable map/constant (not a live channel); log to compare requested throttle target to pedal demand. (0-1; raw/1023)" CURVE 0x4000B822 RL_VALUE_UWORD 0 CM_u16_factor_1_1023 0 6406.15835777126
 /begin AXIS_DESCR COM_AXIS NO_INPUT_QUANTITY CM_u16_factor_1_1023 16 0 6406.15835777126 AXIS_PTS_REF CAL_tpstarget_low_gear_tour_ips_X_pps /end AXIS_DESCR
/end CHARACTERISTIC
/begin AXIS_PTS CAL_tpstarget_sport_ips_X_pps "X-axis breakpoints for the 'tpstarget sport IPS' table. Defines the lookup grid (not a live channel); change only when re-axing the map. (0-1; raw/1023)" 0x4000B842 NO_INPUT_QUANTITY RL_AXIS_UWORD 0 CM_u16_factor_1_1023 16 0 6406.15835777126 /end AXIS_PTS
/begin CHARACTERISTIC CAL_tpstarget_sport_ips "Calibration: tpstarget sport IPS. Tunable map/constant (not a live channel); log to compare requested throttle target to pedal demand. (0-1; raw/1023)" CURVE 0x4000B862 RL_VALUE_UWORD 0 CM_u16_factor_1_1023 0 6406.15835777126
 /begin AXIS_DESCR COM_AXIS NO_INPUT_QUANTITY CM_u16_factor_1_1023 16 0 6406.15835777126 AXIS_PTS_REF CAL_tpstarget_sport_ips_X_pps /end AXIS_DESCR
/end CHARACTERISTIC
/begin CHARACTERISTIC CAL_evap_purge_flow_X_vacuum "X-axis (filtered vacuum, 4 mbar/count) for CAL_evap_purge_flow_max_duty." VAL_BLK 0x4000BA72 RL_VALUE_UBYTE 0 CM_u8_pressure_4mbar 0 1020 NUMBER 8 /end CHARACTERISTIC
/begin CHARACTERISTIC CAL_evap_purge_flow_max_duty "Max evap purge duty allowed vs filtered manifold vacuum (flow limit). 0 when vacuum = 0." VAL_BLK 0x4000BA7A RL_VALUE_UBYTE 0 CM_u8_factor_1_255 0 100 NUMBER 8 /end CHARACTERISTIC
/begin AXIS_PTS CAL_tpstarget_tour_manual_X_pps "X-axis breakpoints for the 'tpstarget tour manual' table. Defines the lookup grid (not a live channel); change only when re-axing the map. (0-1; raw/1023)" 0x4000BA82 NO_INPUT_QUANTITY RL_AXIS_UWORD 0 CM_u16_factor_1_1023 16 0 6406.15835777126 /end AXIS_PTS
/begin CHARACTERISTIC CAL_tpstarget_tour_manual "Calibration: tpstarget tour manual. Tunable map/constant (not a live channel); log to compare requested throttle target to pedal demand. (0-1; raw/1023)" CURVE 0x4000BAA2 RL_VALUE_UWORD 0 CM_u16_factor_1_1023 0 6406.15835777126
 /begin AXIS_DESCR COM_AXIS NO_INPUT_QUANTITY CM_u16_factor_1_1023 16 0 6406.15835777126 AXIS_PTS_REF CAL_tpstarget_tour_manual_X_pps /end AXIS_DESCR
/end CHARACTERISTIC
/begin AXIS_PTS CAL_tpstarget_sport_manual_X_pps "X-axis breakpoints for the 'tpstarget sport manual' table. Defines the lookup grid (not a live channel); change only when re-axing the map. (0-1; raw/1023)" 0x4000BB02 NO_INPUT_QUANTITY RL_AXIS_UWORD 0 CM_u16_factor_1_1023 16 0 6406.15835777126 /end AXIS_PTS
/begin CHARACTERISTIC CAL_tpstarget_sport_manual "Calibration: tpstarget sport manual. Tunable map/constant (not a live channel); log to compare requested throttle target to pedal demand. (0-1; raw/1023)" CURVE 0x4000BB22 RL_VALUE_UWORD 0 CM_u16_factor_1_1023 0 6406.15835777126
 /begin AXIS_DESCR COM_AXIS NO_INPUT_QUANTITY CM_u16_factor_1_1023 16 0 6406.15835777126 AXIS_PTS_REF CAL_tpstarget_sport_manual_X_pps /end AXIS_DESCR
/end CHARACTERISTIC
/begin AXIS_PTS CAL_torque_load_to_torque_X_engine_speed "X-axis breakpoints for the 'torque load to torque' table. Defines the lookup grid (not a live channel); change only when re-axing the map. (RPM; raw*125/4+500)" 0x4000BBDA engine_speed_3 RL_AXIS_UBYTE 0 CM_u8_rspeed_125_4_500rpm 16 500 8468.75 /end AXIS_PTS
/begin AXIS_PTS CAL_torque_load_to_torque_Y_load "Y-axis breakpoints for the 'torque load to torque' table. Defines the lookup grid (not a live channel); change only when re-axing the map. (mg/stroke; raw*4)" 0x4000BBEA NO_INPUT_QUANTITY RL_AXIS_UBYTE 0 CM_u8_load_4mg_stroke 16 0 1020 /end AXIS_PTS
/begin CHARACTERISTIC CAL_torque_load_to_torque "Calibration: torque load to torque. Tunable map/constant (not a live channel); log to follow the ECU torque estimate and any torque limiting. (Nm; raw*2)" MAP 0x4000BBFA RL_VALUE_UBYTE 0 CM_u8_torque_2nm 0 510
 /begin AXIS_DESCR COM_AXIS engine_speed_3 CM_u8_rspeed_125_4_500rpm 16 500 8468.75 AXIS_PTS_REF CAL_torque_load_to_torque_X_engine_speed /end AXIS_DESCR
 /begin AXIS_DESCR COM_AXIS NO_INPUT_QUANTITY CM_u8_load_4mg_stroke 16 0 1020 AXIS_PTS_REF CAL_torque_load_to_torque_Y_load /end AXIS_DESCR
/end CHARACTERISTIC
/begin AXIS_PTS CAL_torque_engine_friction_speed_component_X_rpm "X-axis breakpoints for the 'torque engine friction speed component' table. Defines the lookup grid (not a live channel); change only when re-axing the map. (RPM; raw*125/4+500)" 0x4000BCFA engine_speed_3 RL_AXIS_UBYTE 0 CM_u8_rspeed_125_4_500rpm 16 500 8468.75 /end AXIS_PTS
/begin AXIS_PTS CAL_torque_engine_friction_speed_component_Y_load "Y-axis breakpoints for the 'torque engine friction speed component' table. Defines the lookup grid (not a live channel); change only when re-axing the map. (mg/stroke; raw*4)" 0x4000BD0A NO_INPUT_QUANTITY RL_AXIS_UBYTE 0 CM_u8_load_4mg_stroke 16 0 1020 /end AXIS_PTS
/begin CHARACTERISTIC CAL_torque_engine_friction_speed_component "Calibration: torque engine friction speed component. Tunable map/constant (not a live channel); log to follow the ECU torque estimate and any torque limiting. (Nm)" MAP 0x4000BD1A RL_VALUE_UBYTE 0 CM_u8_torque_nm 0 255
 /begin AXIS_DESCR COM_AXIS engine_speed_3 CM_u8_rspeed_125_4_500rpm 16 500 8468.75 AXIS_PTS_REF CAL_torque_engine_friction_speed_component_X_rpm /end AXIS_DESCR
 /begin AXIS_DESCR COM_AXIS NO_INPUT_QUANTITY CM_u8_load_4mg_stroke 16 0 1020 AXIS_PTS_REF CAL_torque_engine_friction_speed_component_Y_load /end AXIS_DESCR
/end CHARACTERISTIC
/begin AXIS_PTS CAL_torque_torque_to_load_X_engine_speed "X-axis breakpoints for the 'torque torque to load' table. Defines the lookup grid (not a live channel); change only when re-axing the map. (RPM; raw*125/4+500)" 0x4000BE1A engine_speed_3 RL_AXIS_UBYTE 0 CM_u8_rspeed_125_4_500rpm 16 500 8468.75 /end AXIS_PTS
/begin AXIS_PTS CAL_torque_torque_to_load_Y_torque "Y-axis breakpoints for the 'torque torque to load' table. Defines the lookup grid (not a live channel); change only when re-axing the map. (Nm; raw*2)" 0x4000BE2A V_CAL_torque_torque_to_load_Y_torque RL_AXIS_UBYTE 0 CM_u8_torque_2nm 16 0 510 /end AXIS_PTS
/begin CHARACTERISTIC CAL_torque_torque_to_load "Calibration: torque torque to load. Tunable map/constant (not a live channel); log to follow the ECU torque estimate and any torque limiting. (mg/stroke; raw*4)" MAP 0x4000BE3A RL_VALUE_UBYTE 0 CM_u8_load_4mg_stroke 0 1020
 /begin AXIS_DESCR COM_AXIS engine_speed_3 CM_u8_rspeed_125_4_500rpm 16 500 8468.75 AXIS_PTS_REF CAL_torque_torque_to_load_X_engine_speed /end AXIS_DESCR
 /begin AXIS_DESCR COM_AXIS V_CAL_torque_torque_to_load_Y_torque CM_u8_torque_2nm 16 0 510 AXIS_PTS_REF CAL_torque_torque_to_load_Y_torque /end AXIS_DESCR
/end CHARACTERISTIC
/begin AXIS_PTS CAL_torque_ign_retard_base_X_engine_speed "X-axis breakpoints for the 'torque ignition retard base' table. Defines the lookup grid (not a live channel); change only when re-axing the map. (RPM; raw*125/4+500)" 0x4000C05A engine_speed_3 RL_AXIS_UBYTE 0 CM_u8_rspeed_125_4_500rpm 16 500 8468.75 /end AXIS_PTS
/begin AXIS_PTS CAL_torque_ign_retard_base_Y_torque_reduction_factor "Y-axis breakpoints for the 'torque ignition retard base' table. Defines the lookup grid (not a live channel); change only when re-axing the map. (0-1; raw/255)" 0x4000C06A torque_reduction_factor_ign RL_AXIS_UBYTE 0 CM_u8_factor_1_255 16 0 100 /end AXIS_PTS
/begin CHARACTERISTIC CAL_torque_ign_retard_base "Calibration: torque ignition retard base. Tunable map/constant (not a live channel); log spark advance to confirm the timing strategy and headroom to knock. (deg; raw/4-64)" MAP 0x4000C07A RL_VALUE_UBYTE 0 CM_u8_angle_1_4_64deg -64 -0.25
 /begin AXIS_DESCR COM_AXIS engine_speed_3 CM_u8_rspeed_125_4_500rpm 16 500 8468.75 AXIS_PTS_REF CAL_torque_ign_retard_base_X_engine_speed /end AXIS_DESCR
 /begin AXIS_DESCR COM_AXIS torque_reduction_factor_ign CM_u8_factor_1_255 16 0 100 AXIS_PTS_REF CAL_torque_ign_retard_base_Y_torque_reduction_factor /end AXIS_DESCR
/end CHARACTERISTIC
/begin AXIS_PTS CAL_idle_target_ips_neutral_tour_X_coolant_temp "X-axis breakpoints for the 'idle target IPS neutral tour' table. Defines the lookup grid (not a live channel); change only when re-axing the map. (deg C; raw*5/8-40)" 0x4000C29A coolant_temp RL_AXIS_UBYTE 0 CM_u8_temp_5_8_40c 16 -40 119.375 /end AXIS_PTS
/begin CHARACTERISTIC CAL_idle_target_ips_neutral_tour "Calibration: idle target IPS neutral tour. Tunable map/constant (not a live channel); log to diagnose idle quality, hunting, and stalls. (RPM; raw*4+500)" CURVE 0x4000C2AA RL_VALUE_UBYTE 0 CM_u8_rspeed_4_500rpm 500 1520
 /begin AXIS_DESCR COM_AXIS coolant_temp CM_u8_temp_5_8_40c 16 -40 119.375 AXIS_PTS_REF CAL_idle_target_ips_neutral_tour_X_coolant_temp /end AXIS_DESCR
/end CHARACTERISTIC
/begin AXIS_PTS CAL_torque_limit_base_factor_X_rpm "X-axis breakpoints for the 'torque limit base factor' table. Defines the lookup grid (not a live channel); change only when re-axing the map. (RPM; raw*125/4+500)" 0x4000C2BA engine_speed_3 RL_AXIS_UBYTE 0 CM_u8_rspeed_125_4_500rpm 16 500 8468.75 /end AXIS_PTS
/begin AXIS_PTS CAL_torque_limit_base_factor_Y_load "Y-axis breakpoints for the 'torque limit base factor' table. Defines the lookup grid (not a live channel); change only when re-axing the map. (mg/stroke; raw*4)" 0x4000C2CA load_mass_per_stroke RL_AXIS_UBYTE 0 CM_u8_load_4mg_stroke 16 0 1020 /end AXIS_PTS
/begin CHARACTERISTIC CAL_torque_limit_base_factor "Calibration: torque limit base factor. Tunable map/constant (not a live channel); log to follow the ECU torque estimate and any torque limiting. (0-1; raw/255)" MAP 0x4000C2DA RL_VALUE_UBYTE 0 CM_u8_factor_1_255 0 100
 /begin AXIS_DESCR COM_AXIS engine_speed_3 CM_u8_rspeed_125_4_500rpm 16 500 8468.75 AXIS_PTS_REF CAL_torque_limit_base_factor_X_rpm /end AXIS_DESCR
 /begin AXIS_DESCR COM_AXIS load_mass_per_stroke CM_u8_load_4mg_stroke 16 0 1020 AXIS_PTS_REF CAL_torque_limit_base_factor_Y_load /end AXIS_DESCR
/end CHARACTERISTIC
/begin AXIS_PTS CAL_torque_engine_friction_temp_component_X_coolant_temp "X-axis breakpoints for the 'torque engine friction temperature component' table. Defines the lookup grid (not a live channel); change only when re-axing the map. (deg C; raw*5/8-40)" 0x4000C3DA coolant_temp RL_AXIS_UBYTE 0 CM_u8_temp_5_8_40c 8 -40 119.375 /end AXIS_PTS
/begin AXIS_PTS CAL_torque_engine_friction_temp_component_Y_load "Y-axis breakpoints for the 'torque engine friction temperature component' table. Defines the lookup grid (not a live channel); change only when re-axing the map. (mg/stroke; raw*4)" 0x4000C3E2 load_mass_per_stroke RL_AXIS_UBYTE 0 CM_u8_load_4mg_stroke 8 0 1020 /end AXIS_PTS
/begin CHARACTERISTIC CAL_torque_engine_friction_temp_component "Calibration: torque engine friction temperature component. Tunable map/constant (not a live channel); log to follow the ECU torque estimate and any torque limiting. (Nm)" MAP 0x4000C3EA RL_VALUE_UBYTE 0 CM_u8_torque_nm 0 255
 /begin AXIS_DESCR COM_AXIS coolant_temp CM_u8_temp_5_8_40c 8 -40 119.375 AXIS_PTS_REF CAL_torque_engine_friction_temp_component_X_coolant_temp /end AXIS_DESCR
 /begin AXIS_DESCR COM_AXIS load_mass_per_stroke CM_u8_load_4mg_stroke 8 0 1020 AXIS_PTS_REF CAL_torque_engine_friction_temp_component_Y_load /end AXIS_DESCR
/end CHARACTERISTIC
/begin AXIS_PTS CAL_torque_spark_efficiency_X_rpm "X-axis breakpoints for the 'torque spark efficiency' table. Defines the lookup grid (not a live channel); change only when re-axing the map. (RPM; raw*125/4+500)" 0x4000C42A engine_speed_3 RL_AXIS_UBYTE 0 CM_u8_rspeed_125_4_500rpm 16 500 8468.75 /end AXIS_PTS
/begin AXIS_PTS CAL_torque_spark_efficiency_Y_ign_retard_from_mbt "Y-axis breakpoints for the 'torque spark efficiency' table. Defines the lookup grid (not a live channel); change only when re-axing the map. (deg; raw/4)" 0x4000C43A NO_INPUT_QUANTITY RL_AXIS_UBYTE 0 CM_u8_angle_1_4deg 16 0 63.75 /end AXIS_PTS
/begin CHARACTERISTIC CAL_torque_spark_efficiency "Calibration: torque spark efficiency. Tunable map/constant (not a live channel); log to follow the ECU torque estimate and any torque limiting. (0-1; raw/255)" MAP 0x4000C44A RL_VALUE_UBYTE 0 CM_u8_factor_1_255 0 100
 /begin AXIS_DESCR COM_AXIS engine_speed_3 CM_u8_rspeed_125_4_500rpm 16 500 8468.75 AXIS_PTS_REF CAL_torque_spark_efficiency_X_rpm /end AXIS_DESCR
 /begin AXIS_DESCR COM_AXIS NO_INPUT_QUANTITY CM_u8_angle_1_4deg 16 0 63.75 AXIS_PTS_REF CAL_torque_spark_efficiency_Y_ign_retard_from_mbt /end AXIS_DESCR
/end CHARACTERISTIC
/begin AXIS_PTS CAL_torque_spark_efficiency_slope_X_rpm "X-axis breakpoints for the 'torque spark efficiency slope' table. Defines the lookup grid (not a live channel); change only when re-axing the map. (RPM; raw*125/4+500)" 0x4000C54A engine_speed_3 RL_AXIS_UBYTE 0 CM_u8_rspeed_125_4_500rpm 16 500 8468.75 /end AXIS_PTS
/begin AXIS_PTS CAL_torque_spark_efficiency_slope_Y_load "Y-axis breakpoints for the 'torque spark efficiency slope' table. Defines the lookup grid (not a live channel); change only when re-axing the map. (mg/stroke; raw*4)" 0x4000C55A load_mass_per_stroke RL_AXIS_UBYTE 0 CM_u8_load_4mg_stroke 16 0 1020 /end AXIS_PTS
/begin CHARACTERISTIC CAL_torque_spark_efficiency_slope "Calibration: torque spark efficiency slope. Tunable map/constant (not a live channel); log to follow the ECU torque estimate and any torque limiting. ((raw-104)/26)" MAP 0x4000C56A RL_VALUE_UBYTE 0 CM_u8_gain__x_104_26 -4 5.80769230769231
 /begin AXIS_DESCR COM_AXIS engine_speed_3 CM_u8_rspeed_125_4_500rpm 16 500 8468.75 AXIS_PTS_REF CAL_torque_spark_efficiency_slope_X_rpm /end AXIS_DESCR
 /begin AXIS_DESCR COM_AXIS load_mass_per_stroke CM_u8_load_4mg_stroke 16 0 1020 AXIS_PTS_REF CAL_torque_spark_efficiency_slope_Y_load /end AXIS_DESCR
/end CHARACTERISTIC
/begin AXIS_PTS CAL_idle_air_base_ips_ingear_tour_X_rpm "u16_rspeed_rpm[16]" 0x4000C78A obd_ii_idle_speed_target_total RL_AXIS_UWORD 0 CM_u8_rspeed_rpm 16 0 65535 /end AXIS_PTS
/begin CHARACTERISTIC CAL_idle_air_base_ips_ingear_tour "u16_flow_100/256mg/s[16]" CURVE 0x4000C7AA RL_VALUE_UWORD 0 CM_u16_flow_100_256mg_s 0 25599.609375
 /begin AXIS_DESCR COM_AXIS obd_ii_idle_speed_target_total CM_u8_rspeed_rpm 16 0 65535 AXIS_PTS_REF CAL_idle_air_base_ips_ingear_tour_X_rpm /end AXIS_DESCR
/end CHARACTERISTIC
/begin AXIS_PTS CAL_revlimit_speed_base_auto_gearbox_tour_X_coolant "X-axis breakpoints for the 'revlimit speed base auto gearbox tour' table. Defines the lookup grid (not a live channel); change only when re-axing the map. (deg C; raw*5/8-40)" 0x4000C7EA coolant_temp RL_AXIS_UBYTE 0 CM_u8_temp_5_8_40c 8 -40 119.375 /end AXIS_PTS
/begin AXIS_PTS CAL_revlimit_speed_base_auto_gearbox_tour_Y_timer "Y-axis breakpoints for the 'revlimit speed base auto gearbox tour' table. Defines the lookup grid (not a live channel); change only when re-axing the map. (ms; raw*100)" 0x4000C7F2 NO_INPUT_QUANTITY RL_AXIS_UBYTE 0 CM_u8_time_100ms 8 0 25500 /end AXIS_PTS
/begin CHARACTERISTIC CAL_revlimit_speed_base_auto_gearbox_tour "Calibration: revlimit speed base auto gearbox tour. Tunable map/constant (not a live channel); log to confirm where and how the rev limiter intervenes. (RPM; raw*10+6000)" MAP 0x4000C7FA RL_VALUE_UBYTE 0 CM_u8_rspeed_10_6000rpm 6000 8550
 /begin AXIS_DESCR COM_AXIS coolant_temp CM_u8_temp_5_8_40c 8 -40 119.375 AXIS_PTS_REF CAL_revlimit_speed_base_auto_gearbox_tour_X_coolant /end AXIS_DESCR
 /begin AXIS_DESCR COM_AXIS NO_INPUT_QUANTITY CM_u8_time_100ms 8 0 25500 AXIS_PTS_REF CAL_revlimit_speed_base_auto_gearbox_tour_Y_timer /end AXIS_DESCR
/end CHARACTERISTIC
/begin AXIS_PTS CAL_revlimit_speed_base_auto_gearbox_sport_X_coolant "X-axis breakpoints for the 'revlimit speed base auto gearbox sport' table. Defines the lookup grid (not a live channel); change only when re-axing the map. (deg C; raw*5/8-40)" 0x4000C83A coolant_temp RL_AXIS_UBYTE 0 CM_u8_temp_5_8_40c 8 -40 119.375 /end AXIS_PTS
/begin AXIS_PTS CAL_revlimit_speed_base_auto_gearbox_sport_Y_timer "Y-axis breakpoints for the 'revlimit speed base auto gearbox sport' table. Defines the lookup grid (not a live channel); change only when re-axing the map. (ms; raw*100)" 0x4000C842 NO_INPUT_QUANTITY RL_AXIS_UBYTE 0 CM_u8_time_100ms 8 0 25500 /end AXIS_PTS
/begin CHARACTERISTIC CAL_revlimit_speed_base_auto_gearbox_sport "Calibration: revlimit speed base auto gearbox sport. Tunable map/constant (not a live channel); log to confirm where and how the rev limiter intervenes. (RPM; raw*10+6000)" MAP 0x4000C84A RL_VALUE_UBYTE 0 CM_u8_rspeed_10_6000rpm 6000 8550
 /begin AXIS_DESCR COM_AXIS coolant_temp CM_u8_temp_5_8_40c 8 -40 119.375 AXIS_PTS_REF CAL_revlimit_speed_base_auto_gearbox_sport_X_coolant /end AXIS_DESCR
 /begin AXIS_DESCR COM_AXIS NO_INPUT_QUANTITY CM_u8_time_100ms 8 0 25500 AXIS_PTS_REF CAL_revlimit_speed_base_auto_gearbox_sport_Y_timer /end AXIS_DESCR
/end CHARACTERISTIC
/begin AXIS_PTS CAL_idle_comp_carspeed_ips_X_carspeed "X-axis breakpoints for the 'idle compensation carspeed IPS' table. Defines the lookup grid (not a live channel); change only when re-axing the map. (km/h)" 0x4000C88A car_speed_u8 RL_AXIS_UBYTE 0 CM_u8_speed_kph 8 0 255 /end AXIS_PTS
/begin CHARACTERISTIC CAL_idle_comp_carspeed_ips "Calibration: idle compensation carspeed IPS. Tunable map/constant (not a live channel); log to diagnose idle quality, hunting, and stalls. (RPM; raw*4)" CURVE 0x4000C892 RL_VALUE_UBYTE 0 CM_u8_rspeed_4rpm 0 1020
 /begin AXIS_DESCR COM_AXIS car_speed_u8 CM_u8_speed_kph 8 0 255 AXIS_PTS_REF CAL_idle_comp_carspeed_ips_X_carspeed /end AXIS_DESCR
/end CHARACTERISTIC
/begin AXIS_PTS CAL_idle_comp_car_speed_ips_X_carspeed "X-axis breakpoints for the 'idle compensation car speed IPS' table. Defines the lookup grid (not a live channel); change only when re-axing the map. (km/h)" 0x4000C89A car_speed_u8 RL_AXIS_UBYTE 0 CM_u8_speed_kph 8 0 255 /end AXIS_PTS
/begin CHARACTERISTIC CAL_idle_comp_car_speed_ips "Calibration: idle compensation car speed IPS. Tunable map/constant (not a live channel); log to diagnose idle quality, hunting, and stalls. (RPM)" CURVE 0x4000C8A2 RL_VALUE_UBYTE 0 CM_u8_flow_100mg_s 0 25500
 /begin AXIS_DESCR COM_AXIS car_speed_u8 CM_u8_speed_kph 8 0 255 AXIS_PTS_REF CAL_idle_comp_car_speed_ips_X_carspeed /end AXIS_DESCR
/end CHARACTERISTIC
/begin AXIS_PTS CAL_idle_target_ips_ingear_sport_X_coolant_temp "X-axis breakpoints for the 'idle target IPS ingear sport' table. Defines the lookup grid (not a live channel); change only when re-axing the map. (deg C; raw*5/8-40)" 0x4000CE0A NO_INPUT_QUANTITY RL_AXIS_UBYTE 0 CM_u8_temp_5_8_40c 16 -40 119.375 /end AXIS_PTS
/begin CHARACTERISTIC CAL_idle_target_ips_ingear_sport "Calibration: idle target IPS ingear sport. Tunable map/constant (not a live channel); log to diagnose idle quality, hunting, and stalls. (RPM; raw*4+500)" CURVE 0x4000CE1A RL_VALUE_UBYTE 0 CM_u8_rspeed_4_500rpm 500 1520
 /begin AXIS_DESCR COM_AXIS NO_INPUT_QUANTITY CM_u8_temp_5_8_40c 16 -40 119.375 AXIS_PTS_REF CAL_idle_target_ips_ingear_sport_X_coolant_temp /end AXIS_DESCR
/end CHARACTERISTIC
/begin AXIS_PTS CAL_idle_target_ips_neutral_sport_X_coolant_temp "X-axis breakpoints for the 'idle target IPS neutral sport' table. Defines the lookup grid (not a live channel); change only when re-axing the map. (deg C; raw*5/8-40)" 0x4000CE2A coolant_temp RL_AXIS_UBYTE 0 CM_u8_temp_5_8_40c 16 -40 119.375 /end AXIS_PTS
/begin CHARACTERISTIC CAL_idle_target_ips_neutral_sport "Calibration: idle target IPS neutral sport. Tunable map/constant (not a live channel); log to diagnose idle quality, hunting, and stalls. (RPM; raw*4+500)" CURVE 0x4000CE3A RL_VALUE_UBYTE 0 CM_u8_rspeed_4_500rpm 500 1520
 /begin AXIS_DESCR COM_AXIS coolant_temp CM_u8_temp_5_8_40c 16 -40 119.375 AXIS_PTS_REF CAL_idle_target_ips_neutral_sport_X_coolant_temp /end AXIS_DESCR
/end CHARACTERISTIC
/begin AXIS_PTS CAL_vvt_exhaust_advance_coolant_offset_X_coolant_temp "X-axis breakpoints for the 'VVT exhaust advance coolant offset' table. Defines the lookup grid (not a live channel); change only when re-axing the map. (deg C; raw*5/8-40)" 0x4000CE5A coolant_temp RL_AXIS_UBYTE 0 CM_u8_temp_5_8_40c 16 -40 119.375 /end AXIS_PTS
/begin CHARACTERISTIC CAL_vvt_exhaust_advance_coolant_offset "Calibration: VVT exhaust advance coolant offset. Tunable map/constant (not a live channel); log commanded vs actual cam timing to verify VVT response. (deg; raw/4)" CURVE 0x4000CE6A RL_VALUE_UBYTE 0 CM_u8_angle_1_4deg 0 63.75
 /begin AXIS_DESCR COM_AXIS coolant_temp CM_u8_temp_5_8_40c 16 -40 119.375 AXIS_PTS_REF CAL_vvt_exhaust_advance_coolant_offset_X_coolant_temp /end AXIS_DESCR
/end CHARACTERISTIC
/begin AXIS_PTS CAL_vvt_intake_advance_base_low_load_X_rpm "X-axis breakpoints for the 'VVT intake advance base low load' table. Defines the lookup grid (not a live channel); change only when re-axing the map. (RPM; raw*125/4+500)" 0x4000CEC2 engine_speed_3 RL_AXIS_UBYTE 0 CM_u8_rspeed_125_4_500rpm 6 500 8468.75 /end AXIS_PTS
/begin AXIS_PTS CAL_vvt_intake_advance_base_low_load_Y_load "Y-axis breakpoints for the 'VVT intake advance base low load' table. Defines the lookup grid (not a live channel); change only when re-axing the map. (mg/stroke; raw*4)" 0x4000CEC8 load_mass_per_stroke RL_AXIS_UBYTE 0 CM_u8_load_4mg_stroke 6 0 1020 /end AXIS_PTS
/begin CHARACTERISTIC CAL_vvt_intake_advance_base_low_load "Calibration: VVT intake advance base low load. Tunable map/constant (not a live channel); log commanded vs actual cam timing to verify VVT response. (deg; raw/4)" MAP 0x4000CECE RL_VALUE_UBYTE 0 CM_u8_angle_1_4deg 0 63.75
 /begin AXIS_DESCR COM_AXIS engine_speed_3 CM_u8_rspeed_125_4_500rpm 6 500 8468.75 AXIS_PTS_REF CAL_vvt_intake_advance_base_low_load_X_rpm /end AXIS_DESCR
 /begin AXIS_DESCR COM_AXIS load_mass_per_stroke CM_u8_load_4mg_stroke 6 0 1020 AXIS_PTS_REF CAL_vvt_intake_advance_base_low_load_Y_load /end AXIS_DESCR
/end CHARACTERISTIC
/begin AXIS_PTS CAL_idle_air_base_ips_neutral_tour_X_rpm "u16_rspeed_rpm[16]" 0x4000CEFA obd_ii_idle_speed_target_total RL_AXIS_UWORD 0 CM_u8_rspeed_rpm 16 0 65535 /end AXIS_PTS
/begin CHARACTERISTIC CAL_idle_air_base_ips_neutral_tour "u16_flow_100/256mg/s[16]" CURVE 0x4000CF1A RL_VALUE_UWORD 0 CM_u16_flow_100_256mg_s 0 25599.609375
 /begin AXIS_DESCR COM_AXIS obd_ii_idle_speed_target_total CM_u8_rspeed_rpm 16 0 65535 AXIS_PTS_REF CAL_idle_air_base_ips_neutral_tour_X_rpm /end AXIS_DESCR
/end CHARACTERISTIC
/begin AXIS_PTS CAL_vvt_exhaust_advance_base_low_load_X_rpm "X-axis breakpoints for the 'VVT exhaust advance base low load' table. Defines the lookup grid (not a live channel); change only when re-axing the map. (RPM; raw*125/4+500)" 0x4000CF3A engine_speed_3 RL_AXIS_UBYTE 0 CM_u8_rspeed_125_4_500rpm 6 500 8468.75 /end AXIS_PTS
/begin AXIS_PTS CAL_vvt_exhaust_advance_base_low_load_Y_load "Y-axis breakpoints for the 'VVT exhaust advance base low load' table. Defines the lookup grid (not a live channel); change only when re-axing the map. (mg/stroke; raw*4)" 0x4000CF40 load_mass_per_stroke RL_AXIS_UBYTE 0 CM_u8_load_4mg_stroke 6 0 1020 /end AXIS_PTS
/begin CHARACTERISTIC CAL_vvt_exhaust_advance_base_low_load "Calibration: VVT exhaust advance base low load. Tunable map/constant (not a live channel); log commanded vs actual cam timing to verify VVT response. (deg; raw/4)" MAP 0x4000CF46 RL_VALUE_UBYTE 0 CM_u8_angle_1_4deg 0 63.75
 /begin AXIS_DESCR COM_AXIS engine_speed_3 CM_u8_rspeed_125_4_500rpm 6 500 8468.75 AXIS_PTS_REF CAL_vvt_exhaust_advance_base_low_load_X_rpm /end AXIS_DESCR
 /begin AXIS_DESCR COM_AXIS load_mass_per_stroke CM_u8_load_4mg_stroke 6 0 1020 AXIS_PTS_REF CAL_vvt_exhaust_advance_base_low_load_Y_load /end AXIS_DESCR
/end CHARACTERISTIC
/begin AXIS_PTS CAL_idle_air_base_ips_neutral_sport_X_rpm "u16_rspeed_rpm[16]" 0x4000CF72 obd_ii_idle_speed_target_total RL_AXIS_UWORD 0 CM_u8_rspeed_rpm 16 0 65535 /end AXIS_PTS
/begin CHARACTERISTIC CAL_idle_air_base_ips_neutral_sport "u16_flow_100/256mg/s[16]" CURVE 0x4000CF92 RL_VALUE_UWORD 0 CM_u16_flow_100_256mg_s 0 25599.609375
 /begin AXIS_DESCR COM_AXIS obd_ii_idle_speed_target_total CM_u8_rspeed_rpm 16 0 65535 AXIS_PTS_REF CAL_idle_air_base_ips_neutral_sport_X_rpm /end AXIS_DESCR
/end CHARACTERISTIC
/begin AXIS_PTS CAL_revlimit_trim_per_gear_X_gear "X-axis breakpoints for the 'revlimit trim per gear' table. Defines the lookup grid (not a live channel); change only when re-axing the map." 0x4000D01E car_gear_current RL_AXIS_UBYTE 0 NO_COMPU_METHOD 7 0 255 /end AXIS_PTS
/begin CHARACTERISTIC CAL_revlimit_trim_per_gear "Calibration: revlimit trim per gear. Tunable map/constant (not a live channel); log to confirm where and how the rev limiter intervenes. (RPM; raw*2)" CURVE 0x4000D025 RL_VALUE_UBYTE 0 CM_u8_rspeed_2rpm 0 510
 /begin AXIS_DESCR COM_AXIS car_gear_current NO_COMPU_METHOD 7 0 255 AXIS_PTS_REF CAL_revlimit_trim_per_gear_X_gear /end AXIS_DESCR
/end CHARACTERISTIC
/begin AXIS_PTS CAL_revlimit_maf_max_by_gear_X_gear "X-axis breakpoints for the 'revlimit max MAF by gear' table. Defines the lookup grid (not a live channel); change only when re-axing the map." 0x4000D02C car_gear_current RL_AXIS_UBYTE 0 NO_COMPU_METHOD 7 0 255 /end AXIS_PTS
/begin CHARACTERISTIC CAL_revlimit_maf_max_by_gear "Calibration: revlimit max MAF by gear. Tunable map/constant (not a live channel); log to confirm where and how the rev limiter intervenes. (g/s; raw*2)" CURVE 0x4000D033 RL_VALUE_UBYTE 0 CM_u8_flow_2g_s 0 510
 /begin AXIS_DESCR COM_AXIS car_gear_current NO_COMPU_METHOD 7 0 255 AXIS_PTS_REF CAL_revlimit_maf_max_by_gear_X_gear /end AXIS_DESCR
/end CHARACTERISTIC
/begin AXIS_PTS CAL_idle_air_base_ips_ingear_sport_X_rpm "u16_rspeed_rpm[16]" 0x4000D062 obd_ii_idle_speed_target_total RL_AXIS_UWORD 0 CM_u8_rspeed_rpm 16 0 65535 /end AXIS_PTS
/begin CHARACTERISTIC CAL_idle_air_base_ips_ingear_sport "u16_flow_100/256mg/s[16]" CURVE 0x4000D082 RL_VALUE_UWORD 0 CM_u16_flow_100_256mg_s 0 25599.609375
 /begin AXIS_DESCR COM_AXIS obd_ii_idle_speed_target_total CM_u8_rspeed_rpm 16 0 65535 AXIS_PTS_REF CAL_idle_air_base_ips_ingear_sport_X_rpm /end AXIS_DESCR
/end CHARACTERISTIC
/begin AXIS_PTS CAL_idle_air_comp_misfire_X_cyl_count "uint8_t[8]" 0x4000D0C2 failed_ignition_cyl_count RL_AXIS_UBYTE 0 NO_COMPU_METHOD 8 0 255 /end AXIS_PTS
/begin CHARACTERISTIC CAL_idle_air_comp_misfire "u8_flow_100mg/s[8]" CURVE 0x4000D0CA RL_VALUE_UBYTE 0 CM_u8_flow_100mg_s 0 25500
 /begin AXIS_DESCR COM_AXIS failed_ignition_cyl_count NO_COMPU_METHOD 8 0 255 AXIS_PTS_REF CAL_idle_air_comp_misfire_X_cyl_count /end AXIS_DESCR
/end CHARACTERISTIC
/begin AXIS_PTS CAL_tpstarget_tour_shifting_X_pps "X-axis breakpoints for the 'tpstarget tour shifting' table. Defines the lookup grid (not a live channel); change only when re-axing the map. (0-1; raw/1023)" 0x4000D0E2 NO_INPUT_QUANTITY RL_AXIS_UWORD 0 CM_u16_factor_1_1023 16 0 6406.15835777126 /end AXIS_PTS
/begin CHARACTERISTIC CAL_tpstarget_tour_shifting "Calibration: tpstarget tour shifting. Tunable map/constant (not a live channel); log to compare requested throttle target to pedal demand. (0-1; raw/1023)" CURVE 0x4000D102 RL_VALUE_UWORD 0 CM_u16_factor_1_1023 0 6406.15835777126
 /begin AXIS_DESCR COM_AXIS NO_INPUT_QUANTITY CM_u16_factor_1_1023 16 0 6406.15835777126 AXIS_PTS_REF CAL_tpstarget_tour_shifting_X_pps /end AXIS_DESCR
/end CHARACTERISTIC
/begin AXIS_PTS CAL_tpstarget_sport_shifting_X_pps "X-axis breakpoints for the 'tpstarget sport shifting' table. Defines the lookup grid (not a live channel); change only when re-axing the map. (0-1; raw/1023)" 0x4000D122 NO_INPUT_QUANTITY RL_AXIS_UWORD 0 CM_u16_factor_1_1023 16 0 6406.15835777126 /end AXIS_PTS
/begin CHARACTERISTIC CAL_tpstarget_sport_shifting "Calibration: tpstarget sport shifting. Tunable map/constant (not a live channel); log to compare requested throttle target to pedal demand. (0-1; raw/1023)" CURVE 0x4000D142 RL_VALUE_UWORD 0 CM_u16_factor_1_1023 0 6406.15835777126
 /begin AXIS_DESCR COM_AXIS NO_INPUT_QUANTITY CM_u16_factor_1_1023 16 0 6406.15835777126 AXIS_PTS_REF CAL_tpstarget_sport_shifting_X_pps /end AXIS_DESCR
/end CHARACTERISTIC
/begin AXIS_PTS CAL_revlimit_p_flow_gain_X_gear "X-axis breakpoints for the 'revlimit p flow gain' table. Defines the lookup grid (not a live channel); change only when re-axing the map." 0x4000D162 car_gear_current RL_AXIS_UBYTE 0 NO_COMPU_METHOD 7 0 255 /end AXIS_PTS
/begin CHARACTERISTIC CAL_revlimit_p_flow_gain "Calibration: revlimit p flow gain. Tunable map/constant (not a live channel); log to confirm where and how the rev limiter intervenes. (0-1; raw/255)" CURVE 0x4000D169 RL_VALUE_UBYTE 0 CM_u8_factor_1_255 0 100
 /begin AXIS_DESCR COM_AXIS car_gear_current NO_COMPU_METHOD 7 0 255 AXIS_PTS_REF CAL_revlimit_p_flow_gain_X_gear /end AXIS_DESCR
/end CHARACTERISTIC
/begin AXIS_PTS CAL_revlimit_i_flow_gain_X_gear "X-axis breakpoints for the 'revlimit i flow gain' table. Defines the lookup grid (not a live channel); change only when re-axing the map." 0x4000D170 car_gear_current RL_AXIS_UBYTE 0 NO_COMPU_METHOD 7 0 255 /end AXIS_PTS
/begin CHARACTERISTIC CAL_revlimit_i_flow_gain "Calibration: revlimit i flow gain. Tunable map/constant (not a live channel); log to confirm where and how the rev limiter intervenes. (0-1; raw/255)" CURVE 0x4000D177 RL_VALUE_UBYTE 0 CM_u8_factor_1_255 0 100
 /begin AXIS_DESCR COM_AXIS car_gear_current NO_COMPU_METHOD 7 0 255 AXIS_PTS_REF CAL_revlimit_i_flow_gain_X_gear /end AXIS_DESCR
/end CHARACTERISTIC
/begin AXIS_PTS CAL_revlimit_d_flow_gain_X_gear "X-axis breakpoints for the 'revlimit d flow gain' table. Defines the lookup grid (not a live channel); change only when re-axing the map." 0x4000D17E car_gear_current RL_AXIS_UBYTE 0 NO_COMPU_METHOD 7 0 255 /end AXIS_PTS
/begin CHARACTERISTIC CAL_revlimit_d_flow_gain "Calibration: revlimit d flow gain. Tunable map/constant (not a live channel); log to confirm where and how the rev limiter intervenes. (0-1; raw/255)" CURVE 0x4000D185 RL_VALUE_UBYTE 0 CM_u8_factor_1_255 0 100
 /begin AXIS_DESCR COM_AXIS car_gear_current NO_COMPU_METHOD 7 0 255 AXIS_PTS_REF CAL_revlimit_d_flow_gain_X_gear /end AXIS_DESCR
/end CHARACTERISTIC
/begin CHARACTERISTIC CAL_misfire_inhibit_tps_rate_declutched "u8_factor_1/1023" VALUE 0x4000D1A2 RL_VALUE_UBYTE 0 CM_u16_factor_1_1023 0 24.9266862170088 /end CHARACTERISTIC
/begin CHARACTERISTIC CAL_misfire_inhibit_tps_rate_pos "u8_factor_1/1023" VALUE 0x4000D1A3 RL_VALUE_UBYTE 0 CM_u16_factor_1_1023 0 24.9266862170088 /end CHARACTERISTIC
/begin CHARACTERISTIC CAL_misfire_inhibit_tps_rate_neg "u8_factor_1/1023" VALUE 0x4000D1A4 RL_VALUE_UBYTE 0 CM_u16_factor_1_1023 0 24.9266862170088 /end CHARACTERISTIC
/begin CHARACTERISTIC CAL_evap_pressure_filter_coeff "uchar" VALUE 0x4000D1B1 RL_VALUE_UBYTE 0 NO_COMPU_METHOD 0 255 /end CHARACTERISTIC
/begin CHARACTERISTIC CAL_evap_vacuum_threshold "uint8_t" VALUE 0x4000D1B3 RL_VALUE_UBYTE 0 NO_COMPU_METHOD 0 255 /end CHARACTERISTIC
/begin CHARACTERISTIC CAL_evap_purge_stuck_open_test_passes "uchar" VALUE 0x4000D1B4 RL_VALUE_UBYTE 0 NO_COMPU_METHOD 0 255 /end CHARACTERISTIC
/begin CHARACTERISTIC CAL_misfire_per_cyl_learn_enable "bool" VALUE 0x4000D1B5 RL_VALUE_UBYTE 0 NO_COMPU_METHOD 0 255 /end CHARACTERISTIC
/begin CHARACTERISTIC CAL_revlimit_limp_mode_rpm_reduction "Calibration: revlimit limp mode offset. Tunable map/constant (not a live channel); log to confirm where and how the rev limiter intervenes. (RPM)" VALUE 0x4000D1D8 RL_VALUE_UWORD 0 CM_u8_rspeed_rpm 0 65535 /end CHARACTERISTIC
/begin CHARACTERISTIC CAL_misfire_enable_coolant_min "u8_temp_5/8-40c" VALUE 0x4000D200 RL_VALUE_UBYTE 0 CM_u8_temp_5_8_40c -40 119.375 /end CHARACTERISTIC
/begin CHARACTERISTIC CAL_misfire_enable_coolant_max "u8_temp_5/8-40c" VALUE 0x4000D201 RL_VALUE_UBYTE 0 CM_u8_temp_5_8_40c -40 119.375 /end CHARACTERISTIC
/begin CHARACTERISTIC CAL_misfire_enable_rpm_min "u8_rspeed_125/4+500rpm" VALUE 0x4000D206 RL_VALUE_UBYTE 0 CM_u8_rspeed_125_4_500rpm 500 8468.75 /end CHARACTERISTIC
/begin CHARACTERISTIC CAL_misfire_enable_rpm_max "u8_rspeed_125/4+500rpm" VALUE 0x4000D207 RL_VALUE_UBYTE 0 CM_u8_rspeed_125_4_500rpm 500 8468.75 /end CHARACTERISTIC
/begin CHARACTERISTIC CAL_misfire_failed_bank_scaling "Calibration: misfire failed bank scaling. Tunable map/constant (not a live channel); log to find misfires and which cylinder is responsible. (0-1; raw/255)" VALUE 0x4000D20A RL_VALUE_UBYTE 0 CM_u8_factor_1_255 0 100 /end CHARACTERISTIC
/begin CHARACTERISTIC CAL_engine_speed_3_threshold_0 "uchar" VALUE 0x4000D20F RL_VALUE_UBYTE 0 NO_COMPU_METHOD 0 255 /end CHARACTERISTIC
/begin CHARACTERISTIC CAL_idle_monitor_voltage_operating_range "u16_voltage_18/1023v[2]" VAL_BLK 0x4000D210 RL_VALUE_UWORD 0 CM_u16_voltage_18_1023v 0 1153.10850439883 NUMBER 2 /end CHARACTERISTIC
/begin CHARACTERISTIC CAL_idle_learn_ac_on_param "uchar" VALUE 0x4000D214 RL_VALUE_UBYTE 0 NO_COMPU_METHOD 0 255 /end CHARACTERISTIC
/begin CHARACTERISTIC CAL_vvt_zero_target_timeout "Calibration: VVT zero target timeout. Tunable map/constant (not a live channel); log commanded vs actual cam timing to verify VVT response. (ms; raw*100)" VALUE 0x4000D217 RL_VALUE_UBYTE 0 CM_u8_time_100ms 0 25500 /end CHARACTERISTIC
/begin CHARACTERISTIC CAL_coolant_temp_limit "uchar" VALUE 0x4000D218 RL_VALUE_UBYTE 0 NO_COMPU_METHOD 0 255 /end CHARACTERISTIC
/begin CHARACTERISTIC CAL_misfire_inhibit_tps_rate_hold "uint16_t" VALUE 0x4000D21C RL_VALUE_UWORD 0 NO_COMPU_METHOD 0 65535 /end CHARACTERISTIC
/begin CHARACTERISTIC CAL_misfire_enable_conditions_hold "u16_time_5ms" VALUE 0x4000D21E RL_VALUE_UWORD 0 CM_u8_time_5ms 0 327675 /end CHARACTERISTIC
/begin CHARACTERISTIC CAL_misfire_rough_road_deviation_threshold "u16_speed_1/100kph" VALUE 0x4000D224 RL_VALUE_UWORD 0 CM_u8_speed_1_100kph 0 655.35 /end CHARACTERISTIC
/begin CHARACTERISTIC CAL_coolant_temp_threshold "uchar" VALUE 0x4000D22C RL_VALUE_UBYTE 0 NO_COMPU_METHOD 0 255 /end CHARACTERISTIC
/begin CHARACTERISTIC CAL_engine_speed_3_limit "uchar" VALUE 0x4000D241 RL_VALUE_UBYTE 0 NO_COMPU_METHOD 0 255 /end CHARACTERISTIC
/begin CHARACTERISTIC CAL_engine_speed_3_threshold_2 "uchar" VALUE 0x4000D246 RL_VALUE_UBYTE 0 NO_COMPU_METHOD 0 255 /end CHARACTERISTIC
/begin CHARACTERISTIC CAL_engine_speed_3_threshold_3 "uchar" VALUE 0x4000D247 RL_VALUE_UBYTE 0 NO_COMPU_METHOD 0 255 /end CHARACTERISTIC
/begin CHARACTERISTIC CAL_misfire_rough_road_hold "u16_time_5ms" VALUE 0x4000D25E RL_VALUE_UWORD 0 CM_u8_time_5ms 0 327675 /end CHARACTERISTIC
/begin CHARACTERISTIC CAL_coolant_temp_threshold_1 "uchar" VALUE 0x4000D263 RL_VALUE_UBYTE 0 NO_COMPU_METHOD 0 255 /end CHARACTERISTIC
/begin CHARACTERISTIC CAL_tps_commanded_during_fault "Calibration: throttle position commanded during fault. Tunable map/constant (not a live channel); log to see throttle/pedal demand and throttle response. (0-1; raw/255)" VALUE 0x4000D26B RL_VALUE_UBYTE 0 CM_u8_factor_1_255 0 100 /end CHARACTERISTIC
/begin CHARACTERISTIC CAL_evap_state_timer_threshold "uint8_t" VALUE 0x4000D27C RL_VALUE_UBYTE 0 NO_COMPU_METHOD 0 255 /end CHARACTERISTIC
/begin CHARACTERISTIC CAL_misfire_emissions_limit "Calibration: misfire emissions limit. Tunable map/constant (not a live channel); log to find misfires and which cylinder is responsible." VALUE 0x4000D2A8 RL_VALUE_UBYTE 0 NO_COMPU_METHOD 0 255 /end CHARACTERISTIC
/begin CHARACTERISTIC CAL_evap_purge_pressure_voltage_threshold "ushort" VALUE 0x4000D2B4 RL_VALUE_UWORD 0 NO_COMPU_METHOD 0 65535 /end CHARACTERISTIC
/begin CHARACTERISTIC CAL_evap_purge_pressure_voltage_threshold_0 "ushort" VALUE 0x4000D2B6 RL_VALUE_UWORD 0 NO_COMPU_METHOD 0 65535 /end CHARACTERISTIC
/begin CHARACTERISTIC CAL_coolant_temp_limit_0 "uchar" VALUE 0x4000D2BF RL_VALUE_UBYTE 0 NO_COMPU_METHOD 0 255 /end CHARACTERISTIC
/begin CHARACTERISTIC CAL_temp_engine_air_threshold_0 "uchar" VALUE 0x4000D2C0 RL_VALUE_UBYTE 0 NO_COMPU_METHOD 0 255 /end CHARACTERISTIC
/begin CHARACTERISTIC CAL_evap_unknown2 "u8_temp_5/8-40c" VALUE 0x4000D2C1 RL_VALUE_UBYTE 0 CM_u8_temp_5_8_40c -40 119.375 /end CHARACTERISTIC
/begin CHARACTERISTIC CAL_evap_leak_vacuum_decay_sample "uint8_t" VALUE 0x4000D2C3 RL_VALUE_UBYTE 0 NO_COMPU_METHOD 0 255 /end CHARACTERISTIC
/begin CHARACTERISTIC CAL_cat_check_unknown4 "ushort" VALUE 0x4000D2C4 RL_VALUE_UWORD 0 NO_COMPU_METHOD 0 65535 /end CHARACTERISTIC
/begin CHARACTERISTIC CAL_evap_tank_vacuum_flow_threshold "ushort" VALUE 0x4000D2C8 RL_VALUE_UWORD 0 NO_COMPU_METHOD 0 65535 /end CHARACTERISTIC
/begin CHARACTERISTIC CAL_evap_system_state_flags_param "ushort" VALUE 0x4000D2CA RL_VALUE_UWORD 0 NO_COMPU_METHOD 0 65535 /end CHARACTERISTIC
/begin CHARACTERISTIC CAL_evap_purge_flow_state_timer_init "uchar" VALUE 0x4000D2CC RL_VALUE_UBYTE 0 NO_COMPU_METHOD 0 255 /end CHARACTERISTIC
/begin CHARACTERISTIC CAL_evap_canister_purge_solenoid_timer_init "uchar" VALUE 0x4000D2CD RL_VALUE_UBYTE 0 NO_COMPU_METHOD 0 255 /end CHARACTERISTIC
/begin CHARACTERISTIC CAL_evap_purge_min_load "u8_load_4mg/stroke" VALUE 0x4000D2CE RL_VALUE_UBYTE 0 CM_u8_load_4mg_stroke 0 1020 /end CHARACTERISTIC
/begin CHARACTERISTIC CAL_evap_purge_min_load_active "uchar" VALUE 0x4000D2CF RL_VALUE_UBYTE 0 NO_COMPU_METHOD 0 255 /end CHARACTERISTIC
/begin CHARACTERISTIC CAL_evap_purge_vacuum_min "i16_pressure_mbar" VALUE 0x4000D2D0 RL_VALUE_SWORD 0 CM_i16_pressure_mbar -32768 32767 /end CHARACTERISTIC
/begin CHARACTERISTIC CAL_evap_leak_test_fuel_level_min "u8_volume_1/10gallon" VALUE 0x4000D2D6 RL_VALUE_UBYTE 0 CM_u8_volume_1_10gallon 0 25.5 /end CHARACTERISTIC
/begin CHARACTERISTIC CAL_evap_leak_test_fuel_level_max "u8_volume_1/10gallon" VALUE 0x4000D2D7 RL_VALUE_UBYTE 0 CM_u8_volume_1_10gallon 0 25.5 /end CHARACTERISTIC
/begin CHARACTERISTIC CAL_evap_purge_flow_vacuum_min "uint16_t" VALUE 0x4000D2D8 RL_VALUE_UWORD 0 NO_COMPU_METHOD 0 65535 /end CHARACTERISTIC
/begin CHARACTERISTIC CAL_evap_leak_test_pre_start_delay "u8_count" VALUE 0x4000D2DA RL_VALUE_UBYTE 0 NO_COMPU_METHOD 0 255 /end CHARACTERISTIC
/begin CHARACTERISTIC CAL_evap_leak_test_purge_settle_delay "u8_count" VALUE 0x4000D2DB RL_VALUE_UBYTE 0 NO_COMPU_METHOD 0 255 /end CHARACTERISTIC
/begin CHARACTERISTIC CAL_evap_leak_test_settle_samples "uchar" VALUE 0x4000D2DC RL_VALUE_UBYTE 0 NO_COMPU_METHOD 0 255 /end CHARACTERISTIC
/begin CHARACTERISTIC CAL_evap_leak_test_stage4_dwell "uchar" VALUE 0x4000D2DD RL_VALUE_UBYTE 0 NO_COMPU_METHOD 0 255 /end CHARACTERISTIC
/begin CHARACTERISTIC CAL_evap_leak_test_sample_count "ushort" VALUE 0x4000D2DE RL_VALUE_UWORD 0 NO_COMPU_METHOD 0 65535 /end CHARACTERISTIC
/begin CHARACTERISTIC CAL_evap_leak_test_baro_min "u16_pressure_mbar" VALUE 0x4000D2EA RL_VALUE_UWORD 0 CM_i16_pressure_mbar 0 65535 /end CHARACTERISTIC
/begin CHARACTERISTIC CAL_evap_leak_test_force_enable "bool" VALUE 0x4000D2EC RL_VALUE_UBYTE 0 NO_COMPU_METHOD 0 255 /end CHARACTERISTIC
/begin CHARACTERISTIC CAL_coolant_temp_limit_1 "uchar" VALUE 0x4000D2FF RL_VALUE_UBYTE 0 NO_COMPU_METHOD 0 255 /end CHARACTERISTIC
/begin CHARACTERISTIC CAL_coolant_temp_threshold_2 "uchar" VALUE 0x4000D300 RL_VALUE_UBYTE 0 NO_COMPU_METHOD 0 255 /end CHARACTERISTIC
/begin CHARACTERISTIC CAL_evap_fuel_level_threshold_mid "uint8_t" VALUE 0x4000D315 RL_VALUE_UBYTE 0 NO_COMPU_METHOD 0 255 /end CHARACTERISTIC
/begin CHARACTERISTIC CAL_vvt_cam_park_offset_max "u8_angle_1/4deg" VALUE 0x4000D328 RL_VALUE_UBYTE 0 CM_u8_angle_1_4deg 0 63.75 /end CHARACTERISTIC
/begin CHARACTERISTIC CAL_evap_fuel_used_window_level_high "u8_count" VALUE 0x4000D360 RL_VALUE_UBYTE 0 NO_COMPU_METHOD 0 255 /end CHARACTERISTIC
/begin CHARACTERISTIC CAL_evap_fuel_used_window_level_low "u8_count" VALUE 0x4000D361 RL_VALUE_UBYTE 0 NO_COMPU_METHOD 0 255 /end CHARACTERISTIC
/begin CHARACTERISTIC CAL_evap_fuel_used_window_level_mid "u8_count" VALUE 0x4000D362 RL_VALUE_UBYTE 0 NO_COMPU_METHOD 0 255 /end CHARACTERISTIC
/begin CHARACTERISTIC CAL_idle_coolant_fallback_temp "Calibration: idle coolant fallback temperature. Tunable map/constant (not a live channel); log to diagnose idle quality, hunting, and stalls. (deg C; raw*5/8-40)" VALUE 0x4000D380 RL_VALUE_UBYTE 0 CM_u8_temp_5_8_40c -40 119.375 /end CHARACTERISTIC
/begin CHARACTERISTIC CAL_idle_sensor_fault_coolant_temp "uint8_t" VALUE 0x4000D381 RL_VALUE_UBYTE 0 NO_COMPU_METHOD 0 255 /end CHARACTERISTIC
/begin CHARACTERISTIC CAL_idle_sensor_fault_coolant_temp_4000D382 "uint8_t" VALUE 0x4000D382 RL_VALUE_UBYTE 0 NO_COMPU_METHOD 0 255 /end CHARACTERISTIC
/begin CHARACTERISTIC CAL_evap_pressure_deviation_max "uchar" VALUE 0x4000D384 RL_VALUE_UBYTE 0 NO_COMPU_METHOD 0 255 /end CHARACTERISTIC
/begin CHARACTERISTIC CAL_misfire_rough_road_speed_min "u16_speed_1/100kph" VALUE 0x4000D394 RL_VALUE_UWORD 0 CM_u8_speed_1_100kph 0 655.35 /end CHARACTERISTIC
/begin CHARACTERISTIC CAL_engine_speed_3_limit_0 "uchar" VALUE 0x4000D3AC RL_VALUE_UBYTE 0 NO_COMPU_METHOD 0 255 /end CHARACTERISTIC
/begin CHARACTERISTIC CAL_engine_speed_3_threshold_4 "uchar" VALUE 0x4000D3AD RL_VALUE_UBYTE 0 NO_COMPU_METHOD 0 255 /end CHARACTERISTIC
/begin CHARACTERISTIC CAL_coolant_temp_limit_2 "uchar" VALUE 0x4000D3B4 RL_VALUE_UBYTE 0 NO_COMPU_METHOD 0 255 /end CHARACTERISTIC
/begin CHARACTERISTIC CAL_overrev_advisory_coolant_max "u8_temp_5/8-40c" VALUE 0x4000D40B RL_VALUE_UBYTE 0 CM_u8_temp_5_8_40c -40 119.375 /end CHARACTERISTIC
/begin CHARACTERISTIC CAL_overrev_advisory_margin_scale "u8_factor_1/100" VALUE 0x4000D40F RL_VALUE_UBYTE 0 CM_u8_factor_1_100 0 255 /end CHARACTERISTIC
/begin CHARACTERISTIC CAL_tps_obd_throttle_model_step_max_opening "uint8_t" VALUE 0x4000D417 RL_VALUE_UBYTE 0 NO_COMPU_METHOD 0 255 /end CHARACTERISTIC
/begin CHARACTERISTIC CAL_idle_unknown10 "uint8_t" VALUE 0x4000DBD9 RL_VALUE_UBYTE 0 NO_COMPU_METHOD 0 255 /end CHARACTERISTIC
/begin AXIS_PTS CAL_misfire_comp_maf_manual_X_coolant_temp "X-axis breakpoints for the 'misfire compensation MAF manual' table. Defines the lookup grid (not a live channel); change only when re-axing the map. (deg C; raw*5/8-40)" 0x4000DD70 coolant_temp_engine_stopped RL_AXIS_UWORD 0 CM_u8_temp_5_8_40c 4 -40 40919.375 /end AXIS_PTS
/begin AXIS_PTS CAL_misfire_comp_maf_manual_Y_maf_accum "Y-axis breakpoints for the 'misfire compensation MAF manual' table. Defines the lookup grid (not a live channel); change only when re-axing the map. (mg)" 0x4000DD78 maf_accumulated_2 RL_AXIS_UWORD 0 CM_u16_mass_mg 5 0 65535 /end AXIS_PTS
/begin CHARACTERISTIC CAL_misfire_comp_maf_manual "Calibration: misfire compensation MAF manual. Tunable map/constant (not a live channel); log to find misfires and which cylinder is responsible." MAP 0x4000DD82 RL_VALUE_UWORD 0 NO_COMPU_METHOD 0 65535
 /begin AXIS_DESCR COM_AXIS coolant_temp_engine_stopped CM_u8_temp_5_8_40c 4 -40 40919.375 AXIS_PTS_REF CAL_misfire_comp_maf_manual_X_coolant_temp /end AXIS_DESCR
 /begin AXIS_DESCR COM_AXIS maf_accumulated_2 CM_u16_mass_mg 5 0 65535 AXIS_PTS_REF CAL_misfire_comp_maf_manual_Y_maf_accum /end AXIS_DESCR
/end CHARACTERISTIC
/begin AXIS_PTS CAL_misfire_comp_maf_ips_X_coolant_temp "X-axis breakpoints for the 'misfire compensation MAF IPS' table. Defines the lookup grid (not a live channel); change only when re-axing the map. (deg C; raw*5/8-40)" 0x4000DDAA coolant_temp_engine_stopped RL_AXIS_UWORD 0 CM_u8_temp_5_8_40c 4 -40 40919.375 /end AXIS_PTS
/begin AXIS_PTS CAL_misfire_comp_maf_ips_Y_maf_accum "Y-axis breakpoints for the 'misfire compensation MAF IPS' table. Defines the lookup grid (not a live channel); change only when re-axing the map. (mg)" 0x4000DDB2 maf_accumulated_2 RL_AXIS_UWORD 0 CM_u16_mass_mg 5 0 65535 /end AXIS_PTS
/begin CHARACTERISTIC CAL_misfire_comp_maf_ips "Calibration: misfire compensation MAF IPS. Tunable map/constant (not a live channel); log to find misfires and which cylinder is responsible." MAP 0x4000DDBC RL_VALUE_SWORD 0 NO_COMPU_METHOD -32768 32767
 /begin AXIS_DESCR COM_AXIS coolant_temp_engine_stopped CM_u8_temp_5_8_40c 4 -40 40919.375 AXIS_PTS_REF CAL_misfire_comp_maf_ips_X_coolant_temp /end AXIS_DESCR
 /begin AXIS_DESCR COM_AXIS maf_accumulated_2 CM_u16_mass_mg 5 0 65535 AXIS_PTS_REF CAL_misfire_comp_maf_ips_Y_maf_accum /end AXIS_DESCR
/end CHARACTERISTIC
/begin AXIS_PTS CAL_engine_speed_filter_rise_coeff_tour_X_rpm "X-axis breakpoints for the 'engine speed filter rise coeff tour' table. Defines the lookup grid (not a live channel); change only when re-axing the map. (RPM; raw*125/4+500)" 0x4000DDE4 engine_speed_3 RL_AXIS_UBYTE 0 CM_u8_rspeed_125_4_500rpm 4 500 8468.75 /end AXIS_PTS
/begin AXIS_PTS CAL_engine_speed_filter_rise_coeff_tour_Y_coolant_temp "Y-axis breakpoints for the 'engine speed filter rise coeff tour' table. Defines the lookup grid (not a live channel); change only when re-axing the map. (deg C; raw*5/8-40)" 0x4000DDE8 coolant_temp RL_AXIS_UBYTE 0 CM_u8_temp_5_8_40c 4 -40 119.375 /end AXIS_PTS
/begin CHARACTERISTIC CAL_engine_speed_filter_rise_coeff_tour "engine_speed_filter_rise_coeff is the IIR low-pass filter coefficient controlling how quickly the tachometer-displayed RPM climbs toward the" MAP 0x4000DDEC RL_VALUE_UBYTE 0 CM_u8_factor_1_255 0 100
 /begin AXIS_DESCR COM_AXIS engine_speed_3 CM_u8_rspeed_125_4_500rpm 4 500 8468.75 AXIS_PTS_REF CAL_engine_speed_filter_rise_coeff_tour_X_rpm /end AXIS_DESCR
 /begin AXIS_DESCR COM_AXIS coolant_temp CM_u8_temp_5_8_40c 4 -40 119.375 AXIS_PTS_REF CAL_engine_speed_filter_rise_coeff_tour_Y_coolant_temp /end AXIS_DESCR
/end CHARACTERISTIC
/begin AXIS_PTS CAL_engine_speed_filter_rise_coeff_sport_X_rpm "X-axis breakpoints for the 'engine speed filter rise coeff sport' table. Defines the lookup grid (not a live channel); change only when re-axing the map. (RPM; raw*125/4+500)" 0x4000DDFC engine_speed_3 RL_AXIS_UBYTE 0 CM_u8_rspeed_125_4_500rpm 4 500 8468.75 /end AXIS_PTS
/begin AXIS_PTS CAL_engine_speed_filter_rise_coeff_sport_Y_coolant_temp "Y-axis breakpoints for the 'engine speed filter rise coeff sport' table. Defines the lookup grid (not a live channel); change only when re-axing the map. (deg C; raw*5/8-40)" 0x4000DE00 coolant_temp RL_AXIS_UBYTE 0 CM_u8_temp_5_8_40c 4 -40 119.375 /end AXIS_PTS
/begin CHARACTERISTIC CAL_engine_speed_filter_rise_coeff_sport "Calibration: engine speed filter rise coeff sport. Tunable map/constant (not a live channel); log to follow core engine state. (0-1; raw/255)" MAP 0x4000DE04 RL_VALUE_UBYTE 0 CM_u8_factor_1_255 0 100
 /begin AXIS_DESCR COM_AXIS engine_speed_3 CM_u8_rspeed_125_4_500rpm 4 500 8468.75 AXIS_PTS_REF CAL_engine_speed_filter_rise_coeff_sport_X_rpm /end AXIS_DESCR
 /begin AXIS_DESCR COM_AXIS coolant_temp CM_u8_temp_5_8_40c 4 -40 119.375 AXIS_PTS_REF CAL_engine_speed_filter_rise_coeff_sport_Y_coolant_temp /end AXIS_DESCR
/end CHARACTERISTIC
/begin AXIS_PTS CAL_tps_scaling_factor_rpm_prototype_X_rpm "X-axis breakpoints for the 'throttle position scaling factor RPM prototype' table. Defines the lookup grid (not a live channel); change only when re-axing the map. (RPM; raw*125/4+500)" 0x4000DE14 engine_speed_3 RL_AXIS_UBYTE 0 CM_u8_rspeed_125_4_500rpm 16 500 8468.75 /end AXIS_PTS
/begin CHARACTERISTIC CAL_tps_scaling_factor_rpm_prototype "Calibration: throttle position scaling factor RPM prototype. Tunable map/constant (not a live channel); log to see throttle/pedal demand and throttle response. (0-1; raw/255)" CURVE 0x4000DE24 RL_VALUE_UBYTE 0 CM_u8_factor_1_255 0 100
 /begin AXIS_DESCR COM_AXIS engine_speed_3 CM_u8_rspeed_125_4_500rpm 16 500 8468.75 AXIS_PTS_REF CAL_tps_scaling_factor_rpm_prototype_X_rpm /end AXIS_DESCR
/end CHARACTERISTIC
/begin AXIS_PTS CAL_misfire_sensitivity_manual_X_rpm "X-axis breakpoints for the 'misfire sensitivity manual' table. Defines the lookup grid (not a live channel); change only when re-axing the map. (RPM)" 0x4000DF5C engine_speed_16bit RL_AXIS_UWORD 0 CM_u8_rspeed_rpm 8 0 65535 /end AXIS_PTS
/begin AXIS_PTS CAL_misfire_sensitivity_manual_Y_load "Y-axis breakpoints for the 'misfire sensitivity manual' table. Defines the lookup grid (not a live channel); change only when re-axing the map. (mg/stroke)" 0x4000DF6C V_CAL_misfire_sensitivity_manual_Y_load RL_AXIS_UWORD 0 CM_u16_load_mg_stroke 8 0 65535 /end AXIS_PTS
/begin CHARACTERISTIC CAL_misfire_sensitivity_manual "Calibration: misfire sensitivity manual. Tunable map/constant (not a live channel); log to find misfires and which cylinder is responsible." MAP 0x4000DF7C RL_VALUE_UWORD 0 NO_COMPU_METHOD 0 65535
 /begin AXIS_DESCR COM_AXIS engine_speed_16bit CM_u8_rspeed_rpm 8 0 65535 AXIS_PTS_REF CAL_misfire_sensitivity_manual_X_rpm /end AXIS_DESCR
 /begin AXIS_DESCR COM_AXIS V_CAL_misfire_sensitivity_manual_Y_load CM_u16_load_mg_stroke 8 0 65535 AXIS_PTS_REF CAL_misfire_sensitivity_manual_Y_load /end AXIS_DESCR
/end CHARACTERISTIC
/begin AXIS_PTS CAL_misfire_sensitivity_ips_X_rpm "X-axis breakpoints for the 'misfire sensitivity IPS' table. Defines the lookup grid (not a live channel); change only when re-axing the map. (RPM)" 0x4000DFFC engine_speed_16bit RL_AXIS_UWORD 0 CM_u8_rspeed_rpm 8 0 65535 /end AXIS_PTS
/begin AXIS_PTS CAL_misfire_sensitivity_ips_Y_load "Y-axis breakpoints for the 'misfire sensitivity IPS' table. Defines the lookup grid (not a live channel); change only when re-axing the map. (mg/stroke)" 0x4000E00C V_CAL_misfire_sensitivity_ips_Y_load RL_AXIS_UWORD 0 CM_u16_load_mg_stroke 8 0 65535 /end AXIS_PTS
/begin CHARACTERISTIC CAL_misfire_sensitivity_ips "Calibration: misfire sensitivity IPS. Tunable map/constant (not a live channel); log to find misfires and which cylinder is responsible." MAP 0x4000E01C RL_VALUE_UWORD 0 NO_COMPU_METHOD 0 65535
 /begin AXIS_DESCR COM_AXIS engine_speed_16bit CM_u8_rspeed_rpm 8 0 65535 AXIS_PTS_REF CAL_misfire_sensitivity_ips_X_rpm /end AXIS_DESCR
 /begin AXIS_DESCR COM_AXIS V_CAL_misfire_sensitivity_ips_Y_load CM_u16_load_mg_stroke 8 0 65535 AXIS_PTS_REF CAL_misfire_sensitivity_ips_Y_load /end AXIS_DESCR
/end CHARACTERISTIC
/begin AXIS_PTS CAL_overrev_advisory_limit_X_mass_air "u16_mass_g[4]" 0x4000E12C maf_accumulated_2 RL_AXIS_UWORD 0 CM_u16_mass_g 4 0 65535 /end AXIS_PTS
/begin CHARACTERISTIC CAL_overrev_advisory_limit "uint16_t[4]" CURVE 0x4000E134 RL_VALUE_UWORD 0 NO_COMPU_METHOD 0 65535
 /begin AXIS_DESCR COM_AXIS maf_accumulated_2 CM_u16_mass_g 4 0 65535 AXIS_PTS_REF CAL_overrev_advisory_limit_X_mass_air /end AXIS_DESCR
/end CHARACTERISTIC
/begin CHARACTERISTIC CAL_misfire_detect_min_load_ips "Calibration: misfire detect min load IPS. Tunable map/constant (not a live channel); log to find misfires and which cylinder is responsible. (mg/stroke; raw*4)" VAL_BLK 0x4000E1AC RL_VALUE_UBYTE 0 CM_u8_load_4mg_stroke 0 1020 NUMBER 10 /end CHARACTERISTIC
/begin CHARACTERISTIC CAL_misfire_detect_min_load_manual "Calibration: misfire detect min load manual. Tunable map/constant (not a live channel); log to find misfires and which cylinder is responsible. (mg/stroke; raw*4)" VAL_BLK 0x4000E1B6 RL_VALUE_UBYTE 0 CM_u8_load_4mg_stroke 0 1020 NUMBER 10 /end CHARACTERISTIC
/begin AXIS_PTS CAL_misfire_base_threshold_manual_X_rpm "X-axis breakpoints for the 'misfire base threshold manual' table. Defines the lookup grid (not a live channel); change only when re-axing the map. (RPM)" 0x4000E1E0 engine_speed_16bit RL_AXIS_UWORD 0 CM_u8_rspeed_rpm 16 0 65535 /end AXIS_PTS
/begin AXIS_PTS CAL_misfire_base_threshold_manual_Y_load "Y-axis breakpoints for the 'misfire base threshold manual' table. Defines the lookup grid (not a live channel); change only when re-axing the map. (mg/stroke)" 0x4000E200 V_CAL_misfire_base_threshold_manual_Y_load RL_AXIS_UWORD 0 CM_u16_load_mg_stroke 16 0 65535 /end AXIS_PTS
/begin CHARACTERISTIC CAL_misfire_base_threshold_manual "Calibration: misfire base threshold manual. Tunable map/constant (not a live channel); log to find misfires and which cylinder is responsible." MAP 0x4000E220 RL_VALUE_SWORD 0 NO_COMPU_METHOD -32768 32767
 /begin AXIS_DESCR COM_AXIS engine_speed_16bit CM_u8_rspeed_rpm 16 0 65535 AXIS_PTS_REF CAL_misfire_base_threshold_manual_X_rpm /end AXIS_DESCR
 /begin AXIS_DESCR COM_AXIS V_CAL_misfire_base_threshold_manual_Y_load CM_u16_load_mg_stroke 16 0 65535 AXIS_PTS_REF CAL_misfire_base_threshold_manual_Y_load /end AXIS_DESCR
/end CHARACTERISTIC
/begin AXIS_PTS CAL_misfire_cat_damage_limit_X_rpm "X-axis breakpoints for the 'misfire cat damage limit' table. Defines the lookup grid (not a live channel); change only when re-axing the map. (RPM; raw*125/4+500)" 0x4000E420 engine_speed_3 RL_AXIS_UBYTE 0 CM_u8_rspeed_125_4_500rpm 8 500 8468.75 /end AXIS_PTS
/begin AXIS_PTS CAL_misfire_cat_damage_limit_Y_load "Y-axis breakpoints for the 'misfire cat damage limit' table. Defines the lookup grid (not a live channel); change only when re-axing the map. (mg/stroke; raw*4)" 0x4000E428 load_mass_per_stroke RL_AXIS_UBYTE 0 CM_u8_load_4mg_stroke 8 0 1020 /end AXIS_PTS
/begin CHARACTERISTIC CAL_misfire_cat_damage_limit "Calibration: misfire cat damage limit. Tunable map/constant (not a live channel); log to find misfires and which cylinder is responsible." MAP 0x4000E430 RL_VALUE_UBYTE 0 NO_COMPU_METHOD 0 255
 /begin AXIS_DESCR COM_AXIS engine_speed_3 CM_u8_rspeed_125_4_500rpm 8 500 8468.75 AXIS_PTS_REF CAL_misfire_cat_damage_limit_X_rpm /end AXIS_DESCR
 /begin AXIS_DESCR COM_AXIS load_mass_per_stroke CM_u8_load_4mg_stroke 8 0 1020 AXIS_PTS_REF CAL_misfire_cat_damage_limit_Y_load /end AXIS_DESCR
/end CHARACTERISTIC
/begin AXIS_PTS CAL_misfire_base_threshold_ips_X_rpm "X-axis breakpoints for the 'misfire base threshold IPS' table. Defines the lookup grid (not a live channel); change only when re-axing the map. (RPM)" 0x4000E470 engine_speed_16bit RL_AXIS_UWORD 0 CM_u8_rspeed_rpm 16 0 65535 /end AXIS_PTS
/begin AXIS_PTS CAL_misfire_base_threshold_ips_Y_load "Y-axis breakpoints for the 'misfire base threshold IPS' table. Defines the lookup grid (not a live channel); change only when re-axing the map. (mg/stroke)" 0x4000E490 V_CAL_misfire_base_threshold_ips_Y_load RL_AXIS_UWORD 0 CM_u16_load_mg_stroke 16 0 65535 /end AXIS_PTS
/begin CHARACTERISTIC CAL_misfire_base_threshold_ips "Calibration: misfire base threshold IPS. Tunable map/constant (not a live channel); log to find misfires and which cylinder is responsible." MAP 0x4000E4B0 RL_VALUE_SWORD 0 NO_COMPU_METHOD -32768 32767
 /begin AXIS_DESCR COM_AXIS engine_speed_16bit CM_u8_rspeed_rpm 16 0 65535 AXIS_PTS_REF CAL_misfire_base_threshold_ips_X_rpm /end AXIS_DESCR
 /begin AXIS_DESCR COM_AXIS V_CAL_misfire_base_threshold_ips_Y_load CM_u16_load_mg_stroke 16 0 65535 AXIS_PTS_REF CAL_misfire_base_threshold_ips_Y_load /end AXIS_DESCR
/end CHARACTERISTIC
/begin AXIS_PTS CAL_idle_air_warmup_factor_ips_X_coolant_temp "u8_temp_5/8-40c[16]" 0x4000E960 coolant_temp RL_AXIS_UBYTE 0 CM_u8_temp_5_8_40c 16 -40 119.375 /end AXIS_PTS
/begin AXIS_PTS CAL_idle_air_warmup_factor_ips_Y_maf_accum "uint8_t[8]" 0x4000E970 NO_INPUT_QUANTITY RL_AXIS_UBYTE 0 NO_COMPU_METHOD 8 0 255 /end AXIS_PTS
/begin CHARACTERISTIC CAL_idle_air_warmup_factor_ips "u8_factor_1/64[128]" MAP 0x4000E978 RL_VALUE_UBYTE 0 CM_u8_factor_1_64 0 398.4375
 /begin AXIS_DESCR COM_AXIS coolant_temp CM_u8_temp_5_8_40c 16 -40 119.375 AXIS_PTS_REF CAL_idle_air_warmup_factor_ips_X_coolant_temp /end AXIS_DESCR
 /begin AXIS_DESCR COM_AXIS NO_INPUT_QUANTITY NO_COMPU_METHOD 8 0 255 AXIS_PTS_REF CAL_idle_air_warmup_factor_ips_Y_maf_accum /end AXIS_DESCR
/end CHARACTERISTIC
/begin AXIS_PTS CAL_tpstarget_low_gear_tour_manual_X_pps "X-axis breakpoints for the 'tpstarget low gear tour manual' table. Defines the lookup grid (not a live channel); change only when re-axing the map. (0-1; raw/1023)" 0x4000E9F8 NO_INPUT_QUANTITY RL_AXIS_UWORD 0 CM_u16_factor_1_1023 16 0 6406.15835777126 /end AXIS_PTS
/begin CHARACTERISTIC CAL_tpstarget_low_gear_tour_manual "Calibration: tpstarget low gear tour manual. Tunable map/constant (not a live channel); log to compare requested throttle target to pedal demand. (0-1; raw/1023)" CURVE 0x4000EA18 RL_VALUE_UWORD 0 CM_u16_factor_1_1023 0 6406.15835777126
 /begin AXIS_DESCR COM_AXIS NO_INPUT_QUANTITY CM_u16_factor_1_1023 16 0 6406.15835777126 AXIS_PTS_REF CAL_tpstarget_low_gear_tour_manual_X_pps /end AXIS_DESCR
/end CHARACTERISTIC
/begin AXIS_PTS CAL_tpssmooth_increment_tour_parking_X_tps_rate "X-axis breakpoints for the 'tpssmooth increment tour parking' table. Defines the lookup grid (not a live channel); change only when re-axing the map. (0-1; raw/255)" 0x4000EA38 NO_INPUT_QUANTITY RL_AXIS_UBYTE 0 CM_u8_factor_1_255 8 0 100 /end AXIS_PTS
/begin CHARACTERISTIC CAL_tpssmooth_increment_tour_parking "Calibration: tpssmooth increment tour parking. Tunable map/constant (not a live channel); log to see throttle-signal smoothing/filtering behavior. (0-1; raw/1023)" CURVE 0x4000EA40 RL_VALUE_UBYTE 0 CM_u16_factor_1_1023 0 24.9266862170088
 /begin AXIS_DESCR COM_AXIS NO_INPUT_QUANTITY CM_u8_factor_1_255 8 0 100 AXIS_PTS_REF CAL_tpssmooth_increment_tour_parking_X_tps_rate /end AXIS_DESCR
/end CHARACTERISTIC
/begin AXIS_PTS CAL_idle_air_comp_low_load_cam_X_cam_offset "uint8_t[8]" 0x4000EA48 vvt_low_load_cam_offset RL_AXIS_UBYTE 0 NO_COMPU_METHOD 8 0 255 /end AXIS_PTS
/begin AXIS_PTS CAL_idle_air_comp_low_load_cam_Y_idle_rpm "u8_rspeed_10rpm[8]" 0x4000EA50 NO_INPUT_QUANTITY RL_AXIS_UBYTE 0 CM_u8_rspeed_10rpm 8 0 2550 /end AXIS_PTS
/begin CHARACTERISTIC CAL_idle_air_comp_low_load_cam "u8_flow_100mg/s[64]" MAP 0x4000EA58 RL_VALUE_UBYTE 0 CM_u8_flow_100mg_s 0 25500
 /begin AXIS_DESCR COM_AXIS vvt_low_load_cam_offset NO_COMPU_METHOD 8 0 255 AXIS_PTS_REF CAL_idle_air_comp_low_load_cam_X_cam_offset /end AXIS_DESCR
 /begin AXIS_DESCR COM_AXIS NO_INPUT_QUANTITY CM_u8_rspeed_10rpm 8 0 2550 AXIS_PTS_REF CAL_idle_air_comp_low_load_cam_Y_idle_rpm /end AXIS_DESCR
/end CHARACTERISTIC
/begin AXIS_PTS CAL_exhaust_flap_position_tour_X_rpm "X-axis breakpoints for the 'exhaust flap position tour' table. Defines the lookup grid (not a live channel); change only when re-axing the map. (RPM; raw*50)" 0x4000EA98 V_CAL_exhaust_flap_position_tour_X_rpm RL_AXIS_UBYTE 0 CM_u8_rspeed_50rpm 8 0 12750 /end AXIS_PTS
/begin AXIS_PTS CAL_exhaust_flap_position_tour_Y_accel_pps "Y-axis breakpoints for the 'exhaust flap position tour' table. Defines the lookup grid (not a live channel); change only when re-axing the map. (0-1; raw/255)" 0x4000EAA0 NO_INPUT_QUANTITY RL_AXIS_UBYTE 0 CM_u8_factor_1_255 8 0 100 /end AXIS_PTS
/begin CHARACTERISTIC CAL_exhaust_flap_position_tour "0 = closed (active control, eTPU = 10000)" MAP 0x4000EAA8 RL_VALUE_UBYTE 0 NO_COMPU_METHOD 0 255
 /begin AXIS_DESCR COM_AXIS V_CAL_exhaust_flap_position_tour_X_rpm CM_u8_rspeed_50rpm 8 0 12750 AXIS_PTS_REF CAL_exhaust_flap_position_tour_X_rpm /end AXIS_DESCR
 /begin AXIS_DESCR COM_AXIS NO_INPUT_QUANTITY CM_u8_factor_1_255 8 0 100 AXIS_PTS_REF CAL_exhaust_flap_position_tour_Y_accel_pps /end AXIS_DESCR
/end CHARACTERISTIC
/begin AXIS_PTS CAL_exhaust_flap_position_tour_sport_X_rpm "X-axis breakpoints for the 'exhaust flap position tour sport' table. Defines the lookup grid (not a live channel); change only when re-axing the map. (RPM; raw*50)" 0x4000EAE8 V_CAL_exhaust_flap_position_tour_sport_X_rpm RL_AXIS_UBYTE 0 CM_u8_rspeed_50rpm 8 0 12750 /end AXIS_PTS
/begin AXIS_PTS CAL_exhaust_flap_position_tour_sport_Y_accel_pps "Y-axis breakpoints for the 'exhaust flap position tour sport' table. Defines the lookup grid (not a live channel); change only when re-axing the map. (0-1; raw/255)" 0x4000EAF0 NO_INPUT_QUANTITY RL_AXIS_UBYTE 0 CM_u8_factor_1_255 8 0 100 /end AXIS_PTS
/begin CHARACTERISTIC CAL_exhaust_flap_position_tour_sport "Calibration: exhaust flap position tour sport. Tunable map/constant (not a live channel); log to see exhaust bypass valve position (sound/backpressure)." MAP 0x4000EAF8 RL_VALUE_UBYTE 0 NO_COMPU_METHOD 0 255
 /begin AXIS_DESCR COM_AXIS V_CAL_exhaust_flap_position_tour_sport_X_rpm CM_u8_rspeed_50rpm 8 0 12750 AXIS_PTS_REF CAL_exhaust_flap_position_tour_sport_X_rpm /end AXIS_DESCR
 /begin AXIS_DESCR COM_AXIS NO_INPUT_QUANTITY CM_u8_factor_1_255 8 0 100 AXIS_PTS_REF CAL_exhaust_flap_position_tour_sport_Y_accel_pps /end AXIS_DESCR
/end CHARACTERISTIC
/begin AXIS_PTS CAL_idle_comp_timer_carspeed_ips_X_airtemp "X-axis breakpoints for the 'idle compensation timer carspeed IPS' table. Defines the lookup grid (not a live channel); change only when re-axing the map. (deg C; raw*5/8-40)" 0x4000EB38 NO_INPUT_QUANTITY RL_AXIS_UBYTE 0 CM_u8_temp_5_8_40c 8 -40 119.375 /end AXIS_PTS
/begin AXIS_PTS CAL_idle_comp_timer_carspeed_ips_Y_time_above_speed "Y-axis breakpoints for the 'idle compensation timer carspeed IPS' table. Defines the lookup grid (not a live channel); change only when re-axing the map." 0x4000EB40 timer_above_min_carspeed RL_AXIS_UBYTE 0 NO_COMPU_METHOD 8 0 255 /end AXIS_PTS
/begin CHARACTERISTIC CAL_idle_comp_timer_carspeed_ips "Calibration: idle compensation timer carspeed IPS. Tunable map/constant (not a live channel); log to diagnose idle quality, hunting, and stalls. (RPM; raw*8)" MAP 0x4000EB48 RL_VALUE_UBYTE 0 CM_u8_rspeed_8rpm 0 2040
 /begin AXIS_DESCR COM_AXIS NO_INPUT_QUANTITY CM_u8_temp_5_8_40c 8 -40 119.375 AXIS_PTS_REF CAL_idle_comp_timer_carspeed_ips_X_airtemp /end AXIS_DESCR
 /begin AXIS_DESCR COM_AXIS timer_above_min_carspeed NO_COMPU_METHOD 8 0 255 AXIS_PTS_REF CAL_idle_comp_timer_carspeed_ips_Y_time_above_speed /end AXIS_DESCR
/end CHARACTERISTIC
/begin AXIS_PTS CAL_torque_external_request_minimum_X_engine_speed "X-axis breakpoints for the 'torque external request minimum' table. Defines the lookup grid (not a live channel); change only when re-axing the map. (RPM; raw*125/4+500)" 0x4000ECB8 engine_speed_3 RL_AXIS_UBYTE 0 CM_u8_rspeed_125_4_500rpm 16 500 8468.75 /end AXIS_PTS
/begin AXIS_PTS CAL_torque_external_request_minimum_Y_torque "Y-axis breakpoints for the 'torque external request minimum' table. Defines the lookup grid (not a live channel); change only when re-axing the map. (Nm; raw*2)" 0x4000ECC8 NO_INPUT_QUANTITY RL_AXIS_UBYTE 0 CM_u8_torque_2nm 16 0 510 /end AXIS_PTS
/begin CHARACTERISTIC CAL_torque_external_request_minimum "Calibration: torque external request minimum. Tunable map/constant (not a live channel); log to follow the ECU torque estimate and any torque limiting." MAP 0x4000ECD8 RL_VALUE_UBYTE 0 NO_COMPU_METHOD 0 255
 /begin AXIS_DESCR COM_AXIS engine_speed_3 CM_u8_rspeed_125_4_500rpm 16 500 8468.75 AXIS_PTS_REF CAL_torque_external_request_minimum_X_engine_speed /end AXIS_DESCR
 /begin AXIS_DESCR COM_AXIS NO_INPUT_QUANTITY CM_u8_torque_2nm 16 0 510 AXIS_PTS_REF CAL_torque_external_request_minimum_Y_torque /end AXIS_DESCR
/end CHARACTERISTIC
/begin GROUP G_Throttle_etb "etb"
 /begin REF_CHARACTERISTIC CAL_etb_pid_i_clamp CAL_etb_pid_kd CAL_etb_pid_ki CAL_etb_pid_kp CAL_etb_pwm_period CAL_etb_tps1_max_count CAL_etb_tps2_max_count CAL_etb_tps2_range_lo_frac /end REF_CHARACTERISTIC
/end GROUP
/begin GROUP G_Throttle_throttle "throttle" /begin REF_CHARACTERISTIC CAL_throttle_model_torque_gain /end REF_CHARACTERISTIC /end GROUP
/begin GROUP G_Throttle_tps "tps"
 /begin REF_CHARACTERISTIC CAL_tps_accel_pedal_zero_calibrate_timer CAL_tps_brake_safety_floor CAL_tps_brake_wheeldecel_threshold CAL_tps_brake_wheeldecel_tps_cut_threshold CAL_tps_commanded_during_fault CAL_tps_commanded_wamup_min CAL_tps_decrement_base CAL_tps_delta_neg_clamp CAL_tps_delta_neg_threshold CAL_tps_delta_rate_window_size CAL_tps_idle_target_cranking CAL_tps_idle_target_cranking_X_baro CAL_tps_idle_target_cranking_Y_coolant CAL_tps_limit_idle_request_max CAL_tps_limit_misfire_single_bank CAL_tps_limit_severe_misfire_1_cut CAL_tps_limit_severe_misfire_multi_cut CAL_tps_limit_severe_misfire_no_cut CAL_tps_limit_warmup_coolant_max CAL_tps_limit_warmup_stepsize CAL_tps_obd_throttle_model_step_max_opening CAL_tps_scaling_factor_rpm CAL_tps_scaling_factor_rpm_X_rpm CAL_tps_scaling_factor_rpm_prototype CAL_tps_scaling_factor_rpm_prototype_X_rpm CAL_tps_warmup_max /end REF_CHARACTERISTIC
/end GROUP
/begin GROUP G_Throttle_tps1 "tps1" /begin REF_CHARACTERISTIC CAL_tps1_normalize_full_frac /end REF_CHARACTERISTIC /end GROUP
/begin GROUP G_Throttle_tpssmooth "tpssmooth"
 /begin REF_CHARACTERISTIC CAL_tpssmooth_accel_pedal_modes_enable CAL_tpssmooth_decrement_by_delta CAL_tpssmooth_decrement_by_delta_X_tps_delta CAL_tpssmooth_decrement_comp_gears_ips CAL_tpssmooth_decrement_comp_gears_manual CAL_tpssmooth_decrement_cruise_scale CAL_tpssmooth_increment_sport_driving CAL_tpssmooth_increment_sport_driving_X_tps_rate CAL_tpssmooth_increment_sport_shifting CAL_tpssmooth_increment_sport_shifting_X_tps_rate CAL_tpssmooth_increment_tour_driving CAL_tpssmooth_increment_tour_driving_X_tps_rate CAL_tpssmooth_increment_tour_parking CAL_tpssmooth_increment_tour_parking_X_tps_rate CAL_tpssmooth_increment_tour_shifting CAL_tpssmooth_increment_tour_shifting_X_tps_rate CAL_tpssmooth_parking_clutch_threshold CAL_tpssmooth_parking_gear_max CAL_tpssmooth_parking_pedal_max CAL_tpssmooth_parking_speed_max CAL_tpssmooth_parking_threshold_carspeed CAL_tpssmooth_parking_threshold_tps CAL_tpssmooth_rate_calc_window_size CAL_tpssmooth_step_timer /end REF_CHARACTERISTIC
/end GROUP
/begin GROUP G_Throttle_tpstarget "tpstarget"
 /begin REF_CHARACTERISTIC CAL_tpstarget_low_gear_tour_ips CAL_tpstarget_low_gear_tour_ips_X_pps CAL_tpstarget_low_gear_tour_manual CAL_tpstarget_low_gear_tour_manual_X_pps CAL_tpstarget_sport_ips CAL_tpstarget_sport_ips_X_pps CAL_tpstarget_sport_manual CAL_tpstarget_sport_manual_X_pps CAL_tpstarget_sport_shifting CAL_tpstarget_sport_shifting_X_pps CAL_tpstarget_tour_manual CAL_tpstarget_tour_manual_X_pps CAL_tpstarget_tour_shifting CAL_tpstarget_tour_shifting_X_pps /end REF_CHARACTERISTIC
/end GROUP
/begin GROUP G_Idle "Idle" ROOT
 /begin REF_CHARACTERISTIC CAL_idle_air_base_ips_ingear_sport CAL_idle_air_base_ips_ingear_sport_X_rpm CAL_idle_air_base_ips_ingear_tour CAL_idle_air_base_ips_ingear_tour_X_rpm CAL_idle_air_base_ips_neutral_sport CAL_idle_air_base_ips_neutral_sport_X_rpm CAL_idle_air_base_ips_neutral_tour CAL_idle_air_base_ips_neutral_tour_X_rpm CAL_idle_air_base_manual CAL_idle_air_base_manual_X_rpm CAL_idle_air_comp_bay_fan CAL_idle_air_comp_bay_fan_X_time CAL_idle_air_comp_fan_1 CAL_idle_air_comp_fan_1_X_time CAL_idle_air_comp_fan_2 CAL_idle_air_comp_fan_2_X_time CAL_idle_air_comp_low_load_cam CAL_idle_air_comp_low_load_cam_X_cam_offset CAL_idle_air_comp_low_load_cam_Y_idle_rpm CAL_idle_air_comp_misfire CAL_idle_air_comp_misfire_X_cyl_count CAL_idle_air_control_unknown CAL_idle_air_decay_period CAL_idle_air_decay_period_X_phase CAL_idle_air_fast_decay_period CAL_idle_air_hi_rpm_adder CAL_idle_air_hi_rpm_adder_X_rpm CAL_idle_air_hi_rpm_adder_speed_min CAL_idle_air_integral_step CAL_idle_air_integral_step_X_speed_error CAL_idle_air_prop_gain CAL_idle_air_prop_gain_X_speed_error CAL_idle_air_warmup_factor_ips CAL_idle_air_warmup_factor_ips_X_coolant_temp CAL_idle_air_warmup_factor_ips_Y_maf_accum CAL_idle_air_warmup_factor_manual CAL_idle_air_warmup_factor_manual_X_coolant_temp CAL_idle_air_warmup_factor_manual_Y_maf_accumulated CAL_idle_bypass_airflow_factor CAL_idle_carspeed_comp_decay_step CAL_idle_carspeed_comp_decay_step_ac CAL_idle_comp_ac_load CAL_idle_comp_ac_load_X_ac_load CAL_idle_comp_baro CAL_idle_comp_baro_X_baro CAL_idle_comp_car_speed_ips CAL_idle_comp_car_speed_ips_X_carspeed CAL_idle_comp_car_speed_manual CAL_idle_comp_car_speed_manual_X_carspeed CAL_idle_comp_carspeed_ips CAL_idle_comp_carspeed_ips_X_carspeed CAL_idle_comp_carspeed_manual CAL_idle_comp_carspeed_manual_X_carspeed CAL_idle_comp_decay_period CAL_idle_comp_decay_period_ac CAL_idle_comp_ecu_voltage CAL_idle_comp_ecu_voltage_X_voltage CAL_idle_comp_iat CAL_idle_comp_iat_X_iat CAL_idle_comp_timer_carspeed_ips CAL_idle_comp_timer_carspeed_ips_X_airtemp CAL_idle_comp_timer_carspeed_ips_Y_time_above_speed CAL_idle_comp_timer_carspeed_manual CAL_idle_comp_timer_carspeed_manual_X_airtemp CAL_idle_comp_timer_carspeed_manual_Y_time_above_speed CAL_idle_control_entry_offset CAL_idle_coolant_fallback_temp CAL_idle_dashpot_decel_threshold CAL_idle_dashpot_rpm_lift_max CAL_idle_dashpot_rpm_lift_max_X_rpm CAL_idle_exit_rpm_offset CAL_idle_flow_adj1_maf_accum_max CAL_idle_flow_integral_adj_max CAL_idle_flow_integral_adj_max_40008E91 CAL_idle_high_rpm_transient_air_comp CAL_idle_ign_control_entry_offset CAL_idle_ign_control_exit_offset CAL_idle_learn_ac_on_param CAL_idle_learn_coolant_min CAL_idle_learn_integral_max CAL_idle_learn_integral_min CAL_idle_learn_temp_range CAL_idle_low_car_speed_enter CAL_idle_low_car_speed_exit CAL_idle_monitor_voltage_operating_range CAL_idle_rpm_ramp_step CAL_idle_rpm_ramp_step_ips CAL_idle_sensor_fault_coolant_temp CAL_idle_sensor_fault_coolant_temp_4000D382 CAL_idle_target_ips_ingear_sport CAL_idle_target_ips_ingear_sport_X_coolant_temp CAL_idle_target_ips_ingear_tour CAL_idle_target_ips_ingear_tour_X_coolant_temp CAL_idle_target_ips_neutral_sport CAL_idle_target_ips_neutral_sport_X_coolant_temp CAL_idle_target_ips_neutral_tour CAL_idle_target_ips_neutral_tour_X_coolant_temp CAL_idle_target_manual_sport CAL_idle_target_manual_sport_X_coolant_temp CAL_idle_target_manual_tour CAL_idle_target_manual_tour_X_coolant_temp CAL_idle_tps_from_air_demand CAL_idle_tps_from_air_demand_X_idle_air CAL_idle_tps_from_air_demand_Y_vacuum CAL_idle_tps_max CAL_idle_underspeed_latch_rpm_delta CAL_idle_unknown10 CAL_idle_unknown2 CAL_idle_unknown3 /end REF_CHARACTERISTIC
/end GROUP
/begin GROUP G_Torque "Torque and limits" ROOT
 /begin SUB_GROUP G_Torque_overrev G_Torque_racetc G_Torque_revlimit G_Torque_torque G_Torque_wheel /end SUB_GROUP
/end GROUP
/begin GROUP G_Torque_overrev "overrev"
 /begin REF_CHARACTERISTIC CAL_overrev_advisory_coolant_max CAL_overrev_advisory_limit CAL_overrev_advisory_limit_X_mass_air CAL_overrev_advisory_margin_scale /end REF_CHARACTERISTIC
/end GROUP
/begin GROUP G_Torque_racetc "racetc"
 /begin REF_CHARACTERISTIC CAL_racetc_slip_target_base CAL_racetc_slip_target_base_X_dpm_level /end REF_CHARACTERISTIC
/end GROUP
/begin GROUP G_Torque_revlimit "revlimit"
 /begin REF_CHARACTERISTIC CAL_revlimit_bounce_count_threshold CAL_revlimit_d_flow_gain CAL_revlimit_d_flow_gain_X_gear CAL_revlimit_enforce_delay_after_start CAL_revlimit_escalation_integrator_step CAL_revlimit_escalation_integrator_step_X_gear CAL_revlimit_exit_margin CAL_revlimit_flow_correction_i_limit CAL_revlimit_flow_correction_p_limit CAL_revlimit_flow_integral_limit CAL_revlimit_flow_slew_step CAL_revlimit_hard_hysteresis CAL_revlimit_i_flow_gain CAL_revlimit_i_flow_gain_X_gear CAL_revlimit_limp_mode_rpm_reduction CAL_revlimit_maf_error_max CAL_revlimit_maf_max_by_gear CAL_revlimit_maf_max_by_gear_X_gear CAL_revlimit_max_with_speedlimit CAL_revlimit_offset_reset_timer CAL_revlimit_p_flow_gain CAL_revlimit_p_flow_gain_X_gear CAL_revlimit_rpm_integral_limit CAL_revlimit_speed_base_auto_gearbox_sport CAL_revlimit_speed_base_auto_gearbox_sport_X_coolant CAL_revlimit_speed_base_auto_gearbox_sport_Y_timer CAL_revlimit_speed_base_auto_gearbox_tour CAL_revlimit_speed_base_auto_gearbox_tour_X_coolant CAL_revlimit_speed_base_auto_gearbox_tour_Y_timer CAL_revlimit_speed_base_manual_gearbox_sport CAL_revlimit_speed_base_manual_gearbox_sport_X_coolant CAL_revlimit_speed_base_manual_gearbox_sport_Y_timer CAL_revlimit_speed_base_manual_gearbox_tour CAL_revlimit_speed_base_manual_gearbox_tour_X_coolant CAL_revlimit_speed_base_manual_gearbox_tour_Y_timer CAL_revlimit_startup_offset_decrement CAL_revlimit_time_above_soft_threshold CAL_revlimit_tps_cut_enable CAL_revlimit_trim_per_gear CAL_revlimit_trim_per_gear_X_gear /end REF_CHARACTERISTIC
/end GROUP
/begin GROUP G_Torque_torque "torque"
 /begin REF_CHARACTERISTIC CAL_torque_engine_ac_load_base CAL_torque_engine_ac_load_base_X_ac CAL_torque_engine_ac_load_scaler CAL_torque_engine_ac_load_scaler_X_rpm CAL_torque_engine_friction_speed_component CAL_torque_engine_friction_speed_component_X_rpm CAL_torque_engine_friction_speed_component_Y_load CAL_torque_engine_friction_temp_component CAL_torque_engine_friction_temp_component_X_coolant_temp CAL_torque_engine_friction_temp_component_Y_load CAL_torque_estimate_min_ips CAL_torque_ext_torque_limit_hold_count CAL_torque_external_request_minimum CAL_torque_external_request_minimum_X_engine_speed CAL_torque_external_request_minimum_Y_torque CAL_torque_hysteresis_threshold1 CAL_torque_ign_retard_base CAL_torque_ign_retard_base_X_engine_speed CAL_torque_ign_retard_base_Y_torque_reduction_factor CAL_torque_limit_base_factor CAL_torque_limit_base_factor_X_rpm CAL_torque_limit_base_factor_Y_load CAL_torque_limit_low_speed_min_torque CAL_torque_limit_low_speed_rpm_threshold CAL_torque_load_to_torque CAL_torque_load_to_torque_X_engine_speed CAL_torque_load_to_torque_Y_load CAL_torque_spark_efficiency CAL_torque_spark_efficiency_X_rpm CAL_torque_spark_efficiency_Y_ign_retard_from_mbt CAL_torque_spark_efficiency_slope CAL_torque_spark_efficiency_slope_X_rpm CAL_torque_spark_efficiency_slope_Y_load CAL_torque_torque_to_load CAL_torque_torque_to_load_X_engine_speed CAL_torque_torque_to_load_Y_torque CAL_torque_tps_gain /end REF_CHARACTERISTIC
/end GROUP
/begin GROUP G_Torque_wheel "wheel"
 /begin REF_CHARACTERISTIC CAL_wheel_speed_front_accel_update_interval CAL_wheel_speed_front_dvdt_scaling CAL_wheel_speed_smoothing CAL_wheel_speed_vss_pulses_per_rev CAL_wheel_speed_vss_tire_circumference /end REF_CHARACTERISTIC
/end GROUP
/begin GROUP G_Vvt "Variable valve timing" ROOT
 /begin REF_CHARACTERISTIC CAL_vvt_cam_park_offset_max CAL_vvt_exhaust_advance_base CAL_vvt_exhaust_advance_base_X_rpm CAL_vvt_exhaust_advance_base_Y_load CAL_vvt_exhaust_advance_base_low_load CAL_vvt_exhaust_advance_base_low_load_X_rpm CAL_vvt_exhaust_advance_base_low_load_Y_load CAL_vvt_exhaust_advance_coolant_offset CAL_vvt_exhaust_advance_coolant_offset_X_coolant_temp CAL_vvt_intake_advance_base CAL_vvt_intake_advance_base_X_rpm CAL_vvt_intake_advance_base_Y_load CAL_vvt_intake_advance_base_low_load CAL_vvt_intake_advance_base_low_load_X_rpm CAL_vvt_intake_advance_base_low_load_Y_load CAL_vvt_intake_advance_coolant_offset CAL_vvt_intake_advance_coolant_offset_X_coolant_temp CAL_vvt_integral_gain CAL_vvt_low_load_disable CAL_vvt_low_load_ips_enable CAL_vvt_low_load_map_enable_temp CAL_vvt_p_gain CAL_vvt_pwm_driver_divisor CAL_vvt_start_timer CAL_vvt_start_timer_X_coolant_temp CAL_vvt_zero_target_timeout /end REF_CHARACTERISTIC
/end GROUP
/begin GROUP G_Cooling "Cooling and temperatures" ROOT
 /begin SUB_GROUP G_Cooling_coolant G_Cooling_cooling G_Cooling_engine G_Cooling_oil G_Cooling_temp /end SUB_GROUP
/end GROUP
/begin GROUP G_Cooling_coolant "coolant"
 /begin REF_CHARACTERISTIC CAL_coolant_temp_limit CAL_coolant_temp_limit_0 CAL_coolant_temp_limit_1 CAL_coolant_temp_limit_2 CAL_coolant_temp_threshold CAL_coolant_temp_threshold_1 CAL_coolant_temp_threshold_2 /end REF_CHARACTERISTIC
/end GROUP
/begin GROUP G_Cooling_cooling "cooling"
 /begin REF_CHARACTERISTIC CAL_cooling_afterrun_fan_timer_unknown CAL_cooling_fan_1_afterrun_timer CAL_cooling_fan_2_after_run_counter_threshold CAL_cooling_fan_afterrun CAL_cooling_fan_afterrun_X_air_temp CAL_cooling_fan_afterrun_Y_coolant_temp CAL_cooling_fan_air_temp_threshold CAL_cooling_fan_bay_afterrun_heatsoak_duration CAL_cooling_fan_bay_afterrun_heatsoak_window CAL_cooling_fan_bay_afterrun_shutdown_duration CAL_cooling_fan_bay_idle_stationary_dwell CAL_cooling_fan_bay_idle_temp_low CAL_cooling_fan_bay_off_temp_2min CAL_cooling_fan_bay_off_temp_3min CAL_cooling_fan_bay_restart_inhibit CAL_cooling_fan_carspeed_min CAL_cooling_fan_carspeed_min_1 CAL_cooling_fan_coolant_fall_check_period CAL_cooling_fan_coolant_fall_threshold CAL_cooling_fan_coolant_fall_window CAL_cooling_fan_coolant_temp_threshold CAL_cooling_fan_disable_carspeed CAL_cooling_fan_engine_bay_aux_afterrun_timer CAL_cooling_fan_engine_bay_run_duration CAL_cooling_fan_high_iat CAL_cooling_fan_high_off_coolant CAL_cooling_fan_high_off_coolant_with_ac CAL_cooling_fan_high_off_min_time CAL_cooling_fan_high_on_coolant CAL_cooling_fan_high_on_coolant_with_ac CAL_cooling_fan_iat_low CAL_cooling_fan_iat_mid CAL_cooling_fan_iat_mid_timer_threshold CAL_cooling_fan_low_off_engine_off CAL_cooling_fan_low_off_engine_on CAL_cooling_fan_low_on_engine_off CAL_cooling_fan_low_on_engine_on CAL_cooling_fan_low_rpm_hysteresis_threshold CAL_cooling_fan_rpm_inhibit_off CAL_cooling_fan_rpm_inhibit_on CAL_cooling_fan_start_inhibit_time CAL_cooling_recirc_airtemp_disable_engine_on CAL_cooling_recirc_pump_enable_temp CAL_cooling_recirc_pump_rpm_max_disable CAL_cooling_recirc_pump_rpm_max_enable CAL_cooling_recirc_pump_run_ambient_max CAL_cooling_recirc_pump_run_ambient_min CAL_cooling_recirc_pump_run_time_sec CAL_cooling_recirc_pump_stopped_dwell CAL_cooling_recirc_rpm_enable_engine_on /end REF_CHARACTERISTIC
/end GROUP
/begin GROUP G_Cooling_engine "engine"
 /begin REF_CHARACTERISTIC CAL_engine_accel_lookback_teeth CAL_engine_speed_3_limit CAL_engine_speed_3_limit_0 CAL_engine_speed_3_threshold CAL_engine_speed_3_threshold_0 CAL_engine_speed_3_threshold_2 CAL_engine_speed_3_threshold_3 CAL_engine_speed_3_threshold_4 CAL_engine_speed_avg_samples CAL_engine_speed_calc_unknown2 CAL_engine_speed_coolant_temp_unknown7 CAL_engine_speed_filter_coeff_by_coolant CAL_engine_speed_filter_coeff_by_coolant_X_coolant CAL_engine_speed_filter_rise_coeff_sport CAL_engine_speed_filter_rise_coeff_sport_X_rpm CAL_engine_speed_filter_rise_coeff_sport_Y_coolant_temp CAL_engine_speed_filter_rise_coeff_tour CAL_engine_speed_filter_rise_coeff_tour_X_rpm CAL_engine_speed_filter_rise_coeff_tour_Y_coolant_temp /end REF_CHARACTERISTIC
/end GROUP
/begin GROUP G_Cooling_oil "oil"
 /begin REF_CHARACTERISTIC CAL_oil_pressure_switch_offset CAL_oil_pressure_switch_voltage_scaling /end REF_CHARACTERISTIC
/end GROUP
/begin GROUP G_Cooling_temp "temp"
 /begin REF_CHARACTERISTIC CAL_temp_engine_air_threshold CAL_temp_engine_air_threshold_0 /end REF_CHARACTERISTIC
/end GROUP
/begin GROUP G_Emissions "Emissions and evaporative" ROOT
 /begin SUB_GROUP G_Emissions_cat G_Emissions_evap G_Emissions_exhaust G_Emissions_misfire /end SUB_GROUP
/end GROUP
/begin GROUP G_Emissions_cat "cat" /begin REF_CHARACTERISTIC CAL_cat_check_unknown4 /end REF_CHARACTERISTIC /end GROUP
/begin GROUP G_Emissions_evap "evap"
 /begin REF_CHARACTERISTIC CAL_evap_canister_purge_solenoid_timer_init CAL_evap_commanded_purge_unknown CAL_evap_fuel_level_threshold_mid CAL_evap_fuel_used_window_level_high CAL_evap_fuel_used_window_level_low CAL_evap_fuel_used_window_level_mid CAL_evap_leak_test_baro_min CAL_evap_leak_test_force_enable CAL_evap_leak_test_fuel_level_max CAL_evap_leak_test_fuel_level_min CAL_evap_leak_test_pre_start_delay CAL_evap_leak_test_purge_settle_delay CAL_evap_leak_test_sample_count CAL_evap_leak_test_settle_samples CAL_evap_leak_test_stage4_dwell CAL_evap_leak_vacuum_decay_sample CAL_evap_pressure_deviation_max CAL_evap_pressure_filter_coeff CAL_evap_purge_conditioning_timer_100ms CAL_evap_purge_duty_ramp_down_conditioning CAL_evap_purge_duty_ramp_up_min CAL_evap_purge_filter_alpha CAL_evap_purge_flow_X_vacuum CAL_evap_purge_flow_max_duty CAL_evap_purge_flow_state_timer_init CAL_evap_purge_flow_vacuum_min CAL_evap_purge_flow_vapor_min CAL_evap_purge_flow_vapor_min_leaktest CAL_evap_purge_idle_duty_max CAL_evap_purge_idle_lean_recovery_holdoff_ticks CAL_evap_purge_idle_speed_error_deadband CAL_evap_purge_idle_speed_error_deadband_alt CAL_evap_purge_mass_ratio_stft_inhibit_threshold CAL_evap_purge_min_inj_pulse_enter CAL_evap_purge_min_inj_pulse_exit CAL_evap_purge_min_load CAL_evap_purge_min_load_active CAL_evap_purge_power_enrich_suspend_hold CAL_evap_purge_power_enrich_suspend_timeout CAL_evap_purge_pressure_voltage_threshold CAL_evap_purge_pressure_voltage_threshold_0 CAL_evap_purge_pwm_freq CAL_evap_purge_stuck_open_test_passes CAL_evap_purge_vacuum_min CAL_evap_state_timer_threshold CAL_evap_system_state_flags_param CAL_evap_tank_vacuum_flow_threshold CAL_evap_unknown2 CAL_evap_vacuum_threshold CAL_evap_vapor_conc_max_for_fuel_learn /end REF_CHARACTERISTIC
/end GROUP
/begin GROUP G_Emissions_exhaust "exhaust"
 /begin REF_CHARACTERISTIC CAL_exhaust_flap_load1 CAL_exhaust_flap_load2 CAL_exhaust_flap_position_tour CAL_exhaust_flap_position_tour_X_rpm CAL_exhaust_flap_position_tour_Y_accel_pps CAL_exhaust_flap_position_tour_sport CAL_exhaust_flap_position_tour_sport_X_rpm CAL_exhaust_flap_position_tour_sport_Y_accel_pps CAL_exhaust_flap_rpm1 CAL_exhaust_flap_rpm2 CAL_exhaust_flap_startup_delay /end REF_CHARACTERISTIC
/end GROUP
/begin GROUP G_Emissions_misfire "misfire"
 /begin REF_CHARACTERISTIC CAL_misfire_base_threshold_ips CAL_misfire_base_threshold_ips_X_rpm CAL_misfire_base_threshold_ips_Y_load CAL_misfire_base_threshold_manual CAL_misfire_base_threshold_manual_X_rpm CAL_misfire_base_threshold_manual_Y_load CAL_misfire_cat_damage_limit CAL_misfire_cat_damage_limit_X_rpm CAL_misfire_cat_damage_limit_Y_load CAL_misfire_comp_maf_ips CAL_misfire_comp_maf_ips_X_coolant_temp CAL_misfire_comp_maf_ips_Y_maf_accum CAL_misfire_comp_maf_manual CAL_misfire_comp_maf_manual_X_coolant_temp CAL_misfire_comp_maf_manual_Y_maf_accum CAL_misfire_detect_min_load_ips CAL_misfire_detect_min_load_manual CAL_misfire_emissions_limit CAL_misfire_enable_conditions_hold CAL_misfire_enable_coolant_max CAL_misfire_enable_coolant_min CAL_misfire_enable_rpm_max CAL_misfire_enable_rpm_min CAL_misfire_failed_bank_scaling CAL_misfire_inhibit_tps_rate_declutched CAL_misfire_inhibit_tps_rate_hold CAL_misfire_inhibit_tps_rate_neg CAL_misfire_inhibit_tps_rate_pos CAL_misfire_per_cyl_learn_enable CAL_misfire_rough_road_deviation_threshold CAL_misfire_rough_road_hold CAL_misfire_rough_road_speed_min CAL_misfire_sensitivity_ips CAL_misfire_sensitivity_ips_X_rpm CAL_misfire_sensitivity_ips_Y_load CAL_misfire_sensitivity_manual CAL_misfire_sensitivity_manual_X_rpm CAL_misfire_sensitivity_manual_Y_load /end REF_CHARACTERISTIC
/end GROUP
/end MODULE
/end PROJECT
