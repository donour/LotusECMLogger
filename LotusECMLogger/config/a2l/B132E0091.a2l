ASAP2_VERSION 1 61
/begin PROJECT B132E0091 "Lotus T6 B132E0091"
/begin HEADER "" VERSION "generated v1" /end HEADER
/begin MODULE B132E0091 ""
/begin MOD_COMMON "" BYTE_ORDER MSB_FIRST ALIGNMENT_BYTE 1 ALIGNMENT_WORD 2 ALIGNMENT_LONG 4 /end MOD_COMMON
/begin RECORD_LAYOUT RL_VALUE_UBYTE FNC_VALUES 1 UBYTE ROW_DIR DIRECT /end RECORD_LAYOUT
/begin RECORD_LAYOUT RL_AXIS_UBYTE AXIS_PTS_X 1 UBYTE INDEX_INCR DIRECT /end RECORD_LAYOUT
/begin RECORD_LAYOUT RL_VALUE_UWORD FNC_VALUES 1 UWORD ROW_DIR DIRECT /end RECORD_LAYOUT
/begin RECORD_LAYOUT RL_AXIS_UWORD AXIS_PTS_X 1 UWORD INDEX_INCR DIRECT /end RECORD_LAYOUT
/begin RECORD_LAYOUT RL_VALUE_SWORD FNC_VALUES 1 SWORD ROW_DIR DIRECT /end RECORD_LAYOUT
/begin RECORD_LAYOUT RL_VALUE_ULONG FNC_VALUES 1 ULONG ROW_DIR DIRECT /end RECORD_LAYOUT
/begin COMPU_METHOD CM_i16_pressure_1_10mbar "i16_pressure_1/10mbar" RAT_FUNC "%9.1" "mbar" COEFFS 0 1 0 0 0 0.1 /end COMPU_METHOD
/begin COMPU_METHOD CM_i16_pressure_mbar "i16_pressure_mbar" RAT_FUNC "%8.0" "mbar" COEFFS 0 1 0 0 0 1 /end COMPU_METHOD
/begin COMPU_METHOD CM_u16_angle_1_10deg "u16_angle_1/10deg" RAT_FUNC "%9.1" "deg" COEFFS 0 1 0 0 0 0.1 /end COMPU_METHOD
/begin COMPU_METHOD CM_u16_factor_1_1000 "u16_factor_1/1000" RAT_FUNC "%9.1" "%" COEFFS 0 1 0 0 0 0.1 /end COMPU_METHOD
/begin COMPU_METHOD CM_u16_factor_1_1023 "u16_factor_1/1023" RAT_FUNC "%12.4" "%" COEFFS 0 1 0 0 0 0.0977517106549365 /end COMPU_METHOD
/begin COMPU_METHOD CM_u16_flow_10mg_s "u16_flow_10mg/s" RAT_FUNC "%8.0" "mg/s" COEFFS 0 1 0 0 0 10 /end COMPU_METHOD
/begin COMPU_METHOD CM_u16_load_mg_stroke "u16_load_mg/stroke" RAT_FUNC "%8.0" "mg/stroke" COEFFS 0 1 0 0 0 1 /end COMPU_METHOD
/begin COMPU_METHOD CM_u16_mass_g "u16_mass_g" RAT_FUNC "%8.0" "g" COEFFS 0 1 0 0 0 1 /end COMPU_METHOD
/begin COMPU_METHOD CM_u16_rspeed_1_4rpm "u16_rspeed_1/4rpm" RAT_FUNC "%10.2" "rpm" COEFFS 0 1 0 0 0 0.25 /end COMPU_METHOD
/begin COMPU_METHOD CM_u16_voltage_5_1023v "u16_voltage_5/1023v" RAT_FUNC "%12.4" "V" COEFFS 0 1 0 0 0 0.00488758553274682 /end COMPU_METHOD
/begin COMPU_METHOD CM_u8_accel_1_100g "u8_accel_1/100g" RAT_FUNC "%10.2" "g" COEFFS 0 1 0 0 0 0.01 /end COMPU_METHOD
/begin COMPU_METHOD CM_u8_afr_1_100 "u8_afr_1/100" RAT_FUNC "%10.2" "AFR" COEFFS 0 1 0 0 0 0.01 /end COMPU_METHOD
/begin COMPU_METHOD CM_u8_angle_1_4deg "u8_angle_1/4deg" RAT_FUNC "%10.2" "deg" COEFFS 0 1 0 0 0 0.25 /end COMPU_METHOD
/begin COMPU_METHOD CM_u8_factor_1 "u8_factor_1" RAT_FUNC "%8.0" "%" COEFFS 0 1 0 0 0 100 /end COMPU_METHOD
/begin COMPU_METHOD CM_u8_factor_1_10 "u8_factor_1/10" RAT_FUNC "%8.0" "%" COEFFS 0 1 0 0 0 10 /end COMPU_METHOD
/begin COMPU_METHOD CM_u8_factor_1_100 "u8_factor_1/100" RAT_FUNC "%8.0" "%" COEFFS 0 1 0 0 0 1 /end COMPU_METHOD
/begin COMPU_METHOD CM_u8_factor_1_255 "u8_factor_1/255" RAT_FUNC "%12.4" "%" COEFFS 0 1 0 0 0 0.392156862745098 /end COMPU_METHOD
/begin COMPU_METHOD CM_u8_factor_1_256 "u8_factor_1/256" RAT_FUNC "%12.4" "%" COEFFS 0 1 0 0 0 0.390625 /end COMPU_METHOD
/begin COMPU_METHOD CM_u8_flow_100mg_s "u8_flow_100mg/s" RAT_FUNC "%8.0" "mg/s" COEFFS 0 1 0 0 0 100 /end COMPU_METHOD
/begin COMPU_METHOD CM_u8_flow_200mg_s "u8_flow_200mg/s" RAT_FUNC "%8.0" "mg/s" COEFFS 0 1 0 0 0 200 /end COMPU_METHOD
/begin COMPU_METHOD CM_u8_flow_2g_s "u8_flow_2g/s" RAT_FUNC "%8.0" "g/s" COEFFS 0 1 0 0 0 2 /end COMPU_METHOD
/begin COMPU_METHOD CM_u8_flow_500mg_s "u8_flow_500mg/s" RAT_FUNC "%8.0" "mg/s" COEFFS 0 1 0 0 0 500 /end COMPU_METHOD
/begin COMPU_METHOD CM_u8_flow_g_s "u8_flow_g/s" RAT_FUNC "%8.0" "g/s" COEFFS 0 1 0 0 0 1 /end COMPU_METHOD
/begin COMPU_METHOD CM_u8_load_4mg_stroke "u8_load_4mg/stroke" RAT_FUNC "%8.0" "mg/stroke" COEFFS 0 1 0 0 0 4 /end COMPU_METHOD
/begin COMPU_METHOD CM_u8_mass_5g "u8_mass_5g" RAT_FUNC "%8.0" "g" COEFFS 0 1 0 0 0 5 /end COMPU_METHOD
/begin COMPU_METHOD CM_u8_pressure_4mbar "u8_pressure_4mbar" RAT_FUNC "%8.0" "mbar" COEFFS 0 1 0 0 0 4 /end COMPU_METHOD
/begin COMPU_METHOD CM_u8_rspeed_125_4_500rpm "u8_rspeed_125/4+500rpm" RAT_FUNC "%10.2" "rpm" COEFFS 0 1 -500 0 0 31.25 /end COMPU_METHOD
/begin COMPU_METHOD CM_u8_rspeed_2rpm "u8_rspeed_2rpm" RAT_FUNC "%8.0" "rpm" COEFFS 0 1 0 0 0 2 /end COMPU_METHOD
/begin COMPU_METHOD CM_u8_rspeed_4_500rpm "u8_rspeed_4+500rpm" RAT_FUNC "%8.0" "rpm" COEFFS 0 1 -500 0 0 4 /end COMPU_METHOD
/begin COMPU_METHOD CM_u8_rspeed_4rpm "u8_rspeed_4rpm" RAT_FUNC "%8.0" "rpm" COEFFS 0 1 0 0 0 4 /end COMPU_METHOD
/begin COMPU_METHOD CM_u8_rspeed_50rpm "u8_rspeed_50rpm" RAT_FUNC "%8.0" "rpm" COEFFS 0 1 0 0 0 50 /end COMPU_METHOD
/begin COMPU_METHOD CM_u8_rspeed_8rpm "u8_rspeed_8rpm" RAT_FUNC "%8.0" "rpm" COEFFS 0 1 0 0 0 8 /end COMPU_METHOD
/begin COMPU_METHOD CM_u8_rspeed_rpm "u8_rspeed_rpm" RAT_FUNC "%8.0" "rpm" COEFFS 0 1 0 0 0 1 /end COMPU_METHOD
/begin COMPU_METHOD CM_u8_speed_1_100kph "u8_speed_1/100kph" RAT_FUNC "%10.2" "km/h" COEFFS 0 1 0 0 0 0.01 /end COMPU_METHOD
/begin COMPU_METHOD CM_u8_speed_1_10kph "u8_speed_1/10kph" RAT_FUNC "%9.1" "km/h" COEFFS 0 1 0 0 0 0.1 /end COMPU_METHOD
/begin COMPU_METHOD CM_u8_speed_kph "u8_speed_kph" RAT_FUNC "%8.0" "km/h" COEFFS 0 1 0 0 0 1 /end COMPU_METHOD
/begin COMPU_METHOD CM_u8_temp_1_10C "u8_temp_1/10C" RAT_FUNC "%9.1" "°C" COEFFS 0 1 0 0 0 0.1 /end COMPU_METHOD
/begin COMPU_METHOD CM_u8_temp_5_8_40c "u8_temp_5/8-40c" RAT_FUNC "%11.3" "°C" COEFFS 0 1 40 0 0 0.625 /end COMPU_METHOD
/begin COMPU_METHOD CM_u8_tempdelta_5_8c "u8_tempdelta_5/8c" RAT_FUNC "%11.3" "°C" COEFFS 0 1 0 0 0 0.625 /end COMPU_METHOD
/begin COMPU_METHOD CM_u8_time_100ms "u8_time_100ms" RAT_FUNC "%8.0" "ms" COEFFS 0 1 0 0 0 100 /end COMPU_METHOD
/begin COMPU_METHOD CM_u8_time_10ms "u8_time_10ms" RAT_FUNC "%8.0" "ms" COEFFS 0 1 0 0 0 10 /end COMPU_METHOD
/begin COMPU_METHOD CM_u8_time_10us "u8_time_10us" RAT_FUNC "%8.0" "us" COEFFS 0 1 0 0 0 10 /end COMPU_METHOD
/begin COMPU_METHOD CM_u8_time_25ms "u8_time_25ms" RAT_FUNC "%8.0" "ms" COEFFS 0 1 0 0 0 25 /end COMPU_METHOD
/begin COMPU_METHOD CM_u8_time_50ms "u8_time_50ms" RAT_FUNC "%8.0" "ms" COEFFS 0 1 0 0 0 50 /end COMPU_METHOD
/begin COMPU_METHOD CM_u8_time_5ms "u8_time_5ms" RAT_FUNC "%8.0" "ms" COEFFS 0 1 0 0 0 5 /end COMPU_METHOD
/begin COMPU_METHOD CM_u8_time_ms "u8_time_ms" RAT_FUNC "%8.0" "ms" COEFFS 0 1 0 0 0 1 /end COMPU_METHOD
/begin COMPU_METHOD CM_u8_time_s "u8_time_s" RAT_FUNC "%8.0" "s" COEFFS 0 1 0 0 0 1 /end COMPU_METHOD
/begin COMPU_METHOD CM_u8_torque_2nm "u8_torque_2nm" RAT_FUNC "%8.0" "Nm" COEFFS 0 1 0 0 0 2 /end COMPU_METHOD
/begin COMPU_METHOD CM_u8_torque_nm "u8_torque_nm" RAT_FUNC "%8.0" "Nm" COEFFS 0 1 0 0 0 1 /end COMPU_METHOD
/begin COMPU_METHOD CM_u8_volume_1_10gallon "u8_volume_1/10gallon" RAT_FUNC "%9.1" "gallon" COEFFS 0 1 0 0 0 0.1 /end COMPU_METHOD
/begin COMPU_METHOD CM_u8_volume_liter "u8_volume_liter" RAT_FUNC "%8.0" "liter" COEFFS 0 1 0 0 0 1 /end COMPU_METHOD
/begin CHARACTERISTIC CAL_ips_request_msg_id_nibble "4-bit nibble; IPS CAN request message ID = `(nibble << 4)" VALUE 0x40008E4B RL_VALUE_UBYTE 0 NO_COMPU_METHOD 0 255 /end CHARACTERISTIC
/begin CHARACTERISTIC CAL_obd_ii_countdown_unknown "uint8_t" VALUE 0x40008E69 RL_VALUE_UBYTE 0 NO_COMPU_METHOD 0 255 /end CHARACTERISTIC
/begin CHARACTERISTIC CAL_ac_inhibit_coolant "Calibration: A/C inhibit coolant. Tunable map/constant (not a live channel); log to see A/C clutch engagement and its load/idle impact. (deg C; raw*5/8-40)" VAL_BLK 0x40008E84 RL_VALUE_UBYTE 0 CM_u8_temp_5_8_40c -40 119.375 NUMBER 2 /end CHARACTERISTIC
/begin CHARACTERISTIC CAL_ac_inhibit_tps "Calibration: A/C inhibit throttle position. Tunable map/constant (not a live channel); log to see throttle/pedal demand and throttle response. (0-1; raw/255)" VAL_BLK 0x40008E86 RL_VALUE_UBYTE 0 CM_u8_factor_1_255 0 100 NUMBER 2 /end CHARACTERISTIC
/begin CHARACTERISTIC CAL_ac_ign_comp_delay "u8_time_100ms" VALUE 0x40008E88 RL_VALUE_UBYTE 0 CM_u8_time_100ms 0 25500 /end CHARACTERISTIC
/begin CHARACTERISTIC CAL_ac_inhibit_rpm_cutoff_min_hold "u8_time_50ms" VALUE 0x40008E96 RL_VALUE_UBYTE 0 CM_u8_time_50ms 0 12750 /end CHARACTERISTIC
/begin CHARACTERISTIC CAL_ac_inhibit_rpm "Calibration: A/C inhibit RPM. Tunable map/constant (not a live channel); log to see A/C clutch engagement and its load/idle impact. (RPM; raw*125/4+500)" VAL_BLK 0x40008E98 RL_VALUE_UBYTE 0 CM_u8_rspeed_125_4_500rpm 500 8468.75 NUMBER 2 /end CHARACTERISTIC
/begin CHARACTERISTIC CAL_ac_tps_inhibit_timer "Calibration: A/C throttle position inhibit timer. Tunable map/constant (not a live channel); log to see throttle/pedal demand and throttle response." VALUE 0x40008E9A RL_VALUE_UBYTE 0 NO_COMPU_METHOD 0 255 /end CHARACTERISTIC
/begin CHARACTERISTIC CAL_ac_shutdown_delay "uint8_t" VALUE 0x40008E9C RL_VALUE_UBYTE 0 NO_COMPU_METHOD 0 255 /end CHARACTERISTIC
/begin CHARACTERISTIC CAL_ac_fan_startup_hold_time "Calibration: A/C fan startup hold time. Tunable map/constant (not a live channel); log to see A/C clutch engagement and its load/idle impact. (s)" VALUE 0x40008EA5 RL_VALUE_UBYTE 0 CM_u8_time_s 0 255 /end CHARACTERISTIC
/begin CHARACTERISTIC CAL_obd_ii_readiness_bit3_enable "uint8_t" VALUE 0x40008EA6 RL_VALUE_UBYTE 0 NO_COMPU_METHOD 0 255 /end CHARACTERISTIC
/begin CHARACTERISTIC CAL_ac_inhibit_carspeed2 "Calibration: A/C inhibit carspeed2. Tunable map/constant (not a live channel); log to see A/C clutch engagement and its load/idle impact. (km/h)" VAL_BLK 0x40008EAC RL_VALUE_UBYTE 0 CM_u8_speed_kph 0 255 NUMBER 2 /end CHARACTERISTIC
/begin CHARACTERISTIC CAL_obd_ii_idle_air_output_limit "u8_flow_100mg/s" VALUE 0x40008ECF RL_VALUE_UBYTE 0 CM_u8_flow_100mg_s 0 25500 /end CHARACTERISTIC
/begin CHARACTERISTIC CAL_obd_ii_idle_air_output_threshold "u8_flow_100mg/s" VALUE 0x40008ED0 RL_VALUE_UBYTE 0 CM_u8_flow_100mg_s 0 25500 /end CHARACTERISTIC
/begin CHARACTERISTIC CAL_ac_inhibit_evap_temp "Calibration: A/C inhibit EVAP temperature. Tunable map/constant (not a live channel); log to see A/C clutch engagement and its load/idle impact." VAL_BLK 0x40008ED7 RL_VALUE_UBYTE 0 CM_u8_temp_1_10C 0 25.5 NUMBER 2 /end CHARACTERISTIC
/begin CHARACTERISTIC CAL_ac_evap_timer_ticks_5ms "uint8_t" VALUE 0x40008ED9 RL_VALUE_UBYTE 0 NO_COMPU_METHOD 0 255 /end CHARACTERISTIC
/begin CHARACTERISTIC CAL_ac_evap_timer_ticks_5ms2 "uint8_t" VALUE 0x40008EDA RL_VALUE_UBYTE 0 NO_COMPU_METHOD 0 255 /end CHARACTERISTIC
/begin CHARACTERISTIC CAL_ac_evap_pid_derivative_filter_alpha "u8_factor_1/256" VALUE 0x40008EDB RL_VALUE_UBYTE 0 CM_u8_factor_1_256 0 99.609375 /end CHARACTERISTIC
/begin CHARACTERISTIC CAL_cruise_override_coast_cancel_time "COAST held during pedal override for val*100 ms cancels cruise (reason 0x2000); stock 10 = 1 s" VALUE 0x40008EE6 RL_VALUE_UBYTE 0 NO_COMPU_METHOD 0 255 /end CHARACTERISTIC
/begin CHARACTERISTIC CAL_ac_evap_freeze_inhibit_delay "uint8_t" VALUE 0x40008EE8 RL_VALUE_UBYTE 0 NO_COMPU_METHOD 0 255 /end CHARACTERISTIC
/begin CHARACTERISTIC CAL_ac_evap_temp_trend_period2 "u8_time_5ms" VALUE 0x40008EE9 RL_VALUE_UBYTE 0 CM_u8_time_5ms 0 1275 /end CHARACTERISTIC
/begin CHARACTERISTIC CAL_ac_load_ramp_steps "u8_count" VALUE 0x40008EEE RL_VALUE_UBYTE 0 NO_COMPU_METHOD 0 255 /end CHARACTERISTIC
/begin CHARACTERISTIC CAL_ac_evap_target_temp "Calibration: A/C EVAP target temperature. Tunable map/constant (not a live channel); log to see A/C clutch engagement and its load/idle impact. (deg C; raw/10)" VALUE 0x40008EEF RL_VALUE_UBYTE 0 CM_u8_temp_1_10C 0 25.5 /end CHARACTERISTIC
/begin CHARACTERISTIC CAL_ac_evap_pid_kd "uint8_t" VALUE 0x40008EF0 RL_VALUE_UBYTE 0 NO_COMPU_METHOD 0 255 /end CHARACTERISTIC
/begin CHARACTERISTIC CAL_ac_evap_pid_ki_warm "uint8_t" VALUE 0x40008EF1 RL_VALUE_UBYTE 0 NO_COMPU_METHOD 0 255 /end CHARACTERISTIC
/begin CHARACTERISTIC CAL_ac_evap_pid_integrator_limit "uint8_t" VALUE 0x40008EF2 RL_VALUE_UBYTE 0 NO_COMPU_METHOD 0 255 /end CHARACTERISTIC
/begin CHARACTERISTIC CAL_ac_output_pwm_freq "uint8_t" VALUE 0x40008EF3 RL_VALUE_UBYTE 0 NO_COMPU_METHOD 0 255 /end CHARACTERISTIC
/begin CHARACTERISTIC CAL_ac_pwm_dc_divisor "Calibration: A/C pwm dc divisor. Tunable map/constant (not a live channel); log to see A/C clutch engagement and its load/idle impact." VALUE 0x40008EF4 RL_VALUE_UWORD 0 NO_COMPU_METHOD 0 65535 /end CHARACTERISTIC
/begin CHARACTERISTIC CAL_ac_unused_40008ef6 "undefined" VALUE 0x40008EF6 RL_VALUE_ULONG 0 NO_COMPU_METHOD 0 4294967295 /end CHARACTERISTIC
/begin CHARACTERISTIC CAL_ac_compressor_soft_engage_time "Calibration: A/C compressor soft engage time. Tunable map/constant (not a live channel); log to see A/C clutch engagement and its load/idle impact." VALUE 0x40008EF7 RL_VALUE_UBYTE 0 NO_COMPU_METHOD 0 255 /end CHARACTERISTIC
/begin CHARACTERISTIC CAL_ac_unknown3 "uint8_t" VALUE 0x40008EF9 RL_VALUE_UBYTE 0 NO_COMPU_METHOD 0 255 /end CHARACTERISTIC
/begin CHARACTERISTIC CAL_obd_o2_tps_transient_threshold "u8_factor_1/1023" VALUE 0x40008EFE RL_VALUE_UBYTE 0 CM_u16_factor_1_1023 0 24.9266862170088 /end CHARACTERISTIC
/begin CHARACTERISTIC CAL_obd_o2_tps_transient_settle_ticks "u16_time_5ms" VALUE 0x40008F00 RL_VALUE_UWORD 0 CM_u8_time_5ms 0 327675 /end CHARACTERISTIC
/begin CHARACTERISTIC CAL_ac_compressor_power_offset "uint8_t" VALUE 0x40008F06 RL_VALUE_UBYTE 0 NO_COMPU_METHOD 0 255 /end CHARACTERISTIC
/begin CHARACTERISTIC CAL_ac_load_slew_up_period "u8_count" VALUE 0x40008F0C RL_VALUE_UBYTE 0 NO_COMPU_METHOD 0 255 /end CHARACTERISTIC
/begin CHARACTERISTIC CAL_ac_load_slew_down_period "u8_count" VALUE 0x40008F0D RL_VALUE_UBYTE 0 NO_COMPU_METHOD 0 255 /end CHARACTERISTIC
/begin CHARACTERISTIC CAL_ac_load_slew_up_step "uint8_t" VALUE 0x40008F10 RL_VALUE_UBYTE 0 NO_COMPU_METHOD 0 255 /end CHARACTERISTIC
/begin CHARACTERISTIC CAL_ac_load_slew_down_step "uint8_t" VALUE 0x40008F11 RL_VALUE_UBYTE 0 NO_COMPU_METHOD 0 255 /end CHARACTERISTIC
/begin CHARACTERISTIC CAL_ac_evap_pid_ki_cold "uint8_t" VALUE 0x40008F17 RL_VALUE_UBYTE 0 NO_COMPU_METHOD 0 255 /end CHARACTERISTIC
/begin CHARACTERISTIC CAL_ac_evap_pid_update_period_cold "u8_time_5ms" VALUE 0x40008F18 RL_VALUE_UBYTE 0 CM_u8_time_5ms 0 1275 /end CHARACTERISTIC
/begin CHARACTERISTIC CAL_ac_evap_pid_ki_cold_boost_delay "uint8_t" VALUE 0x40008F48 RL_VALUE_UBYTE 0 NO_COMPU_METHOD 0 255 /end CHARACTERISTIC
/begin CHARACTERISTIC CAL_ac_evap_pid_ki_cold_boost_factor "u8_factor_1/10" VALUE 0x40008F49 RL_VALUE_UBYTE 0 CM_u8_factor_1_10 0 2550 /end CHARACTERISTIC
/begin CHARACTERISTIC CAL_ac_inhibit_rpm_cutoff_on_delay "u8_time_50ms" VALUE 0x40008F56 RL_VALUE_UBYTE 0 CM_u8_time_50ms 0 12750 /end CHARACTERISTIC
/begin CHARACTERISTIC CAL_ac_inhibit_rpm_cutoff_min_hold_40008F57 "u8_time_50ms" VALUE 0x40008F57 RL_VALUE_UBYTE 0 CM_u8_time_50ms 0 12750 /end CHARACTERISTIC
/begin CHARACTERISTIC CAL_ac_inhibit_rpm_cutoff "Calibration: A/C inhibit RPM cutoff. Tunable map/constant (not a live channel); log to see A/C clutch engagement and its load/idle impact. (RPM; raw*125/4+500)" VAL_BLK 0x40008F7E RL_VALUE_UBYTE 0 CM_u8_rspeed_125_4_500rpm 500 8468.75 NUMBER 2 /end CHARACTERISTIC
/begin CHARACTERISTIC CAL_ac_startup_lockout_time "Calibration: A/C startup lockout time. Tunable map/constant (not a live channel); log to see A/C clutch engagement and its load/idle impact. (ms; raw*5)" VALUE 0x40008F80 RL_VALUE_UWORD 0 CM_u8_time_5ms 0 327675 /end CHARACTERISTIC
/begin CHARACTERISTIC CAL_obd_ii_o2_response_load_stability_max "uint8_t" VALUE 0x40008F9A RL_VALUE_UBYTE 0 NO_COMPU_METHOD 0 255 /end CHARACTERISTIC
/begin CHARACTERISTIC CAL_obd_ii_o2_response_alphaN_blackout "u8_time_5ms" VALUE 0x40008F9B RL_VALUE_UBYTE 0 CM_u8_time_5ms 0 1275 /end CHARACTERISTIC
/begin CHARACTERISTIC CAL_cruise_cancel_dfco_inhibit_time "after cruise cancel: timer = val*2 (200 Hz) = 10 ms/count, stock 110 = 1.1 s; status 0x20000 blocks DFCO entry. Was CAL_closedloop_stft_ramp_interval_manual" VALUE 0x40008F9D RL_VALUE_UBYTE 0 NO_COMPU_METHOD 0 255 /end CHARACTERISTIC
/begin CHARACTERISTIC CAL_cluster_shift_light_deadband_rpm "Calibration: cluster shift light deadband RPM. Tunable map/constant (not a live channel); log to check what the ECU sends the dash (gauges/warnings). (RPM)" VALUE 0x40008FAE RL_VALUE_UWORD 0 CM_u8_rspeed_rpm 0 65535 /end CHARACTERISTIC
/begin CHARACTERISTIC CAL_cruise_integrator_clamp "cruise_speed_error_integral limited to +/- val*250" VALUE 0x40008FBA RL_VALUE_UBYTE 0 NO_COMPU_METHOD 0 255 /end CHARACTERISTIC
/begin CHARACTERISTIC CAL_cruise_derivative_clamp "cruise_speed_error_rate limited to +/- val*25" VALUE 0x40008FBB RL_VALUE_UBYTE 0 NO_COMPU_METHOD 0 255 /end CHARACTERISTIC
/begin CHARACTERISTIC CAL_obd_ii_commanded_evap_purge_max "uint8_t" VALUE 0x40008FD2 RL_VALUE_UBYTE 0 NO_COMPU_METHOD 0 255 /end CHARACTERISTIC
/begin CHARACTERISTIC CAL_obd_ii_commanded_evap_purge_min "uint8_t" VALUE 0x40008FD3 RL_VALUE_UBYTE 0 NO_COMPU_METHOD 0 255 /end CHARACTERISTIC
/begin CHARACTERISTIC CAL_cruise_airflow_fast_slew_time "after set/accel/coast hold: cruise_airflow_fast_slew_timer = val*5 (200 Hz) = 25 ms/count, stock 20 = 0.5 s; airflow rises at 2x slew step, falls unlimited" VALUE 0x40008FDD RL_VALUE_UBYTE 0 NO_COMPU_METHOD 0 255 /end CHARACTERISTIC
/begin CHARACTERISTIC CAL_cruise_proportional_term_limit "cruise P-term clamp: +/- val*100 in 10 mg/s = +/- val g/s airflow (stock 65); was CAL_cruise_speed_error_limit" VALUE 0x40008FDE RL_VALUE_UBYTE 0 NO_COMPU_METHOD 0 255 /end CHARACTERISTIC
/begin CHARACTERISTIC CAL_cruise_integral_term_limit "cruise I-term clamp: +/- val*100 in 10 mg/s = +/- val g/s airflow" VALUE 0x40008FDF RL_VALUE_UBYTE 0 NO_COMPU_METHOD 0 255 /end CHARACTERISTIC
/begin CHARACTERISTIC CAL_cruise_derivative_term_limit "cruise D-term clamp: +/- val*100 in 10 mg/s = +/- val g/s airflow (stock 50); was CAL_injtip_dfco_enable_rpm_manual_clutch_disengage" VALUE 0x40008FE0 RL_VALUE_UBYTE 0 NO_COMPU_METHOD 0 255 /end CHARACTERISTIC
/begin CHARACTERISTIC CAL_cruise_speed_limit "Calibration: cruise speed limit. Tunable map/constant (not a live channel); log to debug cruise engagement and speed holding. (km/h)" VAL_BLK 0x40009030 RL_VALUE_UBYTE 0 CM_u8_speed_kph 0 255 NUMBER 2 /end CHARACTERISTIC
/begin CHARACTERISTIC CAL_cruise_rpm_max_manual "projected rpm at target; engage val*50 rpm, cancel val*52 rpm (cruise_rpm_max_cancel_scale)" VALUE 0x40009032 RL_VALUE_UBYTE 0 CM_u8_rspeed_50rpm 0 12750 /end CHARACTERISTIC
/begin CHARACTERISTIC CAL_cruise_rpm_min_manual "engage val*50 rpm, cancel val*48 rpm (cruise_rpm_min_cancel_scale)" VALUE 0x40009033 RL_VALUE_UBYTE 0 CM_u8_rspeed_50rpm 0 12750 /end CHARACTERISTIC
/begin CHARACTERISTIC CAL_cruise_speed_error_max "abs(err) < val/2 = captured (0x80); after capture abs(err) > val cancels (reason 0x20). Was CAL_cruise_speed_deadband" VALUE 0x40009034 RL_VALUE_UBYTE 0 CM_u8_speed_kph 0 255 /end CHARACTERISTIC
/begin CHARACTERISTIC CAL_cruise_accel_hold_step "added to target every 100 ms while + held; stock 38 = 3.8 km/h/s" VALUE 0x40009035 RL_VALUE_UBYTE 0 CM_u8_speed_1_100kph 0 2.55 /end CHARACTERISTIC
/begin CHARACTERISTIC CAL_cruise_decel_hold_step "subtracted from target every 100 ms while - held; stock 31 = 3.1 km/h/s" VALUE 0x40009036 RL_VALUE_UBYTE 0 CM_u8_speed_1_100kph 0 2.55 /end CHARACTERISTIC
/begin CHARACTERISTIC CAL_cruise_override_timeout "pedal override longer than val*4 (10 Hz) = 400 ms/count cancels cruise (reason 0x100); stock 112 = 44.8 s. Was CAL_ign_comp_recovery_timer" VALUE 0x4000903A RL_VALUE_UWORD 0 NO_COMPU_METHOD 0 65535 /end CHARACTERISTIC
/begin CHARACTERISTIC CAL_cruise_speed_tap_step "SET+/COAST- tap step; stock 16 = 1.6 km/h (~1 mph)" VALUE 0x4000903C RL_VALUE_UBYTE 0 CM_u8_speed_1_10kph 0 25.5 /end CHARACTERISTIC
/begin CHARACTERISTIC CAL_cruise_airflow_slew_step "u8_flow_10mg/s" VALUE 0x4000903D RL_VALUE_UBYTE 0 CM_u16_flow_10mg_s 0 2550 /end CHARACTERISTIC
/begin CHARACTERISTIC CAL_cruise_speed_filter_coeff "cruise_speed_smoothed = (k*old + (255-k)*car_speed_x100)/255 at 40 Hz. Was CAL_cruise_speed_increment2" VALUE 0x4000903E RL_VALUE_UBYTE 0 CM_u8_factor_1_255 0 100 /end CHARACTERISTIC
/begin CHARACTERISTIC CAL_ac_compressor_speed_filter_coeff "uint8_t" VALUE 0x4000904B RL_VALUE_UBYTE 0 NO_COMPU_METHOD 0 255 /end CHARACTERISTIC
/begin CHARACTERISTIC CAL_cruise_rpm_max_ips "as CAL_cruise_rpm_max_manual" VALUE 0x40009061 RL_VALUE_UBYTE 0 CM_u8_rspeed_50rpm 0 12750 /end CHARACTERISTIC
/begin CHARACTERISTIC CAL_cruise_rpm_min_ips "as CAL_cruise_rpm_min_manual" VALUE 0x40009062 RL_VALUE_UBYTE 0 CM_u8_rspeed_50rpm 0 12750 /end CHARACTERISTIC
/begin CHARACTERISTIC CAL_cruise_integral_gearchange_blend "IPS upshift: integ = rescaled + k*(old - rescaled)/255, rescaled = integ*Ki_old/Ki_new. Was CAL_ecu_engine_breakin_distance" VALUE 0x4000907F RL_VALUE_UBYTE 0 CM_u8_factor_1_255 0 100 /end CHARACTERISTIC
/begin CHARACTERISTIC CAL_cruise_integrator_accel_freeze "integrator runs only while wheel_speed_front_accel <= val (or error 0). Was CAL_vehicle_standing_start_throttle_threshold" VALUE 0x40009080 RL_VALUE_UBYTE 0 CM_u8_accel_1_100g 0 2.55 /end CHARACTERISTIC
/begin CHARACTERISTIC CAL_cruise_tps_accelerating_threshold "uint16_t" VALUE 0x4000908A RL_VALUE_UWORD 0 NO_COMPU_METHOD 0 65535 /end CHARACTERISTIC
/begin CHARACTERISTIC CAL_cruise_tps_override_threshold "Calibration: cruise throttle position override threshold. Tunable map/constant (not a live channel); log to see throttle/pedal demand and throttle response. (0-1; raw/255)" VALUE 0x4000908F RL_VALUE_UBYTE 0 CM_u8_factor_1_255 0 100 /end CHARACTERISTIC
/begin CHARACTERISTIC CAL_cruise_torque_request_braking "u8_torque_2nm" VALUE 0x400090AD RL_VALUE_UBYTE 0 CM_u8_torque_2nm 0 510 /end CHARACTERISTIC
/begin CHARACTERISTIC CAL_cruise_brake_standstill_timer "u16_time_10ms" VALUE 0x400090AE RL_VALUE_UWORD 0 CM_u8_time_10ms 0 655350 /end CHARACTERISTIC
/begin CHARACTERISTIC CAL_obd_ii_variant_enable "Calibration: OBD variant enable. Tunable map/constant (not a live channel); adjust to change this behavior." VALUE 0x400090B6 RL_VALUE_UBYTE 0 NO_COMPU_METHOD 0 255 /end CHARACTERISTIC
/begin CHARACTERISTIC CAL_ips_speed_match_p_gain "uint16_t" VALUE 0x400090C2 RL_VALUE_UWORD 0 NO_COMPU_METHOD 0 65535 /end CHARACTERISTIC
/begin CHARACTERISTIC CAL_ips_speed_match_i_gain "uint16_t" VALUE 0x400090C6 RL_VALUE_UWORD 0 NO_COMPU_METHOD 0 65535 /end CHARACTERISTIC
/begin CHARACTERISTIC CAL_ips_speed_match_i_error_window "u16_rspeed_rpm" VALUE 0x400090C8 RL_VALUE_UWORD 0 CM_u8_rspeed_rpm 0 65535 /end CHARACTERISTIC
/begin CHARACTERISTIC CAL_ips_speed_match_i_reset "i16_torque_nm" VALUE 0x400090CA RL_VALUE_SWORD 0 CM_u8_torque_nm -32768 32767 /end CHARACTERISTIC
/begin CHARACTERISTIC CAL_ips_speed_match_d_gain "uint16_t" VALUE 0x400090CC RL_VALUE_UWORD 0 NO_COMPU_METHOD 0 65535 /end CHARACTERISTIC
/begin CHARACTERISTIC CAL_ips_speed_match_d_sample_ticks "u8_time_1ms" VALUE 0x400090CE RL_VALUE_UBYTE 0 CM_u8_time_ms 0 255 /end CHARACTERISTIC
/begin CHARACTERISTIC CAL_ips_speed_match_p_term_max "i16_torque_nm" VALUE 0x400090D0 RL_VALUE_SWORD 0 CM_u8_torque_nm -32768 32767 /end CHARACTERISTIC
/begin CHARACTERISTIC CAL_ips_speed_match_p_term_min "i16_torque_nm" VALUE 0x400090D2 RL_VALUE_SWORD 0 CM_u8_torque_nm -32768 32767 /end CHARACTERISTIC
/begin CHARACTERISTIC CAL_ips_speed_match_i_term_max "i16_torque_nm" VALUE 0x400090D4 RL_VALUE_SWORD 0 CM_u8_torque_nm -32768 32767 /end CHARACTERISTIC
/begin CHARACTERISTIC CAL_ips_speed_match_i_term_min "i16_torque_nm" VALUE 0x400090D6 RL_VALUE_SWORD 0 CM_u8_torque_nm -32768 32767 /end CHARACTERISTIC
/begin CHARACTERISTIC CAL_ips_speed_match_d_term_max "i16_torque_nm" VALUE 0x400090D8 RL_VALUE_SWORD 0 CM_u8_torque_nm -32768 32767 /end CHARACTERISTIC
/begin CHARACTERISTIC CAL_ips_speed_match_d_term_min "i16_torque_nm" VALUE 0x400090DA RL_VALUE_SWORD 0 CM_u8_torque_nm -32768 32767 /end CHARACTERISTIC
/begin CHARACTERISTIC CAL_ips_speed_match_torque_max "u16_torque_nm" VALUE 0x400090DC RL_VALUE_UWORD 0 CM_u8_torque_nm 0 65535 /end CHARACTERISTIC
/begin CHARACTERISTIC CAL_ips_torque_reduction_slow_scale_pct "uint8_t" VALUE 0x400090E0 RL_VALUE_UBYTE 0 NO_COMPU_METHOD 0 255 /end CHARACTERISTIC
/begin CHARACTERISTIC CAL_ips_torque_reduction_slow_floor_nm "uint8_t" VALUE 0x400090E1 RL_VALUE_UBYTE 0 NO_COMPU_METHOD 0 255 /end CHARACTERISTIC
/begin CHARACTERISTIC CAL_cruise_resume_pedal_handoff_threshold "u16_factor_1/1023" VALUE 0x4000910C RL_VALUE_UWORD 0 CM_u16_factor_1_1023 0 6406.15835777126 /end CHARACTERISTIC
/begin CHARACTERISTIC CAL_cruise_feedforward_blend_threshold "u8_factor_1/255" VALUE 0x4000910E RL_VALUE_UBYTE 0 CM_u8_factor_1_255 0 100 /end CHARACTERISTIC
/begin CHARACTERISTIC CAL_accessory_output_rpm_inhibit_off "u8_rspeed_4rpm" VALUE 0x4000911E RL_VALUE_UBYTE 0 CM_u8_rspeed_4rpm 0 1020 /end CHARACTERISTIC
/begin CHARACTERISTIC CAL_accessory_output_rpm_inhibit_on "Calibration: seat heater RPM threshold. Tunable map/constant (not a live channel); adjust to change this behavior. (RPM; raw*4)" VALUE 0x4000911F RL_VALUE_UBYTE 0 CM_u8_rspeed_4rpm 0 1020 /end CHARACTERISTIC
/begin CHARACTERISTIC CAL_ac_inhibit_cranking "Calibration: A/C inhibit cranking. Tunable map/constant (not a live channel); log to see A/C clutch engagement and its load/idle impact. (RPM; raw*4)" VAL_BLK 0x40009120 RL_VALUE_UBYTE 0 CM_u8_rspeed_4rpm 0 1020 NUMBER 2 /end CHARACTERISTIC
/begin AXIS_PTS CAL_cruise_proportional_gain_ips_X_gear "u8_gear[4]" 0x400093A6 car_gear_current RL_AXIS_UBYTE 0 NO_COMPU_METHOD 4 0 255 /end AXIS_PTS
/begin CHARACTERISTIC CAL_cruise_proportional_gain_ips "uint8_t[4]" CURVE 0x400093AA RL_VALUE_UBYTE 0 NO_COMPU_METHOD 0 255
 /begin AXIS_DESCR COM_AXIS car_gear_current NO_COMPU_METHOD 4 0 255 AXIS_PTS_REF CAL_cruise_proportional_gain_ips_X_gear /end AXIS_DESCR
/end CHARACTERISTIC
/begin AXIS_PTS CAL_cruise_integral_gain_ips_X_gear "u8_gear[4]" 0x400093AE NO_INPUT_QUANTITY RL_AXIS_UBYTE 0 NO_COMPU_METHOD 4 0 255 /end AXIS_PTS
/begin CHARACTERISTIC CAL_cruise_integral_gain_ips "uint8_t[4]" CURVE 0x400093B2 RL_VALUE_UBYTE 0 NO_COMPU_METHOD 0 255
 /begin AXIS_DESCR COM_AXIS NO_INPUT_QUANTITY NO_COMPU_METHOD 4 0 255 AXIS_PTS_REF CAL_cruise_integral_gain_ips_X_gear /end AXIS_DESCR
/end CHARACTERISTIC
/begin AXIS_PTS CAL_cruise_derivative_gain_ips_X_gear "u8_gear[4]" 0x400093B6 car_gear_current RL_AXIS_UBYTE 0 NO_COMPU_METHOD 4 0 255 /end AXIS_PTS
/begin CHARACTERISTIC CAL_cruise_derivative_gain_ips "uint8_t[4]" CURVE 0x400093BA RL_VALUE_UBYTE 0 NO_COMPU_METHOD 0 255
 /begin AXIS_DESCR COM_AXIS car_gear_current NO_COMPU_METHOD 4 0 255 AXIS_PTS_REF CAL_cruise_derivative_gain_ips_X_gear /end AXIS_DESCR
/end CHARACTERISTIC
/begin CHARACTERISTIC CAL_obd_ii_freeze_frame_pid_list "ushort[8]" VAL_BLK 0x400094EE RL_VALUE_UWORD 0 NO_COMPU_METHOD 0 65535 NUMBER 8 /end CHARACTERISTIC
/begin AXIS_PTS CAL_ips_revmatch_p_gain_X_rpm "X-axis breakpoints for the 'IPS revmatch target RPM' table. Defines the lookup grid (not a live channel); change only when re-axing the map. (RPM)" 0x400094FE ips_engine_speed_at_shift RL_AXIS_UWORD 0 CM_u8_rspeed_rpm 4 0 65535 /end AXIS_PTS
/begin CHARACTERISTIC CAL_ips_revmatch_p_gain "Calibration: IPS revmatch target RPM. Tunable map/constant (not a live channel); log to follow IPS automated-manual shift behavior." CURVE 0x40009506 RL_VALUE_UWORD 0 NO_COMPU_METHOD 0 65535
 /begin AXIS_DESCR COM_AXIS ips_engine_speed_at_shift CM_u8_rspeed_rpm 4 0 65535 AXIS_PTS_REF CAL_ips_revmatch_p_gain_X_rpm /end AXIS_DESCR
/end CHARACTERISTIC
/begin AXIS_PTS CAL_ac_load_limit_X_rpm "X-axis breakpoints for the 'A/C load limit' table. Defines the lookup grid (not a live channel); change only when re-axing the map. (RPM; raw*125/4+500)" 0x40009518 engine_speed_3 RL_AXIS_UBYTE 0 CM_u8_rspeed_125_4_500rpm 4 500 8468.75 /end AXIS_PTS
/begin CHARACTERISTIC CAL_ac_load_limit "Calibration: A/C load limit. Tunable map/constant (not a live channel); log engine load -- the main axis for fueling and ignition." CURVE 0x4000951C RL_VALUE_UBYTE 0 NO_COMPU_METHOD 0 255
 /begin AXIS_DESCR COM_AXIS engine_speed_3 CM_u8_rspeed_125_4_500rpm 4 500 8468.75 AXIS_PTS_REF CAL_ac_load_limit_X_rpm /end AXIS_DESCR
/end CHARACTERISTIC
/begin AXIS_PTS CAL_cruise_proportional_gain_manual_X_gear "u8_gear[4]" 0x40009536 NO_INPUT_QUANTITY RL_AXIS_UBYTE 0 NO_COMPU_METHOD 4 0 255 /end AXIS_PTS
/begin CHARACTERISTIC CAL_cruise_proportional_gain_manual "P term = kp * err(0.01 km/h) / 10 in 10 mg/s" CURVE 0x4000953A RL_VALUE_UBYTE 0 NO_COMPU_METHOD 0 255
 /begin AXIS_DESCR COM_AXIS NO_INPUT_QUANTITY NO_COMPU_METHOD 4 0 255 AXIS_PTS_REF CAL_cruise_proportional_gain_manual_X_gear /end AXIS_DESCR
/end CHARACTERISTIC
/begin AXIS_PTS CAL_cruise_integral_gain_manual_X_gear "u8_gear[4]" 0x4000953E NO_INPUT_QUANTITY RL_AXIS_UBYTE 0 NO_COMPU_METHOD 4 0 255 /end AXIS_PTS
/begin CHARACTERISTIC CAL_cruise_integral_gain_manual "I term = ki * cruise_speed_error_integral / 100" CURVE 0x40009542 RL_VALUE_UBYTE 0 NO_COMPU_METHOD 0 255
 /begin AXIS_DESCR COM_AXIS NO_INPUT_QUANTITY NO_COMPU_METHOD 4 0 255 AXIS_PTS_REF CAL_cruise_integral_gain_manual_X_gear /end AXIS_DESCR
/end CHARACTERISTIC
/begin AXIS_PTS CAL_cruise_derivative_gain_manual_X_gear "u8_gear[4]" 0x40009546 NO_INPUT_QUANTITY RL_AXIS_UBYTE 0 NO_COMPU_METHOD 4 0 255 /end AXIS_PTS
/begin CHARACTERISTIC CAL_cruise_derivative_gain_manual "D term = kd * cruise_speed_error_rate" CURVE 0x4000954A RL_VALUE_UBYTE 0 NO_COMPU_METHOD 0 255
 /begin AXIS_DESCR COM_AXIS NO_INPUT_QUANTITY NO_COMPU_METHOD 4 0 255 AXIS_PTS_REF CAL_cruise_derivative_gain_manual_X_gear /end AXIS_DESCR
/end CHARACTERISTIC
/begin AXIS_PTS CAL_ac_evap_pid_p_gain_X_temp_error "u8_temp_5/8-40c[8]" 0x40009952 NO_INPUT_QUANTITY RL_AXIS_UBYTE 0 CM_u8_temp_5_8_40c 8 -40 119.375 /end AXIS_PTS
/begin CHARACTERISTIC CAL_ac_evap_pid_p_gain "u8_factor_1[8]" CURVE 0x4000995A RL_VALUE_UBYTE 0 CM_u8_factor_1 0 25500
 /begin AXIS_DESCR COM_AXIS NO_INPUT_QUANTITY CM_u8_temp_5_8_40c 8 -40 119.375 AXIS_PTS_REF CAL_ac_evap_pid_p_gain_X_temp_error /end AXIS_DESCR
/end CHARACTERISTIC
/begin AXIS_PTS CAL_cruise_proportional_gain_close_ratio_X_gear "u8_gear[4]" 0x40009C3A NO_INPUT_QUANTITY RL_AXIS_UBYTE 0 NO_COMPU_METHOD 4 0 255 /end AXIS_PTS
/begin CHARACTERISTIC CAL_cruise_proportional_gain_close_ratio "COD[0] bit 16 = close-ratio gearbox" CURVE 0x40009C3E RL_VALUE_UBYTE 0 NO_COMPU_METHOD 0 255
 /begin AXIS_DESCR COM_AXIS NO_INPUT_QUANTITY NO_COMPU_METHOD 4 0 255 AXIS_PTS_REF CAL_cruise_proportional_gain_close_ratio_X_gear /end AXIS_DESCR
/end CHARACTERISTIC
/begin AXIS_PTS CAL_cruise_integral_gain_close_ratio_X_gear "u8_gear[4]" 0x40009C42 NO_INPUT_QUANTITY RL_AXIS_UBYTE 0 NO_COMPU_METHOD 4 0 255 /end AXIS_PTS
/begin CHARACTERISTIC CAL_cruise_integral_gain_close_ratio "uint8_t[4]" CURVE 0x40009C46 RL_VALUE_UBYTE 0 NO_COMPU_METHOD 0 255
 /begin AXIS_DESCR COM_AXIS NO_INPUT_QUANTITY NO_COMPU_METHOD 4 0 255 AXIS_PTS_REF CAL_cruise_integral_gain_close_ratio_X_gear /end AXIS_DESCR
/end CHARACTERISTIC
/begin AXIS_PTS CAL_cruise_derivative_gain_close_ratio_X_gear "u8_gear[4]" 0x40009C4A NO_INPUT_QUANTITY RL_AXIS_UBYTE 0 NO_COMPU_METHOD 4 0 255 /end AXIS_PTS
/begin CHARACTERISTIC CAL_cruise_derivative_gain_close_ratio "uint8_t[4]" CURVE 0x40009C4E RL_VALUE_UBYTE 0 NO_COMPU_METHOD 0 255
 /begin AXIS_DESCR COM_AXIS NO_INPUT_QUANTITY NO_COMPU_METHOD 4 0 255 AXIS_PTS_REF CAL_cruise_derivative_gain_close_ratio_X_gear /end AXIS_DESCR
/end CHARACTERISTIC
/begin AXIS_PTS CAL_cluster_shiftlight_rpm_offset_manual_X_gear "Calibration: cluster shiftlight RPM offset manual. Tunable map/constant (not a live channel); log to check what the ECU sends the dash (gauges/warnings)." 0x4000A36A NO_INPUT_QUANTITY RL_AXIS_UBYTE 0 NO_COMPU_METHOD 8 0 255 /end AXIS_PTS
/begin CHARACTERISTIC CAL_cluster_shiftlight_rpm_offset_manual "u8_rspeed_8rpm[8]" CURVE 0x4000A372 RL_VALUE_UBYTE 0 CM_u8_rspeed_8rpm 0 2040
 /begin AXIS_DESCR COM_AXIS NO_INPUT_QUANTITY NO_COMPU_METHOD 8 0 255 AXIS_PTS_REF CAL_cluster_shiftlight_rpm_offset_manual_X_gear /end AXIS_DESCR
/end CHARACTERISTIC
/begin CHARACTERISTIC CAL_obd_ii_calc_load_wot_airmass "WOT peak air charge at STP vs rpm; denominator of J1979 calculated load (PID 0x04). 255 = divisor × 255/64 mg." VAL_BLK 0x4000A38A RL_VALUE_UBYTE 0 CM_u8_load_4mg_stroke 0 1020 NUMBER 16 /end CHARACTERISTIC
/begin AXIS_PTS CAL_obd_ii_commanded_evap_purge_X_duty "u8_dutycycle_100/255[16]" 0x4000B952 evap_purge_duty RL_AXIS_UBYTE 0 CM_u8_factor_1_255 16 0 100 /end AXIS_PTS
/begin AXIS_PTS CAL_obd_ii_commanded_evap_purge_Y_vacuum "u8_pressure_4mbar[16]" 0x4000B962 V_CAL_obd_ii_commanded_evap_purge_Y_vacuum RL_AXIS_UBYTE 0 CM_u8_pressure_4mbar 16 0 1020 /end AXIS_PTS
/begin CHARACTERISTIC CAL_obd_ii_commanded_evap_purge "u8_dutycycle_100/255[256]" MAP 0x4000B972 RL_VALUE_UBYTE 0 CM_u8_factor_1_255 0 100
 /begin AXIS_DESCR COM_AXIS evap_purge_duty CM_u8_factor_1_255 16 0 100 AXIS_PTS_REF CAL_obd_ii_commanded_evap_purge_X_duty /end AXIS_DESCR
 /begin AXIS_DESCR COM_AXIS V_CAL_obd_ii_commanded_evap_purge_Y_vacuum CM_u8_pressure_4mbar 16 0 1020 AXIS_PTS_REF CAL_obd_ii_commanded_evap_purge_Y_vacuum /end AXIS_DESCR
/end CHARACTERISTIC
/begin AXIS_PTS CAL_cluster_shiftlight_rpm_offset_ips_X_gear "Calibration: cluster shiftlight RPM offset IPS. Tunable map/constant (not a live channel); log to check what the ECU sends the dash (gauges/warnings)." 0x4000CE4A NO_INPUT_QUANTITY RL_AXIS_UBYTE 0 NO_COMPU_METHOD 8 0 255 /end AXIS_PTS
/begin CHARACTERISTIC CAL_cluster_shiftlight_rpm_offset_ips "u8_rspeed_8rpm[8]" CURVE 0x4000CE52 RL_VALUE_UBYTE 0 CM_u8_rspeed_8rpm 0 2040
 /begin AXIS_DESCR COM_AXIS NO_INPUT_QUANTITY NO_COMPU_METHOD 8 0 255 AXIS_PTS_REF CAL_cluster_shiftlight_rpm_offset_ips_X_gear /end AXIS_DESCR
/end CHARACTERISTIC
/begin CHARACTERISTIC CAL_obd_ii_warmup_temp_unknown "u8_temp_5/8-40c" VALUE 0x4000D194 RL_VALUE_UBYTE 0 CM_u8_temp_5_8_40c -40 119.375 /end CHARACTERISTIC
/begin CHARACTERISTIC CAL_obd_ii_coolant_warmup_threshold_unknown "uint8_t" VALUE 0x4000D195 RL_VALUE_UBYTE 0 NO_COMPU_METHOD 0 255 /end CHARACTERISTIC
/begin CHARACTERISTIC CAL_obd_ii_coolant_warmup_thresholds "uint8_t" VALUE 0x4000D196 RL_VALUE_UBYTE 0 NO_COMPU_METHOD 0 255 /end CHARACTERISTIC
/begin CHARACTERISTIC CAL_obd_ii_similar_cond_warmup_cycles "u8_count" VALUE 0x4000D197 RL_VALUE_UBYTE 0 NO_COMPU_METHOD 0 255 /end CHARACTERISTIC
/begin CHARACTERISTIC CAL_obd_ii_similar_cond_load_tol "u8_factor_1/255" VALUE 0x4000D198 RL_VALUE_UBYTE 0 CM_u8_factor_1_255 0 100 /end CHARACTERISTIC
/begin CHARACTERISTIC CAL_obd_ii_cat_monitor_maf_min "u8_flow_500mg/s" VALUE 0x4000D199 RL_VALUE_UBYTE 0 CM_u8_flow_500mg_s 0 127500 /end CHARACTERISTIC
/begin CHARACTERISTIC CAL_obd_ii_similar_cond_rpm_tol "u16_rspeed_1/4rpm" VALUE 0x4000D19A RL_VALUE_UWORD 0 CM_u16_rspeed_1_4rpm 0 16383.75 /end CHARACTERISTIC
/begin CHARACTERISTIC CAL_obd_ii_similar_cond_debounce_reload "u16_time_5ms" VALUE 0x4000D19C RL_VALUE_UWORD 0 CM_u8_time_5ms 0 327675 /end CHARACTERISTIC
/begin CHARACTERISTIC CAL_obd_ii_o2_lean_period_excess_max "u16_time_5ms" VALUE 0x4000D19E RL_VALUE_UWORD 0 CM_u8_time_5ms 0 327675 /end CHARACTERISTIC
/begin CHARACTERISTIC CAL_obd_ii_o2_rich_period_excess_max "u16_time_5ms" VALUE 0x4000D1A0 RL_VALUE_UWORD 0 CM_u8_time_5ms 0 327675 /end CHARACTERISTIC
/begin CHARACTERISTIC CAL_cluster_overtemp_warning_light "Calibration: cluster overtemp warning light. Tunable map/constant (not a live channel); log to check what the ECU sends the dash (gauges/warnings). (deg C; raw*5/8-40)" VALUE 0x4000D1A8 RL_VALUE_UBYTE 0 CM_u8_temp_5_8_40c -40 119.375 /end CHARACTERISTIC
/begin CHARACTERISTIC CAL_obd_ii_unknown7 "uint8_t" VALUE 0x4000D1A9 RL_VALUE_UBYTE 0 NO_COMPU_METHOD 0 255 /end CHARACTERISTIC
/begin CHARACTERISTIC CAL_obd_ii_adc_maf_unknown1 "u16_voltage_5/1023v" VALUE 0x4000D1AA RL_VALUE_UWORD 0 CM_u16_voltage_5_1023v 0 320.307917888563 /end CHARACTERISTIC
/begin CHARACTERISTIC CAL_obd_ii_monitor_debounce_cycles "uint16_t" VALUE 0x4000D1AC RL_VALUE_UWORD 0 NO_COMPU_METHOD 0 65535 /end CHARACTERISTIC
/begin CHARACTERISTIC CAL_obd_ii_brake_pedal_conflict_count "u8_time_100ms" VALUE 0x4000D1AE RL_VALUE_UBYTE 0 CM_u8_time_100ms 0 25500 /end CHARACTERISTIC
/begin CHARACTERISTIC CAL_obd_ii_P0571_switch_mismatch_time "u8_time_100ms" VALUE 0x4000D1AF RL_VALUE_UBYTE 0 CM_u8_time_100ms 0 25500 /end CHARACTERISTIC
/begin CHARACTERISTIC CAL_obd_ii_P0571_brake_check_min_speed "u8_speed_kph" VALUE 0x4000D1B0 RL_VALUE_UBYTE 0 CM_u8_speed_kph 0 255 /end CHARACTERISTIC
/begin CHARACTERISTIC CAL_obd_ii_P0441_runtime_min "u8_time_100ms" VALUE 0x4000D1B2 RL_VALUE_UBYTE 0 CM_u8_time_100ms 0 25500 /end CHARACTERISTIC
/begin CHARACTERISTIC CAL_obd_ii_o2_sensor1_voltage_threshold "u16_voltage_5/1023v" VALUE 0x4000D1B6 RL_VALUE_UWORD 0 CM_u16_voltage_5_1023v 0 320.307917888563 /end CHARACTERISTIC
/begin CHARACTERISTIC CAL_obd_ii_o2_sensor1_voltage_limit "u16_voltage_5/1023v" VALUE 0x4000D1B8 RL_VALUE_UWORD 0 CM_u16_voltage_5_1023v 0 320.307917888563 /end CHARACTERISTIC
/begin CHARACTERISTIC CAL_obd_ii_o2_sensor2_voltage_threshold "u16_voltage_5/1023v" VALUE 0x4000D1BA RL_VALUE_UWORD 0 CM_u16_voltage_5_1023v 0 320.307917888563 /end CHARACTERISTIC
/begin CHARACTERISTIC CAL_obd_ii_o2_sensor2_voltage_limit "u16_voltage_5/1023v" VALUE 0x4000D1BC RL_VALUE_UWORD 0 CM_u16_voltage_5_1023v 0 320.307917888563 /end CHARACTERISTIC
/begin CHARACTERISTIC CAL_obd_ii_cat_monitor_baro_min "u16_pressure_mbar" VALUE 0x4000D1C2 RL_VALUE_UWORD 0 CM_i16_pressure_mbar 0 65535 /end CHARACTERISTIC
/begin CHARACTERISTIC CAL_obd_ii_cat_monitor_ect_min "u8_temp_5/8-40c" VALUE 0x4000D1C4 RL_VALUE_UBYTE 0 CM_u8_temp_5_8_40c -40 119.375 /end CHARACTERISTIC
/begin CHARACTERISTIC CAL_obd_ii_P0420_maf_min "u16_flow_10mg/s" VALUE 0x4000D1C6 RL_VALUE_UWORD 0 CM_u16_flow_10mg_s 0 655350 /end CHARACTERISTIC
/begin CHARACTERISTIC CAL_obd_ii_P0420_maf_max "u16_flow_10mg/s" VALUE 0x4000D1C8 RL_VALUE_UWORD 0 CM_u16_flow_10mg_s 0 655350 /end CHARACTERISTIC
/begin CHARACTERISTIC CAL_obd_ii_postcat_o2_voltage_bias "Calibration: OBD postcat O2 voltage bias. Tunable map/constant (not a live channel); adjust to change this behavior." VALUE 0x4000D1CA RL_VALUE_UBYTE 0 NO_COMPU_METHOD 0 255 /end CHARACTERISTIC
/begin CHARACTERISTIC CAL_obd_ii_cat_mon_post_dfco_holdoff_prescaler "uint8_t" VALUE 0x4000D1CB RL_VALUE_UBYTE 0 NO_COMPU_METHOD 0 255 /end CHARACTERISTIC
/begin CHARACTERISTIC CAL_obd_ii_o2_flatline_band "uint8_t" VALUE 0x4000D1CC RL_VALUE_UBYTE 0 NO_COMPU_METHOD 0 255 /end CHARACTERISTIC
/begin CHARACTERISTIC CAL_obd_ii_o2_flatline_window_inband "u8_time_100ms" VALUE 0x4000D1CD RL_VALUE_UBYTE 0 CM_u8_time_100ms 0 25500 /end CHARACTERISTIC
/begin CHARACTERISTIC CAL_obd_ii_P0420_car_speed_max "u8_speed_kph" VALUE 0x4000D1CE RL_VALUE_UBYTE 0 CM_u8_speed_kph 0 255 /end CHARACTERISTIC
/begin CHARACTERISTIC CAL_obd_ii_P0420_car_speed_min "u8_speed_kph" VALUE 0x4000D1CF RL_VALUE_UBYTE 0 CM_u8_speed_kph 0 255 /end CHARACTERISTIC
/begin CHARACTERISTIC CAL_obd_ii_P0117_coolant_voltage_low "u16_voltage_5/1023v" VALUE 0x4000D1D6 RL_VALUE_UWORD 0 CM_u16_voltage_5_1023v 0 320.307917888563 /end CHARACTERISTIC
/begin CHARACTERISTIC CAL_obd_ii_o2_slow_response_arm_dwell "u16_time_5ms" VALUE 0x4000D1DA RL_VALUE_UWORD 0 CM_u8_time_5ms 0 327675 /end CHARACTERISTIC
/begin CHARACTERISTIC CAL_obd_ii_P0562_sample_count "u8_time_100ms" VALUE 0x4000D1E0 RL_VALUE_UBYTE 0 CM_u8_time_100ms 0 25500 /end CHARACTERISTIC
/begin CHARACTERISTIC CAL_obd_ii_P0563_sample_count "u8_time_100ms" VALUE 0x4000D1E1 RL_VALUE_UBYTE 0 CM_u8_time_100ms 0 25500 /end CHARACTERISTIC
/begin CHARACTERISTIC CAL_obd_ii_P0128_iat_min "u8_temp_5/8-40c" VALUE 0x4000D1E3 RL_VALUE_UBYTE 0 CM_u8_temp_5_8_40c -40 119.375 /end CHARACTERISTIC
/begin CHARACTERISTIC CAL_obd_ii_cat_precat_o2_lean_thresh "u16_voltage_5/1023v" VALUE 0x4000D1E6 RL_VALUE_UWORD 0 CM_u16_voltage_5_1023v 0 320.307917888563 /end CHARACTERISTIC
/begin CHARACTERISTIC CAL_obd_ii_cat_precat_o2_rich_thresh "u16_voltage_5/1023v" VALUE 0x4000D1E8 RL_VALUE_UWORD 0 CM_u16_voltage_5_1023v 0 320.307917888563 /end CHARACTERISTIC
/begin CHARACTERISTIC CAL_obd_ii_cat_postcat_o2_lean_offset "u16_voltage_5/1023v" VALUE 0x4000D1EA RL_VALUE_UWORD 0 CM_u16_voltage_5_1023v 0 320.307917888563 /end CHARACTERISTIC
/begin CHARACTERISTIC CAL_obd_ii_cat_postcat_o2_rich_offset "u16_voltage_5/1023v" VALUE 0x4000D1EC RL_VALUE_UWORD 0 CM_u16_voltage_5_1023v 0 320.307917888563 /end CHARACTERISTIC
/begin CHARACTERISTIC CAL_obd_ii_cat_efficiency_ratio_max "u16_factor_1/1000" VALUE 0x4000D1EE RL_VALUE_UWORD 0 CM_u16_factor_1_1000 0 6553.5 /end CHARACTERISTIC
/begin CHARACTERISTIC CAL_obd_ii_vvt_exhaust_error_bank1_limit "i16_angle_1/4deg" VALUE 0x4000D1F0 RL_VALUE_SWORD 0 CM_u8_angle_1_4deg -8192 8191.75 /end CHARACTERISTIC
/begin CHARACTERISTIC CAL_obd_P0171_ltft_limit "i16_percent_1/10" VALUE 0x4000D1F2 RL_VALUE_SWORD 0 CM_u16_factor_1_1000 -3276.8 3276.7 /end CHARACTERISTIC
/begin CHARACTERISTIC CAL_obd_P0172_ltft_limit "i16_percent_1/10" VALUE 0x4000D1F4 RL_VALUE_SWORD 0 CM_u16_factor_1_1000 -3276.8 3276.7 /end CHARACTERISTIC
/begin CHARACTERISTIC CAL_obd_ii_o2_response_car_speed_min "u8_speed_kph" VALUE 0x4000D1F6 RL_VALUE_UBYTE 0 CM_u8_speed_kph 0 255 /end CHARACTERISTIC
/begin CHARACTERISTIC CAL_obd_ii_o2_response_car_speed_max "u8_speed_kph" VALUE 0x4000D1F7 RL_VALUE_UBYTE 0 CM_u8_speed_kph 0 255 /end CHARACTERISTIC
/begin CHARACTERISTIC CAL_obd_ii_o2_transition_count "u8_count" VALUE 0x4000D1F8 RL_VALUE_UBYTE 0 NO_COMPU_METHOD 0 255 /end CHARACTERISTIC
/begin CHARACTERISTIC CAL_obd_ii_cat_check_o2_rich_time_max "u8_time_25ms" VALUE 0x4000D1F9 RL_VALUE_UBYTE 0 CM_u8_time_25ms 0 6375 /end CHARACTERISTIC
/begin CHARACTERISTIC CAL_obd_ii_mode06_o2_switch_time_min "u16_time_5ms" VALUE 0x4000D1FA RL_VALUE_UWORD 0 CM_u8_time_5ms 0 327675 /end CHARACTERISTIC
/begin CHARACTERISTIC CAL_obd_ii_mode06_o2_switch_time_max "u16_time_5ms" VALUE 0x4000D1FC RL_VALUE_UWORD 0 CM_u8_time_5ms 0 327675 /end CHARACTERISTIC
/begin CHARACTERISTIC CAL_obd_ii_P0111_mass_air_min "u8_mass_5g" VALUE 0x4000D1FE RL_VALUE_UBYTE 0 CM_u8_mass_5g 0 1275 /end CHARACTERISTIC
/begin CHARACTERISTIC CAL_obd_ii_P0500_test_time "u16_time_100ms" VALUE 0x4000D208 RL_VALUE_UWORD 0 CM_u8_time_100ms 0 6553500 /end CHARACTERISTIC
/begin CHARACTERISTIC CAL_obd_ii_P0685_voltage_delta "uint8_t" VALUE 0x4000D20B RL_VALUE_UBYTE 0 NO_COMPU_METHOD 0 255 /end CHARACTERISTIC
/begin CHARACTERISTIC CAL_obd_ii_P0500_car_speed_min "u8_speed_kph" VALUE 0x4000D20C RL_VALUE_UBYTE 0 CM_u8_speed_kph 0 255 /end CHARACTERISTIC
/begin CHARACTERISTIC CAL_obd_ii_crank_cam_error_count_max "u8_count" VALUE 0x4000D20D RL_VALUE_UBYTE 0 NO_COMPU_METHOD 0 255 /end CHARACTERISTIC
/begin CHARACTERISTIC CAL_obd_ii_o2_flatline_window_outband "u8_time_100ms" VALUE 0x4000D20E RL_VALUE_UBYTE 0 CM_u8_time_100ms 0 25500 /end CHARACTERISTIC
/begin CHARACTERISTIC CAL_obd_ii_P0506_P0507_idle_learn_limit "u8_flow_100mg/s" VALUE 0x4000D214 RL_VALUE_UBYTE 0 CM_u8_flow_100mg_s 0 25500 /end CHARACTERISTIC
/begin CHARACTERISTIC CAL_obd_ii_idle_learn_limit "u8_flow_100mg/s" VALUE 0x4000D215 RL_VALUE_UBYTE 0 CM_u8_flow_100mg_s 0 25500 /end CHARACTERISTIC
/begin CHARACTERISTIC CAL_obd_ii_idle_error_fail_count "u8_count" VALUE 0x4000D216 RL_VALUE_UBYTE 0 NO_COMPU_METHOD 0 255 /end CHARACTERISTIC
/begin CHARACTERISTIC CAL_obd_ii_vvt_monitor_coolant_min "u8_temp_5/8-40c" VALUE 0x4000D218 RL_VALUE_UBYTE 0 CM_u8_temp_5_8_40c -40 119.375 /end CHARACTERISTIC
/begin CHARACTERISTIC CAL_obd_ii_vvt_error_fail_count "u8_count" VALUE 0x4000D219 RL_VALUE_UBYTE 0 NO_COMPU_METHOD 0 255 /end CHARACTERISTIC
/begin CHARACTERISTIC CAL_obd_ii_vvt_monitor_min_runtime "u16_time_5ms" VALUE 0x4000D21A RL_VALUE_UWORD 0 CM_u8_time_5ms 0 327675 /end CHARACTERISTIC
/begin CHARACTERISTIC CAL_obd_ii_P1302_pass_holdoff "u16_time_5ms" VALUE 0x4000D220 RL_VALUE_UWORD 0 CM_u8_time_5ms 0 327675 /end CHARACTERISTIC
/begin CHARACTERISTIC CAL_obd_ii_P0071_air_temp_limit "u8_temp_5/8-40c[2]" VAL_BLK 0x4000D222 RL_VALUE_UBYTE 0 CM_u8_temp_5_8_40c -40 119.375 NUMBER 2 /end CHARACTERISTIC
/begin CHARACTERISTIC CAL_obd_P0171_learn_time_threshold "u8_time_10us" VALUE 0x4000D226 RL_VALUE_UBYTE 0 CM_u8_time_10us 0 2550 /end CHARACTERISTIC
/begin CHARACTERISTIC CAL_obd_P0172_learn_time_threshold "u8_time_10us" VALUE 0x4000D227 RL_VALUE_UBYTE 0 CM_u8_time_10us 0 2550 /end CHARACTERISTIC
/begin CHARACTERISTIC CAL_obd_ii_accel_pedal_correlation_max_diff "u16_factor_1/1023" VALUE 0x4000D228 RL_VALUE_UWORD 0 CM_u16_factor_1_1023 0 6406.15835777126 /end CHARACTERISTIC
/begin CHARACTERISTIC CAL_obd_ii_o2_sensors_present "Calibration: OBD O2 sensors present. Tunable map/constant (not a live channel); adjust to change this behavior." VALUE 0x4000D22D RL_VALUE_UBYTE 0 NO_COMPU_METHOD 0 255 /end CHARACTERISTIC
/begin CHARACTERISTIC CAL_obd_ii_standards_supported "Calibration: OBD standards supported. Tunable map/constant (not a live channel); adjust to change this behavior." VALUE 0x4000D22E RL_VALUE_UBYTE 0 NO_COMPU_METHOD 0 255 /end CHARACTERISTIC
/begin CHARACTERISTIC CAL_obd_ii_o2_slow_response_sample_count "u8_count" VALUE 0x4000D22F RL_VALUE_UBYTE 0 NO_COMPU_METHOD 0 255 /end CHARACTERISTIC
/begin CHARACTERISTIC CAL_obd_ii_o2_r2l_time_max_asym "u8_time_5ms" VALUE 0x4000D230 RL_VALUE_UBYTE 0 CM_u8_time_5ms 0 1275 /end CHARACTERISTIC
/begin CHARACTERISTIC CAL_obd_ii_o2_l2r_time_max_asym "u8_time_5ms" VALUE 0x4000D231 RL_VALUE_UBYTE 0 CM_u8_time_5ms 0 1275 /end CHARACTERISTIC
/begin CHARACTERISTIC CAL_obd_ii_o2_slow_response_limit_lean_to_rich "u16_time_5ms" VALUE 0x4000D232 RL_VALUE_UWORD 0 CM_u8_time_5ms 0 327675 /end CHARACTERISTIC
/begin CHARACTERISTIC CAL_obd_ii_o2_slow_response_limit_rich_to_lean "u16_time_5ms" VALUE 0x4000D234 RL_VALUE_UWORD 0 CM_u8_time_5ms 0 327675 /end CHARACTERISTIC
/begin CHARACTERISTIC CAL_obd_ii_P050A_idle_error_high "u8_rspeed_2rpm" VALUE 0x4000D237 RL_VALUE_UBYTE 0 CM_u8_rspeed_2rpm 0 510 /end CHARACTERISTIC
/begin CHARACTERISTIC CAL_obd_ii_P050A_idle_error_low "u8_rspeed_2rpm" VALUE 0x4000D238 RL_VALUE_UBYTE 0 CM_u8_rspeed_2rpm 0 510 /end CHARACTERISTIC
/begin CHARACTERISTIC CAL_obd_ii_P0133_min_coolant_temp "u8_temp_5/8-40c" VALUE 0x4000D239 RL_VALUE_UBYTE 0 CM_u8_temp_5_8_40c -40 119.375 /end CHARACTERISTIC
/begin CHARACTERISTIC CAL_obd_ii_switch_voltage_debounce "u8_time_s" VALUE 0x4000D23E RL_VALUE_UBYTE 0 CM_u8_time_s 0 255 /end CHARACTERISTIC
/begin CHARACTERISTIC CAL_obd_ii_engine_speed_3_threshold_1 "u8_rspeed_125/4+500rpm" VALUE 0x4000D23F RL_VALUE_UBYTE 0 CM_u8_rspeed_125_4_500rpm 500 8468.75 /end CHARACTERISTIC
/begin CHARACTERISTIC CAL_obd_ii_vvt_ok_pass_count "u8_count" VALUE 0x4000D240 RL_VALUE_UBYTE 0 NO_COMPU_METHOD 0 255 /end CHARACTERISTIC
/begin CHARACTERISTIC CAL_obd_ii_o2_switch_time_threshold "uint8_t" VALUE 0x4000D248 RL_VALUE_UBYTE 0 NO_COMPU_METHOD 0 255 /end CHARACTERISTIC
/begin CHARACTERISTIC CAL_obd_ii_o2_switch_time_min "u8_time_5ms" VALUE 0x4000D249 RL_VALUE_UBYTE 0 CM_u8_time_5ms 0 1275 /end CHARACTERISTIC
/begin CHARACTERISTIC CAL_obd_ii_P0638_tps_error_max "u16_factor_1/1023" VALUE 0x4000D256 RL_VALUE_UWORD 0 CM_u16_factor_1_1023 0 6406.15835777126 /end CHARACTERISTIC
/begin CHARACTERISTIC CAL_obd_ii_P2173_load_difference_max "u16_load_mg/stroke" VALUE 0x4000D258 RL_VALUE_UWORD 0 CM_u16_load_mg_stroke 0 65535 /end CHARACTERISTIC
/begin CHARACTERISTIC CAL_obd_ii_o2_precat_diag_timer "uint16_t" VALUE 0x4000D25A RL_VALUE_UWORD 0 NO_COMPU_METHOD 0 65535 /end CHARACTERISTIC
/begin CHARACTERISTIC CAL_obd_ii_mode2f_timeout "Calibration: OBD mode2f timeout. Tunable map/constant (not a live channel); adjust to change this behavior. (ms; raw*100)" VALUE 0x4000D25C RL_VALUE_UWORD 0 CM_u8_time_100ms 0 6553500 /end CHARACTERISTIC
/begin CHARACTERISTIC CAL_obd_ii_mode2f_injector_test_interval "u8_time_5ms" VALUE 0x4000D262 RL_VALUE_UBYTE 0 CM_u8_time_5ms 0 1275 /end CHARACTERISTIC
/begin CHARACTERISTIC CAL_obd_ii_mode2f_injector_test_pulse_10us "uint16_t" VALUE 0x4000D264 RL_VALUE_UWORD 0 NO_COMPU_METHOD 0 65535 /end CHARACTERISTIC
/begin CHARACTERISTIC CAL_obd_ii_mode2f_injector_test_duration "u16_time_5ms" VALUE 0x4000D266 RL_VALUE_UWORD 0 CM_u8_time_5ms 0 327675 /end CHARACTERISTIC
/begin CHARACTERISTIC CAL_obd_ii_mode08_evap_test_duration "u16_time_5ms" VALUE 0x4000D268 RL_VALUE_UWORD 0 CM_u8_time_5ms 0 327675 /end CHARACTERISTIC
/begin CHARACTERISTIC CAL_obd_ii_wheel_speed_correlation_rpm_max "u8_rspeed_125/4+500rpm" VALUE 0x4000D26A RL_VALUE_UBYTE 0 CM_u8_rspeed_125_4_500rpm 500 8468.75 /end CHARACTERISTIC
/begin CHARACTERISTIC CAL_cluster_fuel_level_warning_threshold "Calibration: cluster fuel level warning threshold. Tunable map/constant (not a live channel); log to follow fuel delivery and mixture control. (L)" VAL_BLK 0x4000D270 RL_VALUE_UBYTE 0 CM_u8_volume_liter 0 255 NUMBER 2 /end CHARACTERISTIC
/begin CHARACTERISTIC CAL_obd_ii_P0106_partload_rpm_window "P0106 part-load test rpm window [lo, hi]; also the interpolation endpoints for the throttle-vacuum tables." VAL_BLK 0x4000D276 RL_VALUE_UBYTE 0 CM_u8_rspeed_125_4_500rpm 500 8468.75 NUMBER 2 /end CHARACTERISTIC
/begin CHARACTERISTIC CAL_obd_ii_P0106_partload_tps_window "P0106 part-load test TPS window [lo, hi]." VAL_BLK 0x4000D278 RL_VALUE_UBYTE 0 CM_u8_factor_1_255 0 100 NUMBER 2 /end CHARACTERISTIC
/begin CHARACTERISTIC CAL_obd_ii_P0106_partload_tps_rate_max "P0106 part-load test: max |tps_delta_rate| (steady throttle)." VALUE 0x4000D27A RL_VALUE_UBYTE 0 NO_COMPU_METHOD 0 255 /end CHARACTERISTIC
/begin CHARACTERISTIC CAL_obd_ii_paddle_shift_voltage_stable_time "u8_time_s" VALUE 0x4000D27B RL_VALUE_UBYTE 0 CM_u8_time_s 0 255 /end CHARACTERISTIC
/begin CHARACTERISTIC CAL_obd_ii_mode2f_coil_test_interval "uint8_t" VALUE 0x4000D27D RL_VALUE_UBYTE 0 NO_COMPU_METHOD 0 255 /end CHARACTERISTIC
/begin CHARACTERISTIC CAL_obd_ii_mode2f_coil_test_pulse_count "uint16_t" VALUE 0x4000D27E RL_VALUE_UWORD 0 NO_COMPU_METHOD 0 65535 /end CHARACTERISTIC
/begin CHARACTERISTIC CAL_obd_ii_P0106_baro_error_limits "P0106 limits on baro sensor - baro estimate (mbar): [0] max positive, [1] max negative." VAL_BLK 0x4000D28C RL_VALUE_UWORD 0 CM_i16_pressure_mbar 0 65535 NUMBER 2 /end CHARACTERISTIC
/begin CHARACTERISTIC CAL_obd_ii_P0171_P0172_trim_zone_time_min "uint16_t" VALUE 0x4000D290 RL_VALUE_UWORD 0 NO_COMPU_METHOD 0 65535 /end CHARACTERISTIC
/begin CHARACTERISTIC CAL_obd_ii_fuel_trim_zone3_time_min "u16_time_100ms" VALUE 0x4000D292 RL_VALUE_UWORD 0 CM_u8_time_100ms 0 6553500 /end CHARACTERISTIC
/begin CHARACTERISTIC CAL_obd_ii_o2_precat_activity_window "u16_time_5ms" VALUE 0x4000D294 RL_VALUE_UWORD 0 CM_u8_time_5ms 0 327675 /end CHARACTERISTIC
/begin CHARACTERISTIC CAL_obd_ii_o2_postcat_activity_min "u16_time_5ms" VALUE 0x4000D296 RL_VALUE_UWORD 0 CM_u8_time_5ms 0 327675 /end CHARACTERISTIC
/begin CHARACTERISTIC CAL_obd_ii_o2_slow_response_runtime_limit_unknown "u16_time_5ms" VALUE 0x4000D298 RL_VALUE_UWORD 0 CM_u8_time_5ms 0 327675 /end CHARACTERISTIC
/begin CHARACTERISTIC CAL_obd_ii_cat_monitor_min_engine_runtime "uint16_t" VALUE 0x4000D2A0 RL_VALUE_UWORD 0 NO_COMPU_METHOD 0 65535 /end CHARACTERISTIC
/begin CHARACTERISTIC CAL_obd_ii_P0106_highload_rpm_window "P0106 high-load test rpm window [lo, hi]; also needs tps > CAL_sensor_P0106_min_tps_threshold(rpm)." VAL_BLK 0x4000D2A9 RL_VALUE_UBYTE 0 CM_u8_rspeed_125_4_500rpm 500 8468.75 NUMBER 2 /end CHARACTERISTIC
/begin CHARACTERISTIC CAL_obd_ii_P0128_runtime_to_lowspeed_ratio_min "uint8_t" VALUE 0x4000D2AC RL_VALUE_UBYTE 0 NO_COMPU_METHOD 0 255 /end CHARACTERISTIC
/begin CHARACTERISTIC CAL_obd_ii_P0128_lowspeed_threshold "u8_speed_kph" VALUE 0x4000D2AD RL_VALUE_UBYTE 0 CM_u8_speed_kph 0 255 /end CHARACTERISTIC
/begin CHARACTERISTIC CAL_obd_ii_P0111_iat_agreement_tol "u8_tempdelta_5/8c" VALUE 0x4000D2AE RL_VALUE_UBYTE 0 CM_u8_tempdelta_5_8c 0 159.375 /end CHARACTERISTIC
/begin CHARACTERISTIC CAL_obd_ii_P0116_coolant_deviation_max "u8_tempdelta_5/8c" VALUE 0x4000D2AF RL_VALUE_UBYTE 0 CM_u8_tempdelta_5_8c 0 159.375 /end CHARACTERISTIC
/begin CHARACTERISTIC CAL_obd_ii_runtime_since_start_threshold_unknown "u16_time_5ms" VALUE 0x4000D2B0 RL_VALUE_UWORD 0 CM_u8_time_5ms 0 327675 /end CHARACTERISTIC
/begin CHARACTERISTIC CAL_obd_ii_temp_unknown "u8_temp_5/8-40c" VALUE 0x4000D2B2 RL_VALUE_UBYTE 0 CM_u8_temp_5_8_40c -40 119.375 /end CHARACTERISTIC
/begin CHARACTERISTIC CAL_obd_ii_temp_unknown2 "u8_temp_5/8-40c" VALUE 0x4000D2B3 RL_VALUE_UBYTE 0 CM_u8_temp_5_8_40c -40 119.375 /end CHARACTERISTIC
/begin CHARACTERISTIC CAL_obd_ii_P0116_min_runtime "uint16_t" VALUE 0x4000D2B8 RL_VALUE_UWORD 0 NO_COMPU_METHOD 0 65535 /end CHARACTERISTIC
/begin CHARACTERISTIC CAL_obd_ii_commanded_evap_purge_threshold "u16_factor_1/255" VALUE 0x4000D2C6 RL_VALUE_UWORD 0 CM_u8_factor_1_255 0 25700 /end CHARACTERISTIC
/begin CHARACTERISTIC CAL_obd_ii_evap_vapor_pressure_limit "i16_pressure_1/10mbar" VALUE 0x4000D2D4 RL_VALUE_SWORD 0 CM_i16_pressure_1_10mbar -3276.8 3276.7 /end CHARACTERISTIC
/begin CHARACTERISTIC CAL_obd_ii_commanded_evap_purge_limit "u16_factor_1/255" VALUE 0x4000D2E0 RL_VALUE_UWORD 0 CM_u8_factor_1_255 0 25700 /end CHARACTERISTIC
/begin CHARACTERISTIC CAL_obd_ii_commanded_evap_purge_limit_0 "u16_factor_1/255" VALUE 0x4000D2E2 RL_VALUE_UWORD 0 CM_u8_factor_1_255 0 25700 /end CHARACTERISTIC
/begin CHARACTERISTIC CAL_obd_ii_P0111_maf_low_band_hysteresis "u8_flow_200mg/s" VALUE 0x4000D2F0 RL_VALUE_UBYTE 0 CM_u8_flow_200mg_s 0 51000 /end CHARACTERISTIC
/begin CHARACTERISTIC CAL_obd_ii_P0128_start_coolant_max "u8_temp_5/8-40c" VALUE 0x4000D2F1 RL_VALUE_UBYTE 0 CM_u8_temp_5_8_40c -40 119.375 /end CHARACTERISTIC
/begin CHARACTERISTIC CAL_obd_ii_P0128_coolant_target "Calibration: cooling thermostat open. Tunable map/constant (not a live channel); log to confirm fans/pumps switch at the right temperatures. (deg C; raw*5/8-40)" VALUE 0x4000D2F2 RL_VALUE_UBYTE 0 CM_u8_temp_5_8_40c -40 119.375 /end CHARACTERISTIC
/begin CHARACTERISTIC CAL_obd_ii_P0128_start_coolant_min "u8_temp_5/8-40c" VALUE 0x4000D2F3 RL_VALUE_UBYTE 0 CM_u8_temp_5_8_40c -40 119.375 /end CHARACTERISTIC
/begin CHARACTERISTIC CAL_obd_ii_cat_unknown11 "u8_temp_5/8-40c" VALUE 0x4000D2F8 RL_VALUE_UBYTE 0 CM_u8_temp_5_8_40c -40 119.375 /end CHARACTERISTIC
/begin CHARACTERISTIC CAL_obd_ii_cat_unknown10 "u8_temp_5/8-40c" VALUE 0x4000D2F9 RL_VALUE_UBYTE 0 CM_u8_temp_5_8_40c -40 119.375 /end CHARACTERISTIC
/begin CHARACTERISTIC CAL_obd_ii_cat_unknown2 "u16_time_5ms" VALUE 0x4000D2FA RL_VALUE_UWORD 0 CM_u8_time_5ms 0 327675 /end CHARACTERISTIC
/begin CHARACTERISTIC CAL_obd_ii_cat_unknown3 "u16_pressure_mbar" VALUE 0x4000D2FC RL_VALUE_UWORD 0 CM_i16_pressure_mbar 0 65535 /end CHARACTERISTIC
/begin CHARACTERISTIC CAL_obd_ii_unknown5 "u8_temp_5/8-40c" VALUE 0x4000D2FE RL_VALUE_UBYTE 0 CM_u8_temp_5_8_40c -40 119.375 /end CHARACTERISTIC
/begin CHARACTERISTIC CAL_obd_ii_cat_cold_start_coolant_min "u8_temp_5/8-40c" VALUE 0x4000D2FF RL_VALUE_UBYTE 0 CM_u8_temp_5_8_40c -40 119.375 /end CHARACTERISTIC
/begin CHARACTERISTIC CAL_obd_ii_cat_unknown6 "u8_speed_kph" VALUE 0x4000D301 RL_VALUE_UBYTE 0 CM_u8_speed_kph 0 255 /end CHARACTERISTIC
/begin CHARACTERISTIC CAL_obd_ii_cat_unknown9 "u8_speed_kph" VALUE 0x4000D302 RL_VALUE_UBYTE 0 CM_u8_speed_kph 0 255 /end CHARACTERISTIC
/begin CHARACTERISTIC CAL_obd_ii_cat_monitor_coolant_min_above_iat "u8_tempdelta_5/8c" VALUE 0x4000D303 RL_VALUE_UBYTE 0 CM_u8_tempdelta_5_8c 0 159.375 /end CHARACTERISTIC
/begin CHARACTERISTIC CAL_obd_cat_monitor_init_counter_2 "u16_time_100ms" VALUE 0x4000D304 RL_VALUE_UWORD 0 CM_u8_time_100ms 0 6553500 /end CHARACTERISTIC
/begin CHARACTERISTIC CAL_obd_ii_cat_monitor_run_time_min "u16_time_100ms" VALUE 0x4000D306 RL_VALUE_UWORD 0 CM_u8_time_100ms 0 6553500 /end CHARACTERISTIC
/begin CHARACTERISTIC CAL_obd_ii_cat_monitor_window_time "u16_time_100ms" VALUE 0x4000D308 RL_VALUE_UWORD 0 CM_u8_time_100ms 0 6553500 /end CHARACTERISTIC
/begin CHARACTERISTIC CAL_obd_ii_cat_monitor_stable_time "u16_time_100ms" VALUE 0x4000D30A RL_VALUE_UWORD 0 CM_u8_time_100ms 0 6553500 /end CHARACTERISTIC
/begin CHARACTERISTIC CAL_obd_evap_stability_window_samples "u8_count" VALUE 0x4000D30C RL_VALUE_UBYTE 0 NO_COMPU_METHOD 0 255 /end CHARACTERISTIC
/begin CHARACTERISTIC CAL_obd_evap_entry_settle_delay "u8_time_100ms" VALUE 0x4000D30D RL_VALUE_UBYTE 0 CM_u8_time_100ms 0 25500 /end CHARACTERISTIC
/begin CHARACTERISTIC CAL_obd_ii_evap_refuel_level_rise_threshold "u8_volume_liter" VALUE 0x4000D30E RL_VALUE_UBYTE 0 CM_u8_volume_liter 0 255 /end CHARACTERISTIC
/begin CHARACTERISTIC CAL_obd_evap_fuel_level_noise_count_limit "u8_count" VALUE 0x4000D30F RL_VALUE_UBYTE 0 NO_COMPU_METHOD 0 255 /end CHARACTERISTIC
/begin CHARACTERISTIC CAL_obd_evap_pressure_noise_count_limit "u8_count" VALUE 0x4000D310 RL_VALUE_UBYTE 0 NO_COMPU_METHOD 0 255 /end CHARACTERISTIC
/begin CHARACTERISTIC CAL_obd_evap_fuel_level_noise_threshold "u8_volume_1/10gallon" VALUE 0x4000D311 RL_VALUE_UBYTE 0 CM_u8_volume_1_10gallon 0 25.5 /end CHARACTERISTIC
/begin CHARACTERISTIC CAL_obd_evap_pressure_noise_threshold "uint16_t" VALUE 0x4000D312 RL_VALUE_UWORD 0 NO_COMPU_METHOD 0 65535 /end CHARACTERISTIC
/begin CHARACTERISTIC CAL_obd_ac_load_diag_tolerance_pct "u8_factor_1/100" VALUE 0x4000D31C RL_VALUE_UBYTE 0 CM_u8_factor_1_100 0 255 /end CHARACTERISTIC
/begin CHARACTERISTIC CAL_obd_ii_P0451_pressure_swing_min "i16_pressure_1/10mbar" VALUE 0x4000D31E RL_VALUE_SWORD 0 CM_i16_pressure_1_10mbar -3276.8 3276.7 /end CHARACTERISTIC
/begin CHARACTERISTIC CAL_obd_ac_load_diag_rpm_min "u8_rspeed_50rpm" VALUE 0x4000D32D RL_VALUE_UBYTE 0 CM_u8_rspeed_50rpm 0 12750 /end CHARACTERISTIC
/begin CHARACTERISTIC CAL_obd_ii_P1422_fail_threshold "u8_count" VALUE 0x4000D32E RL_VALUE_UBYTE 0 NO_COMPU_METHOD 0 255 /end CHARACTERISTIC
/begin CHARACTERISTIC CAL_obd_ii_P0806_gear_changes_min "u8_count" VALUE 0x4000D32F RL_VALUE_UBYTE 0 NO_COMPU_METHOD 0 255 /end CHARACTERISTIC
/begin CHARACTERISTIC CAL_obd_ii_P0806_clutch_span_min "u16_voltage_5/1023v" VALUE 0x4000D330 RL_VALUE_UWORD 0 CM_u16_voltage_5_1023v 0 320.307917888563 /end CHARACTERISTIC
/begin CHARACTERISTIC CAL_clutch_pos_voltage_threshold "u16_voltage_5/1023v" VALUE 0x4000D332 RL_VALUE_UWORD 0 CM_u16_voltage_5_1023v 0 320.307917888563 /end CHARACTERISTIC
/begin CHARACTERISTIC CAL_obd_ii_P0806_clutch_voltage_max "u16_voltage_5/1023v" VALUE 0x4000D334 RL_VALUE_UWORD 0 CM_u16_voltage_5_1023v 0 320.307917888563 /end CHARACTERISTIC
/begin CHARACTERISTIC CAL_ac_evap_temp_voltage_low_threshold "u16_voltage_5/1023v" VALUE 0x4000D336 RL_VALUE_UWORD 0 CM_u16_voltage_5_1023v 0 320.307917888563 /end CHARACTERISTIC
/begin CHARACTERISTIC CAL_ac_evap_temp_voltage_high_threshold "u16_voltage_5/1023v" VALUE 0x4000D338 RL_VALUE_UWORD 0 CM_u16_voltage_5_1023v 0 320.307917888563 /end CHARACTERISTIC
/begin CHARACTERISTIC CAL_obd_ii_unknown7_4000D364 "uint8_t" VALUE 0x4000D364 RL_VALUE_UBYTE 0 NO_COMPU_METHOD 0 255 /end CHARACTERISTIC
/begin CHARACTERISTIC CAL_obd_ii_unknown6 "uint8_t" VALUE 0x4000D365 RL_VALUE_UBYTE 0 NO_COMPU_METHOD 0 255 /end CHARACTERISTIC
/begin CHARACTERISTIC CAL_obd_ii_coolant_rationality_count "u8_count" VALUE 0x4000D366 RL_VALUE_UBYTE 0 NO_COMPU_METHOD 0 255 /end CHARACTERISTIC
/begin CHARACTERISTIC CAL_obd_ii_coolant_rationality_holdoff_time "u8_time_100ms" VALUE 0x4000D367 RL_VALUE_UBYTE 0 CM_u8_time_100ms 0 25500 /end CHARACTERISTIC
/begin CHARACTERISTIC CAL_obd_ii_coolant_rationality_rpm_min "u16_rspeed_rpm" VALUE 0x4000D368 RL_VALUE_UWORD 0 CM_u8_rspeed_rpm 0 65535 /end CHARACTERISTIC
/begin CHARACTERISTIC CAL_obd_ii_P0111_maf_low_band "u8_flow_200mg/s" VALUE 0x4000D36C RL_VALUE_UBYTE 0 CM_u8_flow_200mg_s 0 51000 /end CHARACTERISTIC
/begin CHARACTERISTIC CAL_obd_ii_P0111_maf_high_band "u8_flow_200mg/s" VALUE 0x4000D36D RL_VALUE_UBYTE 0 CM_u8_flow_200mg_s 0 51000 /end CHARACTERISTIC
/begin CHARACTERISTIC CAL_obd_ii_P0111_maf_debounce_time "u8_time_100ms" VALUE 0x4000D36E RL_VALUE_UBYTE 0 CM_u8_time_100ms 0 25500 /end CHARACTERISTIC
/begin CHARACTERISTIC CAL_obd_ii_P0111_iat_span_min "u8_voltage_5/1023v" VALUE 0x4000D36F RL_VALUE_UBYTE 0 CM_u16_voltage_5_1023v 0 1.24633431085044 /end CHARACTERISTIC
/begin CHARACTERISTIC CAL_obd_ii_P0111_airflow_stage_time "u8_time_100ms" VALUE 0x4000D370 RL_VALUE_UBYTE 0 CM_u8_time_100ms 0 25500 /end CHARACTERISTIC
/begin CHARACTERISTIC CAL_obd_ii_P0111_high_airflow_time "u8_time_s" VALUE 0x4000D371 RL_VALUE_UBYTE 0 CM_u8_time_s 0 255 /end CHARACTERISTIC
/begin CHARACTERISTIC CAL_obd_ii_high_load_monitor_afr_max "u16_afr_1/100" VALUE 0x4000D372 RL_VALUE_UWORD 0 CM_u8_afr_1_100 0 655.35 /end CHARACTERISTIC
/begin CHARACTERISTIC CAL_obd_ii_P2191_lean_confirm_time "u8_time_100ms" VALUE 0x4000D374 RL_VALUE_UBYTE 0 CM_u8_time_100ms 0 25500 /end CHARACTERISTIC
/begin CHARACTERISTIC CAL_obd_ii_P2192_rich_confirm_time "u8_time_100ms" VALUE 0x4000D375 RL_VALUE_UBYTE 0 CM_u8_time_100ms 0 25500 /end CHARACTERISTIC
/begin CHARACTERISTIC CAL_obd_ii_high_load_monitor_load_min "u8_load_4mg/stroke" VALUE 0x4000D376 RL_VALUE_UBYTE 0 CM_u8_load_4mg_stroke 0 1020 /end CHARACTERISTIC
/begin CHARACTERISTIC CAL_obd_ii_drive_cycle_car_speed_min "u8_speed_kph" VALUE 0x4000D377 RL_VALUE_UBYTE 0 CM_u8_speed_kph 0 255 /end CHARACTERISTIC
/begin CHARACTERISTIC CAL_obd_ii_drive_cycle_idle_time "u16_time_100ms" VALUE 0x4000D378 RL_VALUE_UWORD 0 CM_u8_time_100ms 0 6553500 /end CHARACTERISTIC
/begin CHARACTERISTIC CAL_obd_ii_drive_cycle_runtime "u16_time_100ms" VALUE 0x4000D37A RL_VALUE_UWORD 0 CM_u8_time_100ms 0 6553500 /end CHARACTERISTIC
/begin CHARACTERISTIC CAL_obd_ii_gd_speed_time "u16_time_100ms" VALUE 0x4000D37C RL_VALUE_UWORD 0 CM_u8_time_100ms 0 6553500 /end CHARACTERISTIC
/begin CHARACTERISTIC CAL_obd_ii_monitor_rpm_delta_max "u16_rspeed_rpm" VALUE 0x4000D37E RL_VALUE_UWORD 0 CM_u8_rspeed_rpm 0 65535 /end CHARACTERISTIC
/begin CHARACTERISTIC CAL_obd_ii_unknown5_4000D381 "uint8_t" VALUE 0x4000D381 RL_VALUE_UBYTE 0 NO_COMPU_METHOD 0 255 /end CHARACTERISTIC
/begin CHARACTERISTIC CAL_obd_ii_evap_purge_settle_debounce "u8_time_100ms" VALUE 0x4000D383 RL_VALUE_UBYTE 0 CM_u8_time_100ms 0 25500 /end CHARACTERISTIC
/begin CHARACTERISTIC CAL_obd_ii_P0451_debounce_count "u8_count" VALUE 0x4000D385 RL_VALUE_UBYTE 0 NO_COMPU_METHOD 0 255 /end CHARACTERISTIC
/begin CHARACTERISTIC CAL_obd_ii_o2_period_consistency_tol "u8_time_5ms" VALUE 0x4000D388 RL_VALUE_UBYTE 0 CM_u8_time_5ms 0 1275 /end CHARACTERISTIC
/begin CHARACTERISTIC CAL_obd_ii_o2_imbalance_sample_count "u8_count" VALUE 0x4000D389 RL_VALUE_UBYTE 0 NO_COMPU_METHOD 0 255 /end CHARACTERISTIC
/begin CHARACTERISTIC CAL_obd_ii_o2_slow_response_maf_limit_unknown2 "u16_flow_10mg/s" VALUE 0x4000D38A RL_VALUE_UWORD 0 CM_u16_flow_10mg_s 0 655350 /end CHARACTERISTIC
/begin CHARACTERISTIC CAL_obd_ii_o2_precat_diag_init_counter "u16_time_5ms" VALUE 0x4000D38C RL_VALUE_UWORD 0 CM_u8_time_5ms 0 327675 /end CHARACTERISTIC
/begin CHARACTERISTIC CAL_obd_ii_o2_period_excess_max "u8_time_5ms" VALUE 0x4000D38E RL_VALUE_UBYTE 0 CM_u8_time_5ms 0 1275 /end CHARACTERISTIC
/begin CHARACTERISTIC CAL_obd_ii_o2_imbalance_accum_cap "u8_time_5ms" VALUE 0x4000D38F RL_VALUE_UBYTE 0 CM_u8_time_5ms 0 1275 /end CHARACTERISTIC
/begin CHARACTERISTIC CAL_obd_ii_cat_check_transient_blackout "u16_time_5ms" VALUE 0x4000D390 RL_VALUE_UWORD 0 CM_u8_time_5ms 0 327675 /end CHARACTERISTIC
/begin CHARACTERISTIC CAL_obd_ii_cat_check_tps_rate_max "u8_factor_1/1023" VALUE 0x4000D392 RL_VALUE_UBYTE 0 CM_u16_factor_1_1023 0 24.9266862170088 /end CHARACTERISTIC
/begin CHARACTERISTIC CAL_obd_ii_tps_unknown1 "u8_factor_1/255" VALUE 0x4000D393 RL_VALUE_UBYTE 0 CM_u8_factor_1_255 0 100 /end CHARACTERISTIC
/begin CHARACTERISTIC CAL_obd_ii_rpm_unknown1 "u16_rspeed_rpm" VALUE 0x4000D396 RL_VALUE_UWORD 0 CM_u8_rspeed_rpm 0 65535 /end CHARACTERISTIC
/begin CHARACTERISTIC CAL_obd_ii_o2_slow_response_maf_limit_unknown "u16_flow_10mg/s" VALUE 0x4000D398 RL_VALUE_UWORD 0 CM_u16_flow_10mg_s 0 655350 /end CHARACTERISTIC
/begin CHARACTERISTIC CAL_obd_o2_precat_diag_reset_counter "u16_time_5ms" VALUE 0x4000D39A RL_VALUE_UWORD 0 CM_u8_time_5ms 0 327675 /end CHARACTERISTIC
/begin CHARACTERISTIC CAL_obd_ii_P0579_switch_changes_max "u8_count" VALUE 0x4000D3A0 RL_VALUE_UBYTE 0 NO_COMPU_METHOD 0 255 /end CHARACTERISTIC
/begin CHARACTERISTIC CAL_obd_ii_P0579_window_time "switch-change count window, val*20 ticks at 200 Hz = 100 ms/count; stock 10 = 1 s. Was CAL_obd_ii_P0579_stuck_timeout" VALUE 0x4000D3A1 RL_VALUE_UBYTE 0 NO_COMPU_METHOD 0 255 /end CHARACTERISTIC
/begin CHARACTERISTIC CAL_clutch_sensor_confidence_max "uint16_t" VALUE 0x4000D3A2 RL_VALUE_UWORD 0 NO_COMPU_METHOD 0 65535 /end CHARACTERISTIC
/begin CHARACTERISTIC CAL_clutch_variance_threshold "uint8_t" VALUE 0x4000D3A4 RL_VALUE_UBYTE 0 NO_COMPU_METHOD 0 255 /end CHARACTERISTIC
/begin CHARACTERISTIC CAL_clutch_confidence_decrement "uint8_t" VALUE 0x4000D3A5 RL_VALUE_UBYTE 0 NO_COMPU_METHOD 0 255 /end CHARACTERISTIC
/begin CHARACTERISTIC CAL_clutch_confidence_increment "uint8_t" VALUE 0x4000D3A6 RL_VALUE_UBYTE 0 NO_COMPU_METHOD 0 255 /end CHARACTERISTIC
/begin CHARACTERISTIC CAL_obd_ii_P219A_imbalance_window_count "u8_count" VALUE 0x4000D3A7 RL_VALUE_UBYTE 0 NO_COMPU_METHOD 0 255 /end CHARACTERISTIC
/begin CHARACTERISTIC CAL_obd_ii_P219A_load_min "u16_load_mg/stroke" VALUE 0x4000D3A8 RL_VALUE_UWORD 0 CM_u16_load_mg_stroke 0 65535 /end CHARACTERISTIC
/begin CHARACTERISTIC CAL_obd_ii_P219A_load_max "u16_load_mg/stroke" VALUE 0x4000D3AA RL_VALUE_UWORD 0 CM_u16_load_mg_stroke 0 65535 /end CHARACTERISTIC
/begin CHARACTERISTIC CAL_obd_ii_P219A_rpm_min "u8_rspeed_125/4+500rpm" VALUE 0x4000D3AC RL_VALUE_UBYTE 0 CM_u8_rspeed_125_4_500rpm 500 8468.75 /end CHARACTERISTIC
/begin CHARACTERISTIC CAL_obd_ii_P219A_rpm_max "u8_rspeed_125/4+500rpm" VALUE 0x4000D3AD RL_VALUE_UBYTE 0 CM_u8_rspeed_125_4_500rpm 500 8468.75 /end CHARACTERISTIC
/begin CHARACTERISTIC CAL_obd_ii_P219A_maf_min "u16_flow_10mg/s" VALUE 0x4000D3AE RL_VALUE_UWORD 0 CM_u16_flow_10mg_s 0 655350 /end CHARACTERISTIC
/begin CHARACTERISTIC CAL_obd_ii_P219A_maf_max "u16_flow_10mg/s" VALUE 0x4000D3B0 RL_VALUE_UWORD 0 CM_u16_flow_10mg_s 0 655350 /end CHARACTERISTIC
/begin CHARACTERISTIC CAL_obd_fuel_learn_eng_speed_delta_max "u16_rspeed_rpm" VALUE 0x4000D3B2 RL_VALUE_UWORD 0 CM_u8_rspeed_rpm 0 65535 /end CHARACTERISTIC
/begin CHARACTERISTIC CAL_obd_ii_P219A_coolant_min "u8_temp_5/8-40c" VALUE 0x4000D3B4 RL_VALUE_UBYTE 0 CM_u8_temp_5_8_40c -40 119.375 /end CHARACTERISTIC
/begin CHARACTERISTIC CAL_obd_ii_fuel_learn_max_load_delta "u8_load_mg/stroke" VALUE 0x4000D3B5 RL_VALUE_UBYTE 0 CM_u16_load_mg_stroke 0 255 /end CHARACTERISTIC
/begin CHARACTERISTIC CAL_obd_ii_fuel_learn_inhibit_holdoff_ticks "u16_time_ms" VALUE 0x4000D3B6 RL_VALUE_UWORD 0 CM_u8_time_ms 0 65535 /end CHARACTERISTIC
/begin CHARACTERISTIC CAL_obd_ii_o2_imbalance_sample_count_4000D3B8 "uint16_t" VALUE 0x4000D3B8 RL_VALUE_UWORD 0 NO_COMPU_METHOD 0 65535 /end CHARACTERISTIC
/begin CHARACTERISTIC CAL_obd_ii_o2_imbalance_threshold "u16_factor_1/1000" VALUE 0x4000D3BA RL_VALUE_UWORD 0 CM_u16_factor_1_1000 0 6553.5 /end CHARACTERISTIC
/begin CHARACTERISTIC CAL_obd_ii_o2_imbalance_sample_period "u8_time_ms" VALUE 0x4000D3BC RL_VALUE_UBYTE 0 CM_u8_time_ms 0 255 /end CHARACTERISTIC
/begin CHARACTERISTIC CAL_obd_ii_P0101_idle_coolant_min "u8_temp_5/8-40c" VALUE 0x4000D3BD RL_VALUE_UBYTE 0 CM_u8_temp_5_8_40c -40 119.375 /end CHARACTERISTIC
/begin CHARACTERISTIC CAL_obd_ii_P0101_idle_dwell_min "u8_time_100ms" VALUE 0x4000D3BE RL_VALUE_UBYTE 0 CM_u8_time_100ms 0 25500 /end CHARACTERISTIC
/begin CHARACTERISTIC CAL_obd_ii_P0101_idle_iat_max "u8_temp_5/8-40c" VALUE 0x4000D3BF RL_VALUE_UBYTE 0 CM_u8_temp_5_8_40c -40 119.375 /end CHARACTERISTIC
/begin CHARACTERISTIC CAL_obd_ii_P0101_runtime_min "u8_time_s" VALUE 0x4000D3C0 RL_VALUE_UBYTE 0 CM_u8_time_s 0 255 /end CHARACTERISTIC
/begin CHARACTERISTIC CAL_obd_ii_P0101_load_tolerance_pct_idle "u8_factor_1/100" VALUE 0x4000D3C1 RL_VALUE_UBYTE 0 CM_u8_factor_1_100 0 255 /end CHARACTERISTIC
/begin CHARACTERISTIC CAL_obd_ii_P0101_baro_min "u16_pressure_mbar" VALUE 0x4000D3C2 RL_VALUE_UWORD 0 CM_i16_pressure_mbar 0 65535 /end CHARACTERISTIC
/begin CHARACTERISTIC CAL_obd_ii_P0101_plausibility_enable "bool" VALUE 0x4000D3C4 RL_VALUE_UBYTE 0 NO_COMPU_METHOD 0 255 /end CHARACTERISTIC
/begin CHARACTERISTIC CAL_obd_ii_knock_no_activity_count "uint8_t" VALUE 0x4000D3C5 RL_VALUE_UBYTE 0 NO_COMPU_METHOD 0 255 /end CHARACTERISTIC
/begin CHARACTERISTIC CAL_obd_ii_knock_monitor_sample_count "u16_time_100ms" VALUE 0x4000D3C6 RL_VALUE_UWORD 0 CM_u8_time_100ms 0 6553500 /end CHARACTERISTIC
/begin CHARACTERISTIC CAL_can_yaw_timeout "u8_time_5ms" VALUE 0x4000D3CE RL_VALUE_UBYTE 0 CM_u8_time_5ms 0 1275 /end CHARACTERISTIC
/begin CHARACTERISTIC CAL_can_lat_accel_standstill_timeout "u8_time_100ms" VALUE 0x4000D3CF RL_VALUE_UBYTE 0 CM_u8_time_100ms 0 25500 /end CHARACTERISTIC
/begin CHARACTERISTIC CAL_can_yaw_data_timeout "u8_time_5ms" VALUE 0x4000D3D0 RL_VALUE_UBYTE 0 CM_u8_time_5ms 0 1275 /end CHARACTERISTIC
/begin CHARACTERISTIC CAL_can_yaw_monitor_startup_delay "u8_time_s" VALUE 0x4000D3D3 RL_VALUE_UBYTE 0 CM_u8_time_s 0 255 /end CHARACTERISTIC
/begin CHARACTERISTIC CAL_gsi_rpm_per_kph_ips "Calibration: slip gear speed ratios IPS. Tunable map/constant (not a live channel); log to see wheel slip and traction-control intervention." VAL_BLK 0x4000D3D4 RL_VALUE_UWORD 0 NO_COMPU_METHOD 0 65535 NUMBER 6 /end CHARACTERISTIC
/begin CHARACTERISTIC CAL_gsi_rpm_per_kph_close_ratio "Calibration: slip gear speed ratios cr. Tunable map/constant (not a live channel); log to see wheel slip and traction-control intervention." VAL_BLK 0x4000D3E0 RL_VALUE_UWORD 0 NO_COMPU_METHOD 0 65535 NUMBER 6 /end CHARACTERISTIC
/begin CHARACTERISTIC CAL_gsi_rpm_per_kph_standard "Calibration: slip gear speed ratios long. Tunable map/constant (not a live channel); log to see wheel slip and traction-control intervention." VAL_BLK 0x4000D3EC RL_VALUE_UWORD 0 NO_COMPU_METHOD 0 65535 NUMBER 6 /end CHARACTERISTIC
/begin CHARACTERISTIC CAL_gear_advisory_upshift_rpm_gear1 "u8_rspeed_4+500rpm" VALUE 0x4000D3F8 RL_VALUE_UBYTE 0 CM_u8_rspeed_4_500rpm 500 1520 /end CHARACTERISTIC
/begin CHARACTERISTIC CAL_gear_advisory_upshift_rpm_manual "Calibration: slip threshold per gear manual. Tunable map/constant (not a live channel); log to see wheel slip and traction-control intervention. (RPM; raw*4+500)" VAL_BLK 0x4000D3F9 RL_VALUE_UBYTE 0 CM_u8_rspeed_4_500rpm 500 1520 NUMBER 5 /end CHARACTERISTIC
/begin CHARACTERISTIC CAL_gear_advisory_upshift_rpm_ips "Calibration: slip slip threshold per gear IPS. Tunable map/constant (not a live channel); log to see wheel slip and traction-control intervention. (RPM; raw*4+500)" VAL_BLK 0x4000D3FE RL_VALUE_UBYTE 0 CM_u8_rspeed_4_500rpm 500 1520 NUMBER 5 /end CHARACTERISTIC
/begin CHARACTERISTIC CAL_cluster_gear_advisory_lamp_type "Calibration: slip detect mode. Tunable map/constant (not a live channel); log to see wheel slip and traction-control intervention." VALUE 0x4000D403 RL_VALUE_UBYTE 0 NO_COMPU_METHOD 0 255 /end CHARACTERISTIC
/begin CHARACTERISTIC CAL_gsi_pedal_applied_threshold "u16_factor_1/1023" VALUE 0x4000D404 RL_VALUE_UWORD 0 CM_u16_factor_1_1023 0 6406.15835777126 /end CHARACTERISTIC
/begin CHARACTERISTIC CAL_gsi_steering_angle_inhibit "Calibration: slip steering limit. Tunable map/constant (not a live channel); log to see wheel slip and traction-control intervention. (deg; raw/10)" VALUE 0x4000D406 RL_VALUE_UWORD 0 CM_u16_angle_1_10deg 0 6553.5 /end CHARACTERISTIC
/begin CHARACTERISTIC CAL_gsi_max_gear_rpm "uint16_t" VALUE 0x4000D408 RL_VALUE_UWORD 0 NO_COMPU_METHOD 0 65535 /end CHARACTERISTIC
/begin CHARACTERISTIC CAL_gsi_speed_offset_kph "uint8_t" VALUE 0x4000D40A RL_VALUE_UBYTE 0 NO_COMPU_METHOD 0 255 /end CHARACTERISTIC
/begin CHARACTERISTIC CAL_gsi_upshift_delay "Calibration: slip timer per gear intervention. Tunable map/constant (not a live channel); log to see wheel slip and traction-control intervention." VALUE 0x4000D40C RL_VALUE_UBYTE 0 NO_COMPU_METHOD 0 255 /end CHARACTERISTIC
/begin CHARACTERISTIC CAL_gsi_cornering_inhibit_threshold "uint8_t" VALUE 0x4000D40D RL_VALUE_UBYTE 0 NO_COMPU_METHOD 0 255 /end CHARACTERISTIC
/begin CHARACTERISTIC CAL_gsi_cornering_inhibit_hysteresis "uint8_t" VALUE 0x4000D40E RL_VALUE_UBYTE 0 NO_COMPU_METHOD 0 255 /end CHARACTERISTIC
/begin CHARACTERISTIC CAL_gsi_steering_rate_term_max "uint8_t" VALUE 0x4000D410 RL_VALUE_UBYTE 0 NO_COMPU_METHOD 0 255 /end CHARACTERISTIC
/begin CHARACTERISTIC CAL_gsi_steering_rate_filter_coeff "uint8_t" VALUE 0x4000D411 RL_VALUE_UBYTE 0 NO_COMPU_METHOD 0 255 /end CHARACTERISTIC
/begin CHARACTERISTIC CAL_gsi_pedal_applied_hold_time "uint8_t" VALUE 0x4000D412 RL_VALUE_UBYTE 0 NO_COMPU_METHOD 0 255 /end CHARACTERISTIC
/begin CHARACTERISTIC CAL_gsi_downshift_idle_margin "uint8_t" VALUE 0x4000D413 RL_VALUE_UBYTE 0 NO_COMPU_METHOD 0 255 /end CHARACTERISTIC
/begin CHARACTERISTIC CAL_gsi_downshift_rpm_offset "uint8_t" VALUE 0x4000D414 RL_VALUE_UBYTE 0 NO_COMPU_METHOD 0 255 /end CHARACTERISTIC
/begin CHARACTERISTIC CAL_gsi_downshift_delay "uint8_t" VALUE 0x4000D415 RL_VALUE_UBYTE 0 NO_COMPU_METHOD 0 255 /end CHARACTERISTIC
/begin CHARACTERISTIC CAL_gsi_max_gear_step "uint8_t" VALUE 0x4000D416 RL_VALUE_UBYTE 0 NO_COMPU_METHOD 0 255 /end CHARACTERISTIC
/begin CHARACTERISTIC CAL_gsi_max_gear_step_4000D418 "uint8_t" VALUE 0x4000D418 RL_VALUE_UBYTE 0 NO_COMPU_METHOD 0 255 /end CHARACTERISTIC
/begin CHARACTERISTIC CAL_gsi_gear1_drive_away_speed "u8_speed_kph" VALUE 0x4000D419 RL_VALUE_UBYTE 0 CM_u8_speed_kph 0 255 /end CHARACTERISTIC
/begin CHARACTERISTIC CAL_obd_ii_P0106 "Calibration that arms/thresholds the P0106 monitor (MAP/baro rationality). Fixed value -- it sets when that DTC trips, not a live channel." VALUE 0x4000D97D RL_VALUE_UBYTE 0 NO_COMPU_METHOD 0 255 /end CHARACTERISTIC
/begin CHARACTERISTIC CAL_obd_ii_P0107 "Calibration that arms/thresholds the P0107 monitor (MAP/baro circuit low). Fixed value -- it sets when that DTC trips, not a live channel." VALUE 0x4000D97E RL_VALUE_UBYTE 0 NO_COMPU_METHOD 0 255 /end CHARACTERISTIC
/begin CHARACTERISTIC CAL_obd_ii_P0108 "Calibration that arms/thresholds the P0108 monitor (MAP/baro circuit high). Fixed value -- it sets when that DTC trips, not a live channel." VALUE 0x4000D97F RL_VALUE_UBYTE 0 NO_COMPU_METHOD 0 255 /end CHARACTERISTIC
/begin CHARACTERISTIC CAL_obd_ii_P0111 "Calibration that arms/thresholds the P0111 monitor (IAT rationality). Fixed value -- it sets when that DTC trips, not a live channel." VALUE 0x4000D981 RL_VALUE_UBYTE 0 NO_COMPU_METHOD 0 255 /end CHARACTERISTIC
/begin CHARACTERISTIC CAL_obd_ii_P0112 "Calibration that arms/thresholds the P0112 monitor (IAT circuit low). Fixed value -- it sets when that DTC trips, not a live channel." VALUE 0x4000D982 RL_VALUE_UBYTE 0 NO_COMPU_METHOD 0 255 /end CHARACTERISTIC
/begin CHARACTERISTIC CAL_obd_ii_P0113 "Calibration that arms/thresholds the P0113 monitor (IAT circuit high). Fixed value -- it sets when that DTC trips, not a live channel." VALUE 0x4000D983 RL_VALUE_UBYTE 0 NO_COMPU_METHOD 0 255 /end CHARACTERISTIC
/begin CHARACTERISTIC CAL_obd_ii_P0071 "Calibration that arms/thresholds the P0071 monitor (ambient air temp sensor rationality). Fixed value -- it sets when that DTC trips, not a live channel." VALUE 0x4000D984 RL_VALUE_UBYTE 0 NO_COMPU_METHOD 0 255 /end CHARACTERISTIC
/begin CHARACTERISTIC CAL_obd_ii_P0116 "Calibration that arms/thresholds the P0116 monitor (coolant-temp rationality). Fixed value -- it sets when that DTC trips, not a live channel." VALUE 0x4000D985 RL_VALUE_UBYTE 0 NO_COMPU_METHOD 0 255 /end CHARACTERISTIC
/begin CHARACTERISTIC CAL_obd_ii_P0117 "Calibration that arms/thresholds the P0117 monitor (coolant-temp circuit low). Fixed value -- it sets when that DTC trips, not a live channel." VALUE 0x4000D986 RL_VALUE_UBYTE 0 NO_COMPU_METHOD 0 255 /end CHARACTERISTIC
/begin CHARACTERISTIC CAL_obd_ii_P0118 "Calibration that arms/thresholds the P0118 monitor (coolant-temp circuit high). Fixed value -- it sets when that DTC trips, not a live channel." VALUE 0x4000D987 RL_VALUE_UBYTE 0 NO_COMPU_METHOD 0 255 /end CHARACTERISTIC
/begin CHARACTERISTIC CAL_obd_ii_P2170 "Calibration that arms/thresholds the P2170 monitor (exhaust bypass valve stuck). Fixed value -- it sets when that DTC trips, not a live channel." VALUE 0x4000D988 RL_VALUE_UBYTE 0 NO_COMPU_METHOD 0 255 /end CHARACTERISTIC
/begin CHARACTERISTIC CAL_obd_ii_P2171 "Calibration that arms/thresholds the P2171 monitor (exhaust bypass valve). Fixed value -- it sets when that DTC trips, not a live channel." VALUE 0x4000D989 RL_VALUE_UBYTE 0 NO_COMPU_METHOD 0 255 /end CHARACTERISTIC
/begin CHARACTERISTIC CAL_obd_ii_P0122 "Calibration that arms/thresholds the P0122 monitor (TPS/pedal A circuit low). Fixed value -- it sets when that DTC trips, not a live channel." VALUE 0x4000D98A RL_VALUE_UBYTE 0 NO_COMPU_METHOD 0 255 /end CHARACTERISTIC
/begin CHARACTERISTIC CAL_obd_ii_P0123 "Calibration that arms/thresholds the P0123 monitor (TPS/pedal A circuit high). Fixed value -- it sets when that DTC trips, not a live channel." VALUE 0x4000D98B RL_VALUE_UBYTE 0 NO_COMPU_METHOD 0 255 /end CHARACTERISTIC
/begin CHARACTERISTIC CAL_obd_ii_P2191 "Calibration that arms/thresholds the P2191 monitor (bank1 lean at load). Fixed value -- it sets when that DTC trips, not a live channel." VALUE 0x4000D98C RL_VALUE_UBYTE 0 NO_COMPU_METHOD 0 255 /end CHARACTERISTIC
/begin CHARACTERISTIC CAL_obd_ii_P0128 "Calibration that arms/thresholds the P0128 monitor (coolant below thermostat regulating temp). Fixed value -- it sets when that DTC trips, not a live channel." VALUE 0x4000D98D RL_VALUE_UBYTE 0 NO_COMPU_METHOD 0 255 /end CHARACTERISTIC
/begin CHARACTERISTIC CAL_obd_ii_P0131 "Calibration that arms/thresholds the P0131 monitor (O2 B1S1 low). Fixed value -- it sets when that DTC trips, not a live channel." VALUE 0x4000D98E RL_VALUE_UBYTE 0 NO_COMPU_METHOD 0 255 /end CHARACTERISTIC
/begin CHARACTERISTIC CAL_obd_ii_P0132 "Calibration that arms/thresholds the P0132 monitor (O2 B1S1 high). Fixed value -- it sets when that DTC trips, not a live channel." VALUE 0x4000D98F RL_VALUE_UBYTE 0 NO_COMPU_METHOD 0 255 /end CHARACTERISTIC
/begin CHARACTERISTIC CAL_obd_ii_P0133 "Calibration that arms/thresholds the P0133 monitor (O2 B1S1 slow response). Fixed value -- it sets when that DTC trips, not a live channel." VALUE 0x4000D990 RL_VALUE_UBYTE 0 NO_COMPU_METHOD 0 255 /end CHARACTERISTIC
/begin CHARACTERISTIC CAL_obd_ii_P0134 "Calibration that arms/thresholds the P0134 monitor (O2 B1S1 inactive). Fixed value -- it sets when that DTC trips, not a live channel." VALUE 0x4000D991 RL_VALUE_UBYTE 0 NO_COMPU_METHOD 0 255 /end CHARACTERISTIC
/begin CHARACTERISTIC CAL_obd_ii_P0135 "Calibration that arms/thresholds the P0135 monitor (O2 B1S1 heater). Fixed value -- it sets when that DTC trips, not a live channel." VALUE 0x4000D992 RL_VALUE_UBYTE 0 NO_COMPU_METHOD 0 255 /end CHARACTERISTIC
/begin CHARACTERISTIC CAL_obd_ii_P2193 "Calibration that arms/thresholds the P2193 monitor (bank2 lean at load). Fixed value -- it sets when that DTC trips, not a live channel." VALUE 0x4000D993 RL_VALUE_UBYTE 0 NO_COMPU_METHOD 0 255 /end CHARACTERISTIC
/begin CHARACTERISTIC CAL_obd_ii_P0137 "Calibration that arms/thresholds the P0137 monitor (O2 B1S2 low). Fixed value -- it sets when that DTC trips, not a live channel." VALUE 0x4000D994 RL_VALUE_UBYTE 0 NO_COMPU_METHOD 0 255 /end CHARACTERISTIC
/begin CHARACTERISTIC CAL_obd_ii_P0138 "Calibration that arms/thresholds the P0138 monitor (O2 B1S2 high). Fixed value -- it sets when that DTC trips, not a live channel." VALUE 0x4000D995 RL_VALUE_UBYTE 0 NO_COMPU_METHOD 0 255 /end CHARACTERISTIC
/begin CHARACTERISTIC CAL_obd_ii_P0139 "Calibration that arms/thresholds the P0139 monitor (O2 B1S2 slow response). Fixed value -- it sets when that DTC trips, not a live channel." VALUE 0x4000D996 RL_VALUE_UBYTE 0 NO_COMPU_METHOD 0 255 /end CHARACTERISTIC
/begin CHARACTERISTIC CAL_obd_ii_P0140 "Calibration that arms/thresholds the P0140 monitor (O2 B1S2 inactive). Fixed value -- it sets when that DTC trips, not a live channel." VALUE 0x4000D997 RL_VALUE_UBYTE 0 NO_COMPU_METHOD 0 255 /end CHARACTERISTIC
/begin CHARACTERISTIC CAL_obd_ii_P0141 "Calibration that arms/thresholds the P0141 monitor (O2 B1S2 heater). Fixed value -- it sets when that DTC trips, not a live channel." VALUE 0x4000D998 RL_VALUE_UBYTE 0 NO_COMPU_METHOD 0 255 /end CHARACTERISTIC
/begin CHARACTERISTIC CAL_obd_ii_P0102 "Calibration that arms/thresholds the P0102 monitor (MAF circuit low). Fixed value -- it sets when that DTC trips, not a live channel." VALUE 0x4000D999 RL_VALUE_UBYTE 0 NO_COMPU_METHOD 0 255 /end CHARACTERISTIC
/begin CHARACTERISTIC CAL_obd_ii_P0103 "Calibration that arms/thresholds the P0103 monitor (MAF circuit high). Fixed value -- it sets when that DTC trips, not a live channel." VALUE 0x4000D99A RL_VALUE_UBYTE 0 NO_COMPU_METHOD 0 255 /end CHARACTERISTIC
/begin CHARACTERISTIC CAL_obd_ii_P0101 "Calibration that arms/thresholds the P0101 monitor (MAF rationality). Fixed value -- it sets when that DTC trips, not a live channel." VALUE 0x4000D99B RL_VALUE_UBYTE 0 NO_COMPU_METHOD 0 255 /end CHARACTERISTIC
/begin CHARACTERISTIC CAL_obd_ii_P2122 "Calibration that arms/thresholds the P2122 monitor (pedal D low). Fixed value -- it sets when that DTC trips, not a live channel." VALUE 0x4000D99C RL_VALUE_UBYTE 0 NO_COMPU_METHOD 0 255 /end CHARACTERISTIC
/begin CHARACTERISTIC CAL_obd_ii_P2123 "Calibration that arms/thresholds the P2123 monitor (pedal D high). Fixed value -- it sets when that DTC trips, not a live channel." VALUE 0x4000D99D RL_VALUE_UBYTE 0 NO_COMPU_METHOD 0 255 /end CHARACTERISTIC
/begin CHARACTERISTIC CAL_obd_ii_P2127 "Calibration that arms/thresholds the P2127 monitor (pedal E low). Fixed value -- it sets when that DTC trips, not a live channel." VALUE 0x4000D99E RL_VALUE_UBYTE 0 NO_COMPU_METHOD 0 255 /end CHARACTERISTIC
/begin CHARACTERISTIC CAL_obd_ii_P2128 "Calibration that arms/thresholds the P2128 monitor (pedal E high). Fixed value -- it sets when that DTC trips, not a live channel." VALUE 0x4000D99F RL_VALUE_UBYTE 0 NO_COMPU_METHOD 0 255 /end CHARACTERISTIC
/begin CHARACTERISTIC CAL_obd_ii_P0222 "Calibration that arms/thresholds the P0222 monitor (TPS/pedal B circuit low). Fixed value -- it sets when that DTC trips, not a live channel." VALUE 0x4000D9A0 RL_VALUE_UBYTE 0 NO_COMPU_METHOD 0 255 /end CHARACTERISTIC
/begin CHARACTERISTIC CAL_obd_ii_P0223 "Calibration that arms/thresholds the P0223 monitor (TPS/pedal B circuit high). Fixed value -- it sets when that DTC trips, not a live channel." VALUE 0x4000D9A1 RL_VALUE_UBYTE 0 NO_COMPU_METHOD 0 255 /end CHARACTERISTIC
/begin CHARACTERISTIC CAL_obd_ii_P2135 "Calibration that arms/thresholds the P2135 monitor (TPS A/B correlation). Fixed value -- it sets when that DTC trips, not a live channel." VALUE 0x4000D9A2 RL_VALUE_UBYTE 0 NO_COMPU_METHOD 0 255 /end CHARACTERISTIC
/begin CHARACTERISTIC CAL_obd_ii_P0638 "Calibration that arms/thresholds the P0638 monitor (throttle actuator control rationality bank1). Fixed value -- it sets when that DTC trips, not a live channel." VALUE 0x4000D9A3 RL_VALUE_UBYTE 0 NO_COMPU_METHOD 0 255 /end CHARACTERISTIC
/begin CHARACTERISTIC CAL_obd_ii_P2119 "Calibration that arms/thresholds the P2119 monitor (throttle body rationality). Fixed value -- it sets when that DTC trips, not a live channel." VALUE 0x4000D9A4 RL_VALUE_UBYTE 0 NO_COMPU_METHOD 0 255 /end CHARACTERISTIC
/begin CHARACTERISTIC CAL_obd_ii_P1106 "Calibration that arms/thresholds the P1106 monitor (mfr MAP/baro intermittent). Fixed value -- it sets when that DTC trips, not a live channel." VALUE 0x4000D9A5 RL_VALUE_UBYTE 0 NO_COMPU_METHOD 0 255 /end CHARACTERISTIC
/begin CHARACTERISTIC CAL_obd_ii_P0171 "Calibration that arms/thresholds the P0171 monitor (bank1 too lean). Fixed value -- it sets when that DTC trips, not a live channel." VALUE 0x4000D9A6 RL_VALUE_UBYTE 0 NO_COMPU_METHOD 0 255 /end CHARACTERISTIC
/begin CHARACTERISTIC CAL_obd_ii_P0172 "Calibration that arms/thresholds the P0172 monitor (bank1 too rich). Fixed value -- it sets when that DTC trips, not a live channel." VALUE 0x4000D9A7 RL_VALUE_UBYTE 0 NO_COMPU_METHOD 0 255 /end CHARACTERISTIC
/begin CHARACTERISTIC CAL_obd_ii_P0076 "Calibration that arms/thresholds the P0076 monitor (intake VVT solenoid bank1 low). Fixed value -- it sets when that DTC trips, not a live channel." VALUE 0x4000D9A9 RL_VALUE_UBYTE 0 NO_COMPU_METHOD 0 255 /end CHARACTERISTIC
/begin CHARACTERISTIC CAL_obd_ii_P0077 "Calibration that arms/thresholds the P0077 monitor (intake VVT solenoid bank1 high). Fixed value -- it sets when that DTC trips, not a live channel." VALUE 0x4000D9AA RL_VALUE_UBYTE 0 NO_COMPU_METHOD 0 255 /end CHARACTERISTIC
/begin CHARACTERISTIC CAL_obd_ii_P0261 "Calibration that arms/thresholds the P0261 monitor (injector cyl1 low). Fixed value -- it sets when that DTC trips, not a live channel." VALUE 0x4000D9AB RL_VALUE_UBYTE 0 NO_COMPU_METHOD 0 255 /end CHARACTERISTIC
/begin CHARACTERISTIC CAL_obd_ii_P0262 "Calibration that arms/thresholds the P0262 monitor (injector cyl1 high). Fixed value -- it sets when that DTC trips, not a live channel." VALUE 0x4000D9AC RL_VALUE_UBYTE 0 NO_COMPU_METHOD 0 255 /end CHARACTERISTIC
/begin CHARACTERISTIC CAL_obd_ii_P0264 "Calibration that arms/thresholds the P0264 monitor (injector cyl2 low). Fixed value -- it sets when that DTC trips, not a live channel." VALUE 0x4000D9AD RL_VALUE_UBYTE 0 NO_COMPU_METHOD 0 255 /end CHARACTERISTIC
/begin CHARACTERISTIC CAL_obd_ii_P0265 "Calibration that arms/thresholds the P0265 monitor (injector cyl2 high). Fixed value -- it sets when that DTC trips, not a live channel." VALUE 0x4000D9AE RL_VALUE_UBYTE 0 NO_COMPU_METHOD 0 255 /end CHARACTERISTIC
/begin CHARACTERISTIC CAL_obd_ii_P0267 "Calibration that arms/thresholds the P0267 monitor (injector cyl3 low). Fixed value -- it sets when that DTC trips, not a live channel." VALUE 0x4000D9AF RL_VALUE_UBYTE 0 NO_COMPU_METHOD 0 255 /end CHARACTERISTIC
/begin CHARACTERISTIC CAL_obd_ii_P0268 "Calibration that arms/thresholds the P0268 monitor (injector cyl3 high). Fixed value -- it sets when that DTC trips, not a live channel." VALUE 0x4000D9B0 RL_VALUE_UBYTE 0 NO_COMPU_METHOD 0 255 /end CHARACTERISTIC
/begin CHARACTERISTIC CAL_obd_ii_P0270 "Calibration that arms/thresholds the P0270 monitor (injector cyl4 low). Fixed value -- it sets when that DTC trips, not a live channel." VALUE 0x4000D9B1 RL_VALUE_UBYTE 0 NO_COMPU_METHOD 0 255 /end CHARACTERISTIC
/begin CHARACTERISTIC CAL_obd_ii_P0271 "Calibration that arms/thresholds the P0271 monitor (injector cyl4 high). Fixed value -- it sets when that DTC trips, not a live channel." VALUE 0x4000D9B2 RL_VALUE_UBYTE 0 NO_COMPU_METHOD 0 255 /end CHARACTERISTIC
/begin CHARACTERISTIC CAL_obd_ii_P0273 "Calibration that arms/thresholds the P0273 monitor (injector cyl5 low). Fixed value -- it sets when that DTC trips, not a live channel." VALUE 0x4000D9B3 RL_VALUE_UBYTE 0 NO_COMPU_METHOD 0 255 /end CHARACTERISTIC
/begin CHARACTERISTIC CAL_obd_ii_P0274 "Calibration that arms/thresholds the P0274 monitor (injector cyl5 high). Fixed value -- it sets when that DTC trips, not a live channel." VALUE 0x4000D9B4 RL_VALUE_UBYTE 0 NO_COMPU_METHOD 0 255 /end CHARACTERISTIC
/begin CHARACTERISTIC CAL_obd_ii_P0276 "Calibration that arms/thresholds the P0276 monitor (injector cyl6 low). Fixed value -- it sets when that DTC trips, not a live channel." VALUE 0x4000D9B5 RL_VALUE_UBYTE 0 NO_COMPU_METHOD 0 255 /end CHARACTERISTIC
/begin CHARACTERISTIC CAL_obd_ii_P0277 "Calibration that arms/thresholds the P0277 monitor (injector cyl6 high). Fixed value -- it sets when that DTC trips, not a live channel." VALUE 0x4000D9B6 RL_VALUE_UBYTE 0 NO_COMPU_METHOD 0 255 /end CHARACTERISTIC
/begin CHARACTERISTIC CAL_obd_ii_P0628 "Calibration that arms/thresholds the P0628 monitor (fuel pump control low). Fixed value -- it sets when that DTC trips, not a live channel." VALUE 0x4000D9B7 RL_VALUE_UBYTE 0 NO_COMPU_METHOD 0 255 /end CHARACTERISTIC
/begin CHARACTERISTIC CAL_obd_ii_P0351 "Calibration that arms/thresholds the P0351 monitor (ignition coil 1). Fixed value -- it sets when that DTC trips, not a live channel." VALUE 0x4000D9B8 RL_VALUE_UBYTE 0 NO_COMPU_METHOD 0 255 /end CHARACTERISTIC
/begin CHARACTERISTIC CAL_obd_ii_P0352 "Calibration that arms/thresholds the P0352 monitor (ignition coil 2). Fixed value -- it sets when that DTC trips, not a live channel." VALUE 0x4000D9B9 RL_VALUE_UBYTE 0 NO_COMPU_METHOD 0 255 /end CHARACTERISTIC
/begin CHARACTERISTIC CAL_obd_ii_P0353 "Calibration that arms/thresholds the P0353 monitor (ignition coil 3). Fixed value -- it sets when that DTC trips, not a live channel." VALUE 0x4000D9BA RL_VALUE_UBYTE 0 NO_COMPU_METHOD 0 255 /end CHARACTERISTIC
/begin CHARACTERISTIC CAL_obd_ii_P0354 "Calibration that arms/thresholds the P0354 monitor (ignition coil 4). Fixed value -- it sets when that DTC trips, not a live channel." VALUE 0x4000D9BB RL_VALUE_UBYTE 0 NO_COMPU_METHOD 0 255 /end CHARACTERISTIC
/begin CHARACTERISTIC CAL_obd_ii_P0629 "Calibration that arms/thresholds the P0629 monitor (fuel pump control high). Fixed value -- it sets when that DTC trips, not a live channel." VALUE 0x4000D9BC RL_VALUE_UBYTE 0 NO_COMPU_METHOD 0 255 /end CHARACTERISTIC
/begin CHARACTERISTIC CAL_obd_ii_P0300 "Calibration that arms/thresholds the P0300 monitor (random/multiple misfire). Fixed value -- it sets when that DTC trips, not a live channel." VALUE 0x4000D9BD RL_VALUE_UBYTE 0 NO_COMPU_METHOD 0 255 /end CHARACTERISTIC
/begin CHARACTERISTIC CAL_obd_ii_P0301 "Calibration that arms/thresholds the P0301 monitor (cyl1 misfire). Fixed value -- it sets when that DTC trips, not a live channel." VALUE 0x4000D9BE RL_VALUE_UBYTE 0 NO_COMPU_METHOD 0 255 /end CHARACTERISTIC
/begin CHARACTERISTIC CAL_obd_ii_P0302 "Calibration that arms/thresholds the P0302 monitor (cyl2 misfire). Fixed value -- it sets when that DTC trips, not a live channel." VALUE 0x4000D9BF RL_VALUE_UBYTE 0 NO_COMPU_METHOD 0 255 /end CHARACTERISTIC
/begin CHARACTERISTIC CAL_obd_ii_P0303 "Calibration that arms/thresholds the P0303 monitor (cyl3 misfire). Fixed value -- it sets when that DTC trips, not a live channel." VALUE 0x4000D9C0 RL_VALUE_UBYTE 0 NO_COMPU_METHOD 0 255 /end CHARACTERISTIC
/begin CHARACTERISTIC CAL_obd_ii_P0304 "Calibration that arms/thresholds the P0304 monitor (cyl4 misfire). Fixed value -- it sets when that DTC trips, not a live channel." VALUE 0x4000D9C1 RL_VALUE_UBYTE 0 NO_COMPU_METHOD 0 255 /end CHARACTERISTIC
/begin CHARACTERISTIC CAL_obd_ii_P0305 "Calibration that arms/thresholds the P0305 monitor (cyl5 misfire). Fixed value -- it sets when that DTC trips, not a live channel." VALUE 0x4000D9C2 RL_VALUE_UBYTE 0 NO_COMPU_METHOD 0 255 /end CHARACTERISTIC
/begin CHARACTERISTIC CAL_obd_ii_P0306 "Calibration that arms/thresholds the P0306 monitor (cyl6 misfire). Fixed value -- it sets when that DTC trips, not a live channel." VALUE 0x4000D9C3 RL_VALUE_UBYTE 0 NO_COMPU_METHOD 0 255 /end CHARACTERISTIC
/begin CHARACTERISTIC CAL_obd_ii_P0700 "Calibration that arms/thresholds the P0700 monitor (transmission MIL request). Fixed value -- it sets when that DTC trips, not a live channel." VALUE 0x4000D9C4 RL_VALUE_UBYTE 0 NO_COMPU_METHOD 0 255 /end CHARACTERISTIC
/begin CHARACTERISTIC CAL_obd_ii_P0571 "Calibration that arms/thresholds the P0571 monitor (brake switch). Fixed value -- it sets when that DTC trips, not a live channel." VALUE 0x4000D9C5 RL_VALUE_UBYTE 0 NO_COMPU_METHOD 0 255 /end CHARACTERISTIC
/begin CHARACTERISTIC CAL_obd_ii_P0327 "Calibration that arms/thresholds the P0327 monitor (knock sensor1 low). Fixed value -- it sets when that DTC trips, not a live channel." VALUE 0x4000D9C6 RL_VALUE_UBYTE 0 NO_COMPU_METHOD 0 255 /end CHARACTERISTIC
/begin CHARACTERISTIC CAL_obd_ii_P0328 "Calibration that arms/thresholds the P0328 monitor (knock sensor1 high). Fixed value -- it sets when that DTC trips, not a live channel." VALUE 0x4000D9C7 RL_VALUE_UBYTE 0 NO_COMPU_METHOD 0 255 /end CHARACTERISTIC
/begin CHARACTERISTIC CAL_obd_ii_P0335 "Calibration that arms/thresholds the P0335 monitor (crank position sensor). Fixed value -- it sets when that DTC trips, not a live channel." VALUE 0x4000D9C8 RL_VALUE_UBYTE 0 NO_COMPU_METHOD 0 255 /end CHARACTERISTIC
/begin CHARACTERISTIC CAL_obd_ii_P0826 "Calibration that arms/thresholds the P0826 monitor (shift switch). Fixed value -- it sets when that DTC trips, not a live channel." VALUE 0x4000D9C9 RL_VALUE_UBYTE 0 NO_COMPU_METHOD 0 255 /end CHARACTERISTIC
/begin CHARACTERISTIC CAL_obd_ii_P1301 "Calibration that arms/thresholds the P1301 monitor (mfr misfire (cat/igniter)). Fixed value -- it sets when that DTC trips, not a live channel." VALUE 0x4000D9CA RL_VALUE_UBYTE 0 NO_COMPU_METHOD 0 255 /end CHARACTERISTIC
/begin CHARACTERISTIC CAL_obd_ii_P1302 "Calibration that arms/thresholds the P1302 monitor (mfr misfire). Fixed value -- it sets when that DTC trips, not a live channel." VALUE 0x4000D9CB RL_VALUE_UBYTE 0 NO_COMPU_METHOD 0 255 /end CHARACTERISTIC
/begin CHARACTERISTIC CAL_obd_ii_P0014 "Calibration that arms/thresholds the P0014 monitor (exhaust cam bank1 over-advanced). Fixed value -- it sets when that DTC trips, not a live channel." VALUE 0x4000D9CC RL_VALUE_UBYTE 0 NO_COMPU_METHOD 0 255 /end CHARACTERISTIC
/begin CHARACTERISTIC CAL_obd_ii_P0015 "Calibration that arms/thresholds the P0015 monitor (exhaust cam bank1 retarded). Fixed value -- it sets when that DTC trips, not a live channel." VALUE 0x4000D9CD RL_VALUE_UBYTE 0 NO_COMPU_METHOD 0 255 /end CHARACTERISTIC
/begin CHARACTERISTIC CAL_obd_ii_P0024 "Calibration that arms/thresholds the P0024 monitor (exhaust cam bank2 over-advanced). Fixed value -- it sets when that DTC trips, not a live channel." VALUE 0x4000D9CE RL_VALUE_UBYTE 0 NO_COMPU_METHOD 0 255 /end CHARACTERISTIC
/begin CHARACTERISTIC CAL_obd_ii_P0025 "Calibration that arms/thresholds the P0025 monitor (exhaust cam bank2 retarded). Fixed value -- it sets when that DTC trips, not a live channel." VALUE 0x4000D9CF RL_VALUE_UBYTE 0 NO_COMPU_METHOD 0 255 /end CHARACTERISTIC
/begin CHARACTERISTIC CAL_obd_ii_P0079 "Calibration that arms/thresholds the P0079 monitor (exhaust VVT solenoid bank1 low). Fixed value -- it sets when that DTC trips, not a live channel." VALUE 0x4000D9D0 RL_VALUE_UBYTE 0 NO_COMPU_METHOD 0 255 /end CHARACTERISTIC
/begin CHARACTERISTIC CAL_obd_ii_P0080 "Calibration that arms/thresholds the P0080 monitor (exhaust VVT solenoid bank1 high). Fixed value -- it sets when that DTC trips, not a live channel." VALUE 0x4000D9D1 RL_VALUE_UBYTE 0 NO_COMPU_METHOD 0 255 /end CHARACTERISTIC
/begin CHARACTERISTIC CAL_obd_ii_P0082 "Calibration that arms/thresholds the P0082 monitor (intake VVT solenoid bank2 low). Fixed value -- it sets when that DTC trips, not a live channel." VALUE 0x4000D9D2 RL_VALUE_UBYTE 0 NO_COMPU_METHOD 0 255 /end CHARACTERISTIC
/begin CHARACTERISTIC CAL_obd_ii_P0083 "Calibration that arms/thresholds the P0083 monitor (intake VVT solenoid bank2 high). Fixed value -- it sets when that DTC trips, not a live channel." VALUE 0x4000D9D3 RL_VALUE_UBYTE 0 NO_COMPU_METHOD 0 255 /end CHARACTERISTIC
/begin CHARACTERISTIC CAL_obd_ii_P0420 "Calibration that arms/thresholds the P0420 monitor (catalyst efficiency bank1). Fixed value -- it sets when that DTC trips, not a live channel." VALUE 0x4000D9D4 RL_VALUE_UBYTE 0 NO_COMPU_METHOD 0 255 /end CHARACTERISTIC
/begin CHARACTERISTIC CAL_obd_ii_P0085 "Calibration that arms/thresholds the P0085 monitor (exhaust VVT solenoid bank2 low). Fixed value -- it sets when that DTC trips, not a live channel." VALUE 0x4000D9D5 RL_VALUE_UBYTE 0 NO_COMPU_METHOD 0 255 /end CHARACTERISTIC
/begin CHARACTERISTIC CAL_obd_ii_P0086 "Calibration that arms/thresholds the P0086 monitor (exhaust VVT solenoid bank2 high). Fixed value -- it sets when that DTC trips, not a live channel." VALUE 0x4000D9D6 RL_VALUE_UBYTE 0 NO_COMPU_METHOD 0 255 /end CHARACTERISTIC
/begin CHARACTERISTIC CAL_obd_ii_P0827 "Calibration that arms/thresholds the P0827 monitor (shift switch low). Fixed value -- it sets when that DTC trips, not a live channel." VALUE 0x4000D9D7 RL_VALUE_UBYTE 0 NO_COMPU_METHOD 0 255 /end CHARACTERISTIC
/begin CHARACTERISTIC CAL_obd_ii_P1809 "Calibration that arms/thresholds the P1809 monitor (mfr transmission). Fixed value -- it sets when that DTC trips, not a live channel." VALUE 0x4000D9D8 RL_VALUE_UBYTE 0 NO_COMPU_METHOD 0 255 /end CHARACTERISTIC
/begin CHARACTERISTIC CAL_obd_ii_P0430 "Calibration that arms/thresholds the P0430 monitor (catalyst efficiency bank2). Fixed value -- it sets when that DTC trips, not a live channel." VALUE 0x4000D9D9 RL_VALUE_UBYTE 0 NO_COMPU_METHOD 0 255 /end CHARACTERISTIC
/begin CHARACTERISTIC CAL_obd_ii_P0355 "Calibration that arms/thresholds the P0355 monitor (ignition coil 5). Fixed value -- it sets when that DTC trips, not a live channel." VALUE 0x4000D9DA RL_VALUE_UBYTE 0 NO_COMPU_METHOD 0 255 /end CHARACTERISTIC
/begin CHARACTERISTIC CAL_obd_ii_P0356 "Calibration that arms/thresholds the P0356 monitor (ignition coil 6). Fixed value -- it sets when that DTC trips, not a live channel." VALUE 0x4000D9DB RL_VALUE_UBYTE 0 NO_COMPU_METHOD 0 255 /end CHARACTERISTIC
/begin CHARACTERISTIC CAL_obd_ii_P0579 "Calibration that arms/thresholds the P0579 monitor (cruise switch rationality). Fixed value -- it sets when that DTC trips, not a live channel." VALUE 0x4000D9DC RL_VALUE_UBYTE 0 NO_COMPU_METHOD 0 255 /end CHARACTERISTIC
/begin CHARACTERISTIC CAL_obd_ii_P1104 "Calibration that arms/thresholds the P1104 monitor (mfr MAF/intake). Fixed value -- it sets when that DTC trips, not a live channel." VALUE 0x4000D9DD RL_VALUE_UBYTE 0 NO_COMPU_METHOD 0 255 /end CHARACTERISTIC
/begin CHARACTERISTIC CAL_obd_ii_P0828 "Calibration that arms/thresholds the P0828 monitor (shift switch high). Fixed value -- it sets when that DTC trips, not a live channel." VALUE 0x4000D9DE RL_VALUE_UBYTE 0 NO_COMPU_METHOD 0 255 /end CHARACTERISTIC
/begin CHARACTERISTIC CAL_obd_ii_P0441 "Calibration that arms/thresholds the P0441 monitor (EVAP purge flow). Fixed value -- it sets when that DTC trips, not a live channel." VALUE 0x4000D9DF RL_VALUE_UBYTE 0 NO_COMPU_METHOD 0 255 /end CHARACTERISTIC
/begin CHARACTERISTIC CAL_obd_ii_P0442 "Calibration that arms/thresholds the P0442 monitor (EVAP small leak). Fixed value -- it sets when that DTC trips, not a live channel." VALUE 0x4000D9E0 RL_VALUE_UBYTE 0 NO_COMPU_METHOD 0 255 /end CHARACTERISTIC
/begin CHARACTERISTIC CAL_obd_ii_P050B "Calibration: OBD P050B. Tunable map/constant (not a live channel); adjust to change this behavior." VALUE 0x4000D9E1 RL_VALUE_UBYTE 0 NO_COMPU_METHOD 0 255 /end CHARACTERISTIC
/begin CHARACTERISTIC CAL_obd_ii_P0444 "Calibration that arms/thresholds the P0444 monitor (EVAP purge valve open). Fixed value -- it sets when that DTC trips, not a live channel." VALUE 0x4000D9E2 RL_VALUE_UBYTE 0 NO_COMPU_METHOD 0 255 /end CHARACTERISTIC
/begin CHARACTERISTIC CAL_obd_ii_P0445 "Calibration that arms/thresholds the P0445 monitor (EVAP purge valve shorted). Fixed value -- it sets when that DTC trips, not a live channel." VALUE 0x4000D9E3 RL_VALUE_UBYTE 0 NO_COMPU_METHOD 0 255 /end CHARACTERISTIC
/begin CHARACTERISTIC CAL_obd_ii_P0446 "Calibration that arms/thresholds the P0446 monitor (EVAP vent control). Fixed value -- it sets when that DTC trips, not a live channel." VALUE 0x4000D9E4 RL_VALUE_UBYTE 0 NO_COMPU_METHOD 0 255 /end CHARACTERISTIC
/begin CHARACTERISTIC CAL_obd_ii_P0447 "Calibration that arms/thresholds the P0447 monitor (EVAP vent open). Fixed value -- it sets when that DTC trips, not a live channel." VALUE 0x4000D9E5 RL_VALUE_UBYTE 0 NO_COMPU_METHOD 0 255 /end CHARACTERISTIC
/begin CHARACTERISTIC CAL_obd_ii_P0448 "Calibration that arms/thresholds the P0448 monitor (EVAP vent shorted). Fixed value -- it sets when that DTC trips, not a live channel." VALUE 0x4000D9E6 RL_VALUE_UBYTE 0 NO_COMPU_METHOD 0 255 /end CHARACTERISTIC
/begin CHARACTERISTIC CAL_obd_ii_P050A "Calibration: OBD P050A. Tunable map/constant (not a live channel); adjust to change this behavior." VALUE 0x4000D9E7 RL_VALUE_UBYTE 0 NO_COMPU_METHOD 0 255 /end CHARACTERISTIC
/begin CHARACTERISTIC CAL_obd_ii_P0451 "Calibration that arms/thresholds the P0451 monitor (EVAP pressure sensor rationality). Fixed value -- it sets when that DTC trips, not a live channel." VALUE 0x4000D9E8 RL_VALUE_UBYTE 0 NO_COMPU_METHOD 0 255 /end CHARACTERISTIC
/begin CHARACTERISTIC CAL_obd_ii_P0452 "Calibration that arms/thresholds the P0452 monitor (EVAP pressure sensor low). Fixed value -- it sets when that DTC trips, not a live channel." VALUE 0x4000D9E9 RL_VALUE_UBYTE 0 NO_COMPU_METHOD 0 255 /end CHARACTERISTIC
/begin CHARACTERISTIC CAL_obd_ii_P0453 "Calibration that arms/thresholds the P0453 monitor (EVAP pressure sensor high). Fixed value -- it sets when that DTC trips, not a live channel." VALUE 0x4000D9EA RL_VALUE_UBYTE 0 NO_COMPU_METHOD 0 255 /end CHARACTERISTIC
/begin CHARACTERISTIC CAL_obd_ii_P0480 "Calibration that arms/thresholds the P0480 monitor (cooling fan1 relay). Fixed value -- it sets when that DTC trips, not a live channel." VALUE 0x4000D9EB RL_VALUE_UBYTE 0 NO_COMPU_METHOD 0 255 /end CHARACTERISTIC
/begin CHARACTERISTIC CAL_obd_ii_P0481 "Calibration that arms/thresholds the P0481 monitor (cooling fan2 relay). Fixed value -- it sets when that DTC trips, not a live channel." VALUE 0x4000D9EC RL_VALUE_UBYTE 0 NO_COMPU_METHOD 0 255 /end CHARACTERISTIC
/begin CHARACTERISTIC CAL_obd_ii_P0341 "Calibration that arms/thresholds the P0341 monitor (cam position sensor A rationality). Fixed value -- it sets when that DTC trips, not a live channel." VALUE 0x4000D9ED RL_VALUE_UBYTE 0 NO_COMPU_METHOD 0 255 /end CHARACTERISTIC
/begin CHARACTERISTIC CAL_obd_ii_P0346 "Calibration that arms/thresholds the P0346 monitor (cam position sensor bank2 rationality). Fixed value -- it sets when that DTC trips, not a live channel." VALUE 0x4000D9EE RL_VALUE_UBYTE 0 NO_COMPU_METHOD 0 255 /end CHARACTERISTIC
/begin CHARACTERISTIC CAL_obd_ii_P0366 "Calibration that arms/thresholds the P0366 monitor (cam position sensor B bank1). Fixed value -- it sets when that DTC trips, not a live channel." VALUE 0x4000D9EF RL_VALUE_UBYTE 0 NO_COMPU_METHOD 0 255 /end CHARACTERISTIC
/begin CHARACTERISTIC CAL_obd_ii_P0391 "Calibration that arms/thresholds the P0391 monitor (cam position sensor B bank2). Fixed value -- it sets when that DTC trips, not a live channel." VALUE 0x4000D9F0 RL_VALUE_UBYTE 0 NO_COMPU_METHOD 0 255 /end CHARACTERISTIC
/begin CHARACTERISTIC CAL_obd_ii_P0482 "Calibration that arms/thresholds the P0482 monitor (cooling fan3 relay). Fixed value -- it sets when that DTC trips, not a live channel." VALUE 0x4000D9F1 RL_VALUE_UBYTE 0 NO_COMPU_METHOD 0 255 /end CHARACTERISTIC
/begin CHARACTERISTIC CAL_obd_ii_P0461 "Calibration that arms/thresholds the P0461 monitor (fuel level sensor rationality). Fixed value -- it sets when that DTC trips, not a live channel." VALUE 0x4000D9F2 RL_VALUE_UBYTE 0 NO_COMPU_METHOD 0 255 /end CHARACTERISTIC
/begin CHARACTERISTIC CAL_obd_ii_P0462 "Calibration that arms/thresholds the P0462 monitor (fuel level sensor low). Fixed value -- it sets when that DTC trips, not a live channel." VALUE 0x4000D9F3 RL_VALUE_UBYTE 0 NO_COMPU_METHOD 0 255 /end CHARACTERISTIC
/begin CHARACTERISTIC CAL_obd_ii_P0463 "Calibration that arms/thresholds the P0463 monitor (fuel level sensor high). Fixed value -- it sets when that DTC trips, not a live channel." VALUE 0x4000D9F4 RL_VALUE_UBYTE 0 NO_COMPU_METHOD 0 255 /end CHARACTERISTIC
/begin CHARACTERISTIC CAL_obd_ii_P0523 "Calibration that arms/thresholds the P0523 monitor (oil pressure sensor/switch high). Fixed value -- it sets when that DTC trips, not a live channel." VALUE 0x4000D9F5 RL_VALUE_UBYTE 0 NO_COMPU_METHOD 0 255 /end CHARACTERISTIC
/begin CHARACTERISTIC CAL_obd_ii_P0563 "Calibration that arms/thresholds the P0563 monitor (system voltage high). Fixed value -- it sets when that DTC trips, not a live channel." VALUE 0x4000D9F6 RL_VALUE_UBYTE 0 NO_COMPU_METHOD 0 255 /end CHARACTERISTIC
/begin CHARACTERISTIC CAL_obd_ii_P0562 "Calibration that arms/thresholds the P0562 monitor (system voltage low). Fixed value -- it sets when that DTC trips, not a live channel." VALUE 0x4000D9F7 RL_VALUE_UBYTE 0 NO_COMPU_METHOD 0 255 /end CHARACTERISTIC
/begin CHARACTERISTIC CAL_obd_ii_P0685 "Calibration that arms/thresholds the P0685 monitor (ECU power relay). Fixed value -- it sets when that DTC trips, not a live channel." VALUE 0x4000D9F8 RL_VALUE_UBYTE 0 NO_COMPU_METHOD 0 255 /end CHARACTERISTIC
/begin CHARACTERISTIC CAL_obd_ii_P0610 "Calibration that arms/thresholds the P0610 monitor (vehicle options error). Fixed value -- it sets when that DTC trips, not a live channel." VALUE 0x4000D9F9 RL_VALUE_UBYTE 0 NO_COMPU_METHOD 0 255 /end CHARACTERISTIC
/begin CHARACTERISTIC CAL_obd_ii_P0646 "Calibration that arms/thresholds the P0646 monitor (A/C clutch relay low). Fixed value -- it sets when that DTC trips, not a live channel." VALUE 0x4000D9FA RL_VALUE_UBYTE 0 NO_COMPU_METHOD 0 255 /end CHARACTERISTIC
/begin CHARACTERISTIC CAL_obd_ii_P0647 "Calibration that arms/thresholds the P0647 monitor (A/C clutch relay high). Fixed value -- it sets when that DTC trips, not a live channel." VALUE 0x4000D9FB RL_VALUE_UBYTE 0 NO_COMPU_METHOD 0 255 /end CHARACTERISTIC
/begin CHARACTERISTIC CAL_obd_ii_P0500 "Calibration that arms/thresholds the P0500 monitor (vehicle speed sensor). Fixed value -- it sets when that DTC trips, not a live channel." VALUE 0x4000D9FC RL_VALUE_UBYTE 0 NO_COMPU_METHOD 0 255 /end CHARACTERISTIC
/begin CHARACTERISTIC CAL_obd_ii_P0506 "Calibration that arms/thresholds the P0506 monitor (idle speed too low). Fixed value -- it sets when that DTC trips, not a live channel." VALUE 0x4000D9FD RL_VALUE_UBYTE 0 NO_COMPU_METHOD 0 255 /end CHARACTERISTIC
/begin CHARACTERISTIC CAL_obd_ii_P0507 "Calibration that arms/thresholds the P0507 monitor (idle speed too high). Fixed value -- it sets when that DTC trips, not a live channel." VALUE 0x4000D9FE RL_VALUE_UBYTE 0 NO_COMPU_METHOD 0 255 /end CHARACTERISTIC
/begin CHARACTERISTIC CAL_obd_ii_P1113 "Calibration that arms/thresholds the P1113 monitor (mfr IAT). Fixed value -- it sets when that DTC trips, not a live channel." VALUE 0x4000D9FF RL_VALUE_UBYTE 0 NO_COMPU_METHOD 0 255 /end CHARACTERISTIC
/begin CHARACTERISTIC CAL_obd_ii_P0661 "Calibration that arms/thresholds the P0661 monitor (intake manifold runner (VIMS) control low). Fixed value -- it sets when that DTC trips, not a live channel." VALUE 0x4000DA00 RL_VALUE_UBYTE 0 NO_COMPU_METHOD 0 255 /end CHARACTERISTIC
/begin CHARACTERISTIC CAL_obd_ii_P0662 "Calibration that arms/thresholds the P0662 monitor (intake manifold runner (VIMS) control high). Fixed value -- it sets when that DTC trips, not a live channel." VALUE 0x4000DA01 RL_VALUE_UBYTE 0 NO_COMPU_METHOD 0 255 /end CHARACTERISTIC
/begin CHARACTERISTIC CAL_obd_ii_P0616 "Calibration that arms/thresholds the P0616 monitor (starter relay low). Fixed value -- it sets when that DTC trips, not a live channel." VALUE 0x4000DA02 RL_VALUE_UBYTE 0 NO_COMPU_METHOD 0 255 /end CHARACTERISTIC
/begin CHARACTERISTIC CAL_obd_ii_P0617 "Calibration that arms/thresholds the P0617 monitor (starter relay high). Fixed value -- it sets when that DTC trips, not a live channel." VALUE 0x4000DA03 RL_VALUE_UBYTE 0 NO_COMPU_METHOD 0 255 /end CHARACTERISTIC
/begin CHARACTERISTIC CAL_obd_ii_P0630 "Calibration that arms/thresholds the P0630 monitor (VIN not programmed). Fixed value -- it sets when that DTC trips, not a live channel." VALUE 0x4000DA04 RL_VALUE_UBYTE 0 NO_COMPU_METHOD 0 255 /end CHARACTERISTIC
/begin CHARACTERISTIC CAL_obd_ii_P2138 "Calibration that arms/thresholds the P2138 monitor (pedal D/E correlation). Fixed value -- it sets when that DTC trips, not a live channel." VALUE 0x4000DA05 RL_VALUE_UBYTE 0 NO_COMPU_METHOD 0 255 /end CHARACTERISTIC
/begin CHARACTERISTIC CAL_obd_ii_P2602 "Calibration that arms/thresholds the P2602 monitor (coolant pump control low). Fixed value -- it sets when that DTC trips, not a live channel." VALUE 0x4000DA06 RL_VALUE_UBYTE 0 NO_COMPU_METHOD 0 255 /end CHARACTERISTIC
/begin CHARACTERISTIC CAL_obd_ii_P2603 "Calibration that arms/thresholds the P2603 monitor (coolant pump control high). Fixed value -- it sets when that DTC trips, not a live channel." VALUE 0x4000DA07 RL_VALUE_UBYTE 0 NO_COMPU_METHOD 0 255 /end CHARACTERISTIC
/begin CHARACTERISTIC CAL_obd_ii_P0011 "Calibration that arms/thresholds the P0011 monitor (intake cam (VVT) bank1 over-advanced). Fixed value -- it sets when that DTC trips, not a live channel." VALUE 0x4000DA08 RL_VALUE_UBYTE 0 NO_COMPU_METHOD 0 255 /end CHARACTERISTIC
/begin CHARACTERISTIC CAL_obd_ii_P0012 "Calibration that arms/thresholds the P0012 monitor (intake cam bank1 retarded). Fixed value -- it sets when that DTC trips, not a live channel." VALUE 0x4000DA09 RL_VALUE_UBYTE 0 NO_COMPU_METHOD 0 255 /end CHARACTERISTIC
/begin CHARACTERISTIC CAL_obd_ii_P0601 "Calibration that arms/thresholds the P0601 monitor (ECU memory checksum). Fixed value -- it sets when that DTC trips, not a live channel." VALUE 0x4000DA0A RL_VALUE_UBYTE 0 NO_COMPU_METHOD 0 255 /end CHARACTERISTIC
/begin CHARACTERISTIC CAL_obd_ii_P0606 "Calibration that arms/thresholds the P0606 monitor (ECU processor fault). Fixed value -- it sets when that DTC trips, not a live channel." VALUE 0x4000DA0B RL_VALUE_UBYTE 0 NO_COMPU_METHOD 0 255 /end CHARACTERISTIC
/begin CHARACTERISTIC CAL_obd_ii_P0455 "Calibration that arms/thresholds the P0455 monitor (EVAP large leak). Fixed value -- it sets when that DTC trips, not a live channel." VALUE 0x4000DA0C RL_VALUE_UBYTE 0 NO_COMPU_METHOD 0 255 /end CHARACTERISTIC
/begin CHARACTERISTIC CAL_obd_ii_P0456 "Calibration that arms/thresholds the P0456 monitor (EVAP very small leak). Fixed value -- it sets when that DTC trips, not a live channel." VALUE 0x4000DA0D RL_VALUE_UBYTE 0 NO_COMPU_METHOD 0 255 /end CHARACTERISTIC
/begin CHARACTERISTIC CAL_obd_ii_P0016 "Calibration that arms/thresholds the P0016 monitor (crank/intake-cam bank1 correlation). Fixed value -- it sets when that DTC trips, not a live channel." VALUE 0x4000DA0E RL_VALUE_UBYTE 0 NO_COMPU_METHOD 0 255 /end CHARACTERISTIC
/begin CHARACTERISTIC CAL_obd_ii_P2173 "Calibration that arms/thresholds the P2173 monitor (high airflow / throttle). Fixed value -- it sets when that DTC trips, not a live channel." VALUE 0x4000DA0F RL_VALUE_UBYTE 0 NO_COMPU_METHOD 0 255 /end CHARACTERISTIC
/begin CHARACTERISTIC CAL_obd_ii_P2104 "Calibration that arms/thresholds the P2104 monitor (throttle forced idle). Fixed value -- it sets when that DTC trips, not a live channel." VALUE 0x4000DA10 RL_VALUE_UBYTE 0 NO_COMPU_METHOD 0 255 /end CHARACTERISTIC
/begin CHARACTERISTIC CAL_obd_ii_P2105 "Calibration that arms/thresholds the P2105 monitor (throttle forced shutdown). Fixed value -- it sets when that DTC trips, not a live channel." VALUE 0x4000DA11 RL_VALUE_UBYTE 0 NO_COMPU_METHOD 0 255 /end CHARACTERISTIC
/begin CHARACTERISTIC CAL_obd_ii_P2106 "Calibration that arms/thresholds the P2106 monitor (throttle performance limited). Fixed value -- it sets when that DTC trips, not a live channel." VALUE 0x4000DA12 RL_VALUE_UBYTE 0 NO_COMPU_METHOD 0 255 /end CHARACTERISTIC
/begin CHARACTERISTIC CAL_obd_ii_P2107 "Calibration that arms/thresholds the P2107 monitor (throttle actuator processor). Fixed value -- it sets when that DTC trips, not a live channel." VALUE 0x4000DA13 RL_VALUE_UBYTE 0 NO_COMPU_METHOD 0 255 /end CHARACTERISTIC
/begin CHARACTERISTIC CAL_obd_ii_P2100 "Calibration that arms/thresholds the P2100 monitor (throttle actuator motor open). Fixed value -- it sets when that DTC trips, not a live channel." VALUE 0x4000DA14 RL_VALUE_UBYTE 0 NO_COMPU_METHOD 0 255 /end CHARACTERISTIC
/begin CHARACTERISTIC CAL_obd_ii_P2102 "Calibration that arms/thresholds the P2102 monitor (throttle actuator motor low). Fixed value -- it sets when that DTC trips, not a live channel." VALUE 0x4000DA15 RL_VALUE_UBYTE 0 NO_COMPU_METHOD 0 255 /end CHARACTERISTIC
/begin CHARACTERISTIC CAL_obd_ii_P2103 "Calibration that arms/thresholds the P2103 monitor (throttle actuator motor high). Fixed value -- it sets when that DTC trips, not a live channel." VALUE 0x4000DA16 RL_VALUE_UBYTE 0 NO_COMPU_METHOD 0 255 /end CHARACTERISTIC
/begin CHARACTERISTIC CAL_obd_ii_P2108 "Calibration that arms/thresholds the P2108 monitor (throttle actuator performance). Fixed value -- it sets when that DTC trips, not a live channel." VALUE 0x4000DA17 RL_VALUE_UBYTE 0 NO_COMPU_METHOD 0 255 /end CHARACTERISTIC
/begin CHARACTERISTIC CAL_obd_ii_P0151 "Calibration that arms/thresholds the P0151 monitor (O2 B2S1 low). Fixed value -- it sets when that DTC trips, not a live channel." VALUE 0x4000DA18 RL_VALUE_UBYTE 0 NO_COMPU_METHOD 0 255 /end CHARACTERISTIC
/begin CHARACTERISTIC CAL_obd_ii_P0152 "Calibration that arms/thresholds the P0152 monitor (O2 B2S1 high). Fixed value -- it sets when that DTC trips, not a live channel." VALUE 0x4000DA19 RL_VALUE_UBYTE 0 NO_COMPU_METHOD 0 255 /end CHARACTERISTIC
/begin CHARACTERISTIC CAL_obd_ii_P0153 "Calibration that arms/thresholds the P0153 monitor (O2 B2S1 slow response). Fixed value -- it sets when that DTC trips, not a live channel." VALUE 0x4000DA1A RL_VALUE_UBYTE 0 NO_COMPU_METHOD 0 255 /end CHARACTERISTIC
/begin CHARACTERISTIC CAL_obd_ii_P0154 "Calibration that arms/thresholds the P0154 monitor (O2 B2S1 inactive). Fixed value -- it sets when that DTC trips, not a live channel." VALUE 0x4000DA1B RL_VALUE_UBYTE 0 NO_COMPU_METHOD 0 255 /end CHARACTERISTIC
/begin CHARACTERISTIC CAL_obd_ii_P0155 "Calibration that arms/thresholds the P0155 monitor (O2 B2S1 heater). Fixed value -- it sets when that DTC trips, not a live channel." VALUE 0x4000DA1C RL_VALUE_UBYTE 0 NO_COMPU_METHOD 0 255 /end CHARACTERISTIC
/begin CHARACTERISTIC CAL_obd_ii_P0157 "Calibration that arms/thresholds the P0157 monitor (O2 B2S2 low). Fixed value -- it sets when that DTC trips, not a live channel." VALUE 0x4000DA1D RL_VALUE_UBYTE 0 NO_COMPU_METHOD 0 255 /end CHARACTERISTIC
/begin CHARACTERISTIC CAL_obd_ii_P0158 "Calibration that arms/thresholds the P0158 monitor (O2 B2S2 high). Fixed value -- it sets when that DTC trips, not a live channel." VALUE 0x4000DA1E RL_VALUE_UBYTE 0 NO_COMPU_METHOD 0 255 /end CHARACTERISTIC
/begin CHARACTERISTIC CAL_obd_ii_P0159 "Calibration that arms/thresholds the P0159 monitor (O2 B2S2 slow response). Fixed value -- it sets when that DTC trips, not a live channel." VALUE 0x4000DA1F RL_VALUE_UBYTE 0 NO_COMPU_METHOD 0 255 /end CHARACTERISTIC
/begin CHARACTERISTIC CAL_obd_ii_P0160 "Calibration that arms/thresholds the P0160 monitor (O2 B2S2 inactive). Fixed value -- it sets when that DTC trips, not a live channel." VALUE 0x4000DA20 RL_VALUE_UBYTE 0 NO_COMPU_METHOD 0 255 /end CHARACTERISTIC
/begin CHARACTERISTIC CAL_obd_ii_P0161 "Calibration that arms/thresholds the P0161 monitor (O2 B2S2 heater). Fixed value -- it sets when that DTC trips, not a live channel." VALUE 0x4000DA21 RL_VALUE_UBYTE 0 NO_COMPU_METHOD 0 255 /end CHARACTERISTIC
/begin CHARACTERISTIC CAL_obd_ii_P0174 "Calibration that arms/thresholds the P0174 monitor (bank2 too lean). Fixed value -- it sets when that DTC trips, not a live channel." VALUE 0x4000DA22 RL_VALUE_UBYTE 0 NO_COMPU_METHOD 0 255 /end CHARACTERISTIC
/begin CHARACTERISTIC CAL_obd_ii_P0175 "Calibration that arms/thresholds the P0175 monitor (bank2 too rich). Fixed value -- it sets when that DTC trips, not a live channel." VALUE 0x4000DA23 RL_VALUE_UBYTE 0 NO_COMPU_METHOD 0 255 /end CHARACTERISTIC
/begin CHARACTERISTIC CAL_obd_ii_P0332 "Calibration that arms/thresholds the P0332 monitor (knock sensor2 low). Fixed value -- it sets when that DTC trips, not a live channel." VALUE 0x4000DA24 RL_VALUE_UBYTE 0 NO_COMPU_METHOD 0 255 /end CHARACTERISTIC
/begin CHARACTERISTIC CAL_obd_ii_P0333 "Calibration that arms/thresholds the P0333 monitor (knock sensor2 high). Fixed value -- it sets when that DTC trips, not a live channel." VALUE 0x4000DA25 RL_VALUE_UBYTE 0 NO_COMPU_METHOD 0 255 /end CHARACTERISTIC
/begin CHARACTERISTIC CAL_obd_ii_P0021 "Calibration that arms/thresholds the P0021 monitor (intake cam bank2 over-advanced). Fixed value -- it sets when that DTC trips, not a live channel." VALUE 0x4000DA26 RL_VALUE_UBYTE 0 NO_COMPU_METHOD 0 255 /end CHARACTERISTIC
/begin CHARACTERISTIC CAL_obd_ii_P0022 "Calibration that arms/thresholds the P0022 monitor (intake cam bank2 retarded). Fixed value -- it sets when that DTC trips, not a live channel." VALUE 0x4000DA27 RL_VALUE_UBYTE 0 NO_COMPU_METHOD 0 255 /end CHARACTERISTIC
/begin CHARACTERISTIC CAL_obd_ii_P0017 "Calibration that arms/thresholds the P0017 monitor (crank/exhaust-cam bank1 correlation). Fixed value -- it sets when that DTC trips, not a live channel." VALUE 0x4000DA28 RL_VALUE_UBYTE 0 NO_COMPU_METHOD 0 255 /end CHARACTERISTIC
/begin CHARACTERISTIC CAL_obd_ii_P0018 "Calibration that arms/thresholds the P0018 monitor (crank/intake-cam bank2 correlation). Fixed value -- it sets when that DTC trips, not a live channel." VALUE 0x4000DA29 RL_VALUE_UBYTE 0 NO_COMPU_METHOD 0 255 /end CHARACTERISTIC
/begin CHARACTERISTIC CAL_obd_ii_P0019 "Calibration that arms/thresholds the P0019 monitor (crank/exhaust-cam bank2 correlation). Fixed value -- it sets when that DTC trips, not a live channel." VALUE 0x4000DA2A RL_VALUE_UBYTE 0 NO_COMPU_METHOD 0 255 /end CHARACTERISTIC
/begin CHARACTERISTIC CAL_obd_ii_P0578 "Calibration that arms/thresholds the P0578 monitor (cruise switch stuck). Fixed value -- it sets when that DTC trips, not a live channel." VALUE 0x4000DA2B RL_VALUE_UBYTE 0 NO_COMPU_METHOD 0 255 /end CHARACTERISTIC
/begin CHARACTERISTIC CAL_obd_ii_P0564 "Calibration that arms/thresholds the P0564 monitor (cruise control input). Fixed value -- it sets when that DTC trips, not a live channel." VALUE 0x4000DA2C RL_VALUE_UBYTE 0 NO_COMPU_METHOD 0 255 /end CHARACTERISTIC
/begin CHARACTERISTIC CAL_obd_ii_P0806 "Calibration that arms/thresholds the P0806 monitor (clutch position sensor rationality). Fixed value -- it sets when that DTC trips, not a live channel." VALUE 0x4000DA2D RL_VALUE_UBYTE 0 NO_COMPU_METHOD 0 255 /end CHARACTERISTIC
/begin CHARACTERISTIC CAL_obd_ii_P0807 "Calibration that arms/thresholds the P0807 monitor (clutch position sensor low). Fixed value -- it sets when that DTC trips, not a live channel." VALUE 0x4000DA2E RL_VALUE_UBYTE 0 NO_COMPU_METHOD 0 255 /end CHARACTERISTIC
/begin CHARACTERISTIC CAL_obd_ii_P0808 "Calibration that arms/thresholds the P0808 monitor (clutch position sensor high). Fixed value -- it sets when that DTC trips, not a live channel." VALUE 0x4000DA2F RL_VALUE_UBYTE 0 NO_COMPU_METHOD 0 255 /end CHARACTERISTIC
/begin CHARACTERISTIC CAL_obd_ii_P2612 "Calibration that arms/thresholds the P2612 monitor (A/C refrigerant valve low). Fixed value -- it sets when that DTC trips, not a live channel." VALUE 0x4000DA30 RL_VALUE_UBYTE 0 NO_COMPU_METHOD 0 255 /end CHARACTERISTIC
/begin CHARACTERISTIC CAL_obd_ii_P2613 "Calibration that arms/thresholds the P2613 monitor (A/C refrigerant valve high). Fixed value -- it sets when that DTC trips, not a live channel." VALUE 0x4000DA31 RL_VALUE_UBYTE 0 NO_COMPU_METHOD 0 255 /end CHARACTERISTIC
/begin CHARACTERISTIC CAL_obd_ii_P0537 "Calibration that arms/thresholds the P0537 monitor (A/C evap temp sensor low). Fixed value -- it sets when that DTC trips, not a live channel." VALUE 0x4000DA32 RL_VALUE_UBYTE 0 NO_COMPU_METHOD 0 255 /end CHARACTERISTIC
/begin CHARACTERISTIC CAL_obd_ii_P0538 "Calibration that arms/thresholds the P0538 monitor (A/C evap temp sensor high). Fixed value -- it sets when that DTC trips, not a live channel." VALUE 0x4000DA33 RL_VALUE_UBYTE 0 NO_COMPU_METHOD 0 255 /end CHARACTERISTIC
/begin CHARACTERISTIC CAL_obd_ii_U0127 "Calibration that arms/thresholds the P0127 monitor (intake air too hot). Fixed value -- it sets when that DTC trips, not a live channel." VALUE 0x4000DA34 RL_VALUE_UBYTE 0 NO_COMPU_METHOD 0 255 /end CHARACTERISTIC
/begin CHARACTERISTIC CAL_obd_ii_U0101 "Calibration that arms/thresholds the U0101 monitor (lost comms with TCM). Fixed value -- it sets when that DTC trips, not a live channel." VALUE 0x4000DA35 RL_VALUE_UBYTE 0 NO_COMPU_METHOD 0 255 /end CHARACTERISTIC
/begin CHARACTERISTIC CAL_obd_ii_U0122 "Calibration that arms/thresholds the U0122 monitor (lost comms with ABS/ESP). Fixed value -- it sets when that DTC trips, not a live channel." VALUE 0x4000DA36 RL_VALUE_UBYTE 0 NO_COMPU_METHOD 0 255 /end CHARACTERISTIC
/begin CHARACTERISTIC CAL_obd_ii_U0316 "Calibration that arms/thresholds the U0316 monitor (software mismatch with VDC). Fixed value -- it sets when that DTC trips, not a live channel." VALUE 0x4000DA37 RL_VALUE_UBYTE 0 NO_COMPU_METHOD 0 255 /end CHARACTERISTIC
/begin CHARACTERISTIC CAL_obd_ii_P0141_4000DA38 "Calibration that arms/thresholds the P0141 monitor (O2 B1S2 heater). Fixed value -- it sets when that DTC trips, not a live channel." VALUE 0x4000DA38 RL_VALUE_UBYTE 0 NO_COMPU_METHOD 0 255 /end CHARACTERISTIC
/begin CHARACTERISTIC CAL_obd_ii_U0302 "Calibration that arms/thresholds the U0302 monitor (software mismatch with TCM). Fixed value -- it sets when that DTC trips, not a live channel." VALUE 0x4000DA39 RL_VALUE_UBYTE 0 NO_COMPU_METHOD 0 255 /end CHARACTERISTIC
/begin CHARACTERISTIC CAL_obd_ii_U0416 "Calibration that arms/thresholds the U0416 monitor (bad data from ABS/ESP). Fixed value -- it sets when that DTC trips, not a live channel." VALUE 0x4000DA3A RL_VALUE_UBYTE 0 NO_COMPU_METHOD 0 255 /end CHARACTERISTIC
/begin CHARACTERISTIC CAL_obd_ii_U0123 "Calibration that arms/thresholds the U0123 monitor (lost comms with yaw sensor). Fixed value -- it sets when that DTC trips, not a live channel." VALUE 0x4000DA3B RL_VALUE_UBYTE 0 NO_COMPU_METHOD 0 255 /end CHARACTERISTIC
/begin CHARACTERISTIC CAL_obd_ii_U0513 "Calibration that arms/thresholds the U0513 monitor (bad data from convenience module). Fixed value -- it sets when that DTC trips, not a live channel." VALUE 0x4000DA3C RL_VALUE_UBYTE 0 NO_COMPU_METHOD 0 255 /end CHARACTERISTIC
/begin CHARACTERISTIC CAL_obd_ii_P1422 "Calibration that arms/thresholds the P1422 monitor (mfr emissions). Fixed value -- it sets when that DTC trips, not a live channel." VALUE 0x4000DA48 RL_VALUE_UBYTE 0 NO_COMPU_METHOD 0 255 /end CHARACTERISTIC
/begin CHARACTERISTIC CAL_obd_ii_P219A "Calibration: OBD P219A. Tunable map/constant (not a live channel); adjust to change this behavior." VALUE 0x4000DA49 RL_VALUE_UBYTE 0 NO_COMPU_METHOD 0 255 /end CHARACTERISTIC
/begin CHARACTERISTIC CAL_obd_ii_P219B "Calibration: OBD P219B. Tunable map/constant (not a live channel); adjust to change this behavior." VALUE 0x4000DA4A RL_VALUE_UBYTE 0 NO_COMPU_METHOD 0 255 /end CHARACTERISTIC
/begin CHARACTERISTIC CAL_obd_ii_P2336 "Calibration that arms/thresholds the P2336 monitor (cyl1 over knock threshold). Fixed value -- it sets when that DTC trips, not a live channel." VALUE 0x4000DA4B RL_VALUE_UBYTE 0 NO_COMPU_METHOD 0 255 /end CHARACTERISTIC
/begin CHARACTERISTIC CAL_obd_ii_P2337 "Calibration that arms/thresholds the P2337 monitor (cyl2 over knock threshold). Fixed value -- it sets when that DTC trips, not a live channel." VALUE 0x4000DA4C RL_VALUE_UBYTE 0 NO_COMPU_METHOD 0 255 /end CHARACTERISTIC
/begin CHARACTERISTIC CAL_obd_ii_P2338 "Calibration that arms/thresholds the P2338 monitor (cyl3 over knock threshold). Fixed value -- it sets when that DTC trips, not a live channel." VALUE 0x4000DA4D RL_VALUE_UBYTE 0 NO_COMPU_METHOD 0 255 /end CHARACTERISTIC
/begin CHARACTERISTIC CAL_obd_ii_P2339 "Calibration that arms/thresholds the P2339 monitor (cyl4 over knock threshold). Fixed value -- it sets when that DTC trips, not a live channel." VALUE 0x4000DA4E RL_VALUE_UBYTE 0 NO_COMPU_METHOD 0 255 /end CHARACTERISTIC
/begin CHARACTERISTIC CAL_obd_ii_P2340 "Calibration that arms/thresholds the P2340 monitor (cyl5 over knock threshold). Fixed value -- it sets when that DTC trips, not a live channel." VALUE 0x4000DA4F RL_VALUE_UBYTE 0 NO_COMPU_METHOD 0 255 /end CHARACTERISTIC
/begin CHARACTERISTIC CAL_obd_ii_P2341 "Calibration that arms/thresholds the P2341 monitor (cyl6 over knock threshold). Fixed value -- it sets when that DTC trips, not a live channel." VALUE 0x4000DA50 RL_VALUE_UBYTE 0 NO_COMPU_METHOD 0 255 /end CHARACTERISTIC
/begin CHARACTERISTIC CAL_obd_ii_P1562 "Calibration that arms/thresholds the P1562 monitor (mfr ECU supply voltage). Fixed value -- it sets when that DTC trips, not a live channel." VALUE 0x4000DA51 RL_VALUE_UBYTE 0 NO_COMPU_METHOD 0 255 /end CHARACTERISTIC
/begin CHARACTERISTIC CAL_obd_ii_P0014_debounce_count "u8_count" VALUE 0x4000DB76 RL_VALUE_UBYTE 0 NO_COMPU_METHOD 0 255 /end CHARACTERISTIC
/begin CHARACTERISTIC CAL_obd_ii_P0106_debounce_count "u8_count" VALUE 0x4000DB77 RL_VALUE_UBYTE 0 NO_COMPU_METHOD 0 255 /end CHARACTERISTIC
/begin CHARACTERISTIC CAL_obd_ii_P0107_debounce_count "u8_count" VALUE 0x4000DB78 RL_VALUE_UBYTE 0 NO_COMPU_METHOD 0 255 /end CHARACTERISTIC
/begin CHARACTERISTIC CAL_obd_ii_P0108_debounce_count "u8_count" VALUE 0x4000DB79 RL_VALUE_UBYTE 0 NO_COMPU_METHOD 0 255 /end CHARACTERISTIC
/begin CHARACTERISTIC CAL_obd_ii_P0015_debounce_count "u8_count" VALUE 0x4000DB7A RL_VALUE_UBYTE 0 NO_COMPU_METHOD 0 255 /end CHARACTERISTIC
/begin CHARACTERISTIC CAL_obd_ii_P0111_debounce_count "u8_count" VALUE 0x4000DB7B RL_VALUE_UBYTE 0 NO_COMPU_METHOD 0 255 /end CHARACTERISTIC
/begin CHARACTERISTIC CAL_obd_ii_P0112_debounce_count "u8_count" VALUE 0x4000DB7C RL_VALUE_UBYTE 0 NO_COMPU_METHOD 0 255 /end CHARACTERISTIC
/begin CHARACTERISTIC CAL_obd_ii_P0113_debounce_count "u8_count" VALUE 0x4000DB7D RL_VALUE_UBYTE 0 NO_COMPU_METHOD 0 255 /end CHARACTERISTIC
/begin CHARACTERISTIC CAL_obd_ii_P0024_debounce_count "u8_count" VALUE 0x4000DB7E RL_VALUE_UBYTE 0 NO_COMPU_METHOD 0 255 /end CHARACTERISTIC
/begin CHARACTERISTIC CAL_obd_ii_P0116_debounce_count "u8_count" VALUE 0x4000DB7F RL_VALUE_UBYTE 0 NO_COMPU_METHOD 0 255 /end CHARACTERISTIC
/begin CHARACTERISTIC CAL_obd_ii_P0117_debounce_count "u8_count" VALUE 0x4000DB80 RL_VALUE_UBYTE 0 NO_COMPU_METHOD 0 255 /end CHARACTERISTIC
/begin CHARACTERISTIC CAL_obd_ii_P0118_debounce_count "u8_count" VALUE 0x4000DB81 RL_VALUE_UBYTE 0 NO_COMPU_METHOD 0 255 /end CHARACTERISTIC
/begin CHARACTERISTIC CAL_obd_ii_P0025_debounce_count "u8_count" VALUE 0x4000DB82 RL_VALUE_UBYTE 0 NO_COMPU_METHOD 0 255 /end CHARACTERISTIC
/begin CHARACTERISTIC CAL_obd_ii_P0571_debounce_count "u8_count" VALUE 0x4000DB83 RL_VALUE_UBYTE 0 NO_COMPU_METHOD 0 255 /end CHARACTERISTIC
/begin CHARACTERISTIC CAL_obd_ii_P0122_debounce_count "u8_count" VALUE 0x4000DB84 RL_VALUE_UBYTE 0 NO_COMPU_METHOD 0 255 /end CHARACTERISTIC
/begin CHARACTERISTIC CAL_obd_ii_P0123_debounce_count "u8_count" VALUE 0x4000DB85 RL_VALUE_UBYTE 0 NO_COMPU_METHOD 0 255 /end CHARACTERISTIC
/begin CHARACTERISTIC CAL_obd_ii_P0131_debounce_count "u8_count" VALUE 0x4000DB86 RL_VALUE_UBYTE 0 NO_COMPU_METHOD 0 255 /end CHARACTERISTIC
/begin CHARACTERISTIC CAL_obd_ii_P0132_fail_count "u8_count" VALUE 0x4000DB87 RL_VALUE_UBYTE 0 NO_COMPU_METHOD 0 255 /end CHARACTERISTIC
/begin CHARACTERISTIC CAL_obd_ii_P0137_fail_count "u8_count" VALUE 0x4000DB88 RL_VALUE_UBYTE 0 NO_COMPU_METHOD 0 255 /end CHARACTERISTIC
/begin CHARACTERISTIC CAL_obd_ii_P0138_fail_count "u8_count" VALUE 0x4000DB89 RL_VALUE_UBYTE 0 NO_COMPU_METHOD 0 255 /end CHARACTERISTIC
/begin CHARACTERISTIC CAL_obd_ii_P0102_debounce_count "u8_count" VALUE 0x4000DB8A RL_VALUE_UBYTE 0 NO_COMPU_METHOD 0 255 /end CHARACTERISTIC
/begin CHARACTERISTIC CAL_obd_ii_P0103_debounce_count "u8_count" VALUE 0x4000DB8B RL_VALUE_UBYTE 0 NO_COMPU_METHOD 0 255 /end CHARACTERISTIC
/begin CHARACTERISTIC CAL_obd_ii_P0139_debounce_count "u8_count" VALUE 0x4000DB8C RL_VALUE_UBYTE 0 NO_COMPU_METHOD 0 255 /end CHARACTERISTIC
/begin CHARACTERISTIC CAL_obd_ii_P0101_maturing_limit "u8_count" VALUE 0x4000DB8D RL_VALUE_UBYTE 0 NO_COMPU_METHOD 0 255 /end CHARACTERISTIC
/begin CHARACTERISTIC CAL_obd_ii_P0128_fail_count "u8_count" VALUE 0x4000DB8E RL_VALUE_UBYTE 0 NO_COMPU_METHOD 0 255 /end CHARACTERISTIC
/begin CHARACTERISTIC CAL_obd_ii_P0076_debounce_count "u8_count" VALUE 0x4000DB8F RL_VALUE_UBYTE 0 NO_COMPU_METHOD 0 255 /end CHARACTERISTIC
/begin CHARACTERISTIC CAL_obd_ii_P0077_debounce_count "u8_count" VALUE 0x4000DB90 RL_VALUE_UBYTE 0 NO_COMPU_METHOD 0 255 /end CHARACTERISTIC
/begin CHARACTERISTIC CAL_obd_ii_P0452_debounce_count "u8_count" VALUE 0x4000DB91 RL_VALUE_UBYTE 0 NO_COMPU_METHOD 0 255 /end CHARACTERISTIC
/begin CHARACTERISTIC CAL_obd_ii_P0453_debounce_count "u8_count" VALUE 0x4000DB92 RL_VALUE_UBYTE 0 NO_COMPU_METHOD 0 255 /end CHARACTERISTIC
/begin CHARACTERISTIC CAL_obd_ii_P0351_debounce_count "u8_count" VALUE 0x4000DB93 RL_VALUE_UBYTE 0 NO_COMPU_METHOD 0 255 /end CHARACTERISTIC
/begin CHARACTERISTIC CAL_obd_ii_P0352_debounce_count "u8_count" VALUE 0x4000DB94 RL_VALUE_UBYTE 0 NO_COMPU_METHOD 0 255 /end CHARACTERISTIC
/begin CHARACTERISTIC CAL_obd_ii_P0353_debounce_count "u8_count" VALUE 0x4000DB95 RL_VALUE_UBYTE 0 NO_COMPU_METHOD 0 255 /end CHARACTERISTIC
/begin CHARACTERISTIC CAL_obd_ii_P0354_debounce_count "u8_count" VALUE 0x4000DB96 RL_VALUE_UBYTE 0 NO_COMPU_METHOD 0 255 /end CHARACTERISTIC
/begin CHARACTERISTIC CAL_obd_ii_P0327_debounce_count "u8_count" VALUE 0x4000DB97 RL_VALUE_UBYTE 0 NO_COMPU_METHOD 0 255 /end CHARACTERISTIC
/begin CHARACTERISTIC CAL_obd_ii_P0328_debounce_count "u8_count" VALUE 0x4000DB98 RL_VALUE_UBYTE 0 NO_COMPU_METHOD 0 255 /end CHARACTERISTIC
/begin CHARACTERISTIC CAL_obd_ii_P0563_debounce_count "u8_count" VALUE 0x4000DB99 RL_VALUE_UBYTE 0 NO_COMPU_METHOD 0 255 /end CHARACTERISTIC
/begin CHARACTERISTIC CAL_obd_ii_P0562_debounce_count "u8_count" VALUE 0x4000DB9A RL_VALUE_UBYTE 0 NO_COMPU_METHOD 0 255 /end CHARACTERISTIC
/begin CHARACTERISTIC CAL_obd_ii_P0646_debounce_count "u8_count" VALUE 0x4000DB9B RL_VALUE_UBYTE 0 NO_COMPU_METHOD 0 255 /end CHARACTERISTIC
/begin CHARACTERISTIC CAL_obd_ii_P0647_debounce_count "u8_count" VALUE 0x4000DB9C RL_VALUE_UBYTE 0 NO_COMPU_METHOD 0 255 /end CHARACTERISTIC
/begin CHARACTERISTIC CAL_obd_ii_P0444_debounce_count "u8_count" VALUE 0x4000DB9D RL_VALUE_UBYTE 0 NO_COMPU_METHOD 0 255 /end CHARACTERISTIC
/begin CHARACTERISTIC CAL_obd_ii_P0445_debounce_count "u8_count" VALUE 0x4000DB9E RL_VALUE_UBYTE 0 NO_COMPU_METHOD 0 255 /end CHARACTERISTIC
/begin CHARACTERISTIC CAL_obd_ii_P0447_debounce_count "u8_count" VALUE 0x4000DB9F RL_VALUE_UBYTE 0 NO_COMPU_METHOD 0 255 /end CHARACTERISTIC
/begin CHARACTERISTIC CAL_obd_ii_P0448_debounce_count "u8_count" VALUE 0x4000DBA0 RL_VALUE_UBYTE 0 NO_COMPU_METHOD 0 255 /end CHARACTERISTIC
/begin CHARACTERISTIC CAL_obd_ii_P0451_debounce_count_4000DBA1 "u8_count" VALUE 0x4000DBA1 RL_VALUE_UBYTE 0 NO_COMPU_METHOD 0 255 /end CHARACTERISTIC
/begin CHARACTERISTIC CAL_obd_ii_P0079_debounce_count "u8_count" VALUE 0x4000DBA2 RL_VALUE_UBYTE 0 NO_COMPU_METHOD 0 255 /end CHARACTERISTIC
/begin CHARACTERISTIC CAL_obd_ii_P0261_debounce_count "u8_count" VALUE 0x4000DBA3 RL_VALUE_UBYTE 0 NO_COMPU_METHOD 0 255 /end CHARACTERISTIC
/begin CHARACTERISTIC CAL_obd_ii_P0262_debounce_count "u8_count" VALUE 0x4000DBA4 RL_VALUE_UBYTE 0 NO_COMPU_METHOD 0 255 /end CHARACTERISTIC
/begin CHARACTERISTIC CAL_obd_ii_P0264_debounce_count "u8_count" VALUE 0x4000DBA5 RL_VALUE_UBYTE 0 NO_COMPU_METHOD 0 255 /end CHARACTERISTIC
/begin CHARACTERISTIC CAL_obd_ii_P0265_debounce_count "u8_count" VALUE 0x4000DBA6 RL_VALUE_UBYTE 0 NO_COMPU_METHOD 0 255 /end CHARACTERISTIC
/begin CHARACTERISTIC CAL_obd_ii_P0267_debounce_count "u8_count" VALUE 0x4000DBA7 RL_VALUE_UBYTE 0 NO_COMPU_METHOD 0 255 /end CHARACTERISTIC
/begin CHARACTERISTIC CAL_obd_ii_P0268_debounce_count "u8_count" VALUE 0x4000DBA8 RL_VALUE_UBYTE 0 NO_COMPU_METHOD 0 255 /end CHARACTERISTIC
/begin CHARACTERISTIC CAL_obd_ii_P0270_debounce_count "u8_count" VALUE 0x4000DBA9 RL_VALUE_UBYTE 0 NO_COMPU_METHOD 0 255 /end CHARACTERISTIC
/begin CHARACTERISTIC CAL_obd_ii_P0271_debounce_count "u8_count" VALUE 0x4000DBAA RL_VALUE_UBYTE 0 NO_COMPU_METHOD 0 255 /end CHARACTERISTIC
/begin CHARACTERISTIC CAL_obd_ii_P0273_debounce_count "u8_count" VALUE 0x4000DBAB RL_VALUE_UBYTE 0 NO_COMPU_METHOD 0 255 /end CHARACTERISTIC
/begin CHARACTERISTIC CAL_obd_ii_P0274_debounce_count "u8_count" VALUE 0x4000DBAC RL_VALUE_UBYTE 0 NO_COMPU_METHOD 0 255 /end CHARACTERISTIC
/begin CHARACTERISTIC CAL_obd_ii_P0276_debounce_count "u8_count" VALUE 0x4000DBAD RL_VALUE_UBYTE 0 NO_COMPU_METHOD 0 255 /end CHARACTERISTIC
/begin CHARACTERISTIC CAL_obd_ii_P0277_debounce_count "u8_count" VALUE 0x4000DBAE RL_VALUE_UBYTE 0 NO_COMPU_METHOD 0 255 /end CHARACTERISTIC
/begin CHARACTERISTIC CAL_obd_ii_P0629_debounce_count "u8_count" VALUE 0x4000DBAF RL_VALUE_UBYTE 0 NO_COMPU_METHOD 0 255 /end CHARACTERISTIC
/begin CHARACTERISTIC CAL_obd_ii_P0080_debounce_count "u8_count" VALUE 0x4000DBB0 RL_VALUE_UBYTE 0 NO_COMPU_METHOD 0 255 /end CHARACTERISTIC
/begin CHARACTERISTIC CAL_obd_ii_P0082_debounce_count "u8_count" VALUE 0x4000DBB1 RL_VALUE_UBYTE 0 NO_COMPU_METHOD 0 255 /end CHARACTERISTIC
/begin CHARACTERISTIC CAL_obd_ii_P0083_debounce_count "u8_count" VALUE 0x4000DBB2 RL_VALUE_UBYTE 0 NO_COMPU_METHOD 0 255 /end CHARACTERISTIC
/begin CHARACTERISTIC CAL_obd_ii_P0085_debounce_count "u8_count" VALUE 0x4000DBB3 RL_VALUE_UBYTE 0 NO_COMPU_METHOD 0 255 /end CHARACTERISTIC
/begin CHARACTERISTIC CAL_obd_ii_P0086_debounce_count "u8_count" VALUE 0x4000DBB4 RL_VALUE_UBYTE 0 NO_COMPU_METHOD 0 255 /end CHARACTERISTIC
/begin CHARACTERISTIC CAL_obd_ii_P0628_debounce_count "u8_count" VALUE 0x4000DBB5 RL_VALUE_UBYTE 0 NO_COMPU_METHOD 0 255 /end CHARACTERISTIC
/begin CHARACTERISTIC CAL_obd_ii_P1106_debounce_count "u8_count" VALUE 0x4000DBB6 RL_VALUE_UBYTE 0 NO_COMPU_METHOD 0 255 /end CHARACTERISTIC
/begin CHARACTERISTIC CAL_obd_ii_P0480_debounce_count "u8_count" VALUE 0x4000DBB7 RL_VALUE_UBYTE 0 NO_COMPU_METHOD 0 255 /end CHARACTERISTIC
/begin CHARACTERISTIC CAL_obd_ii_P0481_debounce_count "u8_count" VALUE 0x4000DBB8 RL_VALUE_UBYTE 0 NO_COMPU_METHOD 0 255 /end CHARACTERISTIC
/begin CHARACTERISTIC CAL_obd_ii_P2122_debounce_count "u8_count" VALUE 0x4000DBB9 RL_VALUE_UBYTE 0 NO_COMPU_METHOD 0 255 /end CHARACTERISTIC
/begin CHARACTERISTIC CAL_obd_ii_P2123_debounce_count "u8_count" VALUE 0x4000DBBA RL_VALUE_UBYTE 0 NO_COMPU_METHOD 0 255 /end CHARACTERISTIC
/begin CHARACTERISTIC CAL_obd_ii_P2127_debounce_count "u8_count" VALUE 0x4000DBBB RL_VALUE_UBYTE 0 NO_COMPU_METHOD 0 255 /end CHARACTERISTIC
/begin CHARACTERISTIC CAL_obd_ii_P2128_debounce_count "u8_count" VALUE 0x4000DBBC RL_VALUE_UBYTE 0 NO_COMPU_METHOD 0 255 /end CHARACTERISTIC
/begin CHARACTERISTIC CAL_obd_ii_P0420_debounce_count "u8_count" VALUE 0x4000DBBD RL_VALUE_UBYTE 0 NO_COMPU_METHOD 0 255 /end CHARACTERISTIC
/begin CHARACTERISTIC CAL_obd_ii_P0222_debounce_count "u8_count" VALUE 0x4000DBBE RL_VALUE_UBYTE 0 NO_COMPU_METHOD 0 255 /end CHARACTERISTIC
/begin CHARACTERISTIC CAL_obd_ii_P0223_debounce_count "u8_count" VALUE 0x4000DBBF RL_VALUE_UBYTE 0 NO_COMPU_METHOD 0 255 /end CHARACTERISTIC
/begin CHARACTERISTIC CAL_obd_ii_P2135_debounce_count "u8_count" VALUE 0x4000DBC0 RL_VALUE_UBYTE 0 NO_COMPU_METHOD 0 255 /end CHARACTERISTIC
/begin CHARACTERISTIC CAL_obd_ii_P0638_fail_count "u8_count" VALUE 0x4000DBC1 RL_VALUE_UBYTE 0 NO_COMPU_METHOD 0 255 /end CHARACTERISTIC
/begin CHARACTERISTIC CAL_obd_ii_P0430_debounce_count "u8_count" VALUE 0x4000DBC2 RL_VALUE_UBYTE 0 NO_COMPU_METHOD 0 255 /end CHARACTERISTIC
/begin CHARACTERISTIC CAL_obd_ii_P2138_debounce_count "u8_count" VALUE 0x4000DBC3 RL_VALUE_UBYTE 0 NO_COMPU_METHOD 0 255 /end CHARACTERISTIC
/begin CHARACTERISTIC CAL_obd_ii_P2602_debounce_count "u8_count" VALUE 0x4000DBC4 RL_VALUE_UBYTE 0 NO_COMPU_METHOD 0 255 /end CHARACTERISTIC
/begin CHARACTERISTIC CAL_obd_ii_P2603_debounce_count "u8_count" VALUE 0x4000DBC5 RL_VALUE_UBYTE 0 NO_COMPU_METHOD 0 255 /end CHARACTERISTIC
/begin CHARACTERISTIC CAL_obd_ii_P0011_debounce_count "u8_count" VALUE 0x4000DBC6 RL_VALUE_UBYTE 0 NO_COMPU_METHOD 0 255 /end CHARACTERISTIC
/begin CHARACTERISTIC CAL_obd_ii_P0012_debounce_count "u8_count" VALUE 0x4000DBC7 RL_VALUE_UBYTE 0 NO_COMPU_METHOD 0 255 /end CHARACTERISTIC
/begin CHARACTERISTIC CAL_obd_ii_P0171_debounce_count "u8_count" VALUE 0x4000DBC8 RL_VALUE_UBYTE 0 NO_COMPU_METHOD 0 255 /end CHARACTERISTIC
/begin CHARACTERISTIC CAL_obd_ii_P0172_debounce_count "u8_count" VALUE 0x4000DBC9 RL_VALUE_UBYTE 0 NO_COMPU_METHOD 0 255 /end CHARACTERISTIC
/begin CHARACTERISTIC CAL_obd_ii_P1301_debounce_count "u8_count" VALUE 0x4000DBCA RL_VALUE_UBYTE 0 NO_COMPU_METHOD 0 255 /end CHARACTERISTIC
/begin CHARACTERISTIC CAL_obd_ii_P1302_debounce_count "u8_count" VALUE 0x4000DBCB RL_VALUE_UBYTE 0 NO_COMPU_METHOD 0 255 /end CHARACTERISTIC
/begin CHARACTERISTIC CAL_obd_ii_P0133_debounce_count "u8_count" VALUE 0x4000DBCC RL_VALUE_UBYTE 0 NO_COMPU_METHOD 0 255 /end CHARACTERISTIC
/begin CHARACTERISTIC CAL_obd_ii_P0134_debounce_count "u8_count" VALUE 0x4000DBCD RL_VALUE_UBYTE 0 NO_COMPU_METHOD 0 255 /end CHARACTERISTIC
/begin CHARACTERISTIC CAL_obd_ii_P0135_debounce_count "u8_count" VALUE 0x4000DBCE RL_VALUE_UBYTE 0 NO_COMPU_METHOD 0 255 /end CHARACTERISTIC
/begin CHARACTERISTIC CAL_obd_ii_P0355_debounce_count "u8_count" VALUE 0x4000DBCF RL_VALUE_UBYTE 0 NO_COMPU_METHOD 0 255 /end CHARACTERISTIC
/begin CHARACTERISTIC CAL_obd_ii_P0140_debounce_count "u8_count" VALUE 0x4000DBD0 RL_VALUE_UBYTE 0 NO_COMPU_METHOD 0 255 /end CHARACTERISTIC
/begin CHARACTERISTIC CAL_obd_ii_P0141_heater_current_debounce_count "u8_count" VALUE 0x4000DBD1 RL_VALUE_UBYTE 0 NO_COMPU_METHOD 0 255 /end CHARACTERISTIC
/begin CHARACTERISTIC CAL_obd_ii_P0356_debounce_count "u8_count" VALUE 0x4000DBD2 RL_VALUE_UBYTE 0 NO_COMPU_METHOD 0 255 /end CHARACTERISTIC
/begin CHARACTERISTIC CAL_obd_ii_P0579_fail_count "uint8_t" VALUE 0x4000DBD3 RL_VALUE_UBYTE 0 NO_COMPU_METHOD 0 255 /end CHARACTERISTIC
/begin CHARACTERISTIC CAL_obd_ii_P1104_debounce_count "u8_count" VALUE 0x4000DBD4 RL_VALUE_UBYTE 0 NO_COMPU_METHOD 0 255 /end CHARACTERISTIC
/begin CHARACTERISTIC CAL_obd_ii_P0335_debounce_count "u8_count" VALUE 0x4000DBD5 RL_VALUE_UBYTE 0 NO_COMPU_METHOD 0 255 /end CHARACTERISTIC
/begin CHARACTERISTIC CAL_obd_ii_P0523_debounce_count "u8_count" VALUE 0x4000DBD6 RL_VALUE_UBYTE 0 NO_COMPU_METHOD 0 255 /end CHARACTERISTIC
/begin CHARACTERISTIC CAL_obd_ii_P0500_debounce_count "u8_count" VALUE 0x4000DBD7 RL_VALUE_UBYTE 0 NO_COMPU_METHOD 0 255 /end CHARACTERISTIC
/begin CHARACTERISTIC CAL_obd_ii_P0506_debounce_count "u8_count" VALUE 0x4000DBD8 RL_VALUE_UBYTE 0 NO_COMPU_METHOD 0 255 /end CHARACTERISTIC
/begin CHARACTERISTIC CAL_obd_ii_P0507_debounce_count "u8_count" VALUE 0x4000DBD9 RL_VALUE_UBYTE 0 NO_COMPU_METHOD 0 255 /end CHARACTERISTIC
/begin CHARACTERISTIC CAL_obd_ii_P0441_fail_count "u8_count" VALUE 0x4000DBDA RL_VALUE_UBYTE 0 NO_COMPU_METHOD 0 255 /end CHARACTERISTIC
/begin CHARACTERISTIC CAL_obd_ii_P0442_debounce_count "u8_count" VALUE 0x4000DBDB RL_VALUE_UBYTE 0 NO_COMPU_METHOD 0 255 /end CHARACTERISTIC
/begin CHARACTERISTIC CAL_obd_ii_P0301_debounce_count "u8_count" VALUE 0x4000DBDC RL_VALUE_UBYTE 0 NO_COMPU_METHOD 0 255 /end CHARACTERISTIC
/begin CHARACTERISTIC CAL_obd_ii_P0302_debounce_count "u8_count" VALUE 0x4000DBDD RL_VALUE_UBYTE 0 NO_COMPU_METHOD 0 255 /end CHARACTERISTIC
/begin CHARACTERISTIC CAL_obd_ii_P0303_debounce_count "u8_count" VALUE 0x4000DBDE RL_VALUE_UBYTE 0 NO_COMPU_METHOD 0 255 /end CHARACTERISTIC
/begin CHARACTERISTIC CAL_obd_ii_P0304_debounce_count "u8_count" VALUE 0x4000DBDF RL_VALUE_UBYTE 0 NO_COMPU_METHOD 0 255 /end CHARACTERISTIC
/begin CHARACTERISTIC CAL_obd_ii_P0305_debounce_count "u8_count" VALUE 0x4000DBE0 RL_VALUE_UBYTE 0 NO_COMPU_METHOD 0 255 /end CHARACTERISTIC
/begin CHARACTERISTIC CAL_obd_ii_P0306_debounce_count "u8_count" VALUE 0x4000DBE1 RL_VALUE_UBYTE 0 NO_COMPU_METHOD 0 255 /end CHARACTERISTIC
/begin CHARACTERISTIC CAL_obd_ii_P0300_debounce_count "u8_count" VALUE 0x4000DBE2 RL_VALUE_UBYTE 0 NO_COMPU_METHOD 0 255 /end CHARACTERISTIC
/begin CHARACTERISTIC CAL_obd_ii_P0461_debounce_count "u8_count" VALUE 0x4000DBE3 RL_VALUE_UBYTE 0 NO_COMPU_METHOD 0 255 /end CHARACTERISTIC
/begin CHARACTERISTIC CAL_obd_ii_P0462_debounce_count "u8_count" VALUE 0x4000DBE4 RL_VALUE_UBYTE 0 NO_COMPU_METHOD 0 255 /end CHARACTERISTIC
/begin CHARACTERISTIC CAL_obd_ii_P0463_debounce_count "u8_count" VALUE 0x4000DBE5 RL_VALUE_UBYTE 0 NO_COMPU_METHOD 0 255 /end CHARACTERISTIC
/begin CHARACTERISTIC CAL_obd_ii_P0446_fail_count "u8_count" VALUE 0x4000DBE6 RL_VALUE_UBYTE 0 NO_COMPU_METHOD 0 255 /end CHARACTERISTIC
/begin CHARACTERISTIC CAL_obd_ii_P0482_debounce_count "u8_count" VALUE 0x4000DBE7 RL_VALUE_UBYTE 0 NO_COMPU_METHOD 0 255 /end CHARACTERISTIC
/begin CHARACTERISTIC CAL_obd_ii_P2119_debounce_count "u8_count" VALUE 0x4000DBE8 RL_VALUE_UBYTE 0 NO_COMPU_METHOD 0 255 /end CHARACTERISTIC
/begin CHARACTERISTIC CAL_obd_ii_P0455_debounce_count "u8_count" VALUE 0x4000DBE9 RL_VALUE_UBYTE 0 NO_COMPU_METHOD 0 255 /end CHARACTERISTIC
/begin CHARACTERISTIC CAL_obd_ii_P0456_debounce_count "u8_count" VALUE 0x4000DBEA RL_VALUE_UBYTE 0 NO_COMPU_METHOD 0 255 /end CHARACTERISTIC
/begin CHARACTERISTIC CAL_obd_ii_P0016_debounce_count "u8_count" VALUE 0x4000DBEB RL_VALUE_UBYTE 0 NO_COMPU_METHOD 0 255 /end CHARACTERISTIC
/begin CHARACTERISTIC CAL_obd_ii_P2173_fail_count "u8_count" VALUE 0x4000DBEC RL_VALUE_UBYTE 0 NO_COMPU_METHOD 0 255 /end CHARACTERISTIC
/begin CHARACTERISTIC CAL_obd_ii_P2104_debounce_count "u8_count" VALUE 0x4000DBED RL_VALUE_UBYTE 0 NO_COMPU_METHOD 0 255 /end CHARACTERISTIC
/begin CHARACTERISTIC CAL_obd_ii_P2105_debounce_count "u8_count" VALUE 0x4000DBEE RL_VALUE_UBYTE 0 NO_COMPU_METHOD 0 255 /end CHARACTERISTIC
/begin CHARACTERISTIC CAL_obd_ii_P2106_debounce_count "u8_count" VALUE 0x4000DBEF RL_VALUE_UBYTE 0 NO_COMPU_METHOD 0 255 /end CHARACTERISTIC
/begin CHARACTERISTIC CAL_obd_ii_P2107_debounce_count "u8_count" VALUE 0x4000DBF0 RL_VALUE_UBYTE 0 NO_COMPU_METHOD 0 255 /end CHARACTERISTIC
/begin CHARACTERISTIC CAL_obd_ii_P2100_debounce_count "u8_count" VALUE 0x4000DBF1 RL_VALUE_UBYTE 0 NO_COMPU_METHOD 0 255 /end CHARACTERISTIC
/begin CHARACTERISTIC CAL_obd_ii_P2102_debounce_count "u8_count" VALUE 0x4000DBF2 RL_VALUE_UBYTE 0 NO_COMPU_METHOD 0 255 /end CHARACTERISTIC
/begin CHARACTERISTIC CAL_obd_ii_P2103_debounce_count "u8_count" VALUE 0x4000DBF3 RL_VALUE_UBYTE 0 NO_COMPU_METHOD 0 255 /end CHARACTERISTIC
/begin CHARACTERISTIC CAL_obd_ii_P2108_debounce_count "u8_count" VALUE 0x4000DBF4 RL_VALUE_UBYTE 0 NO_COMPU_METHOD 0 255 /end CHARACTERISTIC
/begin CHARACTERISTIC CAL_obd_ii_P0685_debounce_count "u8_count" VALUE 0x4000DBF5 RL_VALUE_UBYTE 0 NO_COMPU_METHOD 0 255 /end CHARACTERISTIC
/begin CHARACTERISTIC CAL_obd_ii_P0151_fail_count "u8_count" VALUE 0x4000DBF6 RL_VALUE_UBYTE 0 NO_COMPU_METHOD 0 255 /end CHARACTERISTIC
/begin CHARACTERISTIC CAL_obd_ii_P0152_fail_count "u8_count" VALUE 0x4000DBF7 RL_VALUE_UBYTE 0 NO_COMPU_METHOD 0 255 /end CHARACTERISTIC
/begin CHARACTERISTIC CAL_obd_ii_P0157_fail_count "u8_count" VALUE 0x4000DBF8 RL_VALUE_UBYTE 0 NO_COMPU_METHOD 0 255 /end CHARACTERISTIC
/begin CHARACTERISTIC CAL_obd_ii_P0158_fail_count "uint8_t" VALUE 0x4000DBF9 RL_VALUE_UBYTE 0 NO_COMPU_METHOD 0 255 /end CHARACTERISTIC
/begin CHARACTERISTIC CAL_obd_ii_P0159_debounce_count "u8_count" VALUE 0x4000DBFA RL_VALUE_UBYTE 0 NO_COMPU_METHOD 0 255 /end CHARACTERISTIC
/begin CHARACTERISTIC CAL_obd_ii_P0332_debounce_count "u8_count" VALUE 0x4000DBFB RL_VALUE_UBYTE 0 NO_COMPU_METHOD 0 255 /end CHARACTERISTIC
/begin CHARACTERISTIC CAL_obd_ii_P0333_debounce_count "u8_count" VALUE 0x4000DBFC RL_VALUE_UBYTE 0 NO_COMPU_METHOD 0 255 /end CHARACTERISTIC
/begin CHARACTERISTIC CAL_obd_ii_unused_4000dbfd "u8_count" VALUE 0x4000DBFD RL_VALUE_UBYTE 0 NO_COMPU_METHOD 0 255 /end CHARACTERISTIC
/begin CHARACTERISTIC CAL_obd_ii_P0021_debounce_count "u8_count" VALUE 0x4000DBFE RL_VALUE_UBYTE 0 NO_COMPU_METHOD 0 255 /end CHARACTERISTIC
/begin CHARACTERISTIC CAL_obd_ii_P0022_debounce_count "u8_count" VALUE 0x4000DBFF RL_VALUE_UBYTE 0 NO_COMPU_METHOD 0 255 /end CHARACTERISTIC
/begin CHARACTERISTIC CAL_obd_ii_P0174_debounce_count "u8_count" VALUE 0x4000DC00 RL_VALUE_UBYTE 0 NO_COMPU_METHOD 0 255 /end CHARACTERISTIC
/begin CHARACTERISTIC CAL_obd_ii_P0175_debounce_count "u8_count" VALUE 0x4000DC01 RL_VALUE_UBYTE 0 NO_COMPU_METHOD 0 255 /end CHARACTERISTIC
/begin CHARACTERISTIC CAL_obd_ii_P0153_debounce_count "u8_count" VALUE 0x4000DC02 RL_VALUE_UBYTE 0 NO_COMPU_METHOD 0 255 /end CHARACTERISTIC
/begin CHARACTERISTIC CAL_obd_ii_P0154_debounce_count "u8_count" VALUE 0x4000DC03 RL_VALUE_UBYTE 0 NO_COMPU_METHOD 0 255 /end CHARACTERISTIC
/begin CHARACTERISTIC CAL_obd_ii_P0155_debounce_count "u8_count" VALUE 0x4000DC04 RL_VALUE_UBYTE 0 NO_COMPU_METHOD 0 255 /end CHARACTERISTIC
/begin CHARACTERISTIC CAL_obd_ii_P0160_debounce_count "u8_count" VALUE 0x4000DC05 RL_VALUE_UBYTE 0 NO_COMPU_METHOD 0 255 /end CHARACTERISTIC
/begin CHARACTERISTIC CAL_obd_ii_P0161_debounce_count "u8_count" VALUE 0x4000DC06 RL_VALUE_UBYTE 0 NO_COMPU_METHOD 0 255 /end CHARACTERISTIC
/begin CHARACTERISTIC CAL_obd_ii_P0017_debounce_count "u8_count" VALUE 0x4000DC07 RL_VALUE_UBYTE 0 NO_COMPU_METHOD 0 255 /end CHARACTERISTIC
/begin CHARACTERISTIC CAL_obd_ii_P0018_debounce_count "u8_count" VALUE 0x4000DC08 RL_VALUE_UBYTE 0 NO_COMPU_METHOD 0 255 /end CHARACTERISTIC
/begin CHARACTERISTIC CAL_obd_ii_P0019_debounce_count "u8_count" VALUE 0x4000DC09 RL_VALUE_UBYTE 0 NO_COMPU_METHOD 0 255 /end CHARACTERISTIC
/begin CHARACTERISTIC CAL_obd_ii_P1113_debounce_count "u8_count" VALUE 0x4000DC0A RL_VALUE_UBYTE 0 NO_COMPU_METHOD 0 255 /end CHARACTERISTIC
/begin CHARACTERISTIC CAL_obd_ii_P0661_debounce_count "u8_count" VALUE 0x4000DC0B RL_VALUE_UBYTE 0 NO_COMPU_METHOD 0 255 /end CHARACTERISTIC
/begin CHARACTERISTIC CAL_obd_ii_P0662_debounce_count "u8_count" VALUE 0x4000DC0C RL_VALUE_UBYTE 0 NO_COMPU_METHOD 0 255 /end CHARACTERISTIC
/begin CHARACTERISTIC CAL_obd_ii_P0616_debounce_count "u8_count" VALUE 0x4000DC0D RL_VALUE_UBYTE 0 NO_COMPU_METHOD 0 255 /end CHARACTERISTIC
/begin CHARACTERISTIC CAL_obd_ii_P0617_debounce_count "u8_count" VALUE 0x4000DC0E RL_VALUE_UBYTE 0 NO_COMPU_METHOD 0 255 /end CHARACTERISTIC
/begin CHARACTERISTIC CAL_obd_ii_P0341_debounce_count "u8_count" VALUE 0x4000DC0F RL_VALUE_UBYTE 0 NO_COMPU_METHOD 0 255 /end CHARACTERISTIC
/begin CHARACTERISTIC CAL_obd_ii_P0346_debounce_count "u8_count" VALUE 0x4000DC10 RL_VALUE_UBYTE 0 NO_COMPU_METHOD 0 255 /end CHARACTERISTIC
/begin CHARACTERISTIC CAL_obd_ii_P0366_debounce_count "u8_count" VALUE 0x4000DC11 RL_VALUE_UBYTE 0 NO_COMPU_METHOD 0 255 /end CHARACTERISTIC
/begin CHARACTERISTIC CAL_obd_ii_P0391_debounce_count "u8_count" VALUE 0x4000DC12 RL_VALUE_UBYTE 0 NO_COMPU_METHOD 0 255 /end CHARACTERISTIC
/begin CHARACTERISTIC CAL_obd_ii_P0578_fail_count "uint8_t" VALUE 0x4000DC13 RL_VALUE_UBYTE 0 NO_COMPU_METHOD 0 255 /end CHARACTERISTIC
/begin CHARACTERISTIC CAL_obd_ii_P0564_debounce_count "u8_count" VALUE 0x4000DC14 RL_VALUE_UBYTE 0 NO_COMPU_METHOD 0 255 /end CHARACTERISTIC
/begin CHARACTERISTIC CAL_obd_ii_P0806_debounce_count "u8_count" VALUE 0x4000DC15 RL_VALUE_UBYTE 0 NO_COMPU_METHOD 0 255 /end CHARACTERISTIC
/begin CHARACTERISTIC CAL_obd_ii_P0807_debounce_count "u8_count" VALUE 0x4000DC16 RL_VALUE_UBYTE 0 NO_COMPU_METHOD 0 255 /end CHARACTERISTIC
/begin CHARACTERISTIC CAL_obd_ii_P0808_debounce_count "u8_count" VALUE 0x4000DC17 RL_VALUE_UBYTE 0 NO_COMPU_METHOD 0 255 /end CHARACTERISTIC
/begin CHARACTERISTIC CAL_obd_ii_P2612_debounce_count "u8_count" VALUE 0x4000DC18 RL_VALUE_UBYTE 0 NO_COMPU_METHOD 0 255 /end CHARACTERISTIC
/begin CHARACTERISTIC CAL_obd_ii_P2613_debounce_count "u8_count" VALUE 0x4000DC19 RL_VALUE_UBYTE 0 NO_COMPU_METHOD 0 255 /end CHARACTERISTIC
/begin CHARACTERISTIC CAL_obd_ii_P0537_debounce_count "u8_count" VALUE 0x4000DC1A RL_VALUE_UBYTE 0 NO_COMPU_METHOD 0 255 /end CHARACTERISTIC
/begin CHARACTERISTIC CAL_obd_ii_P0538_debounce_count "u8_count" VALUE 0x4000DC1B RL_VALUE_UBYTE 0 NO_COMPU_METHOD 0 255 /end CHARACTERISTIC
/begin CHARACTERISTIC CAL_obd_ii_U0127_debounce_count "Calibration that arms/thresholds the P0127 monitor (intake air too hot). Fixed value -- it sets when that DTC trips, not a live channel." VALUE 0x4000DC1C RL_VALUE_UBYTE 0 NO_COMPU_METHOD 0 255 /end CHARACTERISTIC
/begin CHARACTERISTIC CAL_obd_ii_U0101_pass_counter_max "u8_count" VALUE 0x4000DC1D RL_VALUE_UBYTE 0 NO_COMPU_METHOD 0 255 /end CHARACTERISTIC
/begin CHARACTERISTIC CAL_obd_U0122_pass_counter_max "u8_count" VALUE 0x4000DC1E RL_VALUE_UBYTE 0 NO_COMPU_METHOD 0 255 /end CHARACTERISTIC
/begin CHARACTERISTIC CAL_obd_ii_U0316_debounce_count "u8_count" VALUE 0x4000DC1F RL_VALUE_UBYTE 0 NO_COMPU_METHOD 0 255 /end CHARACTERISTIC
/begin CHARACTERISTIC CAL_obd_ii_P0141_debounce_count "u8_count" VALUE 0x4000DC20 RL_VALUE_UBYTE 0 NO_COMPU_METHOD 0 255 /end CHARACTERISTIC
/begin CHARACTERISTIC CAL_obd_ii_P050A_debounce_count "u8_count" VALUE 0x4000DC21 RL_VALUE_UBYTE 0 NO_COMPU_METHOD 0 255 /end CHARACTERISTIC
/begin CHARACTERISTIC CAL_obd_ii_P0071_maturing_limit "uint8_t" VALUE 0x4000DC22 RL_VALUE_UBYTE 0 NO_COMPU_METHOD 0 255 /end CHARACTERISTIC
/begin CHARACTERISTIC CAL_obd_ii_P050B_maturing_limit "u8_count" VALUE 0x4000DC23 RL_VALUE_UBYTE 0 NO_COMPU_METHOD 0 255 /end CHARACTERISTIC
/begin CHARACTERISTIC CAL_obd_P2170_pass_counter_max "u8_count" VALUE 0x4000DC24 RL_VALUE_UBYTE 0 NO_COMPU_METHOD 0 255 /end CHARACTERISTIC
/begin CHARACTERISTIC CAL_obd_ii_P2171_debounce_count "u8_count" VALUE 0x4000DC25 RL_VALUE_UBYTE 0 NO_COMPU_METHOD 0 255 /end CHARACTERISTIC
/begin CHARACTERISTIC CAL_obd_ii_P0826_debounce_count "u8_count" VALUE 0x4000DC26 RL_VALUE_UBYTE 0 NO_COMPU_METHOD 0 255 /end CHARACTERISTIC
/begin CHARACTERISTIC CAL_obd_ii_P0827_debounce_count "u8_count" VALUE 0x4000DC27 RL_VALUE_UBYTE 0 NO_COMPU_METHOD 0 255 /end CHARACTERISTIC
/begin CHARACTERISTIC CAL_obd_ii_P0828_debounce_count "u8_count" VALUE 0x4000DC28 RL_VALUE_UBYTE 0 NO_COMPU_METHOD 0 255 /end CHARACTERISTIC
/begin CHARACTERISTIC CAL_obd_ii_U0302_debounce_count "u8_count" VALUE 0x4000DC29 RL_VALUE_UBYTE 0 NO_COMPU_METHOD 0 255 /end CHARACTERISTIC
/begin CHARACTERISTIC CAL_obd_ii_U0416_debounce_count "u8_count" VALUE 0x4000DC2A RL_VALUE_UBYTE 0 NO_COMPU_METHOD 0 255 /end CHARACTERISTIC
/begin CHARACTERISTIC CAL_obd_ii_P2191_debounce_count "u8_count" VALUE 0x4000DC2B RL_VALUE_UBYTE 0 NO_COMPU_METHOD 0 255 /end CHARACTERISTIC
/begin CHARACTERISTIC CAL_obd_ii_P2193_debounce_count "u8_count" VALUE 0x4000DC2C RL_VALUE_UBYTE 0 NO_COMPU_METHOD 0 255 /end CHARACTERISTIC
/begin CHARACTERISTIC CAL_obd_ii_P1809_debounce_count "u8_count" VALUE 0x4000DC2D RL_VALUE_UBYTE 0 NO_COMPU_METHOD 0 255 /end CHARACTERISTIC
/begin CHARACTERISTIC CAL_obd_ii_P2336_maturing_limit "uint8_t" VALUE 0x4000DC2E RL_VALUE_UBYTE 0 NO_COMPU_METHOD 0 255 /end CHARACTERISTIC
/begin CHARACTERISTIC CAL_obd_ii_P2337_maturing_limit "u8_count" VALUE 0x4000DC2F RL_VALUE_UBYTE 0 NO_COMPU_METHOD 0 255 /end CHARACTERISTIC
/begin CHARACTERISTIC CAL_obd_ii_P2338_maturing_limit "u8_count" VALUE 0x4000DC30 RL_VALUE_UBYTE 0 NO_COMPU_METHOD 0 255 /end CHARACTERISTIC
/begin CHARACTERISTIC CAL_obd_ii_P2339_maturing_limit "u8_count" VALUE 0x4000DC31 RL_VALUE_UBYTE 0 NO_COMPU_METHOD 0 255 /end CHARACTERISTIC
/begin CHARACTERISTIC CAL_obd_ii_P2340_maturing_limit "u8_count" VALUE 0x4000DC32 RL_VALUE_UBYTE 0 NO_COMPU_METHOD 0 255 /end CHARACTERISTIC
/begin CHARACTERISTIC CAL_obd_ii_P2341_maturing_limit "u8_count" VALUE 0x4000DC33 RL_VALUE_UBYTE 0 NO_COMPU_METHOD 0 255 /end CHARACTERISTIC
/begin CHARACTERISTIC CAL_obd_ii_U0123_debounce_count "u8_count" VALUE 0x4000DC34 RL_VALUE_UBYTE 0 NO_COMPU_METHOD 0 255 /end CHARACTERISTIC
/begin CHARACTERISTIC CAL_obd_ii_U0513_debounce_count "u8_count" VALUE 0x4000DC35 RL_VALUE_UBYTE 0 NO_COMPU_METHOD 0 255 /end CHARACTERISTIC
/begin CHARACTERISTIC CAL_obd_ii_P1562_debounce_count "u8_count" VALUE 0x4000DC36 RL_VALUE_UBYTE 0 NO_COMPU_METHOD 0 255 /end CHARACTERISTIC
/begin AXIS_PTS CAL_obd_ii_P0420_precat_switch_target_ips_X_maf_flow "Calibration: MAF compensation IPS unknown by flow. Tunable map/constant (not a live channel); log to follow IPS automated-manual shift behavior. (g)" 0x4000E09C NO_INPUT_QUANTITY RL_AXIS_UBYTE 0 CM_u16_mass_g 8 0 255 /end AXIS_PTS
/begin CHARACTERISTIC CAL_obd_ii_P0420_precat_switch_target_ips "u8_count[8]" CURVE 0x4000E0A4 RL_VALUE_UBYTE 0 NO_COMPU_METHOD 0 255
 /begin AXIS_DESCR COM_AXIS NO_INPUT_QUANTITY CM_u16_mass_g 8 0 255 AXIS_PTS_REF CAL_obd_ii_P0420_precat_switch_target_ips_X_maf_flow /end AXIS_DESCR
/end CHARACTERISTIC
/begin AXIS_PTS CAL_gsi_power_rpm_limit_X_power "X-axis breakpoints for the 'slip power based RPM thresholds' table. Defines the lookup grid (not a live channel); change only when re-axing the map." 0x4000E13C slip_power_index RL_AXIS_UWORD 0 NO_COMPU_METHOD 8 0 65535 /end AXIS_PTS
/begin CHARACTERISTIC CAL_gsi_power_rpm_limit "Calibration: slip power based RPM thresholds. Tunable map/constant (not a live channel); log to see wheel slip and traction-control intervention. (RPM)" CURVE 0x4000E14C RL_VALUE_UWORD 0 CM_u8_rspeed_rpm 0 65535
 /begin AXIS_DESCR COM_AXIS slip_power_index NO_COMPU_METHOD 8 0 65535 AXIS_PTS_REF CAL_gsi_power_rpm_limit_X_power /end AXIS_DESCR
/end CHARACTERISTIC
/begin AXIS_PTS CAL_obd_ii_P2173_alphaN_trim_limit_X_rpm "u8_rspeed_125/4+500rpm[8]" 0x4000E15C engine_speed_3 RL_AXIS_UBYTE 0 CM_u8_rspeed_125_4_500rpm 8 500 8468.75 /end AXIS_PTS
/begin AXIS_PTS CAL_obd_ii_P2173_alphaN_trim_limit_Y_tps "u8_factor_1/255[8]" 0x4000E164 tps_8bit RL_AXIS_UBYTE 0 CM_u8_factor_1_255 8 0 100 /end AXIS_PTS
/begin CHARACTERISTIC CAL_obd_ii_P2173_alphaN_trim_limit "u8_factor_1/100[64]" MAP 0x4000E16C RL_VALUE_UBYTE 0 CM_u8_factor_1_100 0 255
 /begin AXIS_DESCR COM_AXIS engine_speed_3 CM_u8_rspeed_125_4_500rpm 8 500 8468.75 AXIS_PTS_REF CAL_obd_ii_P2173_alphaN_trim_limit_X_rpm /end AXIS_DESCR
 /begin AXIS_DESCR COM_AXIS tps_8bit CM_u8_factor_1_255 8 0 100 AXIS_PTS_REF CAL_obd_ii_P2173_alphaN_trim_limit_Y_tps /end AXIS_DESCR
/end CHARACTERISTIC
/begin AXIS_PTS CAL_obd_ii_cat_monitor_min_maf_accum_thresh_X_coolant_temp "u8_temp_5/8-40c[8]" 0x4000E6B0 coolant_temp_engine_stopped RL_AXIS_UBYTE 0 CM_u8_temp_5_8_40c 8 -40 119.375 /end AXIS_PTS
/begin CHARACTERISTIC CAL_obd_ii_cat_monitor_min_maf_accum_thresh "uint8_t[8]" CURVE 0x4000E6B8 RL_VALUE_UBYTE 0 NO_COMPU_METHOD 0 255
 /begin AXIS_DESCR COM_AXIS coolant_temp_engine_stopped CM_u8_temp_5_8_40c 8 -40 119.375 AXIS_PTS_REF CAL_obd_ii_cat_monitor_min_maf_accum_thresh_X_coolant_temp /end AXIS_DESCR
/end CHARACTERISTIC
/begin AXIS_PTS CAL_obd_ii_P0420_precat_switch_target_manual_X_maf_flow "Calibration: MAF compensation manual unknown by MAF flow. Tunable map/constant (not a live channel); adjust to change this behavior. (g)" 0x4000E6C0 NO_INPUT_QUANTITY RL_AXIS_UBYTE 0 CM_u8_flow_g_s 8 0 255 /end AXIS_PTS
/begin CHARACTERISTIC CAL_obd_ii_P0420_precat_switch_target_manual "uint8_t[8]" CURVE 0x4000E6C8 RL_VALUE_UBYTE 0 NO_COMPU_METHOD 0 255
 /begin AXIS_DESCR COM_AXIS NO_INPUT_QUANTITY CM_u8_flow_g_s 8 0 255 AXIS_PTS_REF CAL_obd_ii_P0420_precat_switch_target_manual_X_maf_flow /end AXIS_DESCR
/end CHARACTERISTIC
/begin AXIS_PTS CAL_obd_ii_P0128_heat_weight_X_load "u8_load_4mg/stroke[8]" 0x4000E7A8 load_mass_per_stroke RL_AXIS_UBYTE 0 CM_u8_load_4mg_stroke 8 0 1020 /end AXIS_PTS
/begin CHARACTERISTIC CAL_obd_ii_P0128_heat_weight "u8_factor_1/255[8]" CURVE 0x4000E7B0 RL_VALUE_UBYTE 0 CM_u8_factor_1_255 0 100
 /begin AXIS_DESCR COM_AXIS load_mass_per_stroke CM_u8_load_4mg_stroke 8 0 1020 AXIS_PTS_REF CAL_obd_ii_P0128_heat_weight_X_load /end AXIS_DESCR
/end CHARACTERISTIC
/begin CHARACTERISTIC CAL_obd_ii_P0101_load_tolerance_X_rpm "u8_rspeed_125/4+500rpm[8]" VAL_BLK 0x4000E7CA RL_VALUE_UBYTE 0 CM_u8_rspeed_125_4_500rpm 500 8468.75 NUMBER 8 /end CHARACTERISTIC
/begin CHARACTERISTIC CAL_obd_ii_P0101_load_tolerance_pct "u8_factor_1/100[8]" VAL_BLK 0x4000E7D2 RL_VALUE_UBYTE 0 CM_u8_factor_1_100 0 255 NUMBER 8 /end CHARACTERISTIC
/begin AXIS_PTS CAL_obd_ii_P0106_intake_pressure_drop_X_maf_flow "X-axis: maf_flow_1/200 = 2 g/s per count." 0x4000E818 V_CAL_obd_ii_P0106_intake_pressure_drop_X_maf_flow RL_AXIS_UBYTE 0 CM_u8_flow_2g_s 8 0 510 /end AXIS_PTS
/begin CHARACTERISTIC CAL_obd_ii_P0106_intake_pressure_drop "P0106: pressure drop upstream of the throttle (air filter/MAF/intake) vs MAF flow (mbar), added to the baro estimate." CURVE 0x4000E820 RL_VALUE_UBYTE 0 CM_i16_pressure_mbar 0 255
 /begin AXIS_DESCR COM_AXIS V_CAL_obd_ii_P0106_intake_pressure_drop_X_maf_flow CM_u8_flow_2g_s 8 0 510 AXIS_PTS_REF CAL_obd_ii_P0106_intake_pressure_drop_X_maf_flow /end AXIS_DESCR
/end CHARACTERISTIC
/begin AXIS_PTS CAL_obd_ii_P0106_throttle_vacuum_rpm_lo_X_tps "X-axis breakpoints for the 'OBD MAP plausibility unknown' table. Defines the lookup grid (not a live channel); change only when re-axing the map. (0-1; raw/255)" 0x4000E828 tps_8bit RL_AXIS_UBYTE 0 CM_u8_factor_1_255 8 0 100 /end AXIS_PTS
/begin AXIS_PTS CAL_obd_ii_P0106_throttle_vacuum_rpm_lo_Y_load "Y-axis breakpoints for the 'OBD MAP plausibility unknown' table. Defines the lookup grid (not a live channel); change only when re-axing the map. (mg/stroke; raw*4)" 0x4000E830 load_mass_per_stroke RL_AXIS_UBYTE 0 CM_u8_load_4mg_stroke 8 0 1020 /end AXIS_PTS
/begin CHARACTERISTIC CAL_obd_ii_P0106_throttle_vacuum_rpm_lo "P0106 part-load expected vacuum across the throttle (4 mbar) vs TPS (X) and load (Y) at the low end of CAL_obd_ii_P0106_partload_rpm_window." MAP 0x4000E838 RL_VALUE_UBYTE 0 CM_u8_pressure_4mbar 0 1020
 /begin AXIS_DESCR COM_AXIS tps_8bit CM_u8_factor_1_255 8 0 100 AXIS_PTS_REF CAL_obd_ii_P0106_throttle_vacuum_rpm_lo_X_tps /end AXIS_DESCR
 /begin AXIS_DESCR COM_AXIS load_mass_per_stroke CM_u8_load_4mg_stroke 8 0 1020 AXIS_PTS_REF CAL_obd_ii_P0106_throttle_vacuum_rpm_lo_Y_load /end AXIS_DESCR
/end CHARACTERISTIC
/begin AXIS_PTS CAL_obd_ii_P0106_throttle_vacuum_rpm_hi_X_tps "X-axis breakpoints for the 'OBD MAP plausibility unknown2' table. Defines the lookup grid (not a live channel); change only when re-axing the map. (0-1; raw/255)" 0x4000E878 tps_8bit RL_AXIS_UBYTE 0 CM_u8_factor_1_255 8 0 100 /end AXIS_PTS
/begin AXIS_PTS CAL_obd_ii_P0106_throttle_vacuum_rpm_hi_Y_load "Y-axis breakpoints for the 'OBD MAP plausibility unknown2' table. Defines the lookup grid (not a live channel); change only when re-axing the map. (mg/stroke; raw*4)" 0x4000E880 load_mass_per_stroke RL_AXIS_UBYTE 0 CM_u8_load_4mg_stroke 8 0 1020 /end AXIS_PTS
/begin CHARACTERISTIC CAL_obd_ii_P0106_throttle_vacuum_rpm_hi "P0106 part-load expected vacuum across the throttle (4 mbar) vs TPS (X) and load (Y) at the high end of CAL_obd_ii_P0106_partload_rpm_window." MAP 0x4000E888 RL_VALUE_UBYTE 0 CM_u8_pressure_4mbar 0 1020
 /begin AXIS_DESCR COM_AXIS tps_8bit CM_u8_factor_1_255 8 0 100 AXIS_PTS_REF CAL_obd_ii_P0106_throttle_vacuum_rpm_hi_X_tps /end AXIS_DESCR
 /begin AXIS_DESCR COM_AXIS load_mass_per_stroke CM_u8_load_4mg_stroke 8 0 1020 AXIS_PTS_REF CAL_obd_ii_P0106_throttle_vacuum_rpm_hi_Y_load /end AXIS_DESCR
/end CHARACTERISTIC
/begin CHARACTERISTIC CAL_obd_ii_P0106_map_corr_highload_X_rpm "u8_rspeed_125/4+500rpm[8]" VAL_BLK 0x4000E8C8 RL_VALUE_UBYTE 0 CM_u8_rspeed_125_4_500rpm 500 8468.75 NUMBER 8 /end CHARACTERISTIC
/begin CHARACTERISTIC CAL_obd_ii_P0106_map_corr_highload_Y_load "u8_load_4mg/stroke[8]" VAL_BLK 0x4000E8D0 RL_VALUE_UBYTE 0 CM_u8_load_4mg_stroke 0 1020 NUMBER 8 /end CHARACTERISTIC
/begin CHARACTERISTIC CAL_obd_ii_P0106_baro_corr_highload "P0106 high-load correction (mbar) subtracted from the baro estimate; rows = load (Y), cols = rpm (X). Zero in stock cal." VAL_BLK 0x4000E8D8 RL_VALUE_UBYTE 0 CM_i16_pressure_mbar 0 255 NUMBER 64 /end CHARACTERISTIC
/begin AXIS_PTS CAL_obd_ii_o2_lean_time_baseline_X_maf "u8_flow_g/s[8]" 0x4000E918 V_CAL_obd_ii_o2_lean_time_baseline_X_maf RL_AXIS_UBYTE 0 CM_u8_flow_g_s 8 0 255 /end AXIS_PTS
/begin CHARACTERISTIC CAL_obd_ii_o2_lean_time_baseline "uint8_t[8]" CURVE 0x4000E920 RL_VALUE_UBYTE 0 NO_COMPU_METHOD 0 255
 /begin AXIS_DESCR COM_AXIS V_CAL_obd_ii_o2_lean_time_baseline_X_maf CM_u8_flow_g_s 8 0 255 AXIS_PTS_REF CAL_obd_ii_o2_lean_time_baseline_X_maf /end AXIS_DESCR
/end CHARACTERISTIC
/begin AXIS_PTS CAL_obd_ii_o2_rich_time_baseline_X_maf "u8_flow_g/s[8]" 0x4000E928 V_CAL_obd_ii_o2_rich_time_baseline_X_maf RL_AXIS_UBYTE 0 CM_u8_flow_g_s 8 0 255 /end AXIS_PTS
/begin CHARACTERISTIC CAL_obd_ii_o2_rich_time_baseline "u8_time_5ms[8]" CURVE 0x4000E930 RL_VALUE_UBYTE 0 CM_u8_time_5ms 0 1275
 /begin AXIS_DESCR COM_AXIS V_CAL_obd_ii_o2_rich_time_baseline_X_maf CM_u8_flow_g_s 8 0 255 AXIS_PTS_REF CAL_obd_ii_o2_rich_time_baseline_X_maf /end AXIS_DESCR
/end CHARACTERISTIC
/begin AXIS_PTS CAL_cruise_maf_feedforward_X_carspeed "X-axis breakpoints for the 'cruise MAF feedforward' table. Defines the lookup grid (not a live channel); change only when re-axing the map. (km/h)" 0x4000ECA8 NO_INPUT_QUANTITY RL_AXIS_UBYTE 0 CM_u8_speed_kph 8 0 255 /end AXIS_PTS
/begin CHARACTERISTIC CAL_cruise_maf_feedforward "Role in cruise logic" CURVE 0x4000ECB0 RL_VALUE_UBYTE 0 CM_u8_flow_g_s 0 255
 /begin AXIS_DESCR COM_AXIS NO_INPUT_QUANTITY CM_u8_speed_kph 8 0 255 AXIS_PTS_REF CAL_cruise_maf_feedforward_X_carspeed /end AXIS_DESCR
/end CHARACTERISTIC
/begin AXIS_PTS CAL_ips_revmatch_convergence_rpm_X_rpm "X-axis breakpoints for the 'IPS revmatch convergence RPM' table. Defines the lookup grid (not a live channel); change only when re-axing the map. (RPM)" 0x4000EE70 ips_engine_speed_at_shift RL_AXIS_UWORD 0 CM_u8_rspeed_rpm 4 0 65535 /end AXIS_PTS
/begin CHARACTERISTIC CAL_ips_revmatch_convergence_rpm "Calibration: IPS revmatch convergence RPM. Tunable map/constant (not a live channel); log to follow IPS automated-manual shift behavior." CURVE 0x4000EE78 RL_VALUE_UWORD 0 NO_COMPU_METHOD 0 65535
 /begin AXIS_DESCR COM_AXIS ips_engine_speed_at_shift CM_u8_rspeed_rpm 4 0 65535 AXIS_PTS_REF CAL_ips_revmatch_convergence_rpm_X_rpm /end AXIS_DESCR
/end CHARACTERISTIC
/begin GROUP G_Diagnostics "OBD-II diagnostics" ROOT
 /begin REF_CHARACTERISTIC CAL_obd_P0171_learn_time_threshold CAL_obd_P0171_ltft_limit CAL_obd_P0172_learn_time_threshold CAL_obd_P0172_ltft_limit CAL_obd_P2170_pass_counter_max CAL_obd_U0122_pass_counter_max CAL_obd_ac_load_diag_rpm_min CAL_obd_ac_load_diag_tolerance_pct CAL_obd_cat_monitor_init_counter_2 CAL_obd_evap_entry_settle_delay CAL_obd_evap_fuel_level_noise_count_limit CAL_obd_evap_fuel_level_noise_threshold CAL_obd_evap_pressure_noise_count_limit CAL_obd_evap_pressure_noise_threshold CAL_obd_evap_stability_window_samples CAL_obd_fuel_learn_eng_speed_delta_max CAL_obd_ii_P0011 CAL_obd_ii_P0011_debounce_count CAL_obd_ii_P0012 CAL_obd_ii_P0012_debounce_count CAL_obd_ii_P0014 CAL_obd_ii_P0014_debounce_count CAL_obd_ii_P0015 CAL_obd_ii_P0015_debounce_count CAL_obd_ii_P0016 CAL_obd_ii_P0016_debounce_count CAL_obd_ii_P0017 CAL_obd_ii_P0017_debounce_count CAL_obd_ii_P0018 CAL_obd_ii_P0018_debounce_count CAL_obd_ii_P0019 CAL_obd_ii_P0019_debounce_count CAL_obd_ii_P0021 CAL_obd_ii_P0021_debounce_count CAL_obd_ii_P0022 CAL_obd_ii_P0022_debounce_count CAL_obd_ii_P0024 CAL_obd_ii_P0024_debounce_count CAL_obd_ii_P0025 CAL_obd_ii_P0025_debounce_count CAL_obd_ii_P0071 CAL_obd_ii_P0071_air_temp_limit CAL_obd_ii_P0071_maturing_limit CAL_obd_ii_P0076 CAL_obd_ii_P0076_debounce_count CAL_obd_ii_P0077 CAL_obd_ii_P0077_debounce_count CAL_obd_ii_P0079 CAL_obd_ii_P0079_debounce_count CAL_obd_ii_P0080 CAL_obd_ii_P0080_debounce_count CAL_obd_ii_P0082 CAL_obd_ii_P0082_debounce_count CAL_obd_ii_P0083 CAL_obd_ii_P0083_debounce_count CAL_obd_ii_P0085 CAL_obd_ii_P0085_debounce_count CAL_obd_ii_P0086 CAL_obd_ii_P0086_debounce_count CAL_obd_ii_P0101 CAL_obd_ii_P0101_baro_min CAL_obd_ii_P0101_idle_coolant_min CAL_obd_ii_P0101_idle_dwell_min CAL_obd_ii_P0101_idle_iat_max CAL_obd_ii_P0101_load_tolerance_X_rpm CAL_obd_ii_P0101_load_tolerance_pct CAL_obd_ii_P0101_load_tolerance_pct_idle CAL_obd_ii_P0101_maturing_limit CAL_obd_ii_P0101_plausibility_enable CAL_obd_ii_P0101_runtime_min CAL_obd_ii_P0102 CAL_obd_ii_P0102_debounce_count CAL_obd_ii_P0103 CAL_obd_ii_P0103_debounce_count CAL_obd_ii_P0106 CAL_obd_ii_P0106_baro_corr_highload CAL_obd_ii_P0106_baro_error_limits CAL_obd_ii_P0106_debounce_count CAL_obd_ii_P0106_highload_rpm_window CAL_obd_ii_P0106_intake_pressure_drop CAL_obd_ii_P0106_intake_pressure_drop_X_maf_flow CAL_obd_ii_P0106_map_corr_highload_X_rpm CAL_obd_ii_P0106_map_corr_highload_Y_load CAL_obd_ii_P0106_partload_rpm_window CAL_obd_ii_P0106_partload_tps_rate_max CAL_obd_ii_P0106_partload_tps_window CAL_obd_ii_P0106_throttle_vacuum_rpm_hi CAL_obd_ii_P0106_throttle_vacuum_rpm_hi_X_tps CAL_obd_ii_P0106_throttle_vacuum_rpm_hi_Y_load CAL_obd_ii_P0106_throttle_vacuum_rpm_lo CAL_obd_ii_P0106_throttle_vacuum_rpm_lo_X_tps CAL_obd_ii_P0106_throttle_vacuum_rpm_lo_Y_load CAL_obd_ii_P0107 CAL_obd_ii_P0107_debounce_count CAL_obd_ii_P0108 CAL_obd_ii_P0108_debounce_count CAL_obd_ii_P0111 CAL_obd_ii_P0111_airflow_stage_time CAL_obd_ii_P0111_debounce_count CAL_obd_ii_P0111_high_airflow_time CAL_obd_ii_P0111_iat_agreement_tol CAL_obd_ii_P0111_iat_span_min CAL_obd_ii_P0111_maf_debounce_time CAL_obd_ii_P0111_maf_high_band CAL_obd_ii_P0111_maf_low_band CAL_obd_ii_P0111_maf_low_band_hysteresis CAL_obd_ii_P0111_mass_air_min CAL_obd_ii_P0112 CAL_obd_ii_P0112_debounce_count CAL_obd_ii_P0113 CAL_obd_ii_P0113_debounce_count CAL_obd_ii_P0116 CAL_obd_ii_P0116_coolant_deviation_max CAL_obd_ii_P0116_debounce_count CAL_obd_ii_P0116_min_runtime CAL_obd_ii_P0117 CAL_obd_ii_P0117_coolant_voltage_low CAL_obd_ii_P0117_debounce_count CAL_obd_ii_P0118 CAL_obd_ii_P0118_debounce_count CAL_obd_ii_P0122 CAL_obd_ii_P0122_debounce_count CAL_obd_ii_P0123 CAL_obd_ii_P0123_debounce_count CAL_obd_ii_P0128 CAL_obd_ii_P0128_coolant_target CAL_obd_ii_P0128_fail_count CAL_obd_ii_P0128_heat_weight CAL_obd_ii_P0128_heat_weight_X_load CAL_obd_ii_P0128_iat_min CAL_obd_ii_P0128_lowspeed_threshold CAL_obd_ii_P0128_runtime_to_lowspeed_ratio_min CAL_obd_ii_P0128_start_coolant_max CAL_obd_ii_P0128_start_coolant_min CAL_obd_ii_P0131 CAL_obd_ii_P0131_debounce_count CAL_obd_ii_P0132 CAL_obd_ii_P0132_fail_count CAL_obd_ii_P0133 CAL_obd_ii_P0133_debounce_count CAL_obd_ii_P0133_min_coolant_temp CAL_obd_ii_P0134 CAL_obd_ii_P0134_debounce_count CAL_obd_ii_P0135 CAL_obd_ii_P0135_debounce_count CAL_obd_ii_P0137 CAL_obd_ii_P0137_fail_count CAL_obd_ii_P0138 CAL_obd_ii_P0138_fail_count CAL_obd_ii_P0139 CAL_obd_ii_P0139_debounce_count CAL_obd_ii_P0140 CAL_obd_ii_P0140_debounce_count CAL_obd_ii_P0141 CAL_obd_ii_P0141_4000DA38 CAL_obd_ii_P0141_debounce_count CAL_obd_ii_P0141_heater_current_debounce_count CAL_obd_ii_P0151 CAL_obd_ii_P0151_fail_count CAL_obd_ii_P0152 CAL_obd_ii_P0152_fail_count CAL_obd_ii_P0153 CAL_obd_ii_P0153_debounce_count CAL_obd_ii_P0154 CAL_obd_ii_P0154_debounce_count CAL_obd_ii_P0155 CAL_obd_ii_P0155_debounce_count CAL_obd_ii_P0157 CAL_obd_ii_P0157_fail_count CAL_obd_ii_P0158 CAL_obd_ii_P0158_fail_count CAL_obd_ii_P0159 CAL_obd_ii_P0159_debounce_count CAL_obd_ii_P0160 CAL_obd_ii_P0160_debounce_count CAL_obd_ii_P0161 CAL_obd_ii_P0161_debounce_count CAL_obd_ii_P0171 CAL_obd_ii_P0171_P0172_trim_zone_time_min CAL_obd_ii_P0171_debounce_count CAL_obd_ii_P0172 CAL_obd_ii_P0172_debounce_count CAL_obd_ii_P0174 CAL_obd_ii_P0174_debounce_count CAL_obd_ii_P0175 CAL_obd_ii_P0175_debounce_count CAL_obd_ii_P0222 CAL_obd_ii_P0222_debounce_count CAL_obd_ii_P0223 CAL_obd_ii_P0223_debounce_count CAL_obd_ii_P0261 CAL_obd_ii_P0261_debounce_count CAL_obd_ii_P0262 CAL_obd_ii_P0262_debounce_count CAL_obd_ii_P0264 CAL_obd_ii_P0264_debounce_count CAL_obd_ii_P0265 CAL_obd_ii_P0265_debounce_count CAL_obd_ii_P0267 CAL_obd_ii_P0267_debounce_count CAL_obd_ii_P0268 CAL_obd_ii_P0268_debounce_count CAL_obd_ii_P0270 CAL_obd_ii_P0270_debounce_count CAL_obd_ii_P0271 CAL_obd_ii_P0271_debounce_count CAL_obd_ii_P0273 CAL_obd_ii_P0273_debounce_count CAL_obd_ii_P0274 CAL_obd_ii_P0274_debounce_count CAL_obd_ii_P0276 CAL_obd_ii_P0276_debounce_count CAL_obd_ii_P0277 CAL_obd_ii_P0277_debounce_count CAL_obd_ii_P0300 CAL_obd_ii_P0300_debounce_count CAL_obd_ii_P0301 CAL_obd_ii_P0301_debounce_count CAL_obd_ii_P0302 CAL_obd_ii_P0302_debounce_count CAL_obd_ii_P0303 CAL_obd_ii_P0303_debounce_count CAL_obd_ii_P0304 CAL_obd_ii_P0304_debounce_count CAL_obd_ii_P0305 CAL_obd_ii_P0305_debounce_count CAL_obd_ii_P0306 CAL_obd_ii_P0306_debounce_count CAL_obd_ii_P0327 CAL_obd_ii_P0327_debounce_count CAL_obd_ii_P0328 CAL_obd_ii_P0328_debounce_count CAL_obd_ii_P0332 CAL_obd_ii_P0332_debounce_count CAL_obd_ii_P0333 CAL_obd_ii_P0333_debounce_count CAL_obd_ii_P0335 CAL_obd_ii_P0335_debounce_count CAL_obd_ii_P0341 CAL_obd_ii_P0341_debounce_count CAL_obd_ii_P0346 CAL_obd_ii_P0346_debounce_count CAL_obd_ii_P0351 CAL_obd_ii_P0351_debounce_count CAL_obd_ii_P0352 CAL_obd_ii_P0352_debounce_count CAL_obd_ii_P0353 CAL_obd_ii_P0353_debounce_count CAL_obd_ii_P0354 CAL_obd_ii_P0354_debounce_count CAL_obd_ii_P0355 CAL_obd_ii_P0355_debounce_count CAL_obd_ii_P0356 CAL_obd_ii_P0356_debounce_count CAL_obd_ii_P0366 CAL_obd_ii_P0366_debounce_count CAL_obd_ii_P0391 CAL_obd_ii_P0391_debounce_count CAL_obd_ii_P0420 CAL_obd_ii_P0420_car_speed_max CAL_obd_ii_P0420_car_speed_min CAL_obd_ii_P0420_debounce_count CAL_obd_ii_P0420_maf_max CAL_obd_ii_P0420_maf_min CAL_obd_ii_P0420_precat_switch_target_ips CAL_obd_ii_P0420_precat_switch_target_ips_X_maf_flow CAL_obd_ii_P0420_precat_switch_target_manual CAL_obd_ii_P0420_precat_switch_target_manual_X_maf_flow CAL_obd_ii_P0430 CAL_obd_ii_P0430_debounce_count CAL_obd_ii_P0441 CAL_obd_ii_P0441_fail_count CAL_obd_ii_P0441_runtime_min CAL_obd_ii_P0442 CAL_obd_ii_P0442_debounce_count CAL_obd_ii_P0444 CAL_obd_ii_P0444_debounce_count CAL_obd_ii_P0445 CAL_obd_ii_P0445_debounce_count CAL_obd_ii_P0446 CAL_obd_ii_P0446_fail_count CAL_obd_ii_P0447 CAL_obd_ii_P0447_debounce_count CAL_obd_ii_P0448 CAL_obd_ii_P0448_debounce_count CAL_obd_ii_P0451 CAL_obd_ii_P0451_debounce_count CAL_obd_ii_P0451_debounce_count_4000DBA1 CAL_obd_ii_P0451_pressure_swing_min CAL_obd_ii_P0452 CAL_obd_ii_P0452_debounce_count CAL_obd_ii_P0453 CAL_obd_ii_P0453_debounce_count CAL_obd_ii_P0455 CAL_obd_ii_P0455_debounce_count CAL_obd_ii_P0456 CAL_obd_ii_P0456_debounce_count CAL_obd_ii_P0461 CAL_obd_ii_P0461_debounce_count CAL_obd_ii_P0462 CAL_obd_ii_P0462_debounce_count CAL_obd_ii_P0463 CAL_obd_ii_P0463_debounce_count CAL_obd_ii_P0480 CAL_obd_ii_P0480_debounce_count CAL_obd_ii_P0481 CAL_obd_ii_P0481_debounce_count CAL_obd_ii_P0482 CAL_obd_ii_P0482_debounce_count CAL_obd_ii_P0500 CAL_obd_ii_P0500_car_speed_min CAL_obd_ii_P0500_debounce_count CAL_obd_ii_P0500_test_time CAL_obd_ii_P0506 CAL_obd_ii_P0506_P0507_idle_learn_limit CAL_obd_ii_P0506_debounce_count CAL_obd_ii_P0507 CAL_obd_ii_P0507_debounce_count CAL_obd_ii_P050A CAL_obd_ii_P050A_debounce_count CAL_obd_ii_P050A_idle_error_high CAL_obd_ii_P050A_idle_error_low CAL_obd_ii_P050B CAL_obd_ii_P050B_maturing_limit CAL_obd_ii_P0523 CAL_obd_ii_P0523_debounce_count CAL_obd_ii_P0537 CAL_obd_ii_P0537_debounce_count CAL_obd_ii_P0538 CAL_obd_ii_P0538_debounce_count CAL_obd_ii_P0562 CAL_obd_ii_P0562_debounce_count CAL_obd_ii_P0562_sample_count CAL_obd_ii_P0563 CAL_obd_ii_P0563_debounce_count CAL_obd_ii_P0563_sample_count CAL_obd_ii_P0564 CAL_obd_ii_P0564_debounce_count CAL_obd_ii_P0571 CAL_obd_ii_P0571_brake_check_min_speed CAL_obd_ii_P0571_debounce_count CAL_obd_ii_P0571_switch_mismatch_time CAL_obd_ii_P0578 CAL_obd_ii_P0578_fail_count CAL_obd_ii_P0579 CAL_obd_ii_P0579_fail_count CAL_obd_ii_P0579_switch_changes_max CAL_obd_ii_P0579_window_time CAL_obd_ii_P0601 CAL_obd_ii_P0606 CAL_obd_ii_P0610 CAL_obd_ii_P0616 CAL_obd_ii_P0616_debounce_count CAL_obd_ii_P0617 CAL_obd_ii_P0617_debounce_count CAL_obd_ii_P0628 CAL_obd_ii_P0628_debounce_count CAL_obd_ii_P0629 CAL_obd_ii_P0629_debounce_count CAL_obd_ii_P0630 CAL_obd_ii_P0638 CAL_obd_ii_P0638_fail_count CAL_obd_ii_P0638_tps_error_max CAL_obd_ii_P0646 CAL_obd_ii_P0646_debounce_count CAL_obd_ii_P0647 CAL_obd_ii_P0647_debounce_count CAL_obd_ii_P0661 CAL_obd_ii_P0661_debounce_count CAL_obd_ii_P0662 CAL_obd_ii_P0662_debounce_count CAL_obd_ii_P0685 CAL_obd_ii_P0685_debounce_count CAL_obd_ii_P0685_voltage_delta CAL_obd_ii_P0700 CAL_obd_ii_P0806 CAL_obd_ii_P0806_clutch_span_min CAL_obd_ii_P0806_clutch_voltage_max CAL_obd_ii_P0806_debounce_count CAL_obd_ii_P0806_gear_changes_min CAL_obd_ii_P0807 CAL_obd_ii_P0807_debounce_count CAL_obd_ii_P0808 CAL_obd_ii_P0808_debounce_count CAL_obd_ii_P0826 CAL_obd_ii_P0826_debounce_count CAL_obd_ii_P0827 CAL_obd_ii_P0827_debounce_count CAL_obd_ii_P0828 CAL_obd_ii_P0828_debounce_count CAL_obd_ii_P1104 CAL_obd_ii_P1104_debounce_count CAL_obd_ii_P1106 CAL_obd_ii_P1106_debounce_count CAL_obd_ii_P1113 CAL_obd_ii_P1113_debounce_count CAL_obd_ii_P1301 CAL_obd_ii_P1301_debounce_count CAL_obd_ii_P1302 CAL_obd_ii_P1302_debounce_count CAL_obd_ii_P1302_pass_holdoff CAL_obd_ii_P1422 CAL_obd_ii_P1422_fail_threshold CAL_obd_ii_P1562 CAL_obd_ii_P1562_debounce_count CAL_obd_ii_P1809 CAL_obd_ii_P1809_debounce_count CAL_obd_ii_P2100 CAL_obd_ii_P2100_debounce_count CAL_obd_ii_P2102 CAL_obd_ii_P2102_debounce_count CAL_obd_ii_P2103 CAL_obd_ii_P2103_debounce_count CAL_obd_ii_P2104 CAL_obd_ii_P2104_debounce_count CAL_obd_ii_P2105 CAL_obd_ii_P2105_debounce_count CAL_obd_ii_P2106 CAL_obd_ii_P2106_debounce_count CAL_obd_ii_P2107 CAL_obd_ii_P2107_debounce_count CAL_obd_ii_P2108 CAL_obd_ii_P2108_debounce_count CAL_obd_ii_P2119 CAL_obd_ii_P2119_debounce_count CAL_obd_ii_P2122 CAL_obd_ii_P2122_debounce_count CAL_obd_ii_P2123 CAL_obd_ii_P2123_debounce_count CAL_obd_ii_P2127 CAL_obd_ii_P2127_debounce_count CAL_obd_ii_P2128 CAL_obd_ii_P2128_debounce_count CAL_obd_ii_P2135 CAL_obd_ii_P2135_debounce_count CAL_obd_ii_P2138 CAL_obd_ii_P2138_debounce_count CAL_obd_ii_P2170 CAL_obd_ii_P2171 CAL_obd_ii_P2171_debounce_count CAL_obd_ii_P2173 CAL_obd_ii_P2173_alphaN_trim_limit CAL_obd_ii_P2173_alphaN_trim_limit_X_rpm CAL_obd_ii_P2173_alphaN_trim_limit_Y_tps CAL_obd_ii_P2173_fail_count CAL_obd_ii_P2173_load_difference_max CAL_obd_ii_P2191 CAL_obd_ii_P2191_debounce_count CAL_obd_ii_P2191_lean_confirm_time CAL_obd_ii_P2192_rich_confirm_time CAL_obd_ii_P2193 CAL_obd_ii_P2193_debounce_count CAL_obd_ii_P219A CAL_obd_ii_P219A_coolant_min CAL_obd_ii_P219A_imbalance_window_count CAL_obd_ii_P219A_load_max CAL_obd_ii_P219A_load_min CAL_obd_ii_P219A_maf_max CAL_obd_ii_P219A_maf_min CAL_obd_ii_P219A_rpm_max CAL_obd_ii_P219A_rpm_min CAL_obd_ii_P219B CAL_obd_ii_P2336 CAL_obd_ii_P2336_maturing_limit CAL_obd_ii_P2337 CAL_obd_ii_P2337_maturing_limit CAL_obd_ii_P2338 CAL_obd_ii_P2338_maturing_limit CAL_obd_ii_P2339 CAL_obd_ii_P2339_maturing_limit CAL_obd_ii_P2340 CAL_obd_ii_P2340_maturing_limit CAL_obd_ii_P2341 CAL_obd_ii_P2341_maturing_limit CAL_obd_ii_P2602 CAL_obd_ii_P2602_debounce_count CAL_obd_ii_P2603 CAL_obd_ii_P2603_debounce_count CAL_obd_ii_P2612 CAL_obd_ii_P2612_debounce_count CAL_obd_ii_P2613 CAL_obd_ii_P2613_debounce_count CAL_obd_ii_U0101 CAL_obd_ii_U0101_pass_counter_max CAL_obd_ii_U0122 CAL_obd_ii_U0123 CAL_obd_ii_U0123_debounce_count CAL_obd_ii_U0127 CAL_obd_ii_U0127_debounce_count CAL_obd_ii_U0302 CAL_obd_ii_U0302_debounce_count CAL_obd_ii_U0316 CAL_obd_ii_U0316_debounce_count CAL_obd_ii_U0416 CAL_obd_ii_U0416_debounce_count CAL_obd_ii_U0513 CAL_obd_ii_U0513_debounce_count CAL_obd_ii_accel_pedal_correlation_max_diff CAL_obd_ii_adc_maf_unknown1 CAL_obd_ii_brake_pedal_conflict_count CAL_obd_ii_calc_load_wot_airmass CAL_obd_ii_cat_check_o2_rich_time_max CAL_obd_ii_cat_check_tps_rate_max CAL_obd_ii_cat_check_transient_blackout CAL_obd_ii_cat_cold_start_coolant_min CAL_obd_ii_cat_efficiency_ratio_max CAL_obd_ii_cat_mon_post_dfco_holdoff_prescaler CAL_obd_ii_cat_monitor_baro_min CAL_obd_ii_cat_monitor_coolant_min_above_iat CAL_obd_ii_cat_monitor_ect_min CAL_obd_ii_cat_monitor_maf_min CAL_obd_ii_cat_monitor_min_engine_runtime CAL_obd_ii_cat_monitor_min_maf_accum_thresh CAL_obd_ii_cat_monitor_min_maf_accum_thresh_X_coolant_temp CAL_obd_ii_cat_monitor_run_time_min CAL_obd_ii_cat_monitor_stable_time CAL_obd_ii_cat_monitor_window_time CAL_obd_ii_cat_postcat_o2_lean_offset CAL_obd_ii_cat_postcat_o2_rich_offset CAL_obd_ii_cat_precat_o2_lean_thresh CAL_obd_ii_cat_precat_o2_rich_thresh CAL_obd_ii_cat_unknown10 CAL_obd_ii_cat_unknown11 CAL_obd_ii_cat_unknown2 CAL_obd_ii_cat_unknown3 CAL_obd_ii_cat_unknown6 CAL_obd_ii_cat_unknown9 CAL_obd_ii_commanded_evap_purge CAL_obd_ii_commanded_evap_purge_X_duty CAL_obd_ii_commanded_evap_purge_Y_vacuum CAL_obd_ii_commanded_evap_purge_limit CAL_obd_ii_commanded_evap_purge_limit_0 CAL_obd_ii_commanded_evap_purge_max CAL_obd_ii_commanded_evap_purge_min CAL_obd_ii_commanded_evap_purge_threshold CAL_obd_ii_coolant_rationality_count CAL_obd_ii_coolant_rationality_holdoff_time CAL_obd_ii_coolant_rationality_rpm_min CAL_obd_ii_coolant_warmup_threshold_unknown CAL_obd_ii_coolant_warmup_thresholds CAL_obd_ii_countdown_unknown CAL_obd_ii_crank_cam_error_count_max CAL_obd_ii_drive_cycle_car_speed_min CAL_obd_ii_drive_cycle_idle_time CAL_obd_ii_drive_cycle_runtime CAL_obd_ii_engine_speed_3_threshold_1 CAL_obd_ii_evap_purge_settle_debounce CAL_obd_ii_evap_refuel_level_rise_threshold CAL_obd_ii_evap_vapor_pressure_limit CAL_obd_ii_freeze_frame_pid_list CAL_obd_ii_fuel_learn_inhibit_holdoff_ticks CAL_obd_ii_fuel_learn_max_load_delta CAL_obd_ii_fuel_trim_zone3_time_min CAL_obd_ii_gd_speed_time CAL_obd_ii_high_load_monitor_afr_max CAL_obd_ii_high_load_monitor_load_min CAL_obd_ii_idle_air_output_limit CAL_obd_ii_idle_air_output_threshold CAL_obd_ii_idle_error_fail_count CAL_obd_ii_idle_learn_limit CAL_obd_ii_knock_monitor_sample_count CAL_obd_ii_knock_no_activity_count CAL_obd_ii_mode06_o2_switch_time_max CAL_obd_ii_mode06_o2_switch_time_min CAL_obd_ii_mode08_evap_test_duration CAL_obd_ii_mode2f_coil_test_interval CAL_obd_ii_mode2f_coil_test_pulse_count CAL_obd_ii_mode2f_injector_test_duration CAL_obd_ii_mode2f_injector_test_interval CAL_obd_ii_mode2f_injector_test_pulse_10us CAL_obd_ii_mode2f_timeout CAL_obd_ii_monitor_debounce_cycles CAL_obd_ii_monitor_rpm_delta_max CAL_obd_ii_o2_flatline_band CAL_obd_ii_o2_flatline_window_inband CAL_obd_ii_o2_flatline_window_outband CAL_obd_ii_o2_imbalance_accum_cap CAL_obd_ii_o2_imbalance_sample_count CAL_obd_ii_o2_imbalance_sample_count_4000D3B8 CAL_obd_ii_o2_imbalance_sample_period CAL_obd_ii_o2_imbalance_threshold CAL_obd_ii_o2_l2r_time_max_asym CAL_obd_ii_o2_lean_period_excess_max CAL_obd_ii_o2_lean_time_baseline CAL_obd_ii_o2_lean_time_baseline_X_maf CAL_obd_ii_o2_period_consistency_tol CAL_obd_ii_o2_period_excess_max CAL_obd_ii_o2_postcat_activity_min CAL_obd_ii_o2_precat_activity_window CAL_obd_ii_o2_precat_diag_init_counter CAL_obd_ii_o2_precat_diag_timer CAL_obd_ii_o2_r2l_time_max_asym CAL_obd_ii_o2_response_alphaN_blackout CAL_obd_ii_o2_response_car_speed_max CAL_obd_ii_o2_response_car_speed_min CAL_obd_ii_o2_response_load_stability_max CAL_obd_ii_o2_rich_period_excess_max CAL_obd_ii_o2_rich_time_baseline CAL_obd_ii_o2_rich_time_baseline_X_maf CAL_obd_ii_o2_sensor1_voltage_limit CAL_obd_ii_o2_sensor1_voltage_threshold CAL_obd_ii_o2_sensor2_voltage_limit CAL_obd_ii_o2_sensor2_voltage_threshold CAL_obd_ii_o2_sensors_present CAL_obd_ii_o2_slow_response_arm_dwell CAL_obd_ii_o2_slow_response_limit_lean_to_rich CAL_obd_ii_o2_slow_response_limit_rich_to_lean CAL_obd_ii_o2_slow_response_maf_limit_unknown CAL_obd_ii_o2_slow_response_maf_limit_unknown2 CAL_obd_ii_o2_slow_response_runtime_limit_unknown CAL_obd_ii_o2_slow_response_sample_count CAL_obd_ii_o2_switch_time_min CAL_obd_ii_o2_switch_time_threshold CAL_obd_ii_o2_transition_count CAL_obd_ii_paddle_shift_voltage_stable_time CAL_obd_ii_postcat_o2_voltage_bias CAL_obd_ii_readiness_bit3_enable CAL_obd_ii_rpm_unknown1 CAL_obd_ii_runtime_since_start_threshold_unknown CAL_obd_ii_similar_cond_debounce_reload CAL_obd_ii_similar_cond_load_tol CAL_obd_ii_similar_cond_rpm_tol CAL_obd_ii_similar_cond_warmup_cycles CAL_obd_ii_standards_supported CAL_obd_ii_switch_voltage_debounce CAL_obd_ii_temp_unknown CAL_obd_ii_temp_unknown2 CAL_obd_ii_tps_unknown1 CAL_obd_ii_unknown5 CAL_obd_ii_unknown5_4000D381 CAL_obd_ii_unknown6 CAL_obd_ii_unknown7 CAL_obd_ii_unknown7_4000D364 CAL_obd_ii_unused_4000dbfd CAL_obd_ii_variant_enable CAL_obd_ii_vvt_error_fail_count CAL_obd_ii_vvt_exhaust_error_bank1_limit CAL_obd_ii_vvt_monitor_coolant_min CAL_obd_ii_vvt_monitor_min_runtime CAL_obd_ii_vvt_ok_pass_count CAL_obd_ii_warmup_temp_unknown CAL_obd_ii_wheel_speed_correlation_rpm_max CAL_obd_o2_precat_diag_reset_counter CAL_obd_o2_tps_transient_settle_ticks CAL_obd_o2_tps_transient_threshold /end REF_CHARACTERISTIC
/end GROUP
/begin GROUP G_Driveline "Transmission and driveline" ROOT
 /begin SUB_GROUP G_Driveline_clutch G_Driveline_gear G_Driveline_gsi G_Driveline_ips /end SUB_GROUP
/end GROUP
/begin GROUP G_Driveline_clutch "clutch"
 /begin REF_CHARACTERISTIC CAL_clutch_confidence_decrement CAL_clutch_confidence_increment CAL_clutch_pos_voltage_threshold CAL_clutch_sensor_confidence_max CAL_clutch_variance_threshold /end REF_CHARACTERISTIC
/end GROUP
/begin GROUP G_Driveline_gear "gear"
 /begin REF_CHARACTERISTIC CAL_gear_advisory_upshift_rpm_gear1 CAL_gear_advisory_upshift_rpm_ips CAL_gear_advisory_upshift_rpm_manual /end REF_CHARACTERISTIC
/end GROUP
/begin GROUP G_Driveline_gsi "gsi"
 /begin REF_CHARACTERISTIC CAL_gsi_cornering_inhibit_hysteresis CAL_gsi_cornering_inhibit_threshold CAL_gsi_downshift_delay CAL_gsi_downshift_idle_margin CAL_gsi_downshift_rpm_offset CAL_gsi_gear1_drive_away_speed CAL_gsi_max_gear_rpm CAL_gsi_max_gear_step CAL_gsi_max_gear_step_4000D418 CAL_gsi_pedal_applied_hold_time CAL_gsi_pedal_applied_threshold CAL_gsi_power_rpm_limit CAL_gsi_power_rpm_limit_X_power CAL_gsi_rpm_per_kph_close_ratio CAL_gsi_rpm_per_kph_ips CAL_gsi_rpm_per_kph_standard CAL_gsi_speed_offset_kph CAL_gsi_steering_angle_inhibit CAL_gsi_steering_rate_filter_coeff CAL_gsi_steering_rate_term_max CAL_gsi_upshift_delay /end REF_CHARACTERISTIC
/end GROUP
/begin GROUP G_Driveline_ips "ips"
 /begin REF_CHARACTERISTIC CAL_ips_request_msg_id_nibble CAL_ips_revmatch_convergence_rpm CAL_ips_revmatch_convergence_rpm_X_rpm CAL_ips_revmatch_p_gain CAL_ips_revmatch_p_gain_X_rpm CAL_ips_speed_match_d_gain CAL_ips_speed_match_d_sample_ticks CAL_ips_speed_match_d_term_max CAL_ips_speed_match_d_term_min CAL_ips_speed_match_i_error_window CAL_ips_speed_match_i_gain CAL_ips_speed_match_i_reset CAL_ips_speed_match_i_term_max CAL_ips_speed_match_i_term_min CAL_ips_speed_match_p_gain CAL_ips_speed_match_p_term_max CAL_ips_speed_match_p_term_min CAL_ips_speed_match_torque_max CAL_ips_torque_reduction_slow_floor_nm CAL_ips_torque_reduction_slow_scale_pct /end REF_CHARACTERISTIC
/end GROUP
/begin GROUP G_Climate "Air conditioning" ROOT
 /begin REF_CHARACTERISTIC CAL_ac_compressor_power_offset CAL_ac_compressor_soft_engage_time CAL_ac_compressor_speed_filter_coeff CAL_ac_evap_freeze_inhibit_delay CAL_ac_evap_pid_derivative_filter_alpha CAL_ac_evap_pid_integrator_limit CAL_ac_evap_pid_kd CAL_ac_evap_pid_ki_cold CAL_ac_evap_pid_ki_cold_boost_delay CAL_ac_evap_pid_ki_cold_boost_factor CAL_ac_evap_pid_ki_warm CAL_ac_evap_pid_p_gain CAL_ac_evap_pid_p_gain_X_temp_error CAL_ac_evap_pid_update_period_cold CAL_ac_evap_target_temp CAL_ac_evap_temp_trend_period2 CAL_ac_evap_temp_voltage_high_threshold CAL_ac_evap_temp_voltage_low_threshold CAL_ac_evap_timer_ticks_5ms CAL_ac_evap_timer_ticks_5ms2 CAL_ac_fan_startup_hold_time CAL_ac_ign_comp_delay CAL_ac_inhibit_carspeed2 CAL_ac_inhibit_coolant CAL_ac_inhibit_cranking CAL_ac_inhibit_evap_temp CAL_ac_inhibit_rpm CAL_ac_inhibit_rpm_cutoff CAL_ac_inhibit_rpm_cutoff_min_hold CAL_ac_inhibit_rpm_cutoff_min_hold_40008F57 CAL_ac_inhibit_rpm_cutoff_on_delay CAL_ac_inhibit_tps CAL_ac_load_limit CAL_ac_load_limit_X_rpm CAL_ac_load_ramp_steps CAL_ac_load_slew_down_period CAL_ac_load_slew_down_step CAL_ac_load_slew_up_period CAL_ac_load_slew_up_step CAL_ac_output_pwm_freq CAL_ac_pwm_dc_divisor CAL_ac_shutdown_delay CAL_ac_startup_lockout_time CAL_ac_tps_inhibit_timer CAL_ac_unknown3 CAL_ac_unused_40008ef6 /end REF_CHARACTERISTIC
/end GROUP
/begin GROUP G_Cruise "Cruise control" ROOT
 /begin REF_CHARACTERISTIC CAL_cruise_accel_hold_step CAL_cruise_airflow_fast_slew_time CAL_cruise_airflow_slew_step CAL_cruise_brake_standstill_timer CAL_cruise_cancel_dfco_inhibit_time CAL_cruise_decel_hold_step CAL_cruise_derivative_clamp CAL_cruise_derivative_gain_close_ratio CAL_cruise_derivative_gain_close_ratio_X_gear CAL_cruise_derivative_gain_ips CAL_cruise_derivative_gain_ips_X_gear CAL_cruise_derivative_gain_manual CAL_cruise_derivative_gain_manual_X_gear CAL_cruise_derivative_term_limit CAL_cruise_feedforward_blend_threshold CAL_cruise_integral_gain_close_ratio CAL_cruise_integral_gain_close_ratio_X_gear CAL_cruise_integral_gain_ips CAL_cruise_integral_gain_ips_X_gear CAL_cruise_integral_gain_manual CAL_cruise_integral_gain_manual_X_gear CAL_cruise_integral_gearchange_blend CAL_cruise_integral_term_limit CAL_cruise_integrator_accel_freeze CAL_cruise_integrator_clamp CAL_cruise_maf_feedforward CAL_cruise_maf_feedforward_X_carspeed CAL_cruise_override_coast_cancel_time CAL_cruise_override_timeout CAL_cruise_proportional_gain_close_ratio CAL_cruise_proportional_gain_close_ratio_X_gear CAL_cruise_proportional_gain_ips CAL_cruise_proportional_gain_ips_X_gear CAL_cruise_proportional_gain_manual CAL_cruise_proportional_gain_manual_X_gear CAL_cruise_proportional_term_limit CAL_cruise_resume_pedal_handoff_threshold CAL_cruise_rpm_max_ips CAL_cruise_rpm_max_manual CAL_cruise_rpm_min_ips CAL_cruise_rpm_min_manual CAL_cruise_speed_error_max CAL_cruise_speed_filter_coeff CAL_cruise_speed_limit CAL_cruise_speed_tap_step CAL_cruise_torque_request_braking CAL_cruise_tps_accelerating_threshold CAL_cruise_tps_override_threshold /end REF_CHARACTERISTIC
/end GROUP
/begin GROUP G_Vehicle "Vehicle and body" ROOT
 /begin SUB_GROUP G_Vehicle_accessory G_Vehicle_can G_Vehicle_cluster G_Vehicle_dca G_Vehicle_tpms G_Vehicle_vehicle /end SUB_GROUP
/end GROUP
/begin GROUP G_Vehicle_accessory "accessory"
 /begin REF_CHARACTERISTIC CAL_accessory_output_rpm_inhibit_off CAL_accessory_output_rpm_inhibit_on /end REF_CHARACTERISTIC
/end GROUP
/begin GROUP G_Vehicle_can "can"
 /begin REF_CHARACTERISTIC CAL_can_lat_accel_standstill_timeout CAL_can_yaw_data_timeout CAL_can_yaw_monitor_startup_delay CAL_can_yaw_timeout /end REF_CHARACTERISTIC
/end GROUP
/begin GROUP G_Vehicle_cluster "cluster"
 /begin REF_CHARACTERISTIC CAL_cluster_fuel_level_warning_threshold CAL_cluster_gear_advisory_lamp_type CAL_cluster_overtemp_warning_light CAL_cluster_shift_light_deadband_rpm CAL_cluster_shiftlight_rpm_offset_ips CAL_cluster_shiftlight_rpm_offset_ips_X_gear CAL_cluster_shiftlight_rpm_offset_manual CAL_cluster_shiftlight_rpm_offset_manual_X_gear /end REF_CHARACTERISTIC
/end GROUP
/end MODULE
/end PROJECT
