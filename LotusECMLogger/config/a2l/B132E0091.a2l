/*
* Drafted by LotusECMLogger A2lGenerator v1 from the B132E0091 symbol catalog for B132E0091.
* Every axis has NO_INPUT_QUANTITY: add an InputQuantity only after checking the lookup in the decompile
* (scope, conditions, input transforms; CCP-client-plan.md section 5).
* Maps are ROW_DIR: the first AXIS_DESCR is X, stored fastest, as the firmware reads lut[y * size_x + x].
* Generator warnings:
* load_to_tps_trim_factor: also at another address; this one (0x400019F8) is named load_to_tps_trim_factor_400019F8.
* cam_park_offset_fault_inlet_b2: also at another address; this one (0x40002192) is named cam_park_offset_fault_inlet_b2_40002192.
* steering_angle_rate: also at another address; this one (0x400022D0) is named steering_angle_rate_400022D0.
* accel_pedal_track_d_selected: also at another address; this one (0x400024AB) is named accel_pedal_track_d_selected_400024AB.
* ADC_TSCR: also at another address; this one (0x4000299C) is named ADC_TSCR_4000299C.
* ADC_TBCR: also at another address; this one (0x400029A0) is named ADC_TBCR_400029A0.
* timer_main_start1: also at another address; this one (0x40002B68) is named timer_main_start1_40002B68.
* timer_main_start2: also at another address; this one (0x40002B6C) is named timer_main_start2_40002B6C.
* obd_ii_perm_dtc: also at another address; this one (0x400044E6) is named obd_ii_perm_dtc_400044E6.
* LEA_obd_ii_P0141_flags: also at another address; this one (0x400046B6) is named LEA_obd_ii_P0141_flags_400046B6.
* LEA_obd_ii_P0141_fail_counter: also at another address; this one (0x400046B7) is named LEA_obd_ii_P0141_fail_counter_400046B7.
* LEA_obd_ii_P0141_pass_counter: also at another address; this one (0x400046B8) is named LEA_obd_ii_P0141_pass_counter_400046B8.
* CAL_idle_flow_integral_adj_max: also at another address; this one (0x40008E91) is named CAL_idle_flow_integral_adj_max_40008E91.
* CAL_ac_inhibit_rpm_cutoff_min_hold: also at another address; this one (0x40008F57) is named CAL_ac_inhibit_rpm_cutoff_min_hold_40008F57.
* CAL_closedloop_fuel_learn_baro_min: also at another address; this one (0x40008FD1) is named CAL_closedloop_fuel_learn_baro_min_40008FD1.
* CAL_inj_soak_time_max: also at another address; this one (0x40009130) is named CAL_inj_soak_time_max_40009130.
* CAL_obd_ii_P0116_coolant_deviation_max: also at another address; this one (0x4000D2AF) is named CAL_obd_ii_P0116_coolant_deviation_max_4000D2AF.
* CAL_closedloop_max_tipout_enleanment: also at another address; this one (0x4000D365) is named CAL_closedloop_max_tipout_enleanment_4000D365.
* CAL_idle_sensor_fault_coolant_temp: also at another address; this one (0x4000D382) is named CAL_idle_sensor_fault_coolant_temp_4000D382.
* CAL_clutch_confidence_increment: also at another address; this one (0x4000D3A7) is named CAL_clutch_confidence_increment_4000D3A7.
* CAL_obd_ii_o2_imbalance_sample_count: also at another address; this one (0x4000D3B8) is named CAL_obd_ii_o2_imbalance_sample_count_4000D3B8.
* CAL_knock_threshold_obd_ii_check_enable_load: also at another address; this one (0x4000D3CD) is named CAL_knock_threshold_obd_ii_check_enable_load_4000D3CD.
* CAL_gsi_max_gear_step: also at another address; this one (0x4000D418) is named CAL_gsi_max_gear_step_4000D418.
* CAL_obd_ii_P0141: also at another address; this one (0x4000DA38) is named CAL_obd_ii_P0141_4000DA38.
* CAL_obd_ii_unknown24: also at another address; this one (0x4000DBF5) is named CAL_obd_ii_unknown24_4000DBF5.
* CAL_ecu_cvn: 0x4000EFFC+2 is outside calibration RAM; left out.
*/
ASAP2_VERSION 1 61
/begin PROJECT B132E0091 "Lotus T6 B132E0091"
/begin HEADER "" VERSION "generated v1" /end HEADER
/begin MODULE B132E0091 ""
/begin MOD_COMMON "" BYTE_ORDER MSB_FIRST ALIGNMENT_BYTE 1 ALIGNMENT_WORD 2 ALIGNMENT_LONG 4 /end MOD_COMMON
/begin MOD_PAR "" EPK "B132E0091" ADDR_EPK 0x40008E24
 /begin MEMORY_SEGMENT CAL "Calibration RAM" DATA RAM INTERN 0x40008E24 0x61D8 -1 -1 -1 -1 -1 /end MEMORY_SEGMENT
/end MOD_PAR
/begin RECORD_LAYOUT RL_VALUE_UBYTE FNC_VALUES 1 UBYTE ROW_DIR DIRECT /end RECORD_LAYOUT
/begin RECORD_LAYOUT RL_AXIS_UBYTE AXIS_PTS_X 1 UBYTE INDEX_INCR DIRECT /end RECORD_LAYOUT
/begin RECORD_LAYOUT RL_VALUE_SBYTE FNC_VALUES 1 SBYTE ROW_DIR DIRECT /end RECORD_LAYOUT
/begin RECORD_LAYOUT RL_VALUE_UWORD FNC_VALUES 1 UWORD ROW_DIR DIRECT /end RECORD_LAYOUT
/begin RECORD_LAYOUT RL_AXIS_UWORD AXIS_PTS_X 1 UWORD INDEX_INCR DIRECT /end RECORD_LAYOUT
/begin RECORD_LAYOUT RL_VALUE_SWORD FNC_VALUES 1 SWORD ROW_DIR DIRECT /end RECORD_LAYOUT
/begin RECORD_LAYOUT RL_VALUE_ULONG FNC_VALUES 1 ULONG ROW_DIR DIRECT /end RECORD_LAYOUT
/begin COMPU_METHOD CM_i16_factor_1_20 "i16_factor_1/20" RAT_FUNC "%8.0" "%" COEFFS 0 1 0 0 0 5 /end COMPU_METHOD
/begin COMPU_METHOD CM_i16_percent_1_20 "i16_percent_1/20" RAT_FUNC "%10.2" "%" COEFFS 0 1 0 0 0 0.05 /end COMPU_METHOD
/begin COMPU_METHOD CM_i16_pressure_mbar "i16_pressure_mbar" RAT_FUNC "%8.0" "mbar" COEFFS 0 1 0 0 0 1 /end COMPU_METHOD
/begin COMPU_METHOD CM_u16_factor_1_10000 "u16_factor_1/10000" RAT_FUNC "%10.2" "%" COEFFS 0 1 0 0 0 0.01 /end COMPU_METHOD
/begin COMPU_METHOD CM_u16_factor_1_1023 "u16_factor_1/1023" RAT_FUNC "%12.4" "%" COEFFS 0 1 0 0 0 0.0977517106549365 /end COMPU_METHOD
/begin COMPU_METHOD CM_u16_flow_100_256mg_s "u16_flow_100/256mg/s" RAT_FUNC "%12.4" "mg/s" COEFFS 0 1 0 0 0 0.390625 /end COMPU_METHOD
/begin COMPU_METHOD CM_u16_flow_10mg_s "u16_flow_10mg/s" RAT_FUNC "%8.0" "mg/s" COEFFS 0 1 0 0 0 10 /end COMPU_METHOD
/begin COMPU_METHOD CM_u16_flow_mg_s "u16_flow_mg/s" RAT_FUNC "%8.0" "mg/s" COEFFS 0 1 0 0 0 1 /end COMPU_METHOD
/begin COMPU_METHOD CM_u16_load_mg_stroke "u16_load_mg/stroke" RAT_FUNC "%8.0" "mg/stroke" COEFFS 0 1 0 0 0 1 /end COMPU_METHOD
/begin COMPU_METHOD CM_u16_mass_g "u16_mass_g" RAT_FUNC "%8.0" "g" COEFFS 0 1 0 0 0 1 /end COMPU_METHOD
/begin COMPU_METHOD CM_u16_mass_mg "u16_mass_mg" RAT_FUNC "%8.0" "mg" COEFFS 0 1 0 0 0 1 /end COMPU_METHOD
/begin COMPU_METHOD CM_u16_ratio_mbar_5v "u16_ratio_mbar/5v" RAT_FUNC "%8.0" "mbar/5v" COEFFS 0 1 0 0 0 1 /end COMPU_METHOD
/begin COMPU_METHOD CM_u16_rspeed_1_4rpm "u16_rspeed_1/4rpm" RAT_FUNC "%10.2" "rpm" COEFFS 0 1 0 0 0 0.25 /end COMPU_METHOD
/begin COMPU_METHOD CM_u16_time_4us "u16_time_4us" RAT_FUNC "%8.0" "us" COEFFS 0 1 0 0 0 4 /end COMPU_METHOD
/begin COMPU_METHOD CM_u16_voltage_18_1023v "u16_voltage_18/1023v" RAT_FUNC "%12.4" "V" COEFFS 0 1 0 0 0 0.0175953079178886 /end COMPU_METHOD
/begin COMPU_METHOD CM_u16_voltage_5_1023v "u16_voltage_5/1023v" RAT_FUNC "%12.4" "V" COEFFS 0 1 0 0 0 0.00488758553274682 /end COMPU_METHOD
/begin COMPU_METHOD CM_u8_accel_1_255g "u8_accel_1/255g" RAT_FUNC "%12.4" "g" COEFFS 0 1 0 0 0 0.00392156862745098 /end COMPU_METHOD
/begin COMPU_METHOD CM_u8_afr_1_100 "u8_afr_1/100" RAT_FUNC "%10.2" "AFR" COEFFS 0 1 0 0 0 0.01 /end COMPU_METHOD
/begin COMPU_METHOD CM_u8_angle_1_4_10deg "u8_angle_1/4-10deg" RAT_FUNC "%10.2" "deg" COEFFS 0 1 10 0 0 0.25 /end COMPU_METHOD
/begin COMPU_METHOD CM_u8_angle_1_4_32deg "u8_angle_1/4-32deg" RAT_FUNC "%10.2" "deg" COEFFS 0 1 32 0 0 0.25 /end COMPU_METHOD
/begin COMPU_METHOD CM_u8_angle_1_4deg "u8_angle_1/4deg" RAT_FUNC "%10.2" "deg" COEFFS 0 1 0 0 0 0.25 /end COMPU_METHOD
/begin COMPU_METHOD CM_u8_dt_factor_1_100_5ms "u8_dt_factor_1/100/5ms" RAT_FUNC "%10.2" "/5ms" COEFFS 0 1 0 0 0 0.01 /end COMPU_METHOD
/begin COMPU_METHOD CM_u8_factor_1_10 "u8_factor_1/10" RAT_FUNC "%8.0" "%" COEFFS 0 1 0 0 0 10 /end COMPU_METHOD
/begin COMPU_METHOD CM_u8_factor_1_100 "u8_factor_1/100" RAT_FUNC "%8.0" "%" COEFFS 0 1 0 0 0 1 /end COMPU_METHOD
/begin COMPU_METHOD CM_u8_factor_1_128 "u8_factor_1/128" RAT_FUNC "%12.4" "%" COEFFS 0 1 0 0 0 0.78125 /end COMPU_METHOD
/begin COMPU_METHOD CM_u8_factor_1_200 "u8_factor_1/200" RAT_FUNC "%9.1" "%" COEFFS 0 1 0 0 0 0.5 /end COMPU_METHOD
/begin COMPU_METHOD CM_u8_factor_1_255 "u8_factor_1/255" RAT_FUNC "%12.4" "%" COEFFS 0 1 0 0 0 0.392156862745098 /end COMPU_METHOD
/begin COMPU_METHOD CM_u8_factor_1_256 "u8_factor_1/256" RAT_FUNC "%12.4" "%" COEFFS 0 1 0 0 0 0.390625 /end COMPU_METHOD
/begin COMPU_METHOD CM_u8_factor_1_2560 "u8_factor_1/2560" RAT_FUNC "%12.4" "%" COEFFS 0 1 0 0 0 0.0390625 /end COMPU_METHOD
/begin COMPU_METHOD CM_u8_factor_1_32 "u8_factor_1/32" RAT_FUNC "%11.3" "%" COEFFS 0 1 0 0 0 3.125 /end COMPU_METHOD
/begin COMPU_METHOD CM_u8_factor_1_64 "u8_factor_1/64" RAT_FUNC "%12.4" "%" COEFFS 0 1 0 0 0 1.5625 /end COMPU_METHOD
/begin COMPU_METHOD CM_u8_flow_100mg_s "u8_flow_100mg/s" RAT_FUNC "%8.0" "mg/s" COEFFS 0 1 0 0 0 100 /end COMPU_METHOD
/begin COMPU_METHOD CM_u8_flow_g_s "u8_flow_g/s" RAT_FUNC "%8.0" "g/s" COEFFS 0 1 0 0 0 1 /end COMPU_METHOD
/begin COMPU_METHOD CM_u8_load_4mg_stroke "u8_load_4mg/stroke" RAT_FUNC "%8.0" "mg/stroke" COEFFS 0 1 0 0 0 4 /end COMPU_METHOD
/begin COMPU_METHOD CM_u8_mass_8g "u8_mass_8g" RAT_FUNC "%8.0" "g" COEFFS 0 1 0 0 0 8 /end COMPU_METHOD
/begin COMPU_METHOD CM_u8_pressure_4mbar "u8_pressure_4mbar" RAT_FUNC "%8.0" "mbar" COEFFS 0 1 0 0 0 4 /end COMPU_METHOD
/begin COMPU_METHOD CM_u8_rspeed_10rpm "u8_rspeed_10rpm" RAT_FUNC "%8.0" "rpm" COEFFS 0 1 0 0 0 10 /end COMPU_METHOD
/begin COMPU_METHOD CM_u8_rspeed_125_4_500rpm "u8_rspeed_125/4+500rpm" RAT_FUNC "%10.2" "rpm" COEFFS 0 1 -500 0 0 31.25 /end COMPU_METHOD
/begin COMPU_METHOD CM_u8_rspeed_125_4rpm "u8_rspeed_125/4rpm" RAT_FUNC "%10.2" "rpm" COEFFS 0 1 0 0 0 31.25 /end COMPU_METHOD
/begin COMPU_METHOD CM_u8_rspeed_4_500rpm "u8_rspeed_4+500rpm" RAT_FUNC "%8.0" "rpm" COEFFS 0 1 -500 0 0 4 /end COMPU_METHOD
/begin COMPU_METHOD CM_u8_rspeed_4_512rpm "u8_rspeed_4-512rpm" RAT_FUNC "%8.0" "rpm" COEFFS 0 1 512 0 0 4 /end COMPU_METHOD
/begin COMPU_METHOD CM_u8_rspeed_4rpm "u8_rspeed_4rpm" RAT_FUNC "%8.0" "rpm" COEFFS 0 1 0 0 0 4 /end COMPU_METHOD
/begin COMPU_METHOD CM_u8_rspeed_50rpm "u8_rspeed_50rpm" RAT_FUNC "%8.0" "rpm" COEFFS 0 1 0 0 0 50 /end COMPU_METHOD
/begin COMPU_METHOD CM_u8_rspeed_8rpm "u8_rspeed_8rpm" RAT_FUNC "%8.0" "rpm" COEFFS 0 1 0 0 0 8 /end COMPU_METHOD
/begin COMPU_METHOD CM_u8_rspeed_accel_1_168 "u8_rspeed_accel_1/168" RAT_FUNC "%8.0" "accel_1/168" COEFFS 0 1 0 0 0 1 /end COMPU_METHOD
/begin COMPU_METHOD CM_u8_rspeed_rpm "u8_rspeed_rpm" RAT_FUNC "%8.0" "rpm" COEFFS 0 1 0 0 0 1 /end COMPU_METHOD
/begin COMPU_METHOD CM_u8_slip_1_8pct "u8_slip_1/8pct" RAT_FUNC "%11.3" "%" COEFFS 0 1 0 0 0 0.125 /end COMPU_METHOD
/begin COMPU_METHOD CM_u8_speed_1_100kph "u8_speed_1/100kph" RAT_FUNC "%10.2" "km/h" COEFFS 0 1 0 0 0 0.01 /end COMPU_METHOD
/begin COMPU_METHOD CM_u8_speed_1_10kph "u8_speed_1/10kph" RAT_FUNC "%9.1" "km/h" COEFFS 0 1 0 0 0 0.1 /end COMPU_METHOD
/begin COMPU_METHOD CM_u8_speed_kph "u8_speed_kph" RAT_FUNC "%8.0" "km/h" COEFFS 0 1 0 0 0 1 /end COMPU_METHOD
/begin COMPU_METHOD CM_u8_temp_1_10C "u8_temp_1/10C" RAT_FUNC "%9.1" "°C" COEFFS 0 1 0 0 0 0.1 /end COMPU_METHOD
/begin COMPU_METHOD CM_u8_temp_5_8_40c "u8_temp_5/8-40c" RAT_FUNC "%11.3" "°C" COEFFS 0 1 40 0 0 0.625 /end COMPU_METHOD
/begin COMPU_METHOD CM_u8_time_100ms "u8_time_100ms" RAT_FUNC "%8.0" "ms" COEFFS 0 1 0 0 0 100 /end COMPU_METHOD
/begin COMPU_METHOD CM_u8_time_10ms "u8_time_10ms" RAT_FUNC "%8.0" "ms" COEFFS 0 1 0 0 0 10 /end COMPU_METHOD
/begin COMPU_METHOD CM_u8_time_10us "u8_time_10us" RAT_FUNC "%8.0" "us" COEFFS 0 1 0 0 0 10 /end COMPU_METHOD
/begin COMPU_METHOD CM_u8_time_250ms "u8_time_250ms" RAT_FUNC "%8.0" "ms" COEFFS 0 1 0 0 0 250 /end COMPU_METHOD
/begin COMPU_METHOD CM_u8_time_2s "u8_time_2s" RAT_FUNC "%8.0" "s" COEFFS 0 1 0 0 0 2 /end COMPU_METHOD
/begin COMPU_METHOD CM_u8_time_50ms "u8_time_50ms" RAT_FUNC "%8.0" "ms" COEFFS 0 1 0 0 0 50 /end COMPU_METHOD
/begin COMPU_METHOD CM_u8_time_5ms "u8_time_5ms" RAT_FUNC "%8.0" "ms" COEFFS 0 1 0 0 0 5 /end COMPU_METHOD
/begin COMPU_METHOD CM_u8_time_8us "u8_time_8us" RAT_FUNC "%8.0" "us" COEFFS 0 1 0 0 0 8 /end COMPU_METHOD
/begin COMPU_METHOD CM_u8_time_hours "u8_time_hours" RAT_FUNC "%8.0" "hours" COEFFS 0 1 0 0 0 1 /end COMPU_METHOD
/begin COMPU_METHOD CM_u8_time_ms "u8_time_ms" RAT_FUNC "%8.0" "ms" COEFFS 0 1 0 0 0 1 /end COMPU_METHOD
/begin COMPU_METHOD CM_u8_time_s "u8_time_s" RAT_FUNC "%8.0" "s" COEFFS 0 1 0 0 0 1 /end COMPU_METHOD
/begin COMPU_METHOD CM_u8_time_us "u8_time_us" RAT_FUNC "%8.0" "us" COEFFS 0 1 0 0 0 1 /end COMPU_METHOD
/begin COMPU_METHOD CM_u8_torque_2nm "u8_torque_2nm" RAT_FUNC "%8.0" "Nm" COEFFS 0 1 0 0 0 2 /end COMPU_METHOD
/begin COMPU_METHOD CM_u8_torque_nm "u8_torque_nm" RAT_FUNC "%8.0" "Nm" COEFFS 0 1 0 0 0 1 /end COMPU_METHOD
/begin COMPU_METHOD CM_u8_voltage_5_255v "u8_voltage_5/255v" RAT_FUNC "%12.4" "V" COEFFS 0 1 0 0 0 0.0196078431372549 /end COMPU_METHOD
/begin COMPU_METHOD CM_u8_voltage_72_1023v "u8_voltage_72/1023v" RAT_FUNC "%12.4" "V" COEFFS 0 1 0 0 0 0.0703812316715543 /end COMPU_METHOD
/begin COMPU_METHOD CM_u8_volume_1_10gallon "u8_volume_1/10gallon" RAT_FUNC "%9.1" "gallon" COEFFS 0 1 0 0 0 0.1 /end COMPU_METHOD
/begin COMPU_METHOD CM_u8_volume_liter "u8_volume_liter" RAT_FUNC "%8.0" "liter" COEFFS 0 1 0 0 0 1 /end COMPU_METHOD
/begin CHARACTERISTIC CAL_base "T6-V00BU#World#Lotus#Evora#2012-2022#MT#25050b#MPC5534#CRP#0x59D4#LOTUS EVORA" ASCII 0x40008E24 RL_VALUE_UBYTE 0 NO_COMPU_METHOD 0 255 NUMBER 32 /end CHARACTERISTIC
/begin CHARACTERISTIC CAL_ecu_data_base "undefined" VALUE 0x40008E44 RL_VALUE_ULONG 0 NO_COMPU_METHOD 0 4294967295 /end CHARACTERISTIC
/begin CHARACTERISTIC CAL_logger_high_speed_logger_enable "To enable the built-in highspeed data logger, set this configuration option." VALUE 0x40008E4A RL_VALUE_UBYTE 0 NO_COMPU_METHOD 0 255 /end CHARACTERISTIC
/begin CHARACTERISTIC CAL_ips_request_msg_id_nibble "4-bit nibble; IPS CAN request message ID = `(nibble << 4)" VALUE 0x40008E4B RL_VALUE_UBYTE 0 NO_COMPU_METHOD 0 255 /end CHARACTERISTIC
/begin CHARACTERISTIC CAL_sensor_baro_gain "Calibration: sensor barometric gain. Tunable map/constant (not a live channel); log the raw sensor signal to check sensor health and range. (mbar/5V)" VALUE 0x40008E4C RL_VALUE_UWORD 0 CM_u16_ratio_mbar_5v 0 65535 /end CHARACTERISTIC
/begin CHARACTERISTIC CAL_sensor_baro_offset "Calibration: sensor barometric offset. Tunable map/constant (not a live channel); log the raw sensor signal to check sensor health and range. (mbar)" VALUE 0x40008E4E RL_VALUE_SWORD 0 CM_i16_pressure_mbar -32768 32767 /end CHARACTERISTIC
/begin CHARACTERISTIC CAL_sensor_evap_gain "Calibration: sensor EVAP gain. Tunable map/constant (not a live channel); log the raw sensor signal to check sensor health and range. (mbar/5V)" VALUE 0x40008E50 RL_VALUE_UWORD 0 CM_u16_ratio_mbar_5v 0 65535 /end CHARACTERISTIC
/begin CHARACTERISTIC CAL_sensor_evap_offset "Calibration: sensor EVAP offset. Tunable map/constant (not a live channel); log the raw sensor signal to check sensor health and range. (mbar)" VALUE 0x40008E52 RL_VALUE_SWORD 0 CM_i16_pressure_mbar -32768 32767 /end CHARACTERISTIC
/begin CHARACTERISTIC CAL_sensor_adc_map_gain "uint16_t" VALUE 0x40008E54 RL_VALUE_UWORD 0 NO_COMPU_METHOD 0 65535 /end CHARACTERISTIC
/begin CHARACTERISTIC CAL_sensor_adc_map_offset "undefined2" VALUE 0x40008E56 RL_VALUE_UWORD 0 NO_COMPU_METHOD 0 65535 /end CHARACTERISTIC
/begin CHARACTERISTIC CAL_cooling_fan_carspeed_min_1 "Calibration: cooling fan carspeed min 1. Tunable map/constant (not a live channel); log to confirm fans/pumps switch at the right temperatures. (km/h)" VALUE 0x40008E58 RL_VALUE_UBYTE 0 CM_u8_speed_kph 0 255 /end CHARACTERISTIC
/begin CHARACTERISTIC CAL_cooling_fan_bay_off_temp_3min "Calibration: cooling fan bay off temperature 3min. Tunable map/constant (not a live channel); log to confirm fans/pumps switch at the right temperatures. (deg C; raw*5/8-40)" VALUE 0x40008E59 RL_VALUE_UBYTE 0 CM_u8_temp_5_8_40c -40 119.375 /end CHARACTERISTIC
/begin CHARACTERISTIC CAL_cooling_fan_bay_off_temp_2min "Calibration: cooling fan bay off temperature 2min. Tunable map/constant (not a live channel); log to confirm fans/pumps switch at the right temperatures. (deg C; raw*5/8-40)" VALUE 0x40008E5A RL_VALUE_UBYTE 0 CM_u8_temp_5_8_40c -40 119.375 /end CHARACTERISTIC
/begin CHARACTERISTIC CAL_cooling_fan_bay_afterrun_shutdown_duration "u8_time_2s" VALUE 0x40008E5B RL_VALUE_UBYTE 0 CM_u8_time_2s 0 510 /end CHARACTERISTIC
/begin CHARACTERISTIC CAL_cooling_fan_bay_afterrun_heatsoak_duration "u8_time_2s" VALUE 0x40008E5C RL_VALUE_UBYTE 0 CM_u8_time_2s 0 510 /end CHARACTERISTIC
/begin CHARACTERISTIC CAL_cooling_fan_bay_afterrun_heatsoak_window "u8_time_2s" VALUE 0x40008E5D RL_VALUE_UBYTE 0 CM_u8_time_2s 0 510 /end CHARACTERISTIC
/begin CHARACTERISTIC CAL_cooling_fan_coolant_temp_threshold "Coolant temperature above which cooling fan activates" VALUE 0x40008E5E RL_VALUE_UBYTE 0 CM_u8_temp_5_8_40c -40 119.375 /end CHARACTERISTIC
/begin CHARACTERISTIC CAL_cooling_fan_engine_bay_run_duration "uint8_t" VALUE 0x40008E5F RL_VALUE_UBYTE 0 NO_COMPU_METHOD 0 255 /end CHARACTERISTIC
/begin CHARACTERISTIC CAL_cooling_fan_bay_idle_stationary_dwell "Calibration: cooling fan bay idle stationary dwell. Tunable map/constant (not a live channel); log to confirm fans/pumps switch at the right temperatures. (s)" VALUE 0x40008E60 RL_VALUE_UBYTE 0 CM_u8_time_s 0 255 /end CHARACTERISTIC
/begin CHARACTERISTIC CAL_cooling_fan_bay_idle_temp_low "Calibration: cooling fan bay idle temperature low. Tunable map/constant (not a live channel); log to confirm fans/pumps switch at the right temperatures. (deg C; raw*5/8-40)" VALUE 0x40008E61 RL_VALUE_UBYTE 0 CM_u8_temp_5_8_40c -40 119.375 /end CHARACTERISTIC
/begin CHARACTERISTIC CAL_cooling_fan_bay_restart_inhibit "Calibration: cooling fan bay restart inhibit. Tunable map/constant (not a live channel); log to confirm fans/pumps switch at the right temperatures. (s)" VALUE 0x40008E62 RL_VALUE_UBYTE 0 CM_u8_time_s 0 255 /end CHARACTERISTIC
/begin CHARACTERISTIC CAL_fuel_level_debounce_window_low "Calibration: fuel level debounce window low. Tunable map/constant (not a live channel); log to follow fuel delivery and mixture control. (gal; raw/10)" VALUE 0x40008E63 RL_VALUE_UBYTE 0 CM_u8_volume_1_10gallon 0 25.5 /end CHARACTERISTIC
/begin CHARACTERISTIC CAL_fuel_level_debounce_window_high "Calibration: fuel level debounce window high. Tunable map/constant (not a live channel); log to follow fuel delivery and mixture control. (gal; raw/10)" VALUE 0x40008E65 RL_VALUE_UBYTE 0 CM_u8_volume_1_10gallon 0 25.5 /end CHARACTERISTIC
/begin CHARACTERISTIC CAL_fuel_level_update_holdoff "u8_count" VALUE 0x40008E66 RL_VALUE_UBYTE 0 NO_COMPU_METHOD 0 255 /end CHARACTERISTIC
/begin CHARACTERISTIC CAL_fuel_level_stable_count "u8_count" VALUE 0x40008E67 RL_VALUE_UBYTE 0 NO_COMPU_METHOD 0 255 /end CHARACTERISTIC
/begin CHARACTERISTIC CAL_load_alphaN_hold_time "Calibration: load alphaN hold time. Tunable map/constant (not a live channel); log engine load -- the main axis for fueling and ignition. (ms; raw*5)" VALUE 0x40008E68 RL_VALUE_UBYTE 0 CM_u8_time_5ms 0 1275 /end CHARACTERISTIC
/begin CHARACTERISTIC CAL_ign_comp_coolant_engine_stopped_max "uint8_t" VALUE 0x40008E69 RL_VALUE_UBYTE 0 NO_COMPU_METHOD 0 255 /end CHARACTERISTIC
/begin CHARACTERISTIC CAL_ign_comp_coolant_engine_stopped_min "uint8_t" VALUE 0x40008E6A RL_VALUE_UBYTE 0 NO_COMPU_METHOD 0 255 /end CHARACTERISTIC
/begin CHARACTERISTIC CAL_tpssmooth_rate_calc_window_size "Calibration: tpssmooth rate calculated window size. Tunable map/constant (not a live channel); log to see throttle-signal smoothing/filtering behavior." VALUE 0x40008E6B RL_VALUE_UBYTE 0 NO_COMPU_METHOD 0 255 /end CHARACTERISTIC
/begin CHARACTERISTIC CAL_wheel_speed_vss_tire_circumference "Calibration: vss tire circumference. Tunable map/constant (not a live channel); adjust to change this behavior." VALUE 0x40008E6C RL_VALUE_UWORD 0 NO_COMPU_METHOD 0 65535 /end CHARACTERISTIC
/begin CHARACTERISTIC CAL_wheel_speed_vss_pulses_per_rev "Calibration: vss pulses per rev. Tunable map/constant (not a live channel); adjust to change this behavior." VALUE 0x40008E6E RL_VALUE_UBYTE 0 NO_COMPU_METHOD 0 255 /end CHARACTERISTIC
/begin CHARACTERISTIC CAL_dfco_pedal_ramp_step_interval "undefined1" VALUE 0x40008E6F RL_VALUE_UBYTE 0 NO_COMPU_METHOD 0 255 /end CHARACTERISTIC
/begin CHARACTERISTIC CAL_load_filter_coeff "Calibration: injector fuel fillm xtau coeff. Tunable map/constant (not a live channel); log to verify injector pulse width and fuel delivery vs target. (0-1; raw/255)" VALUE 0x40008E70 RL_VALUE_UBYTE 0 CM_u8_factor_1_255 0 100 /end CHARACTERISTIC
/begin CHARACTERISTIC CAL_ign_startup_comp_coolant_min "Calibration: ignition startup compensation coolant min. Tunable map/constant (not a live channel); log spark advance to confirm the timing strategy and headroom to knock. (deg C; raw*5/8-40)" VALUE 0x40008E71 RL_VALUE_UBYTE 0 CM_u8_temp_5_8_40c -40 119.375 /end CHARACTERISTIC
/begin CHARACTERISTIC CAL_ign_startup_comp_coolant_max "Calibration: ignition startup compensation coolant max. Tunable map/constant (not a live channel); log spark advance to confirm the timing strategy and headroom to knock. (deg C; raw*5/8-40)" VALUE 0x40008E72 RL_VALUE_UBYTE 0 CM_u8_temp_5_8_40c -40 119.375 /end CHARACTERISTIC
/begin CHARACTERISTIC CAL_ign_fixed_manual "Calibration: ignition fixed manual. Tunable map/constant (not a live channel); log spark advance to confirm the timing strategy and headroom to knock. (deg; raw/4-10)" VALUE 0x40008E73 RL_VALUE_UBYTE 0 CM_u8_angle_1_4_10deg -10 53.75 /end CHARACTERISTIC
/begin CHARACTERISTIC CAL_torque_ext_torque_limit_hold_count "u8_time_10ms" VALUE 0x40008E74 RL_VALUE_UBYTE 0 CM_u8_time_10ms 0 2550 /end CHARACTERISTIC
/begin CHARACTERISTIC CAL_injtip_in_adj_gears "Calibration: injtip in adj gears. Tunable map/constant (not a live channel); log to debug transient (tip-in/out) fueling stumbles and surge. (0-1; raw/128)" VAL_BLK 0x40008E75 RL_VALUE_UBYTE 0 CM_u8_factor_1_128 0 199.21875 NUMBER 6 /end CHARACTERISTIC
/begin CHARACTERISTIC CAL_engine_accel_lookback_teeth "Calibration: engine accelerator lookback teeth. Tunable map/constant (not a live channel); log to follow core engine state." VALUE 0x40008E7B RL_VALUE_UBYTE 0 NO_COMPU_METHOD 0 255 /end CHARACTERISTIC
/begin CHARACTERISTIC CAL_knock_baseline_min_clamp "uint8_t" VALUE 0x40008E7C RL_VALUE_UBYTE 0 NO_COMPU_METHOD 0 255 /end CHARACTERISTIC
/begin CHARACTERISTIC CAL_sensor_ac_evap_temp_filter_alpha "uint8_t" VALUE 0x40008E7D RL_VALUE_UBYTE 0 NO_COMPU_METHOD 0 255 /end CHARACTERISTIC
/begin CHARACTERISTIC CAL_ign_trim_per_cyl "Calibration: ignition trim per cylinder. Tunable map/constant (not a live channel); log spark advance to confirm the timing strategy and headroom to knock. (deg; raw/4-32)" VAL_BLK 0x40008E7E RL_VALUE_UBYTE 0 CM_u8_angle_1_4_32deg -32 31.75 NUMBER 6 /end CHARACTERISTIC
/begin CHARACTERISTIC CAL_ac_inhibit_coolant "Calibration: A/C inhibit coolant. Tunable map/constant (not a live channel); log to see A/C clutch engagement and its load/idle impact. (deg C; raw*5/8-40)" VAL_BLK 0x40008E84 RL_VALUE_UBYTE 0 CM_u8_temp_5_8_40c -40 119.375 NUMBER 2 /end CHARACTERISTIC
/begin CHARACTERISTIC CAL_ac_inhibit_tps "Calibration: A/C inhibit throttle position. Tunable map/constant (not a live channel); log to see throttle/pedal demand and throttle response. (0-1; raw/255)" VAL_BLK 0x40008E86 RL_VALUE_UBYTE 0 CM_u8_factor_1_255 0 100 NUMBER 2 /end CHARACTERISTIC
/begin CHARACTERISTIC CAL_ac_ign_comp_delay "u8_time_100ms" VALUE 0x40008E88 RL_VALUE_UBYTE 0 CM_u8_time_100ms 0 25500 /end CHARACTERISTIC
/begin CHARACTERISTIC CAL_cooling_fan_low_on_engine_on "Calibration: cooling fan low on engine on. Tunable map/constant (not a live channel); log to confirm fans/pumps switch at the right temperatures. (deg C; raw*5/8-40)" VALUE 0x40008E89 RL_VALUE_UBYTE 0 CM_u8_temp_5_8_40c -40 119.375 /end CHARACTERISTIC
/begin CHARACTERISTIC CAL_cooling_fan_low_off_engine_on "Calibration: cooling fan low off engine on. Tunable map/constant (not a live channel); log to confirm fans/pumps switch at the right temperatures. (deg C; raw*5/8-40)" VALUE 0x40008E8A RL_VALUE_UBYTE 0 CM_u8_temp_5_8_40c -40 119.375 /end CHARACTERISTIC
/begin CHARACTERISTIC CAL_cooling_fan_low_on_engine_off "Calibration: cooling fan low on engine off. Tunable map/constant (not a live channel); log to confirm fans/pumps switch at the right temperatures. (deg C; raw*5/8-40)" VALUE 0x40008E8B RL_VALUE_UBYTE 0 CM_u8_temp_5_8_40c -40 119.375 /end CHARACTERISTIC
/begin CHARACTERISTIC CAL_cooling_fan_low_off_engine_off "Calibration: cooling fan low off engine off. Tunable map/constant (not a live channel); log to confirm fans/pumps switch at the right temperatures. (deg C; raw*5/8-40)" VALUE 0x40008E8C RL_VALUE_UBYTE 0 CM_u8_temp_5_8_40c -40 119.375 /end CHARACTERISTIC
/begin CHARACTERISTIC CAL_cooling_fan_high_on_coolant "Calibration: cooling fan high on coolant. Tunable map/constant (not a live channel); log to confirm fans/pumps switch at the right temperatures. (deg C; raw*5/8-40)" VALUE 0x40008E8D RL_VALUE_UBYTE 0 CM_u8_temp_5_8_40c -40 119.375 /end CHARACTERISTIC
/begin CHARACTERISTIC CAL_cooling_fan_high_off_coolant "Calibration: cooling fan high off coolant. Tunable map/constant (not a live channel); log to confirm fans/pumps switch at the right temperatures. (deg C; raw*5/8-40)" VALUE 0x40008E8E RL_VALUE_UBYTE 0 CM_u8_temp_5_8_40c -40 119.375 /end CHARACTERISTIC
/begin CHARACTERISTIC CAL_cooling_fan_disable_carspeed "Calibration: cooling fan disable carspeed. Tunable map/constant (not a live channel); log to confirm fans/pumps switch at the right temperatures. (km/h)" VALUE 0x40008E8F RL_VALUE_UBYTE 0 CM_u8_speed_kph 0 255 /end CHARACTERISTIC
/begin CHARACTERISTIC CAL_idle_flow_integral_adj_max "Calibration: idle flow integral adj max. Tunable map/constant (not a live channel); log to diagnose idle quality, hunting, and stalls. (mg/s; raw*100)" VALUE 0x40008E90 RL_VALUE_UBYTE 0 CM_u8_flow_100mg_s 0 25500 /end CHARACTERISTIC
/begin CHARACTERISTIC CAL_idle_flow_integral_adj_max_40008E91 "Calibration: idle flow integral adj max. Tunable map/constant (not a live channel); log to diagnose idle quality, hunting, and stalls. (mg/s; raw*100)" VALUE 0x40008E91 RL_VALUE_UBYTE 0 CM_u8_flow_100mg_s 0 25500 /end CHARACTERISTIC
/begin CHARACTERISTIC CAL_idle_learn_integral_max "uint8_t" VALUE 0x40008E92 RL_VALUE_UBYTE 0 NO_COMPU_METHOD 0 255 /end CHARACTERISTIC
/begin CHARACTERISTIC CAL_idle_learn_integral_min "uint8_t" VALUE 0x40008E93 RL_VALUE_UBYTE 0 NO_COMPU_METHOD 0 255 /end CHARACTERISTIC
/begin CHARACTERISTIC CAL_closedloop_activate_air_temp "Calibration: closedloop activate air temperature. Tunable map/constant (not a live channel); log to watch O2 feedback trim the mixture and confirm the loop is active. (deg C; raw*5/8-40)" VALUE 0x40008E94 RL_VALUE_UBYTE 0 CM_u8_temp_5_8_40c -40 119.375 /end CHARACTERISTIC
/begin CHARACTERISTIC CAL_closedloop_stft_steady_state_holdoff_ticks "u8_time_100ms" VALUE 0x40008E95 RL_VALUE_UBYTE 0 CM_u8_time_100ms 0 25500 /end CHARACTERISTIC
/begin CHARACTERISTIC CAL_ac_inhibit_rpm_cutoff_min_hold "u8_time_50ms" VALUE 0x40008E96 RL_VALUE_UBYTE 0 CM_u8_time_50ms 0 12750 /end CHARACTERISTIC
/begin CHARACTERISTIC CAL_closedloop_ramp_interval_scale "uint8_t" VALUE 0x40008E97 RL_VALUE_UBYTE 0 NO_COMPU_METHOD 0 255 /end CHARACTERISTIC
/begin CHARACTERISTIC CAL_ac_inhibit_rpm "Calibration: A/C inhibit RPM. Tunable map/constant (not a live channel); log to see A/C clutch engagement and its load/idle impact. (RPM; raw*125/4+500)" VAL_BLK 0x40008E98 RL_VALUE_UBYTE 0 CM_u8_rspeed_125_4_500rpm 500 8468.75 NUMBER 2 /end CHARACTERISTIC
/begin CHARACTERISTIC CAL_ac_tps_inhibit_timer "Calibration: A/C throttle position inhibit timer. Tunable map/constant (not a live channel); log to see throttle/pedal demand and throttle response." VALUE 0x40008E9A RL_VALUE_UBYTE 0 NO_COMPU_METHOD 0 255 /end CHARACTERISTIC
/begin CHARACTERISTIC CAL_misc_engine_running_confirm_delay "Calibration: misc engine running confirm delay. Tunable map/constant (not a live channel); log to follow core engine state." VALUE 0x40008E9B RL_VALUE_UBYTE 0 NO_COMPU_METHOD 0 255 /end CHARACTERISTIC
/begin CHARACTERISTIC CAL_ac_shutdown_delay "uint8_t" VALUE 0x40008E9C RL_VALUE_UBYTE 0 NO_COMPU_METHOD 0 255 /end CHARACTERISTIC
/begin CHARACTERISTIC CAL_cooling_recirc_pump_enable_temp "Calibration: cooling recirc pump enable temperature. Tunable map/constant (not a live channel); log to confirm fans/pumps switch at the right temperatures. (deg C; raw*5/8-40)" VALUE 0x40008E9D RL_VALUE_UBYTE 0 CM_u8_temp_5_8_40c -40 119.375 /end CHARACTERISTIC
/begin CHARACTERISTIC CAL_dfco_entry_pedal_max_clutch_coast "Calibration: DFCO entry pedal max clutch coast. Tunable map/constant (not a live channel); log to see when fuel is cut and restored on deceleration. (0-1; raw/255)" VALUE 0x40008E9E RL_VALUE_UBYTE 0 CM_u8_factor_1_255 0 100 /end CHARACTERISTIC
/begin CHARACTERISTIC CAL_load_alphaN_learn_trim_limits "Calibration: torque torque to throttle position scaling RPM range unknown. Tunable map/constant (not a live channel); log to see throttle/pedal demand and throttle response. (RPM; raw*125/4+500)" VAL_BLK 0x40008E9F RL_VALUE_UBYTE 0 CM_u8_factor_1_100 0 255 NUMBER 2 /end CHARACTERISTIC
/begin CHARACTERISTIC CAL_ecu_learning_x_axis_stability_threshold "Calibration: ECU learning x axis stability threshold. Tunable map/constant (not a live channel); mostly housekeeping/diagnostic state." VALUE 0x40008EA1 RL_VALUE_UBYTE 0 NO_COMPU_METHOD 0 255 /end CHARACTERISTIC
/begin CHARACTERISTIC CAL_ecu_learning_y_axis_stability_threshold "uint8_t" VALUE 0x40008EA2 RL_VALUE_UBYTE 0 NO_COMPU_METHOD 0 255 /end CHARACTERISTIC
/begin CHARACTERISTIC CAL_wheel_speed_smoothing "Calibration: unused wheelspeed smoothing. Tunable map/constant (not a live channel); adjust to change this behavior. (0-1; raw/255)" VALUE 0x40008EA3 RL_VALUE_UBYTE 0 CM_u8_factor_1_255 0 100 /end CHARACTERISTIC
/begin CHARACTERISTIC CAL_load_learning_enable_coolant_min "u8_temp_5/8-40c" VALUE 0x40008EA4 RL_VALUE_UBYTE 0 CM_u8_temp_5_8_40c -40 119.375 /end CHARACTERISTIC
/begin CHARACTERISTIC CAL_ac_fan_startup_hold_time "Calibration: A/C fan startup hold time. Tunable map/constant (not a live channel); log to see A/C clutch engagement and its load/idle impact. (s)" VALUE 0x40008EA5 RL_VALUE_UBYTE 0 CM_u8_time_s 0 255 /end CHARACTERISTIC
/begin CHARACTERISTIC CAL_obd_ii_readiness_bit3_enable "uint8_t" VALUE 0x40008EA6 RL_VALUE_UBYTE 0 NO_COMPU_METHOD 0 255 /end CHARACTERISTIC
/begin CHARACTERISTIC CAL_sensor_airtemp_tmaf_filter_alpha "Calibration: sensor engine air reactivity. Tunable map/constant (not a live channel); log the raw sensor signal to check sensor health and range. (0-1; raw/2560)" VALUE 0x40008EA7 RL_VALUE_UBYTE 0 CM_u8_factor_1_2560 0 9.9609375 /end CHARACTERISTIC
/begin CHARACTERISTIC CAL_sensor_coolant_filter_alpha "Calibration: sensor coolant reactivity. Tunable map/constant (not a live channel); log the raw sensor signal to check sensor health and range. (0-1; raw/2560)" VALUE 0x40008EA8 RL_VALUE_UBYTE 0 CM_u8_factor_1_2560 0 9.9609375 /end CHARACTERISTIC
/begin CHARACTERISTIC CAL_sensor_airtemp_not_wired_filter_alpha "Calibration: sensor intake air reactivity. Tunable map/constant (not a live channel); log the raw sensor signal to check sensor health and range. (0-1; raw/2560)" VALUE 0x40008EA9 RL_VALUE_UBYTE 0 CM_u8_factor_1_2560 0 9.9609375 /end CHARACTERISTIC
/begin CHARACTERISTIC CAL_closedloop_low_rpm_stft_reset_rpm "u8_rspeed_125/4+500rpm" VALUE 0x40008EAA RL_VALUE_UBYTE 0 CM_u8_rspeed_125_4_500rpm 500 8468.75 /end CHARACTERISTIC
/begin CHARACTERISTIC CAL_fuel_level_filter_coeff_rise "u8_factor_1/255" VALUE 0x40008EAB RL_VALUE_UBYTE 0 CM_u8_factor_1_255 0 100 /end CHARACTERISTIC
/begin CHARACTERISTIC CAL_ac_inhibit_carspeed2 "Calibration: A/C inhibit carspeed2. Tunable map/constant (not a live channel); log to see A/C clutch engagement and its load/idle impact. (km/h)" VAL_BLK 0x40008EAC RL_VALUE_UBYTE 0 CM_u8_speed_kph 0 255 NUMBER 2 /end CHARACTERISTIC
/begin CHARACTERISTIC CAL_evap_purge_idle_duty_max "u8_dutycycle_100/255" VALUE 0x40008EAE RL_VALUE_UBYTE 0 CM_u8_factor_1_255 0 100 /end CHARACTERISTIC
/begin CHARACTERISTIC CAL_ecu_ign_threshold "Calibration: ECU ignition threshold. Tunable map/constant (not a live channel); log spark advance to confirm the timing strategy and headroom to knock. (V; raw*72/1023)" VALUE 0x40008EAF RL_VALUE_UBYTE 0 CM_u8_voltage_72_1023v 0 17.9472140762463 /end CHARACTERISTIC
/begin CHARACTERISTIC CAL_dfco_entry_speed_min "Calibration: DFCO entry speed min. Tunable map/constant (not a live channel); log to see when fuel is cut and restored on deceleration. (km/h)" VALUE 0x40008EB0 RL_VALUE_UBYTE 0 CM_u8_speed_kph 0 255 /end CHARACTERISTIC
/begin CHARACTERISTIC CAL_dfco_exit_speed_min_ips "Calibration: DFCO exit speed min IPS. Tunable map/constant (not a live channel); log to see when fuel is cut and restored on deceleration. (km/h)" VALUE 0x40008EB1 RL_VALUE_UBYTE 0 CM_u8_speed_kph 0 255 /end CHARACTERISTIC
/begin CHARACTERISTIC CAL_ign_enable_lea_knock_retard "Calibration: ignition enable lea knock retard. Tunable map/constant (not a live channel); log spark advance to confirm the timing strategy and headroom to knock." VALUE 0x40008EB2 RL_VALUE_UBYTE 0 NO_COMPU_METHOD 0 255 /end CHARACTERISTIC
/begin CHARACTERISTIC CAL_sensor_o2_heater_softstart_pwm_period "uint8_t" VALUE 0x40008EB3 RL_VALUE_UBYTE 0 NO_COMPU_METHOD 0 255 /end CHARACTERISTIC
/begin CHARACTERISTIC CAL_sensor_o2_heater_softstart_duration "u16_time_5ms" VALUE 0x40008EB4 RL_VALUE_UWORD 0 CM_u8_time_5ms 0 327675 /end CHARACTERISTIC
/begin CHARACTERISTIC CAL_knock_retard1_limit "Calibration: knock retard1 limit. Tunable map/constant (not a live channel); log to catch knock events and see how much timing is being pulled. (deg; raw/4)" VALUE 0x40008EB6 RL_VALUE_UBYTE 0 CM_u8_angle_1_4deg 0 63.75 /end CHARACTERISTIC
/begin CHARACTERISTIC CAL_knock_ign_retard_initial "Calibration: knock ignition retard initial. Tunable map/constant (not a live channel); log spark advance to confirm the timing strategy and headroom to knock." VALUE 0x40008EB7 RL_VALUE_UBYTE 0 NO_COMPU_METHOD 0 255 /end CHARACTERISTIC
/begin CHARACTERISTIC CAL_knock_ign_retard_decay_rate "Calibration: knock ignition retard decay rate. Tunable map/constant (not a live channel); log spark advance to confirm the timing strategy and headroom to knock. (deg; raw/4)" VALUE 0x40008EB8 RL_VALUE_UBYTE 0 CM_u8_angle_1_4deg 0 63.75 /end CHARACTERISTIC
/begin CHARACTERISTIC CAL_knock_octane_scaler_increment "Calibration: knock octane scaler increment. Tunable map/constant (not a live channel); log to catch knock events and see how much timing is being pulled." VALUE 0x40008EB9 RL_VALUE_UBYTE 0 NO_COMPU_METHOD 0 255 /end CHARACTERISTIC
/begin CHARACTERISTIC CAL_knock_octane_scaler_decrement "Calibration: knock octane scaler decrement. Tunable map/constant (not a live channel); log to catch knock events and see how much timing is being pulled." VALUE 0x40008EBA RL_VALUE_UBYTE 0 NO_COMPU_METHOD 0 255 /end CHARACTERISTIC
/begin CHARACTERISTIC CAL_knock_detection_engine_speed_max "Calibration: knock detection engine speed max. Tunable map/constant (not a live channel); log to catch knock events and see how much timing is being pulled. (RPM; raw*125/4+500)" VALUE 0x40008EBB RL_VALUE_UBYTE 0 CM_u8_rspeed_125_4_500rpm 500 8468.75 /end CHARACTERISTIC
/begin CHARACTERISTIC CAL_knock_detection_engine_speed_min "Calibration: knock detection engine speed min. Tunable map/constant (not a live channel); log to catch knock events and see how much timing is being pulled. (RPM; raw*125/4+500)" VALUE 0x40008EBC RL_VALUE_UBYTE 0 CM_u8_rspeed_125_4_500rpm 500 8468.75 /end CHARACTERISTIC
/begin CHARACTERISTIC CAL_knock_learning_enable_coolant_temp_min "u8_temp_5/8-40c" VALUE 0x40008EBD RL_VALUE_UBYTE 0 CM_u8_temp_5_8_40c -40 119.375 /end CHARACTERISTIC
/begin CHARACTERISTIC CAL_knock_octane_short_term_retard_max "It sets how much retard a fully saturated short-term octane scaler adds." VALUE 0x40008EBE RL_VALUE_UBYTE 0 CM_u8_angle_1_4deg 0 63.75 /end CHARACTERISTIC
/begin CHARACTERISTIC CAL_injtip_dfco_enable_speed "uint8_t" VALUE 0x40008EBF RL_VALUE_UBYTE 0 NO_COMPU_METHOD 0 255 /end CHARACTERISTIC
/begin CHARACTERISTIC CAL_knock_detection_engine_speed_margin "Calibration: knock detection engine speed margin. Tunable map/constant (not a live channel); log to catch knock events and see how much timing is being pulled. (RPM; raw*125/4)" VALUE 0x40008EC0 RL_VALUE_UBYTE 0 CM_u8_rspeed_125_4rpm 0 7968.75 /end CHARACTERISTIC
/begin CHARACTERISTIC CAL_knock_detection_load_margin_debounce "Calibration: knock detection load margin debounce. Tunable map/constant (not a live channel); log to catch knock events and see how much timing is being pulled. (mg/stroke; raw*4)" VALUE 0x40008EC1 RL_VALUE_UBYTE 0 CM_u8_load_4mg_stroke 0 1020 /end CHARACTERISTIC
/begin CHARACTERISTIC CAL_knock_inhibit_timer_tps_rate "Calibration: knock inhibit timer throttle position rate. Tunable map/constant (not a live channel); log to catch knock events and see how much timing is being pulled. (ms; raw*5)" VALUE 0x40008EC2 RL_VALUE_UBYTE 0 CM_u8_time_5ms 0 1275 /end CHARACTERISTIC
/begin CHARACTERISTIC CAL_knock_inhibit_tps_rate1 "Calibration: knock inhibit throttle position rate1. Tunable map/constant (not a live channel); log to catch knock events and see how much timing is being pulled. (0-1; raw/1023)" VALUE 0x40008EC4 RL_VALUE_UWORD 0 CM_u16_factor_1_1023 0 6406.15835777126 /end CHARACTERISTIC
/begin CHARACTERISTIC CAL_knock_corr_limit "uint8_t" VALUE 0x40008EC6 RL_VALUE_UBYTE 0 NO_COMPU_METHOD 0 255 /end CHARACTERISTIC
/begin CHARACTERISTIC CAL_closedloop_stft_filter_unknown "uint8_t" VALUE 0x40008EC7 RL_VALUE_UBYTE 0 NO_COMPU_METHOD 0 255 /end CHARACTERISTIC
/begin CHARACTERISTIC CAL_evap_purge_conditioning_timer_100ms "uint8_t" VALUE 0x40008EC8 RL_VALUE_UBYTE 0 NO_COMPU_METHOD 0 255 /end CHARACTERISTIC
/begin CHARACTERISTIC CAL_evap_purge_min_inj_pulse_enter "u8_time_8us" VALUE 0x40008EC9 RL_VALUE_UBYTE 0 CM_u8_time_8us 0 2040 /end CHARACTERISTIC
/begin CHARACTERISTIC CAL_evap_purge_min_inj_pulse_exit "u8_time_8us" VALUE 0x40008ECA RL_VALUE_UBYTE 0 CM_u8_time_8us 0 2040 /end CHARACTERISTIC
/begin CHARACTERISTIC CAL_evap_purge_duty_ramp_up_min "uint8_t" VALUE 0x40008ECB RL_VALUE_UBYTE 0 NO_COMPU_METHOD 0 255 /end CHARACTERISTIC
/begin CHARACTERISTIC CAL_evap_purge_duty_ramp_down_conditioning "uchar" VALUE 0x40008ECC RL_VALUE_UBYTE 0 NO_COMPU_METHOD 0 255 /end CHARACTERISTIC
/begin CHARACTERISTIC CAL_dfco_vacuum_target "uchar" VALUE 0x40008ECD RL_VALUE_UBYTE 0 NO_COMPU_METHOD 0 255 /end CHARACTERISTIC
/begin CHARACTERISTIC CAL_evap_purge_filter_alpha "Evap purge vacuum filter coefficient (alpha/256 per 100 ms update)." VALUE 0x40008ECE RL_VALUE_UBYTE 0 CM_u8_factor_1_256 0 99.609375 /end CHARACTERISTIC
/begin CHARACTERISTIC CAL_obd_ii_idle_air_output_limit "uchar" VALUE 0x40008ECF RL_VALUE_UBYTE 0 NO_COMPU_METHOD 0 255 /end CHARACTERISTIC
/begin CHARACTERISTIC CAL_obd_ii_idle_air_output_threshold "uchar" VALUE 0x40008ED0 RL_VALUE_UBYTE 0 NO_COMPU_METHOD 0 255 /end CHARACTERISTIC
/begin CHARACTERISTIC CAL_cooling_fan_high_on_coolant_with_ac "Calibration: cooling fan high on coolant with A/C. Tunable map/constant (not a live channel); log to confirm fans/pumps switch at the right temperatures. (deg C; raw*5/8-40)" VALUE 0x40008ED1 RL_VALUE_UBYTE 0 CM_u8_temp_5_8_40c -40 119.375 /end CHARACTERISTIC
/begin CHARACTERISTIC CAL_cooling_fan_high_off_coolant_with_ac "Calibration: cooling fan high off coolant with A/C. Tunable map/constant (not a live channel); log to confirm fans/pumps switch at the right temperatures. (deg C; raw*5/8-40)" VALUE 0x40008ED2 RL_VALUE_UBYTE 0 CM_u8_temp_5_8_40c -40 119.375 /end CHARACTERISTIC
/begin CHARACTERISTIC CAL_ign_comp_ac_compressor_active "Calibration: ignition compensation A/C compressor active. Tunable map/constant (not a live channel); log spark advance to confirm the timing strategy and headroom to knock. (deg; raw/4)" VALUE 0x40008ED3 RL_VALUE_SBYTE 0 CM_u8_angle_1_4deg -32 31.75 /end CHARACTERISTIC
/begin CHARACTERISTIC CAL_engine_speed_3_threshold "uchar" VALUE 0x40008ED4 RL_VALUE_UBYTE 0 NO_COMPU_METHOD 0 255 /end CHARACTERISTIC
/begin CHARACTERISTIC CAL_injtip_in_adj_gears_6 "Calibration: injtip in adj gears 6. Tunable map/constant (not a live channel); log to debug transient (tip-in/out) fueling stumbles and surge. (0-1; raw/128)" VALUE 0x40008ED5 RL_VALUE_UBYTE 0 CM_u8_factor_1_128 0 199.21875 /end CHARACTERISTIC
/begin CHARACTERISTIC CAL_engine_speed_avg_samples "Calibration: engine speed avg samples. Tunable map/constant (not a live channel); log to follow core engine state." VALUE 0x40008ED6 RL_VALUE_UBYTE 0 NO_COMPU_METHOD 0 255 /end CHARACTERISTIC
/begin CHARACTERISTIC CAL_ac_inhibit_evap_temp "Calibration: A/C inhibit EVAP temperature. Tunable map/constant (not a live channel); log to see A/C clutch engagement and its load/idle impact." VAL_BLK 0x40008ED7 RL_VALUE_UBYTE 0 CM_u8_temp_1_10C 0 25.5 NUMBER 2 /end CHARACTERISTIC
/begin CHARACTERISTIC CAL_ac_evap_timer_ticks_5ms "uint8_t" VALUE 0x40008ED9 RL_VALUE_UBYTE 0 NO_COMPU_METHOD 0 255 /end CHARACTERISTIC
/begin CHARACTERISTIC CAL_ac_evap_timer_ticks_5ms2 "uint8_t" VALUE 0x40008EDA RL_VALUE_UBYTE 0 NO_COMPU_METHOD 0 255 /end CHARACTERISTIC
/begin CHARACTERISTIC CAL_ac_evap_pid_derivative_filter_alpha "u8_factor_1/256" VALUE 0x40008EDB RL_VALUE_UBYTE 0 CM_u8_factor_1_256 0 99.609375 /end CHARACTERISTIC
/begin CHARACTERISTIC CAL_idle_bypass_airflow_factor "u8_factor_1/255" VALUE 0x40008EDC RL_VALUE_UBYTE 0 CM_u8_factor_1_255 0 100 /end CHARACTERISTIC
/begin CHARACTERISTIC CAL_inj_comp_startup_default "uint8_t" VALUE 0x40008EDD RL_VALUE_UBYTE 0 NO_COMPU_METHOD 0 255 /end CHARACTERISTIC
/begin CHARACTERISTIC CAL_inj_comp_power_enrich_from_ign_retard "uint8_t" VALUE 0x40008EDE RL_VALUE_UBYTE 0 NO_COMPU_METHOD 0 255 /end CHARACTERISTIC
/begin CHARACTERISTIC CAL_inj_comp_enrichment_per_degree_ign_retard "Calibration: injector compensation enrichment per degree ignition retard. Tunable map/constant (not a live channel); log to verify injector pulse width and fuel delivery vs target. (AFR; raw/100)" VALUE 0x40008EDF RL_VALUE_UBYTE 0 CM_u8_afr_1_100 0 2.55 /end CHARACTERISTIC
/begin CHARACTERISTIC CAL_inj_fuel_learn_step_timeout "u8_time_5ms" VALUE 0x40008EE0 RL_VALUE_UBYTE 0 CM_u8_time_5ms 0 1275 /end CHARACTERISTIC
/begin CHARACTERISTIC CAL_inj_fuel_learn_zone_1_offset_step "This is the step size of the idle/low-load injector offset learn." VALUE 0x40008EE1 RL_VALUE_UBYTE 0 CM_u8_time_us 0 255 /end CHARACTERISTIC
/begin CHARACTERISTIC CAL_sensor_pps_unknown1 "uint8_t" VALUE 0x40008EE2 RL_VALUE_UBYTE 0 NO_COMPU_METHOD 0 255 /end CHARACTERISTIC
/begin CHARACTERISTIC CAL_sensor_accel_pedal_d_gain "uchar" VALUE 0x40008EE3 RL_VALUE_UBYTE 0 NO_COMPU_METHOD 0 255 /end CHARACTERISTIC
/begin CHARACTERISTIC CAL_sensor_accel_pedal_e_gain "uchar" VALUE 0x40008EE4 RL_VALUE_UBYTE 0 NO_COMPU_METHOD 0 255 /end CHARACTERISTIC
/begin CHARACTERISTIC CAL_tps_accel_pedal_zero_calibrate_timer "uint8_t" VALUE 0x40008EE5 RL_VALUE_UBYTE 0 NO_COMPU_METHOD 0 255 /end CHARACTERISTIC
/begin CHARACTERISTIC CAL_cruise_override_coast_cancel_time "COAST held during pedal override for val*100 ms cancels cruise (reason 0x2000); stock 10 = 1 s" VALUE 0x40008EE6 RL_VALUE_UBYTE 0 NO_COMPU_METHOD 0 255 /end CHARACTERISTIC
/begin CHARACTERISTIC CAL_sensor_map_avg_window_size "u8_count" VALUE 0x40008EE7 RL_VALUE_UBYTE 0 NO_COMPU_METHOD 0 255 /end CHARACTERISTIC
/begin CHARACTERISTIC CAL_ac_evap_freeze_inhibit_delay "uint8_t" VALUE 0x40008EE8 RL_VALUE_UBYTE 0 NO_COMPU_METHOD 0 255 /end CHARACTERISTIC
/begin CHARACTERISTIC CAL_ac_evap_temp_trend_period2 "uchar" VALUE 0x40008EE9 RL_VALUE_UBYTE 0 NO_COMPU_METHOD 0 255 /end CHARACTERISTIC
/begin CHARACTERISTIC CAL_knock_agc_threshold "Calibration: knock AGC threshold. Tunable map/constant (not a live channel); log to catch knock events and see how much timing is being pulled. (RPM; raw*125/4+500)" VAL_BLK 0x40008EEA RL_VALUE_UBYTE 0 CM_u8_rspeed_125_4_500rpm 500 8468.75 NUMBER 3 /end CHARACTERISTIC
/begin CHARACTERISTIC CAL_knock_agc_hysteresis_band "Calibration: knock AGC hysteresis band. Tunable map/constant (not a live channel); log to catch knock events and see how much timing is being pulled. (RPM; raw*125/4+500)" VALUE 0x40008EED RL_VALUE_UBYTE 0 CM_u8_rspeed_125_4_500rpm 500 8468.75 /end CHARACTERISTIC
/begin CHARACTERISTIC CAL_ac_load_ramp_steps "u8_count" VALUE 0x40008EEE RL_VALUE_UBYTE 0 NO_COMPU_METHOD 0 255 /end CHARACTERISTIC
/begin CHARACTERISTIC CAL_ac_evap_target_temp "Calibration: A/C EVAP target temperature. Tunable map/constant (not a live channel); log to see A/C clutch engagement and its load/idle impact. (deg C; raw/10)" VALUE 0x40008EEF RL_VALUE_UBYTE 0 CM_u8_temp_1_10C 0 25.5 /end CHARACTERISTIC
/begin CHARACTERISTIC CAL_ac_evap_pid_kd "uint8_t" VALUE 0x40008EF0 RL_VALUE_UBYTE 0 NO_COMPU_METHOD 0 255 /end CHARACTERISTIC
/begin CHARACTERISTIC CAL_ac_evap_pid_ki_warm "uint8_t" VALUE 0x40008EF1 RL_VALUE_UBYTE 0 NO_COMPU_METHOD 0 255 /end CHARACTERISTIC
/begin CHARACTERISTIC CAL_ac_evap_pid_integrator_limit "uint8_t" VALUE 0x40008EF2 RL_VALUE_UBYTE 0 NO_COMPU_METHOD 0 255 /end CHARACTERISTIC
/begin CHARACTERISTIC CAL_ac_output_pwm_freq "uint8_t" VALUE 0x40008EF3 RL_VALUE_UBYTE 0 NO_COMPU_METHOD 0 255 /end CHARACTERISTIC
/begin CHARACTERISTIC CAL_ac_pwm_dc_divisor "Calibration: A/C pwm dc divisor. Tunable map/constant (not a live channel); log to see A/C clutch engagement and its load/idle impact." VALUE 0x40008EF4 RL_VALUE_UWORD 0 NO_COMPU_METHOD 0 65535 /end CHARACTERISTIC
/begin CHARACTERISTIC CAL_unknown4 "undefined" VALUE 0x40008EF6 RL_VALUE_ULONG 0 NO_COMPU_METHOD 0 4294967295 /end CHARACTERISTIC
/begin CHARACTERISTIC CAL_ac_compressor_soft_engage_time "Calibration: A/C compressor soft engage time. Tunable map/constant (not a live channel); log to see A/C clutch engagement and its load/idle impact." VALUE 0x40008EF7 RL_VALUE_UBYTE 0 NO_COMPU_METHOD 0 255 /end CHARACTERISTIC
/begin CHARACTERISTIC CAL_cooling_fan_air_temp_threshold "Air temperature threshold for fan activation" VALUE 0x40008EF8 RL_VALUE_UBYTE 0 CM_u8_temp_5_8_40c -40 119.375 /end CHARACTERISTIC
/begin CHARACTERISTIC CAL_ac_unknown3 "uint8_t" VALUE 0x40008EF9 RL_VALUE_UBYTE 0 NO_COMPU_METHOD 0 255 /end CHARACTERISTIC
/begin CHARACTERISTIC CAL_ign_zero_rpm_threshold "uint8_t" VALUE 0x40008EFA RL_VALUE_UBYTE 0 NO_COMPU_METHOD 0 255 /end CHARACTERISTIC
/begin CHARACTERISTIC CAL_ign_comp_idle_transient_max_advance "Calibration: ignition compensation idle transient max advance. Tunable map/constant (not a live channel); log spark advance to confirm the timing strategy and headroom to knock. (deg; raw/4)" VALUE 0x40008EFB RL_VALUE_UBYTE 0 CM_u8_angle_1_4deg 0 63.75 /end CHARACTERISTIC
/begin CHARACTERISTIC CAL_idle_exit_rpm_offset "u8_rspeed_rpm" VALUE 0x40008EFC RL_VALUE_UBYTE 0 CM_u8_rspeed_rpm 0 255 /end CHARACTERISTIC
/begin CHARACTERISTIC CAL_idle_dashpot_decel_threshold "u8_rspeed_accel_1/168" VALUE 0x40008EFD RL_VALUE_UBYTE 0 CM_u8_rspeed_accel_1_168 0 255 /end CHARACTERISTIC
/begin CHARACTERISTIC CAL_obd_o2_tps_transient_threshold "u8_factor_1/1023" VALUE 0x40008EFE RL_VALUE_UBYTE 0 CM_u16_factor_1_1023 0 24.9266862170088 /end CHARACTERISTIC
/begin CHARACTERISTIC CAL_idle_high_rpm_transient_air_comp "u8_flow_100mg/s" VALUE 0x40008EFF RL_VALUE_UBYTE 0 CM_u8_flow_100mg_s 0 25500 /end CHARACTERISTIC
/begin CHARACTERISTIC CAL_obd_o2_tps_transient_settle_ticks "ushort" VALUE 0x40008F00 RL_VALUE_UWORD 0 NO_COMPU_METHOD 0 65535 /end CHARACTERISTIC
/begin CHARACTERISTIC CAL_idle_air_hi_rpm_adder_speed_min "u8_speed_kph" VALUE 0x40008F02 RL_VALUE_UBYTE 0 CM_u8_speed_kph 0 255 /end CHARACTERISTIC
/begin CHARACTERISTIC CAL_idle_comp_decay_period_ac "u8_time_ms" VALUE 0x40008F03 RL_VALUE_UBYTE 0 CM_u8_time_ms 0 255 /end CHARACTERISTIC
/begin CHARACTERISTIC CAL_knock_octane_scaler_shortterm_multiplier "uint8_t" VALUE 0x40008F04 RL_VALUE_UBYTE 0 NO_COMPU_METHOD 0 255 /end CHARACTERISTIC
/begin CHARACTERISTIC CAL_knock_octane_scaler_shortterm_decrement "Calibration: knock octane scaler shortterm decrement. Tunable map/constant (not a live channel); log to catch knock events and see how much timing is being pulled." VALUE 0x40008F05 RL_VALUE_UBYTE 0 NO_COMPU_METHOD 0 255 /end CHARACTERISTIC
/begin CHARACTERISTIC CAL_ac_compressor_power_offset "uint8_t" VALUE 0x40008F06 RL_VALUE_UBYTE 0 NO_COMPU_METHOD 0 255 /end CHARACTERISTIC
/begin CHARACTERISTIC CAL_cooling_recirc_pump_run_ambient_min "Calibration: cooling recirc pump run ambient min. Tunable map/constant (not a live channel); log to confirm fans/pumps switch at the right temperatures. (deg C; raw*5/8-40)" VALUE 0x40008F07 RL_VALUE_UBYTE 0 CM_u8_temp_5_8_40c -40 119.375 /end CHARACTERISTIC
/begin CHARACTERISTIC CAL_ign_dfco_recovery_hold_time "For up to 3 seconds after a fuel cut ends, the ignition target keeps slewing on its normal path instead of handing authority to the idle spark controller — even once RPM has fallen far enough that idle mode would otherwise take over." VALUE 0x40008F08 RL_VALUE_UWORD 0 CM_u8_time_5ms 0 327675 /end CHARACTERISTIC
/begin CHARACTERISTIC CAL_etb_pid_kd "uint16_t" VALUE 0x40008F0A RL_VALUE_UWORD 0 NO_COMPU_METHOD 0 65535 /end CHARACTERISTIC
/begin CHARACTERISTIC CAL_ac_load_slew_up_period_ "u8_count" VALUE 0x40008F0C RL_VALUE_UBYTE 0 NO_COMPU_METHOD 0 255 /end CHARACTERISTIC
/begin CHARACTERISTIC CAL_ac_load_slew_down_period "u8_count" VALUE 0x40008F0D RL_VALUE_UBYTE 0 NO_COMPU_METHOD 0 255 /end CHARACTERISTIC
/begin CHARACTERISTIC CAL_etb_tps1_max_count "ushort" VALUE 0x40008F0E RL_VALUE_UWORD 0 NO_COMPU_METHOD 0 65535 /end CHARACTERISTIC
/begin CHARACTERISTIC CAL_ac_load_slew_up_step "uchar" VALUE 0x40008F10 RL_VALUE_UBYTE 0 NO_COMPU_METHOD 0 255 /end CHARACTERISTIC
/begin CHARACTERISTIC CAL_ac_load_slew_down_step "uchar" VALUE 0x40008F11 RL_VALUE_UBYTE 0 NO_COMPU_METHOD 0 255 /end CHARACTERISTIC
/begin CHARACTERISTIC CAL_etb_tps2_max_count "ushort" VALUE 0x40008F12 RL_VALUE_UWORD 0 NO_COMPU_METHOD 0 65535 /end CHARACTERISTIC
/begin CHARACTERISTIC CAL_etb_pwm_period "ushort" VALUE 0x40008F14 RL_VALUE_UWORD 0 NO_COMPU_METHOD 0 65535 /end CHARACTERISTIC
/begin CHARACTERISTIC CAL_torque_limit_low_speed_min_torque "u8_torque_nm" VALUE 0x40008F16 RL_VALUE_UBYTE 0 CM_u8_torque_nm 0 255 /end CHARACTERISTIC
/begin CHARACTERISTIC CAL_ac_evap_pid_ki_cold "uint8_t" VALUE 0x40008F17 RL_VALUE_UBYTE 0 NO_COMPU_METHOD 0 255 /end CHARACTERISTIC
/begin CHARACTERISTIC CAL_ac_evap_pid_update_period_cold "u8_time_5ms" VALUE 0x40008F18 RL_VALUE_UBYTE 0 CM_u8_time_5ms 0 1275 /end CHARACTERISTIC
/begin CHARACTERISTIC CAL_temp_engine_air_threshold "uchar" VALUE 0x40008F19 RL_VALUE_UBYTE 0 NO_COMPU_METHOD 0 255 /end CHARACTERISTIC
/begin CHARACTERISTIC CAL_etb_pid_kp "u16_factor_1/100" VALUE 0x40008F1A RL_VALUE_UWORD 0 CM_u8_factor_1_100 0 65535 /end CHARACTERISTIC
/begin CHARACTERISTIC CAL_torque_limit_low_speed_rpm_threshold "u16_rspeed_rpm" VALUE 0x40008F1C RL_VALUE_UWORD 0 CM_u8_rspeed_rpm 0 65535 /end CHARACTERISTIC
/begin CHARACTERISTIC CAL_etb_pid_ki "u16_factor_1/10000" VALUE 0x40008F1E RL_VALUE_UWORD 0 CM_u16_factor_1_10000 0 655.35 /end CHARACTERISTIC
/begin CHARACTERISTIC CAL_injtip_overrun_hysteresis_timer "Calibration: injtip overrun hysteresis timer. Tunable map/constant (not a live channel); log to debug transient (tip-in/out) fueling stumbles and surge. (ms; raw*5)" VALUE 0x40008F20 RL_VALUE_UWORD 0 CM_u8_time_5ms 0 327675 /end CHARACTERISTIC
/begin CHARACTERISTIC CAL_throttle_model_torque_gain "ushort" VALUE 0x40008F22 RL_VALUE_UWORD 0 NO_COMPU_METHOD 0 65535 /end CHARACTERISTIC
/begin CHARACTERISTIC CAL_tps1_normalize_full_frac "ushort" VALUE 0x40008F24 RL_VALUE_UWORD 0 NO_COMPU_METHOD 0 65535 /end CHARACTERISTIC
/begin CHARACTERISTIC CAL_etb_tps2_range_lo_frac "ushort" VALUE 0x40008F26 RL_VALUE_UWORD 0 NO_COMPU_METHOD 0 65535 /end CHARACTERISTIC
/begin CHARACTERISTIC CAL_tpssmooth_step_timer "uint16_t" VALUE 0x40008F28 RL_VALUE_UWORD 0 NO_COMPU_METHOD 0 65535 /end CHARACTERISTIC
/begin CHARACTERISTIC CAL_etb_pid_i_clamp "u16_factor_1/10000" VALUE 0x40008F2A RL_VALUE_UWORD 0 CM_u16_factor_1_10000 0 655.35 /end CHARACTERISTIC
/begin CHARACTERISTIC CAL_tps_decrement_base "Calibration: throttle position decrement base. Tunable map/constant (not a live channel); log to see throttle/pedal demand and throttle response. (0-1; raw/1023)" VALUE 0x40008F2C RL_VALUE_UWORD 0 CM_u16_factor_1_1023 0 6406.15835777126 /end CHARACTERISTIC
/begin CHARACTERISTIC CAL_dfco_rpm_offset_above_idle "u8_rspeed_rpm" VALUE 0x40008F2E RL_VALUE_UBYTE 0 CM_u8_rspeed_rpm 0 255 /end CHARACTERISTIC
/begin CHARACTERISTIC CAL_cooling_fan_coolant_fall_window "u8_time_250ms" VALUE 0x40008F2F RL_VALUE_UBYTE 0 CM_u8_time_250ms 0 63750 /end CHARACTERISTIC
/begin CHARACTERISTIC CAL_cooling_recirc_pump_run_time_sec "Calibration: cooling recirc pump run time sec. Tunable map/constant (not a live channel); log to confirm fans/pumps switch at the right temperatures." VALUE 0x40008F30 RL_VALUE_UBYTE 0 NO_COMPU_METHOD 0 255 /end CHARACTERISTIC
/begin CHARACTERISTIC CAL_closedloop_bank_sync_max_hold "u8_time_100ms" VALUE 0x40008F31 RL_VALUE_UBYTE 0 CM_u8_time_100ms 0 25500 /end CHARACTERISTIC
/begin CHARACTERISTIC CAL_cooling_fan_coolant_fall_threshold "Calibration: cooling fan thermostat open temperature drop. Tunable map/constant (not a live channel); log to confirm fans/pumps switch at the right temperatures. (deg C; raw*5/8-40)" VALUE 0x40008F32 RL_VALUE_UBYTE 0 CM_u8_temp_5_8_40c -40 119.375 /end CHARACTERISTIC
/begin CHARACTERISTIC CAL_cooling_fan_coolant_fall_check_period "u8_time_100ms" VALUE 0x40008F33 RL_VALUE_UBYTE 0 CM_u8_time_100ms 0 25500 /end CHARACTERISTIC
/begin CHARACTERISTIC CAL_idle_ign_control_entry_offset "u8_rspeed_8rpm" VALUE 0x40008F34 RL_VALUE_UBYTE 0 CM_u8_rspeed_8rpm 0 2040 /end CHARACTERISTIC
/begin CHARACTERISTIC CAL_idle_ign_control_exit_offset "u8_rspeed_8rpm" VALUE 0x40008F35 RL_VALUE_UBYTE 0 CM_u8_rspeed_8rpm 0 2040 /end CHARACTERISTIC
/begin CHARACTERISTIC CAL_cooling_fan_start_inhibit_time "u8_time_250ms" VALUE 0x40008F36 RL_VALUE_UBYTE 0 CM_u8_time_250ms 0 63750 /end CHARACTERISTIC
/begin CHARACTERISTIC CAL_idle_carspeed_comp_decay_step_ac "u8_rspeed_rpm" VALUE 0x40008F37 RL_VALUE_UBYTE 0 CM_u8_rspeed_rpm 0 255 /end CHARACTERISTIC
/begin CHARACTERISTIC CAL_sensor_clutch_engaged_threshold "Calibration: sensor clutch engaged threshold. Tunable map/constant (not a live channel); log the raw sensor signal to check sensor health and range. (V; raw*5/1023)" VALUE 0x40008F38 RL_VALUE_UWORD 0 CM_u16_voltage_5_1023v 0 320.307917888563 /end CHARACTERISTIC
/begin CHARACTERISTIC CAL_sensor_clutch_disengaged_threshold "Calibration: sensor clutch disengaged threshold. Tunable map/constant (not a live channel); log the raw sensor signal to check sensor health and range. (V; raw*5/1023)" VALUE 0x40008F3A RL_VALUE_UWORD 0 CM_u16_voltage_5_1023v 0 320.307917888563 /end CHARACTERISTIC
/begin CHARACTERISTIC CAL_cooling_recirc_pump_stopped_dwell "u8_time_100ms" VALUE 0x40008F3C RL_VALUE_UBYTE 0 CM_u8_time_100ms 0 25500 /end CHARACTERISTIC
/begin CHARACTERISTIC CAL_tpssmooth_decrement_comp_gears_manual "Calibration: tpssmooth decrement compensation gears manual. Tunable map/constant (not a live channel); log to see throttle-signal smoothing/filtering behavior. (0-1; raw/255)" VAL_BLK 0x40008F3D RL_VALUE_UBYTE 0 CM_u8_factor_1_255 0 100 NUMBER 7 /end CHARACTERISTIC
/begin CHARACTERISTIC CAL_ecu_starter_max_engage_after_run "u16_time_5ms" VALUE 0x40008F44 RL_VALUE_UWORD 0 CM_u8_time_5ms 0 327675 /end CHARACTERISTIC
/begin CHARACTERISTIC CAL_evap_purge_pwm_freq "Calibration: EVAP purge pwm freq. Tunable map/constant (not a live channel); adjust to change this behavior." VALUE 0x40008F46 RL_VALUE_UWORD 0 NO_COMPU_METHOD 0 65535 /end CHARACTERISTIC
/begin CHARACTERISTIC CAL_ac_evap_pid_ki_cold_boost_delay "uint8_t" VALUE 0x40008F48 RL_VALUE_UBYTE 0 NO_COMPU_METHOD 0 255 /end CHARACTERISTIC
/begin CHARACTERISTIC CAL_ac_evap_pid_ki_cold_boost_factor "u8_factor_1/10" VALUE 0x40008F49 RL_VALUE_UBYTE 0 CM_u8_factor_1_10 0 2550 /end CHARACTERISTIC
/begin CHARACTERISTIC CAL_load_learning_engine_accel_max "uint16_t" VALUE 0x40008F4A RL_VALUE_UWORD 0 NO_COMPU_METHOD 0 65535 /end CHARACTERISTIC
/begin CHARACTERISTIC CAL_revlimit_hard_hysteresis "Calibration: revlimit hard hysteresis. Tunable map/constant (not a live channel); log to confirm where and how the rev limiter intervenes. (RPM)" VALUE 0x40008F4C RL_VALUE_UWORD 0 CM_u8_rspeed_rpm 0 65535 /end CHARACTERISTIC
/begin CHARACTERISTIC CAL_misc_engine_detection_on "Calibration: misc engine detection on. Tunable map/constant (not a live channel); log to follow core engine state. (us; raw*4)" VALUE 0x40008F4E RL_VALUE_UWORD 0 CM_u16_time_4us 0 262140 /end CHARACTERISTIC
/begin CHARACTERISTIC CAL_misc_engine_detection_off "Calibration: misc engine detection off. Tunable map/constant (not a live channel); log to follow core engine state. (us; raw*4)" VALUE 0x40008F50 RL_VALUE_UWORD 0 CM_u16_time_4us 0 262140 /end CHARACTERISTIC
/begin CHARACTERISTIC CAL_cooling_fan_high_off_min_time "Calibration: cooling fan high off min time. Tunable map/constant (not a live channel); log to confirm fans/pumps switch at the right temperatures. (ms; raw*5)" VALUE 0x40008F52 RL_VALUE_UWORD 0 CM_u8_time_5ms 0 327675 /end CHARACTERISTIC
/begin CHARACTERISTIC CAL_closedloop_o2_warmup_time "Calibration: closedloop O2 warmup time. Tunable map/constant (not a live channel); log to watch O2 feedback trim the mixture and confirm the loop is active. (ms; raw*5)" VALUE 0x40008F54 RL_VALUE_UWORD 0 CM_u8_time_5ms 0 327675 /end CHARACTERISTIC
/begin CHARACTERISTIC CAL_ac_inhibit_rpm_cutoff_on_delay "u8_time_50ms" VALUE 0x40008F56 RL_VALUE_UBYTE 0 CM_u8_time_50ms 0 12750 /end CHARACTERISTIC
/begin CHARACTERISTIC CAL_ac_inhibit_rpm_cutoff_min_hold_40008F57 "u8_time_50ms" VALUE 0x40008F57 RL_VALUE_UBYTE 0 CM_u8_time_50ms 0 12750 /end CHARACTERISTIC
/begin CHARACTERISTIC CAL_ecu_gear_long_ratio "Calibration: ECU gear long ratio. Tunable map/constant (not a live channel); mostly housekeeping/diagnostic state." VAL_BLK 0x40008F58 RL_VALUE_UWORD 0 NO_COMPU_METHOD 0 65535 NUMBER 10 /end CHARACTERISTIC
/begin CHARACTERISTIC CAL_closedloop_afr "Calibration: closedloop AFR. Tunable map/constant (not a live channel); log to watch O2 feedback trim the mixture and confirm the loop is active. (AFR; raw/100)" VALUE 0x40008F6C RL_VALUE_UWORD 0 CM_u8_afr_1_100 0 655.35 /end CHARACTERISTIC
/begin CHARACTERISTIC CAL_closedloop_o2_sensor_voltage_switching_lean "u16_voltage_5/1023v" VALUE 0x40008F6E RL_VALUE_UWORD 0 CM_u16_voltage_5_1023v 0 320.307917888563 /end CHARACTERISTIC
/begin CHARACTERISTIC CAL_closedloop_o2_sensor_voltage_switch_rich "u16_voltage_5/1023v" VALUE 0x40008F70 RL_VALUE_UWORD 0 CM_u16_voltage_5_1023v 0 320.307917888563 /end CHARACTERISTIC
/begin CHARACTERISTIC CAL_inj_stft_limit "Calibration: injector stft limit. Tunable map/constant (not a live channel); log to verify injector pulse width and fuel delivery vs target. (raw/20)" VALUE 0x40008F72 RL_VALUE_SWORD 0 CM_i16_percent_1_20 -1638.4 1638.35 /end CHARACTERISTIC
/begin CHARACTERISTIC CAL_cooling_fan_1_afterrun_timer "Calibration: cooling fan 1 afterrun timer. Tunable map/constant (not a live channel); log to confirm fans/pumps switch at the right temperatures. (s)" VALUE 0x40008F74 RL_VALUE_UWORD 0 CM_u8_time_s 0 65535 /end CHARACTERISTIC
/begin CHARACTERISTIC CAL_ecu_ign_off_relay_hold_time "Calibration: ECU ignition off relay hold time. Tunable map/constant (not a live channel); log spark advance to confirm the timing strategy and headroom to knock." VALUE 0x40008F76 RL_VALUE_UWORD 0 NO_COMPU_METHOD 0 65535 /end CHARACTERISTIC
/begin CHARACTERISTIC CAL_ign_low_gear_number "uint16_t" VALUE 0x40008F7A RL_VALUE_UWORD 0 NO_COMPU_METHOD 0 65535 /end CHARACTERISTIC
/begin CHARACTERISTIC CAL_cooling_fan_engine_bay_aux_afterrun_timer "Calibration: cooling fan engine bay aux afterrun timer. Tunable map/constant (not a live channel); log to confirm fans/pumps switch at the right temperatures. (s)" VALUE 0x40008F7C RL_VALUE_UWORD 0 CM_u8_time_s 0 65535 /end CHARACTERISTIC
/begin CHARACTERISTIC CAL_ac_inhibit_rpm_cutoff "Calibration: A/C inhibit RPM cutoff. Tunable map/constant (not a live channel); log to see A/C clutch engagement and its load/idle impact. (RPM; raw*125/4+500)" VAL_BLK 0x40008F7E RL_VALUE_UBYTE 0 CM_u8_rspeed_125_4_500rpm 500 8468.75 NUMBER 2 /end CHARACTERISTIC
/begin CHARACTERISTIC CAL_ac_startup_lockout_time "Calibration: A/C startup lockout time. Tunable map/constant (not a live channel); log to see A/C clutch engagement and its load/idle impact. (ms; raw*5)" VALUE 0x40008F80 RL_VALUE_UWORD 0 CM_u8_time_5ms 0 327675 /end CHARACTERISTIC
/begin CHARACTERISTIC CAL_load_learning_stabilization_delay "Calibration: load learning stabilization delay. Tunable map/constant (not a live channel); log engine load -- the main axis for fueling and ignition." VALUE 0x40008F82 RL_VALUE_UWORD 0 CM_u8_time_5ms 0 327675 /end CHARACTERISTIC
/begin CHARACTERISTIC CAL_load_alphaN_learn_ratio_deadband "Calibration: throttle position idle to current ratio threshold. Tunable map/constant (not a live channel); log to diagnose idle quality, hunting, and stalls." VAL_BLK 0x40008F84 RL_VALUE_UWORD 0 CM_u8_factor_1_100 0 65535 NUMBER 2 /end CHARACTERISTIC
/begin CHARACTERISTIC CAL_load_learning_min_maf_accumulated "u16_mass_mg" VALUE 0x40008F88 RL_VALUE_UWORD 0 CM_u16_mass_mg 0 65535 /end CHARACTERISTIC
/begin CHARACTERISTIC CAL_load_learning_holdoff_delay "Calibration: load learning holdoff delay. Tunable map/constant (not a live channel); log engine load -- the main axis for fueling and ignition." VALUE 0x40008F8A RL_VALUE_UWORD 0 CM_u8_time_5ms 0 327675 /end CHARACTERISTIC
/begin CHARACTERISTIC CAL_ecu_accel_pedal_released_threshold "Calibration: cruise accelerator pedal override threshold exit. Tunable map/constant (not a live channel); log to debug cruise engagement and speed holding. (0-1; raw/1023)" VALUE 0x40008F8C RL_VALUE_UBYTE 0 CM_u16_factor_1_1023 0 24.9266862170088 /end CHARACTERISTIC
/begin CHARACTERISTIC CAL_ecu_accel_pedal_pressed_threshold "Calibration: cruise accelerator pedal override threshold enter. Tunable map/constant (not a live channel); log to debug cruise engagement and speed holding. (0-1; raw/1023)" VALUE 0x40008F8D RL_VALUE_UBYTE 0 CM_u16_factor_1_1023 0 24.9266862170088 /end CHARACTERISTIC
/begin CHARACTERISTIC CAL_ecu_2gr_cylinder_air_mass_mg "Calibration: ECU 2gr cylinder air mass mg. Tunable map/constant (not a live channel); mostly housekeeping/diagnostic state. (mg)" VALUE 0x40008F8E RL_VALUE_UWORD 0 CM_u16_mass_mg 0 65535 /end CHARACTERISTIC
/begin CHARACTERISTIC CAL_ecu_2gr_cylinder_air_mass_mg_obd_ii "Calibration: ECU 2gr cylinder air mass mg OBD. Tunable map/constant (not a live channel); mostly housekeeping/diagnostic state. (mg)" VALUE 0x40008F90 RL_VALUE_UWORD 0 CM_u16_mass_mg 0 65535 /end CHARACTERISTIC
/begin CHARACTERISTIC CAL_idle_unknown3 "uint8_t" VALUE 0x40008F92 RL_VALUE_UBYTE 0 NO_COMPU_METHOD 0 255 /end CHARACTERISTIC
/begin CHARACTERISTIC CAL_idle_air_control_unknown "uint8_t" VALUE 0x40008F93 RL_VALUE_UBYTE 0 NO_COMPU_METHOD 0 255 /end CHARACTERISTIC
/begin CHARACTERISTIC CAL_injtip_tipout_decay_rate_divider "uint8_t" VALUE 0x40008F94 RL_VALUE_UBYTE 0 NO_COMPU_METHOD 0 255 /end CHARACTERISTIC
/begin CHARACTERISTIC CAL_vehicle_moving_speed_min "Calibration: vehicle moving speed min. Tunable map/constant (not a live channel); adjust to change this behavior. (km/h)" VALUE 0x40008F95 RL_VALUE_UBYTE 0 CM_u8_speed_kph 0 255 /end CHARACTERISTIC
/begin CHARACTERISTIC CAL_tpssmooth_decrement_cruise_scale "u8_factor_1/255" VALUE 0x40008F96 RL_VALUE_UBYTE 0 CM_u8_factor_1_255 0 100 /end CHARACTERISTIC
/begin CHARACTERISTIC CAL_idle_control_entry_offset "u8_rspeed_8rpm" VALUE 0x40008F97 RL_VALUE_UBYTE 0 CM_u8_rspeed_8rpm 0 2040 /end CHARACTERISTIC
/begin CHARACTERISTIC CAL_idle_unknown2 "u8_rspeed_8rpm" VALUE 0x40008F98 RL_VALUE_UBYTE 0 CM_u8_rspeed_8rpm 0 2040 /end CHARACTERISTIC
/begin CHARACTERISTIC CAL_closedloop_prop_gain_lean_slow_switch_scale "u8_factor_1/64" VALUE 0x40008F99 RL_VALUE_UBYTE 0 CM_u8_factor_1_64 0 398.4375 /end CHARACTERISTIC
/begin CHARACTERISTIC CAL_obd_ii_o2_response_load_stability_max "uint8_t" VALUE 0x40008F9A RL_VALUE_UBYTE 0 NO_COMPU_METHOD 0 255 /end CHARACTERISTIC
/begin CHARACTERISTIC CAL_obd_ii_o2_response_alphaN_blackout "u8_time_5ms" VALUE 0x40008F9B RL_VALUE_UBYTE 0 CM_u8_time_5ms 0 1275 /end CHARACTERISTIC
/begin CHARACTERISTIC CAL_sensor_maf_adc_avg_window_depth "Calibration: sensor MAF ADC avg window depth. Tunable map/constant (not a live channel); log the raw sensor signal to check sensor health and range." VALUE 0x40008F9C RL_VALUE_UBYTE 0 NO_COMPU_METHOD 0 255 /end CHARACTERISTIC
/begin CHARACTERISTIC CAL_cruise_cancel_dfco_inhibit_time "after cruise cancel: timer = val*2 (200 Hz) = 10 ms/count, stock 110 = 1.1 s; status 0x20000 blocks DFCO entry. Was CAL_closedloop_stft_ramp_interval_manual" VALUE 0x40008F9D RL_VALUE_UBYTE 0 NO_COMPU_METHOD 0 255 /end CHARACTERISTIC
/begin CHARACTERISTIC CAL_inj_transient_us_per_count "Calibration: injtip time base. Tunable map/constant (not a live channel); log to debug transient (tip-in/out) fueling stumbles and surge. (us)" VALUE 0x40008F9E RL_VALUE_UBYTE 0 CM_u8_time_us 0 255 /end CHARACTERISTIC
/begin CHARACTERISTIC CAL_tps_delta_rate_window_size "Calibration: throttle position delta rate window size. Tunable map/constant (not a live channel); log to see throttle/pedal demand and throttle response." VALUE 0x40008F9F RL_VALUE_UBYTE 0 NO_COMPU_METHOD 0 255 /end CHARACTERISTIC
/begin CHARACTERISTIC CAL_injtip_in_decay_count "u8_count" VALUE 0x40008FA0 RL_VALUE_UBYTE 0 NO_COMPU_METHOD 0 255 /end CHARACTERISTIC
/begin CHARACTERISTIC CAL_injtip_out_decay_count "u8_count" VALUE 0x40008FA1 RL_VALUE_UBYTE 0 NO_COMPU_METHOD 0 255 /end CHARACTERISTIC
/begin CHARACTERISTIC CAL_injtip_in_threshold "Calibration: injtip in threshold. Tunable map/constant (not a live channel); log to debug transient (tip-in/out) fueling stumbles and surge. (0-1; raw/1023)" VAL_BLK 0x40008FA2 RL_VALUE_UWORD 0 CM_u16_factor_1_1023 0 6406.15835777126 NUMBER 2 /end CHARACTERISTIC
/begin CHARACTERISTIC CAL_tps_delta_neg_clamp "uint16_t" VALUE 0x40008FA6 RL_VALUE_UWORD 0 NO_COMPU_METHOD 0 65535 /end CHARACTERISTIC
/begin CHARACTERISTIC CAL_tps_delta_neg_threshold "uint16_t" VALUE 0x40008FA8 RL_VALUE_UWORD 0 NO_COMPU_METHOD 0 65535 /end CHARACTERISTIC
/begin CHARACTERISTIC CAL_closedloop_integration_period "Calibration: closedloop integration period. Tunable map/constant (not a live channel); log to watch O2 feedback trim the mixture and confirm the loop is active. (ms; raw*5)" VALUE 0x40008FAA RL_VALUE_UBYTE 0 CM_u8_time_5ms 0 1275 /end CHARACTERISTIC
/begin CHARACTERISTIC CAL_closedloop_prop_gain_rich_slow_switch_scale "Calibration: closed loop prop gain rich slow switch scale. Tunable map/constant (not a live channel); adjust to change this behavior. (0-1; raw/64)" VALUE 0x40008FAB RL_VALUE_UBYTE 0 CM_u8_factor_1_64 0 398.4375 /end CHARACTERISTIC
/begin CHARACTERISTIC CAL_closedloop_enable_iat_min "Calibration: closed loop enable intake-air temp min. Tunable map/constant (not a live channel); adjust to change this behavior. (deg C; raw*5/8-40)" VALUE 0x40008FAC RL_VALUE_UBYTE 0 CM_u8_temp_5_8_40c -40 119.375 /end CHARACTERISTIC
/begin CHARACTERISTIC CAL_closedloop_fuel_level_min "Calibration: closed loop fuel level min. Tunable map/constant (not a live channel); log to follow fuel delivery and mixture control. (L)" VALUE 0x40008FAD RL_VALUE_UBYTE 0 CM_u8_volume_liter 0 255 /end CHARACTERISTIC
/begin CHARACTERISTIC CAL_cluster_shift_light_deadband_rpm "Calibration: cluster shift light deadband RPM. Tunable map/constant (not a live channel); log to check what the ECU sends the dash (gauges/warnings). (RPM)" VALUE 0x40008FAE RL_VALUE_UWORD 0 CM_u8_rspeed_rpm 0 65535 /end CHARACTERISTIC
/begin CHARACTERISTIC CAL_tps_warmup_max "u16_factor_1/1023" VALUE 0x40008FB0 RL_VALUE_UWORD 0 CM_u16_factor_1_1023 0 6406.15835777126 /end CHARACTERISTIC
/begin CHARACTERISTIC CAL_tps_commanded_wamup_min "Calibration: throttle position commanded wamup min. Tunable map/constant (not a live channel); log to see throttle/pedal demand and throttle response. (0-1; raw/1023)" VALUE 0x40008FB2 RL_VALUE_UWORD 0 CM_u16_factor_1_1023 0 6406.15835777126 /end CHARACTERISTIC
/begin CHARACTERISTIC CAL_idle_tps_max "Calibration: idle throttle position max. Tunable map/constant (not a live channel); log to diagnose idle quality, hunting, and stalls. (0-1; raw/1023)" VALUE 0x40008FB4 RL_VALUE_UWORD 0 CM_u16_factor_1_1023 0 6406.15835777126 /end CHARACTERISTIC
/begin CHARACTERISTIC CAL_dfco_exit_pedal_min "Calibration: DFCO exit pedal min. Tunable map/constant (not a live channel); log to see when fuel is cut and restored on deceleration. (0-1; raw/1023)" VALUE 0x40008FB6 RL_VALUE_UBYTE 0 CM_u16_factor_1_1023 0 24.9266862170088 /end CHARACTERISTIC
/begin CHARACTERISTIC CAL_dfco_entry_pedal_max "Calibration: DFCO entry pedal max. Tunable map/constant (not a live channel); log to see when fuel is cut and restored on deceleration. (0-1; raw/1023)" VALUE 0x40008FB7 RL_VALUE_UBYTE 0 CM_u16_factor_1_1023 0 24.9266862170088 /end CHARACTERISTIC
/begin CHARACTERISTIC CAL_fuel_reserve_size "Calibration: fuel reserve size. Tunable map/constant (not a live channel); log to follow fuel delivery and mixture control. (L)" VALUE 0x40008FB8 RL_VALUE_UBYTE 0 CM_u8_volume_liter 0 255 /end CHARACTERISTIC
/begin CHARACTERISTIC CAL_fuel_level_filter_coeff_fall "u8_factor_1/255" VALUE 0x40008FB9 RL_VALUE_UBYTE 0 CM_u8_factor_1_255 0 100 /end CHARACTERISTIC
/begin CHARACTERISTIC CAL_cruise_integrator_clamp "cruise_speed_error_integral limited to +/- val*250" VALUE 0x40008FBA RL_VALUE_UBYTE 0 NO_COMPU_METHOD 0 255 /end CHARACTERISTIC
/begin CHARACTERISTIC CAL_cruise_derivative_clamp "cruise_speed_error_rate limited to +/- val*25" VALUE 0x40008FBB RL_VALUE_UBYTE 0 NO_COMPU_METHOD 0 255 /end CHARACTERISTIC
/begin CHARACTERISTIC CAL_dfco_entry_temp_min "Calibration: DFCO entry temperature min. Tunable map/constant (not a live channel); log to see when fuel is cut and restored on deceleration. (deg C; raw*5/8-40)" VALUE 0x40008FBC RL_VALUE_UBYTE 0 CM_u8_temp_5_8_40c -40 119.375 /end CHARACTERISTIC
/begin CHARACTERISTIC CAL_dfco_exit_temp_max "Calibration: DFCO exit temperature max. Tunable map/constant (not a live channel); log to see when fuel is cut and restored on deceleration. (deg C; raw*5/8-40)" VALUE 0x40008FBD RL_VALUE_UBYTE 0 CM_u8_temp_5_8_40c -40 119.375 /end CHARACTERISTIC
/begin CHARACTERISTIC CAL_dfco_cyl_ramp_length "Calibration: DFCO cylinder ramp length. Tunable map/constant (not a live channel); log to see when fuel is cut and restored on deceleration." VALUE 0x40008FBE RL_VALUE_UBYTE 0 NO_COMPU_METHOD 0 255 /end CHARACTERISTIC
/begin CHARACTERISTIC CAL_idle_comp_decay_period "uint8_t" VALUE 0x40008FBF RL_VALUE_UBYTE 0 NO_COMPU_METHOD 0 255 /end CHARACTERISTIC
/begin CHARACTERISTIC CAL_dfco_recovery_enrich_decay "uint8_t" VALUE 0x40008FC0 RL_VALUE_UBYTE 0 NO_COMPU_METHOD 0 255 /end CHARACTERISTIC
/begin CHARACTERISTIC CAL_dfco_entry_min_runtime "Calibration: DFCO entry min runtime. Tunable map/constant (not a live channel); log to see when fuel is cut and restored on deceleration. (ms; raw*50)" VALUE 0x40008FC1 RL_VALUE_UBYTE 0 CM_u8_time_50ms 0 12750 /end CHARACTERISTIC
/begin CHARACTERISTIC CAL_load_alphaN_max_rpm "Calibration: load alphaN max RPM. Tunable map/constant (not a live channel); log engine load -- the main axis for fueling and ignition. (RPM)" VALUE 0x40008FC2 RL_VALUE_UWORD 0 CM_u8_rspeed_rpm 0 65535 /end CHARACTERISTIC
/begin CHARACTERISTIC CAL_load_alphaN_tps_rate_closing_threshold "Calibration: load alphaN throttle position rate closing threshold. Tunable map/constant (not a live channel); log to see throttle/pedal demand and throttle response. (0-1; raw/255)" VALUE 0x40008FC4 RL_VALUE_UWORD 0 CM_u8_factor_1_255 0 25700 /end CHARACTERISTIC
/begin CHARACTERISTIC CAL_evap_vapor_conc_max_for_fuel_learn "uint16_t" VALUE 0x40008FC6 RL_VALUE_UWORD 0 NO_COMPU_METHOD 0 65535 /end CHARACTERISTIC
/begin CHARACTERISTIC CAL_evap_purge_flow_vapor_min_leaktest "uint16_t" VALUE 0x40008FC8 RL_VALUE_UWORD 0 NO_COMPU_METHOD 0 65535 /end CHARACTERISTIC
/begin CHARACTERISTIC CAL_injtip_dfco_enable_temp "uint16_t" VALUE 0x40008FCA RL_VALUE_UWORD 0 NO_COMPU_METHOD 0 65535 /end CHARACTERISTIC
/begin CHARACTERISTIC CAL_closedloop_enable_baro_min "Calibration: closed loop enable barometric min. Tunable map/constant (not a live channel); adjust to change this behavior. (mbar)" VALUE 0x40008FCC RL_VALUE_UWORD 0 CM_i16_pressure_mbar 0 65535 /end CHARACTERISTIC
/begin CHARACTERISTIC CAL_injtip_dfco_min_runtime "uint8_t" VALUE 0x40008FCE RL_VALUE_UBYTE 0 NO_COMPU_METHOD 0 255 /end CHARACTERISTIC
/begin CHARACTERISTIC CAL_evap_commanded_purge_unknown "uint8_t" VALUE 0x40008FCF RL_VALUE_UBYTE 0 NO_COMPU_METHOD 0 255 /end CHARACTERISTIC
/begin CHARACTERISTIC CAL_closedloop_fuel_learn_baro_min "uint8_t" VALUE 0x40008FD0 RL_VALUE_UBYTE 0 NO_COMPU_METHOD 0 255 /end CHARACTERISTIC
/begin CHARACTERISTIC CAL_closedloop_fuel_learn_baro_min_40008FD1 "uint8_t" VALUE 0x40008FD1 RL_VALUE_UBYTE 0 NO_COMPU_METHOD 0 255 /end CHARACTERISTIC
/begin CHARACTERISTIC CAL_obd_ii_commanded_evap_purge_max "uint8_t" VALUE 0x40008FD2 RL_VALUE_UBYTE 0 NO_COMPU_METHOD 0 255 /end CHARACTERISTIC
/begin CHARACTERISTIC CAL_obd_ii_commanded_evap_purge_min "uint8_t" VALUE 0x40008FD3 RL_VALUE_UBYTE 0 NO_COMPU_METHOD 0 255 /end CHARACTERISTIC
/begin CHARACTERISTIC CAL_vvt_pwm_driver_divisor "Calibration: VVT pwm driver divisor. Tunable map/constant (not a live channel); log commanded vs actual cam timing to verify VVT response." VALUE 0x40008FD4 RL_VALUE_UWORD 0 NO_COMPU_METHOD 0 65535 /end CHARACTERISTIC
/begin CHARACTERISTIC CAL_acis_open_rpm "Calibration: acis open RPM. Tunable map/constant (not a live channel); adjust to change this behavior. (RPM)" VALUE 0x40008FD6 RL_VALUE_UWORD 0 CM_u8_rspeed_rpm 0 65535 /end CHARACTERISTIC
/begin CHARACTERISTIC CAL_acis_close_rpm "Calibration: acis close RPM. Tunable map/constant (not a live channel); adjust to change this behavior. (RPM)" VALUE 0x40008FD8 RL_VALUE_UWORD 0 CM_u8_rspeed_rpm 0 65535 /end CHARACTERISTIC
/begin CHARACTERISTIC CAL_acis_close_load "Calibration: acis close load. Tunable map/constant (not a live channel); log engine load -- the main axis for fueling and ignition. (mg/stroke; raw*4)" VALUE 0x40008FDA RL_VALUE_UBYTE 0 CM_u8_load_4mg_stroke 0 1020 /end CHARACTERISTIC
/begin CHARACTERISTIC CAL_acis_open_load "Calibration: acis open load. Tunable map/constant (not a live channel); log engine load -- the main axis for fueling and ignition. (mg/stroke; raw*4)" VALUE 0x40008FDB RL_VALUE_UBYTE 0 CM_u8_load_4mg_stroke 0 1020 /end CHARACTERISTIC
/begin CHARACTERISTIC CAL_idle_carspeed_comp_decay_step "u8_rspeed_rpm" VALUE 0x40008FDC RL_VALUE_UBYTE 0 CM_u8_rspeed_rpm 0 255 /end CHARACTERISTIC
/begin CHARACTERISTIC CAL_cruise_airflow_fast_slew_time "after set/accel/coast hold: cruise_airflow_fast_slew_timer = val*5 (200 Hz) = 25 ms/count, stock 20 = 0.5 s; airflow rises at 2x slew step, falls unlimited" VALUE 0x40008FDD RL_VALUE_UBYTE 0 NO_COMPU_METHOD 0 255 /end CHARACTERISTIC
/begin CHARACTERISTIC CAL_cruise_proportional_term_limit "cruise P-term clamp: +/- val*100 in 10 mg/s = +/- val g/s airflow (stock 65); was CAL_cruise_speed_error_limit" VALUE 0x40008FDE RL_VALUE_UBYTE 0 NO_COMPU_METHOD 0 255 /end CHARACTERISTIC
/begin CHARACTERISTIC CAL_cruise_integral_term_limit "cruise I-term clamp: +/- val*100 in 10 mg/s = +/- val g/s airflow" VALUE 0x40008FDF RL_VALUE_UBYTE 0 NO_COMPU_METHOD 0 255 /end CHARACTERISTIC
/begin CHARACTERISTIC CAL_cruise_derivative_term_limit "cruise D-term clamp: +/- val*100 in 10 mg/s = +/- val g/s airflow (stock 50); was CAL_injtip_dfco_enable_rpm_manual_clutch_disengage" VALUE 0x40008FE0 RL_VALUE_UBYTE 0 NO_COMPU_METHOD 0 255 /end CHARACTERISTIC
/begin CHARACTERISTIC CAL_dfco_entry_rpm_clutch_coast "Calibration: DFCO entry RPM clutch coast. Tunable map/constant (not a live channel); log to see when fuel is cut and restored on deceleration. (RPM; raw*10)" VALUE 0x40008FE1 RL_VALUE_UBYTE 0 CM_u8_rspeed_10rpm 0 2550 /end CHARACTERISTIC
/begin CHARACTERISTIC CAL_vvt_p_gain "u16_factor_1/255" VALUE 0x40008FE2 RL_VALUE_UWORD 0 CM_u8_factor_1_255 0 25700 /end CHARACTERISTIC
/begin CHARACTERISTIC CAL_vvt_integral_gain "Calibration: VVT integral gain. Tunable map/constant (not a live channel); log commanded vs actual cam timing to verify VVT response." VALUE 0x40008FE4 RL_VALUE_UWORD 0 NO_COMPU_METHOD 0 65535 /end CHARACTERISTIC
/begin CHARACTERISTIC CAL_idle_flow_adj1_maf_accum_max "Calibration: idle flow adj1 MAF accum max. Tunable map/constant (not a live channel); log to diagnose idle quality, hunting, and stalls. (g)" VALUE 0x40008FE6 RL_VALUE_UWORD 0 CM_u16_mass_g 0 65535 /end CHARACTERISTIC
/begin CHARACTERISTIC CAL_load_learning_tps_rate_max "u16_factor_1/255" VALUE 0x40008FE8 RL_VALUE_UWORD 0 CM_u8_factor_1_255 0 25700 /end CHARACTERISTIC
/begin CHARACTERISTIC CAL_cooling_recirc_pump_rpm_max_disable "Calibration: cooling recirc pump RPM max disable. Tunable map/constant (not a live channel); log to confirm fans/pumps switch at the right temperatures. (RPM)" VALUE 0x40008FEA RL_VALUE_UWORD 0 CM_u8_rspeed_rpm 0 65535 /end CHARACTERISTIC
/begin CHARACTERISTIC CAL_closedloop_stft_increment_period "uint16_t" VALUE 0x40008FEC RL_VALUE_UWORD 0 NO_COMPU_METHOD 0 65535 /end CHARACTERISTIC
/begin CHARACTERISTIC CAL_evap_purge_flow_vapor_min "uint16_t" VALUE 0x40008FEE RL_VALUE_UWORD 0 NO_COMPU_METHOD 0 65535 /end CHARACTERISTIC
/begin CHARACTERISTIC CAL_revlimit_offset_reset_timer "Calibration: revlimit offset reset timer. Tunable map/constant (not a live channel); log to confirm where and how the rev limiter intervenes. (RPM)" VALUE 0x40008FF0 RL_VALUE_UWORD 0 CM_u8_rspeed_rpm 0 65535 /end CHARACTERISTIC
/begin CHARACTERISTIC CAL_load_alphaN_tps_rate_opening_threshold "Calibration: load alphaN throttle position rate opening threshold. Tunable map/constant (not a live channel); log to see throttle/pedal demand and throttle response. (0-1; raw/255)" VALUE 0x40008FF2 RL_VALUE_UWORD 0 CM_u8_factor_1_255 0 25700 /end CHARACTERISTIC
/begin CHARACTERISTIC CAL_ecu_gear_long_ratio_topgear "Calibration: ECU gear long ratio topgear. Tunable map/constant (not a live channel); mostly housekeeping/diagnostic state." VAL_BLK 0x40008FF4 RL_VALUE_UWORD 0 NO_COMPU_METHOD 0 65535 NUMBER 2 /end CHARACTERISTIC
/begin CHARACTERISTIC CAL_evap_purge_power_enrich_suspend_hold "It sets how long evap purge stays suspended after power enrichment ends" VALUE 0x40008FF8 RL_VALUE_UBYTE 0 CM_u8_time_100ms 0 25500 /end CHARACTERISTIC
/begin CHARACTERISTIC CAL_evap_purge_power_enrich_suspend_timeout "timeout in the purge state machine" VALUE 0x40008FF9 RL_VALUE_UBYTE 0 CM_u8_time_100ms 0 25500 /end CHARACTERISTIC
/begin CHARACTERISTIC CAL_inj_fuel_learn_offset_maf_max "u16_flow_10mg/s" VALUE 0x40008FFA RL_VALUE_UWORD 0 CM_u16_flow_10mg_s 0 655350 /end CHARACTERISTIC
/begin CHARACTERISTIC CAL_inj_fuel_learn_offset_rpm_max "u16_rspeed_rpm" VALUE 0x40008FFC RL_VALUE_UWORD 0 CM_u8_rspeed_rpm 0 65535 /end CHARACTERISTIC
/begin CHARACTERISTIC CAL_inj_fuel_learn_zone_2_maf_max "u16_flow_10mg/s" VALUE 0x40008FFE RL_VALUE_UWORD 0 CM_u16_flow_10mg_s 0 655350 /end CHARACTERISTIC
/begin CHARACTERISTIC CAL_inj_fuel_learn_zone_2_maf_min "u16_flow_10mg/s" VALUE 0x40009000 RL_VALUE_UWORD 0 CM_u16_flow_10mg_s 0 655350 /end CHARACTERISTIC
/begin CHARACTERISTIC CAL_inj_fuel_learn_zone_2_load_max "u16_load_mg/stroke" VALUE 0x40009002 RL_VALUE_UWORD 0 CM_u16_load_mg_stroke 0 65535 /end CHARACTERISTIC
/begin CHARACTERISTIC CAL_inj_fuel_learn_zone_2_load_min "u16_load_mg/stroke" VALUE 0x40009004 RL_VALUE_UWORD 0 CM_u16_load_mg_stroke 0 65535 /end CHARACTERISTIC
/begin CHARACTERISTIC CAL_inj_fuel_learn_zone_3_maf_min "u16_flow_10mg/s" VALUE 0x40009006 RL_VALUE_UWORD 0 CM_u16_flow_10mg_s 0 655350 /end CHARACTERISTIC
/begin CHARACTERISTIC CAL_inj_fuel_learn_zone_3_load_min "u16_load_mg/stroke" VALUE 0x40009008 RL_VALUE_UWORD 0 CM_u16_load_mg_stroke 0 65535 /end CHARACTERISTIC
/begin CHARACTERISTIC CAL_closedloop_enable_ect_min "Calibration: closed loop enable coolant temp min. Tunable map/constant (not a live channel); adjust to change this behavior. (deg C; raw*5/8-40)" VALUE 0x4000900A RL_VALUE_UBYTE 0 CM_u8_temp_5_8_40c -40 119.375 /end CHARACTERISTIC
/begin CHARACTERISTIC CAL_inj_fuel_learn_step_period "uint8_t" VALUE 0x4000900B RL_VALUE_UBYTE 0 NO_COMPU_METHOD 0 255 /end CHARACTERISTIC
/begin CHARACTERISTIC CAL_inj_fuel_learn_stft_lean_limit "i16_percent_1/20" VALUE 0x4000900C RL_VALUE_SWORD 0 CM_i16_percent_1_20 -1638.4 1638.35 /end CHARACTERISTIC
/begin CHARACTERISTIC CAL_inj_fuel_learn_stft_rich_limit "i16_percent_1/20" VALUE 0x4000900E RL_VALUE_SWORD 0 CM_i16_percent_1_20 -1638.4 1638.35 /end CHARACTERISTIC
/begin CHARACTERISTIC CAL_inj_fuel_learn_lean_time_limit "u8_time_10us" VALUE 0x40009010 RL_VALUE_UBYTE 0 CM_u8_time_10us 0 2550 /end CHARACTERISTIC
/begin CHARACTERISTIC CAL_inj_fuel_learn_rich_time_limit "u8_time_10us" VALUE 0x40009011 RL_VALUE_UBYTE 0 CM_u8_time_10us 0 2550 /end CHARACTERISTIC
/begin CHARACTERISTIC CAL_inj_fuel_learn_zone_2_max "uchar" VALUE 0x40009012 RL_VALUE_UBYTE 0 NO_COMPU_METHOD 0 255 /end CHARACTERISTIC
/begin CHARACTERISTIC CAL_inj_fuel_learn_zone_2_min "uchar" VALUE 0x40009013 RL_VALUE_UBYTE 0 NO_COMPU_METHOD 0 255 /end CHARACTERISTIC
/begin CHARACTERISTIC CAL_inj_fuel_learn_zone_3_max "uint8_t" VALUE 0x40009014 RL_VALUE_UBYTE 0 NO_COMPU_METHOD 0 255 /end CHARACTERISTIC
/begin CHARACTERISTIC CAL_inj_fuel_learn_zone_3_min "uint8_t" VALUE 0x40009015 RL_VALUE_UBYTE 0 NO_COMPU_METHOD 0 255 /end CHARACTERISTIC
/begin CHARACTERISTIC CAL_closedloop_proportional_gain_rich_ips "Calibration: closedloop proportional gain rich IPS. Tunable map/constant (not a live channel); log to watch O2 feedback trim the mixture and confirm the loop is active." VALUE 0x40009016 RL_VALUE_SWORD 0 CM_i16_factor_1_20 -163840 163835 /end CHARACTERISTIC
/begin CHARACTERISTIC CAL_closedloop_proportional_gain_lean_ips "Calibration: closedloop proportional gain lean IPS. Tunable map/constant (not a live channel); log to watch O2 feedback trim the mixture and confirm the loop is active." VALUE 0x40009018 RL_VALUE_SWORD 0 CM_i16_factor_1_20 -163840 163835 /end CHARACTERISTIC
/begin CHARACTERISTIC CAL_closedloop_integral_gain_ips "Calibration: closedloop integral gain IPS. Tunable map/constant (not a live channel); log to watch O2 feedback trim the mixture and confirm the loop is active." VALUE 0x4000901A RL_VALUE_SWORD 0 CM_i16_factor_1_20 -163840 163835 /end CHARACTERISTIC
/begin CHARACTERISTIC CAL_closedloop_derivative_gain_ips "Calibration: closedloop derivative gain IPS. Tunable map/constant (not a live channel); log to watch O2 feedback trim the mixture and confirm the loop is active." VALUE 0x4000901C RL_VALUE_SWORD 0 CM_i16_factor_1_20 -163840 163835 /end CHARACTERISTIC
/begin CHARACTERISTIC CAL_closedloop_o2_rich_threshold "Calibration: closedloop O2 rich threshold. Tunable map/constant (not a live channel); log to watch O2 feedback trim the mixture and confirm the loop is active. (V; raw*5/1023)" VALUE 0x4000901E RL_VALUE_UWORD 0 CM_u16_voltage_5_1023v 0 320.307917888563 /end CHARACTERISTIC
/begin CHARACTERISTIC CAL_closedloop_o2_lean_threshold "Calibration: closedloop O2 lean threshold. Tunable map/constant (not a live channel); log to watch O2 feedback trim the mixture and confirm the loop is active. (V; raw*5/1023)" VALUE 0x40009020 RL_VALUE_UWORD 0 CM_u16_voltage_5_1023v 0 320.307917888563 /end CHARACTERISTIC
/begin CHARACTERISTIC CAL_revlimit_startup_offset_decrement "uint16_t" VALUE 0x40009022 RL_VALUE_UWORD 0 NO_COMPU_METHOD 0 65535 /end CHARACTERISTIC
/begin CHARACTERISTIC CAL_inj_flow_rate "Calibration: injector flow rate. Tunable map/constant (not a live channel); log to verify injector pulse width and fuel delivery vs target. (mg/s)" VALUE 0x40009024 RL_VALUE_UWORD 0 CM_u16_flow_mg_s 0 65535 /end CHARACTERISTIC
/begin CHARACTERISTIC CAL_tps_limit_idle_request_max "Calibration: throttle position idle request max. Tunable map/constant (not a live channel); log to diagnose idle quality, hunting, and stalls. (0-1; raw/1023)" VALUE 0x40009026 RL_VALUE_UWORD 0 CM_u16_factor_1_1023 0 6406.15835777126 /end CHARACTERISTIC
/begin CHARACTERISTIC CAL_idle_rpm_ramp_step "u8_rspeed_rpm" VALUE 0x40009028 RL_VALUE_UBYTE 0 CM_u8_rspeed_rpm 0 255 /end CHARACTERISTIC
/begin CHARACTERISTIC CAL_tps_limit_misfire_single_bank "Calibration: throttle position limit misfire single bank. Tunable map/constant (not a live channel); log to find misfires and which cylinder is responsible. (0-1; raw/255)" VALUE 0x40009029 RL_VALUE_UBYTE 0 CM_u8_factor_1_255 0 100 /end CHARACTERISTIC
/begin CHARACTERISTIC CAL_airbox_flapper_engine_speed_tour "Calibration: airbox flapper engine speed tour. Tunable map/constant (not a live channel); log to follow core engine state." VAL_BLK 0x4000902A RL_VALUE_UWORD 0 NO_COMPU_METHOD 0 65535 NUMBER 2 /end CHARACTERISTIC
/begin CHARACTERISTIC CAL_ign_idle_recovery_period "Calibration: ignition idle recovery period 5ms. Tunable map/constant (not a live channel); log spark advance to confirm the timing strategy and headroom to knock. (ms; raw*5)" VALUE 0x4000902E RL_VALUE_UBYTE 0 CM_u8_time_5ms 0 1275 /end CHARACTERISTIC
/begin CHARACTERISTIC CAL_torque_tps_gain "Calibration: torque throttle position gain. Tunable map/constant (not a live channel); log to see throttle/pedal demand and throttle response. (0-1; raw/255)" VALUE 0x4000902F RL_VALUE_UBYTE 0 CM_u8_factor_1_255 0 100 /end CHARACTERISTIC
/begin CHARACTERISTIC CAL_cruise_speed_limit "Calibration: cruise speed limit. Tunable map/constant (not a live channel); log to debug cruise engagement and speed holding. (km/h)" VAL_BLK 0x40009030 RL_VALUE_UBYTE 0 CM_u8_speed_kph 0 255 NUMBER 2 /end CHARACTERISTIC
/begin CHARACTERISTIC CAL_cruise_rpm_max_manual "projected rpm at target; engage val*50 rpm, cancel val*52 rpm (cruise_rpm_max_cancel_scale)" VALUE 0x40009032 RL_VALUE_UBYTE 0 CM_u8_rspeed_50rpm 0 12750 /end CHARACTERISTIC
/begin CHARACTERISTIC CAL_cruise_rpm_min_manual "engage val*50 rpm, cancel val*48 rpm (cruise_rpm_min_cancel_scale)" VALUE 0x40009033 RL_VALUE_UBYTE 0 CM_u8_rspeed_50rpm 0 12750 /end CHARACTERISTIC
/begin CHARACTERISTIC CAL_cruise_speed_error_max "abs(err) < val/2 = captured (0x80); after capture abs(err) > val cancels (reason 0x20). Was CAL_cruise_speed_deadband" VALUE 0x40009034 RL_VALUE_UBYTE 0 CM_u8_speed_kph 0 255 /end CHARACTERISTIC
/begin CHARACTERISTIC CAL_cruise_accel_hold_step "added to target every 100 ms while + held; stock 38 = 3.8 km/h/s" VALUE 0x40009035 RL_VALUE_UBYTE 0 CM_u8_speed_1_100kph 0 2.55 /end CHARACTERISTIC
/begin CHARACTERISTIC CAL_cruise_decel_hold_step "subtracted from target every 100 ms while - held; stock 31 = 3.1 km/h/s" VALUE 0x40009036 RL_VALUE_UBYTE 0 CM_u8_speed_1_100kph 0 2.55 /end CHARACTERISTIC
/begin CHARACTERISTIC CAL_tps_limit_severe_misfire_multi_cut "Calibration: throttle position limit severe misfire multi cut. Tunable map/constant (not a live channel); log to find misfires and which cylinder is responsible. (0-1; raw/255)" VALUE 0x40009037 RL_VALUE_UBYTE 0 CM_u8_factor_1_255 0 100 /end CHARACTERISTIC
/begin CHARACTERISTIC CAL_tps_limit_severe_misfire_1_cut "Calibration: throttle position limit severe misfire 1 cut. Tunable map/constant (not a live channel); log to find misfires and which cylinder is responsible. (0-1; raw/255)" VALUE 0x40009038 RL_VALUE_UBYTE 0 CM_u8_factor_1_255 0 100 /end CHARACTERISTIC
/begin CHARACTERISTIC CAL_tps_limit_severe_misfire_no_cut "Calibration: throttle position limit severe misfire no cut. Tunable map/constant (not a live channel); log to find misfires and which cylinder is responsible. (0-1; raw/255)" VALUE 0x40009039 RL_VALUE_UBYTE 0 CM_u8_factor_1_255 0 100 /end CHARACTERISTIC
/begin CHARACTERISTIC CAL_cruise_override_timeout "pedal override longer than val*4 (10 Hz) = 400 ms/count cancels cruise (reason 0x100); stock 112 = 44.8 s. Was CAL_ign_comp_recovery_timer" VALUE 0x4000903A RL_VALUE_UWORD 0 NO_COMPU_METHOD 0 65535 /end CHARACTERISTIC
/begin CHARACTERISTIC CAL_cruise_speed_tap_step "SET+/COAST- tap step; stock 16 = 1.6 km/h (~1 mph)" VALUE 0x4000903C RL_VALUE_UBYTE 0 CM_u8_speed_1_10kph 0 25.5 /end CHARACTERISTIC
/begin CHARACTERISTIC CAL_cruise_airflow_slew_step "u8_flow_10mg/s" VALUE 0x4000903D RL_VALUE_UBYTE 0 CM_u16_flow_10mg_s 0 2550 /end CHARACTERISTIC
/begin CHARACTERISTIC CAL_cruise_speed_filter_coeff "cruise_speed_smoothed = (k*old + (255-k)*car_speed_x100)/255 at 40 Hz. Was CAL_cruise_speed_increment2" VALUE 0x4000903E RL_VALUE_UBYTE 0 CM_u8_factor_1_255 0 100 /end CHARACTERISTIC
/begin CHARACTERISTIC CAL_cooling_recirc_airtemp_disable_engine_on "uint8_t" VALUE 0x4000903F RL_VALUE_UBYTE 0 NO_COMPU_METHOD 0 255 /end CHARACTERISTIC
/begin CHARACTERISTIC CAL_tps_limit_warmup_coolant_max "u8_temp_5/8-40c" VALUE 0x40009040 RL_VALUE_UBYTE 0 CM_u8_temp_5_8_40c -40 119.375 /end CHARACTERISTIC
/begin CHARACTERISTIC CAL_tps_limit_warmup_stepsize "Calibration: throttle position limit warmup stepsize. Tunable map/constant (not a live channel); log to see throttle/pedal demand and throttle response. (0-1; raw/1023)" VALUE 0x40009041 RL_VALUE_UBYTE 0 CM_u16_factor_1_1023 0 24.9266862170088 /end CHARACTERISTIC
/begin CHARACTERISTIC CAL_ecu_brake_or_clutch_inactive_timer "uint16_t" VALUE 0x40009042 RL_VALUE_UWORD 0 NO_COMPU_METHOD 0 65535 /end CHARACTERISTIC
/begin CHARACTERISTIC CAL_cooling_recirc_rpm_enable_engine_on "uint8_t" VALUE 0x40009044 RL_VALUE_UBYTE 0 NO_COMPU_METHOD 0 255 /end CHARACTERISTIC
/begin CHARACTERISTIC CAL_cooling_afterrun_fan_timer_unknown "Calibration: cooling afterrun fan timer unknown. Tunable map/constant (not a live channel); log to confirm fans/pumps switch at the right temperatures." VALUE 0x40009045 RL_VALUE_UBYTE 0 NO_COMPU_METHOD 0 255 /end CHARACTERISTIC
/begin CHARACTERISTIC CAL_tpms_version "Calibration: tpms version. Tunable map/constant (not a live channel); adjust to change this behavior." VALUE 0x40009046 RL_VALUE_UBYTE 0 NO_COMPU_METHOD 0 255 /end CHARACTERISTIC
/begin CHARACTERISTIC CAL_fuel_level_change_threshold "u8_volume_liter" VALUE 0x40009047 RL_VALUE_UBYTE 0 CM_u8_volume_liter 0 255 /end CHARACTERISTIC
/begin CHARACTERISTIC CAL_fuel_trim_integral_max "uint16_t" VALUE 0x40009048 RL_VALUE_UWORD 0 NO_COMPU_METHOD 0 65535 /end CHARACTERISTIC
/begin CHARACTERISTIC CAL_cooling_recirc_pump_run_ambient_max "Calibration: cooling recirc pump run ambient max. Tunable map/constant (not a live channel); log to confirm fans/pumps switch at the right temperatures. (deg C; raw*5/8-40)" VALUE 0x4000904A RL_VALUE_UBYTE 0 CM_u8_temp_5_8_40c -40 119.375 /end CHARACTERISTIC
/begin CHARACTERISTIC CAL_ac_compressor_speed_filter_coeff "uint8_t" VALUE 0x4000904B RL_VALUE_UBYTE 0 NO_COMPU_METHOD 0 255 /end CHARACTERISTIC
/begin CHARACTERISTIC CAL_cooling_recirc_pump_rpm_max_enable "Calibration: cooling recirc pump RPM max enable. Tunable map/constant (not a live channel); log to confirm fans/pumps switch at the right temperatures. (RPM)" VALUE 0x4000904C RL_VALUE_UWORD 0 CM_u8_rspeed_rpm 0 65535 /end CHARACTERISTIC
/begin CHARACTERISTIC CAL_tpssmooth_decrement_comp_gears_ips "Calibration: tpssmooth decrement compensation gears IPS. Tunable map/constant (not a live channel); log to see throttle-signal smoothing/filtering behavior. (0-1; raw/255)" VAL_BLK 0x4000904E RL_VALUE_UBYTE 0 CM_u8_factor_1_255 0 100 NUMBER 7 /end CHARACTERISTIC
/begin CHARACTERISTIC CAL_closedloop_integral_gain_startup_duration "uint8_t" VALUE 0x40009055 RL_VALUE_UBYTE 0 NO_COMPU_METHOD 0 255 /end CHARACTERISTIC
/begin CHARACTERISTIC CAL_closedloop_o2_breakin_window_hours "u8_time_hours; maximum engine run time before long-term fuel trim adaptation stops updating" VALUE 0x40009056 RL_VALUE_UBYTE 0 CM_u8_time_hours 0 255 /end CHARACTERISTIC
/begin CHARACTERISTIC CAL_closedloop_integral_gain_scale_manual "uint8_t" VALUE 0x40009057 RL_VALUE_UBYTE 0 NO_COMPU_METHOD 0 255 /end CHARACTERISTIC
/begin CHARACTERISTIC CAL_closedloop_hold_time "Calibration: closedloop hold time. Tunable map/constant (not a live channel); log to watch O2 feedback trim the mixture and confirm the loop is active." VALUE 0x40009058 RL_VALUE_UBYTE 0 NO_COMPU_METHOD 0 255 /end CHARACTERISTIC
/begin CHARACTERISTIC CAL_idle_air_fast_decay_period "u8_time_ms" VALUE 0x40009059 RL_VALUE_UBYTE 0 CM_u8_time_ms 0 255 /end CHARACTERISTIC
/begin CHARACTERISTIC CAL_exhaust_flap_rpm1 "Calibration: exhaust flap rpm1. Tunable map/constant (not a live channel); log to see exhaust bypass valve position (sound/backpressure). (RPM)" VALUE 0x4000905A RL_VALUE_UWORD 0 CM_u8_rspeed_rpm 0 65535 /end CHARACTERISTIC
/begin CHARACTERISTIC CAL_exhaust_flap_rpm2 "Calibration: exhaust flap rpm2. Tunable map/constant (not a live channel); log to see exhaust bypass valve position (sound/backpressure). (RPM)" VALUE 0x4000905C RL_VALUE_UWORD 0 CM_u8_rspeed_rpm 0 65535 /end CHARACTERISTIC
/begin CHARACTERISTIC CAL_inj_fuel_learn_power_enrich_load_min "u8_load_4mg/stroke" VALUE 0x4000905F RL_VALUE_UBYTE 0 CM_u8_load_4mg_stroke 0 1020 /end CHARACTERISTIC
/begin CHARACTERISTIC CAL_inj_fuel_learn_power_enrich_rpm_min "u8_rspeed_125/4+500rpm" VALUE 0x40009060 RL_VALUE_UBYTE 0 CM_u8_rspeed_125_4_500rpm 500 8468.75 /end CHARACTERISTIC
/begin CHARACTERISTIC CAL_cruise_rpm_max_ips "as CAL_cruise_rpm_max_manual" VALUE 0x40009061 RL_VALUE_UBYTE 0 CM_u8_rspeed_50rpm 0 12750 /end CHARACTERISTIC
/begin CHARACTERISTIC CAL_cruise_rpm_min_ips "as CAL_cruise_rpm_min_manual" VALUE 0x40009062 RL_VALUE_UBYTE 0 CM_u8_rspeed_50rpm 0 12750 /end CHARACTERISTIC
/begin CHARACTERISTIC CAL_exhaust_flap_startup_delay "Calibration: exhaust flap startup delay. Tunable map/constant (not a live channel); log to see exhaust bypass valve position (sound/backpressure). (ms; raw*100)" VALUE 0x40009063 RL_VALUE_UBYTE 0 CM_u8_time_100ms 0 25500 /end CHARACTERISTIC
/begin CHARACTERISTIC CAL_revlimit_flow_correction_p_limit "u8_flow_g/s" VALUE 0x40009064 RL_VALUE_UBYTE 0 CM_u8_flow_g_s 0 255 /end CHARACTERISTIC
/begin CHARACTERISTIC CAL_revlimit_flow_correction_i_limit "uint8_t" VALUE 0x40009065 RL_VALUE_UBYTE 0 NO_COMPU_METHOD 0 255 /end CHARACTERISTIC
/begin CHARACTERISTIC CAL_revlimit_flow_slew_step "u8_flow_10mg/s" VALUE 0x40009066 RL_VALUE_UBYTE 0 CM_u16_flow_10mg_s 0 2550 /end CHARACTERISTIC
/begin CHARACTERISTIC CAL_revlimit_rpm_integral_limit "uint8_t" VALUE 0x40009067 RL_VALUE_UBYTE 0 NO_COMPU_METHOD 0 255 /end CHARACTERISTIC
/begin CHARACTERISTIC CAL_revlimit_flow_integral_limit "uint8_t" VALUE 0x40009068 RL_VALUE_UBYTE 0 NO_COMPU_METHOD 0 255 /end CHARACTERISTIC
/begin CHARACTERISTIC CAL_revlimit_maf_error_max "u8_flow_100mg/s" VALUE 0x40009069 RL_VALUE_UBYTE 0 CM_u8_flow_100mg_s 0 25500 /end CHARACTERISTIC
/begin CHARACTERISTIC CAL_roughness_enable_rpm "Calibration: roughness enable RPM. Tunable map/constant (not a live channel); log to find misfires and rough-running cylinders. (RPM; raw/4)" VAL_BLK 0x4000906A RL_VALUE_UWORD 0 CM_u16_rspeed_1_4rpm 0 16383.75 NUMBER 2 /end CHARACTERISTIC
/begin CHARACTERISTIC CAL_roughness_enable_load "Calibration: roughness enable load. Tunable map/constant (not a live channel); log to find misfires and rough-running cylinders. (mg/stroke; raw*4)" VAL_BLK 0x4000906E RL_VALUE_UBYTE 0 CM_u8_load_4mg_stroke 0 1020 NUMBER 2 /end CHARACTERISTIC
/begin CHARACTERISTIC CAL_roughness_unknown6 "uint8_t" VALUE 0x40009070 RL_VALUE_UBYTE 0 NO_COMPU_METHOD 0 255 /end CHARACTERISTIC
/begin CHARACTERISTIC CAL_roughness_unknown8 "uint8_t" VALUE 0x40009071 RL_VALUE_UBYTE 0 NO_COMPU_METHOD 0 255 /end CHARACTERISTIC
/begin CHARACTERISTIC CAL_roughness_delta_rpm_smoothing_factor "Calibration: roughness delta RPM smoothing factor. Tunable map/constant (not a live channel); log to find misfires and rough-running cylinders. (0-1; raw/100)" VALUE 0x40009072 RL_VALUE_UBYTE 0 CM_u8_factor_1_100 0 255 /end CHARACTERISTIC
/begin CHARACTERISTIC CAL_roughness_min_edge_count "u8_count" VALUE 0x40009073 RL_VALUE_UBYTE 0 NO_COMPU_METHOD 0 255 /end CHARACTERISTIC
/begin CHARACTERISTIC CAL_roughness_cycle_count_threshold "Calibration: roughness cycle count threshold. Tunable map/constant (not a live channel); log to find misfires and rough-running cylinders." VALUE 0x40009074 RL_VALUE_UBYTE 0 NO_COMPU_METHOD 0 255 /end CHARACTERISTIC
/begin CHARACTERISTIC CAL_roughness_peak_valley_imblance_threshold "uint8_t" VALUE 0x40009075 RL_VALUE_UBYTE 0 NO_COMPU_METHOD 0 255 /end CHARACTERISTIC
/begin CHARACTERISTIC CAL_roughness_unknown2 "uint8_t" VALUE 0x40009076 RL_VALUE_UBYTE 0 NO_COMPU_METHOD 0 255 /end CHARACTERISTIC
/begin CHARACTERISTIC CAL_roughness_peak_valley_imbalance_threshold "Calibration: roughness peak valley imbalance threshold. Tunable map/constant (not a live channel); log to find misfires and rough-running cylinders." VALUE 0x40009077 RL_VALUE_UBYTE 0 NO_COMPU_METHOD 0 255 /end CHARACTERISTIC
/begin CHARACTERISTIC CAL_roughness_unknown5 "uint8_t" VALUE 0x40009078 RL_VALUE_UBYTE 0 NO_COMPU_METHOD 0 255 /end CHARACTERISTIC
/begin CHARACTERISTIC CAL_roughness_unknown4 "uint8_t" VALUE 0x40009079 RL_VALUE_UBYTE 0 NO_COMPU_METHOD 0 255 /end CHARACTERISTIC
/begin CHARACTERISTIC CAL_roughness_ign_adv_min_sign_flipped "Calibration: roughness ignition advance min sign flipped. Tunable map/constant (not a live channel); log spark advance to confirm the timing strategy and headroom to knock. (deg; raw/4)" VALUE 0x4000907A RL_VALUE_UBYTE 0 CM_u8_angle_1_4deg 0 63.75 /end CHARACTERISTIC
/begin CHARACTERISTIC CAL_roughness_ign_adv_max "Calibration: roughness ignition advance max. Tunable map/constant (not a live channel); log spark advance to confirm the timing strategy and headroom to knock. (deg; raw/4)" VALUE 0x4000907B RL_VALUE_UBYTE 0 CM_u8_angle_1_4deg 0 63.75 /end CHARACTERISTIC
/begin CHARACTERISTIC CAL_roughness_unknown7 "uint8_t" VALUE 0x4000907C RL_VALUE_UBYTE 0 NO_COMPU_METHOD 0 255 /end CHARACTERISTIC
/begin CHARACTERISTIC CAL_wheel_speed_front_dvdt_scaling "u8_factor_1/256" VALUE 0x4000907D RL_VALUE_UBYTE 0 CM_u8_factor_1_256 0 99.609375 /end CHARACTERISTIC
/begin CHARACTERISTIC CAL_wheel_speed_front_accel_update_interval "uint8_t" VALUE 0x4000907E RL_VALUE_UBYTE 0 NO_COMPU_METHOD 0 255 /end CHARACTERISTIC
/begin CHARACTERISTIC CAL_cruise_integral_gearchange_blend "IPS upshift: integ = rescaled + k*(old - rescaled)/255, rescaled = integ*Ki_old/Ki_new. Was CAL_ecu_engine_breakin_distance" VALUE 0x4000907F RL_VALUE_UBYTE 0 CM_u8_factor_1_255 0 100 /end CHARACTERISTIC
/begin CHARACTERISTIC CAL_cruise_integrator_accel_freeze "integrator runs only while wheel_speed_front_accel <= val (or error 0). Was CAL_vehicle_standing_start_throttle_threshold" VALUE 0x40009080 RL_VALUE_UBYTE 0 CM_u8_accel_1_255g 0 1 /end CHARACTERISTIC
/begin CHARACTERISTIC CAL_revlimit_tps_cut_enable "Calibration: revlimit throttle position cut enable. Tunable map/constant (not a live channel); log to confirm where and how the rev limiter intervenes." VALUE 0x40009081 RL_VALUE_UBYTE 0 NO_COMPU_METHOD 0 255 /end CHARACTERISTIC
/begin CHARACTERISTIC CAL_revlimit_exit_margin "RPM margin below the soft limit required to fully exit rev limit mode and reset all state" VALUE 0x40009082 RL_VALUE_UBYTE 0 CM_u8_rspeed_10rpm 0 2550 /end CHARACTERISTIC
/begin CHARACTERISTIC CAL_revlimit_time_above_soft_threshold "Calibration: revlimit time above soft threshold. Tunable map/constant (not a live channel); log to confirm where and how the rev limiter intervenes. (ms; raw*100)" VALUE 0x40009083 RL_VALUE_UBYTE 0 CM_u8_time_100ms 0 25500 /end CHARACTERISTIC
/begin CHARACTERISTIC CAL_revlimit_max_with_speedlimit "Calibration: revlimit max with speedlimit. Tunable map/constant (not a live channel); log to confirm where and how the rev limiter intervenes. (RPM)" VALUE 0x40009084 RL_VALUE_UWORD 0 CM_u8_rspeed_rpm 0 65535 /end CHARACTERISTIC
/begin CHARACTERISTIC CAL_vehicle_speed_limit "Calibration: vehicle speed limit. Tunable map/constant (not a live channel); adjust to change this behavior. (km/h)" VALUE 0x40009086 RL_VALUE_UBYTE 0 CM_u8_speed_kph 0 255 /end CHARACTERISTIC
/begin CHARACTERISTIC CAL_revlimit_bounce_count_threshold "The number of rev limit bounces before sustained rev limit mode and aggressive throttle management engage." VALUE 0x40009087 RL_VALUE_UBYTE 0 NO_COMPU_METHOD 0 255 /end CHARACTERISTIC
/begin CHARACTERISTIC CAL_vehicle_speed_limit_enforce "Calibration: vehicle speed limit enforce. Tunable map/constant (not a live channel); adjust to change this behavior." VALUE 0x40009088 RL_VALUE_UBYTE 0 NO_COMPU_METHOD 0 255 /end CHARACTERISTIC
/begin CHARACTERISTIC CAL_vehicle_speed_limit_ramp_step "Calibration: vehicle speed limit enforce margin. Tunable map/constant (not a live channel); adjust to change this behavior. (km/h; raw/100)" VALUE 0x40009089 RL_VALUE_UBYTE 0 CM_u8_speed_1_100kph 0 2.55 /end CHARACTERISTIC
/begin CHARACTERISTIC CAL_cruise_tps_accelerating_threshold "uint16_t" VALUE 0x4000908A RL_VALUE_UWORD 0 NO_COMPU_METHOD 0 65535 /end CHARACTERISTIC
/begin CHARACTERISTIC CAL_unused1 "uint16_t" VALUE 0x4000908C RL_VALUE_UWORD 0 NO_COMPU_METHOD 0 65535 /end CHARACTERISTIC
/begin CHARACTERISTIC CAL_idle_rpm_ramp_step_ips "uint8_t" VALUE 0x4000908E RL_VALUE_UBYTE 0 NO_COMPU_METHOD 0 255 /end CHARACTERISTIC
/begin CHARACTERISTIC CAL_cruise_tps_override_threshold "Calibration: cruise throttle position override threshold. Tunable map/constant (not a live channel); log to see throttle/pedal demand and throttle response. (0-1; raw/255)" VALUE 0x4000908F RL_VALUE_UBYTE 0 CM_u8_factor_1_255 0 100 /end CHARACTERISTIC
/begin CHARACTERISTIC CAL_ign_fixed_timing_ips "uint8_t" VALUE 0x40009090 RL_VALUE_UBYTE 0 NO_COMPU_METHOD 0 255 /end CHARACTERISTIC
/begin CHARACTERISTIC CAL_ign_fixed_ips "Calibration: ignition fixed IPS. Tunable map/constant (not a live channel); log spark advance to confirm the timing strategy and headroom to knock. (deg; raw/4-10)" VALUE 0x40009091 RL_VALUE_UBYTE 0 CM_u8_angle_1_4_10deg -10 53.75 /end CHARACTERISTIC
/begin CHARACTERISTIC CAL_knock_freq_bands "u16_freq_hz[11]" VAL_BLK 0x40009092 RL_VALUE_UWORD 0 NO_COMPU_METHOD 0 65535 NUMBER 11 /end CHARACTERISTIC
/begin CHARACTERISTIC CAL_tps_brake_wheeldecel_threshold "undefined1" VALUE 0x400090A8 RL_VALUE_UBYTE 0 NO_COMPU_METHOD 0 255 /end CHARACTERISTIC
/begin CHARACTERISTIC CAL_tps_brake_safety_floor "Calibration: throttle position brake safety floor. Tunable map/constant (not a live channel); log to see throttle/pedal demand and throttle response. (0-1; raw/100)" VALUE 0x400090A9 RL_VALUE_UBYTE 0 CM_u8_factor_1_100 0 255 /end CHARACTERISTIC
/begin CHARACTERISTIC CAL_unused2 "uint16_t" VALUE 0x400090AA RL_VALUE_UWORD 0 NO_COMPU_METHOD 0 65535 /end CHARACTERISTIC
/begin CHARACTERISTIC CAL_tps_brake_wheeldecel_tps_cut_threshold "uint8_t" VALUE 0x400090AC RL_VALUE_UBYTE 0 NO_COMPU_METHOD 0 255 /end CHARACTERISTIC
/begin CHARACTERISTIC CAL_cruise_torque_request_braking "u8_torque_2nm" VALUE 0x400090AD RL_VALUE_UBYTE 0 CM_u8_torque_2nm 0 510 /end CHARACTERISTIC
/begin CHARACTERISTIC CAL_cruise_brake_standstill_timer "u16_time_10ms" VALUE 0x400090AE RL_VALUE_UWORD 0 CM_u8_time_10ms 0 655350 /end CHARACTERISTIC
/begin CHARACTERISTIC CAL_knock_dsp_nyquist_hz "Calibration: knock AGC scaling threshold. Tunable map/constant (not a live channel); log to catch knock events and see how much timing is being pulled." VALUE 0x400090B0 RL_VALUE_UWORD 0 NO_COMPU_METHOD 0 65535 /end CHARACTERISTIC
/begin CHARACTERISTIC CAL_knock_mode "Calibration: knock mode. Tunable map/constant (not a live channel); log to catch knock events and see how much timing is being pulled." VALUE 0x400090B2 RL_VALUE_UBYTE 0 NO_COMPU_METHOD 0 255 /end CHARACTERISTIC
/begin CHARACTERISTIC CAL_dca_enable_untested "Calibration: Drive-Cycle-Assist enable untested. Tunable map/constant (not a live channel); log to observe Drive-Cycle-Assist activation (normally off)." VALUE 0x400090B3 RL_VALUE_UBYTE 0 NO_COMPU_METHOD 0 255 /end CHARACTERISTIC
/begin CHARACTERISTIC CAL_tpssmooth_parking_threshold_carspeed "uint8_t" VALUE 0x400090B4 RL_VALUE_UBYTE 0 NO_COMPU_METHOD 0 255 /end CHARACTERISTIC
/begin CHARACTERISTIC CAL_vvt_low_load_disable "Calibration: VVT low load disable. Tunable map/constant (not a live channel); log commanded vs actual cam timing to verify VVT response." VALUE 0x400090B5 RL_VALUE_UBYTE 0 NO_COMPU_METHOD 0 255 /end CHARACTERISTIC
/begin CHARACTERISTIC CAL_obd_ii_variant_enable "Calibration: OBD variant enable. Tunable map/constant (not a live channel); adjust to change this behavior." VALUE 0x400090B6 RL_VALUE_UBYTE 0 NO_COMPU_METHOD 0 255 /end CHARACTERISTIC
/begin CHARACTERISTIC CAL_vvt_low_load_map_enable_temp "Calibration: VVT low load MAP enable temperature. Tunable map/constant (not a live channel); log commanded vs actual cam timing to verify VVT response. (deg C; raw*5/8-40)" VALUE 0x400090B7 RL_VALUE_UBYTE 0 CM_u8_temp_5_8_40c -40 119.375 /end CHARACTERISTIC
/begin CHARACTERISTIC CAL_tpssmooth_parking_threshold_tps "uint8_t" VALUE 0x400090B8 RL_VALUE_UBYTE 0 NO_COMPU_METHOD 0 255 /end CHARACTERISTIC
/begin CHARACTERISTIC CAL_tpssmooth_accel_pedal_modes_enable "Calibration: tpssmooth accelerator pedal modes enable. Tunable map/constant (not a live channel); log to see throttle-signal smoothing/filtering behavior." VALUE 0x400090B9 RL_VALUE_UBYTE 0 NO_COMPU_METHOD 0 255 /end CHARACTERISTIC
/begin CHARACTERISTIC CAL_unused3 "byte[3]" VAL_BLK 0x400090BA RL_VALUE_UBYTE 0 NO_COMPU_METHOD 0 255 NUMBER 3 /end CHARACTERISTIC
/begin CHARACTERISTIC CAL_tpssmooth_parking_pedal_max "Calibration: tpssmooth parking pedal max. Tunable map/constant (not a live channel); log to see throttle-signal smoothing/filtering behavior. (0-1; raw/255)" VALUE 0x400090BD RL_VALUE_UBYTE 0 CM_u8_factor_1_255 0 100 /end CHARACTERISTIC
/begin CHARACTERISTIC CAL_tpssmooth_parking_speed_max "Calibration: tpssmooth parking speed max. Tunable map/constant (not a live channel); log to see throttle-signal smoothing/filtering behavior. (km/h)" VALUE 0x400090BE RL_VALUE_UBYTE 0 CM_u8_speed_kph 0 255 /end CHARACTERISTIC
/begin CHARACTERISTIC CAL_tpssmooth_parking_gear_max "Calibration: tpssmooth parking gear max. Tunable map/constant (not a live channel); log to see throttle-signal smoothing/filtering behavior." VALUE 0x400090BF RL_VALUE_UBYTE 0 NO_COMPU_METHOD 0 255 /end CHARACTERISTIC
/begin CHARACTERISTIC CAL_ips_speed_match_p_gain "uint16_t" VALUE 0x400090C2 RL_VALUE_UWORD 0 NO_COMPU_METHOD 0 65535 /end CHARACTERISTIC
/begin CHARACTERISTIC CAL_ips_speed_match_d_gain "undefined" VALUE 0x400090CC RL_VALUE_ULONG 0 NO_COMPU_METHOD 0 4294967295 /end CHARACTERISTIC
/begin CHARACTERISTIC CAL_ips_speed_match_d_sample_ticks "undefined" VALUE 0x400090CE RL_VALUE_ULONG 0 NO_COMPU_METHOD 0 4294967295 /end CHARACTERISTIC
/begin CHARACTERISTIC CAL_ips_speed_match_torque_max "undefined" VALUE 0x400090DC RL_VALUE_ULONG 0 NO_COMPU_METHOD 0 4294967295 /end CHARACTERISTIC
/begin CHARACTERISTIC CAL_torque_estimate_min_ips "short" VALUE 0x400090DE RL_VALUE_SWORD 0 NO_COMPU_METHOD -32768 32767 /end CHARACTERISTIC
/begin CHARACTERISTIC CAL_ips_torque_reduction_slow_scale_pct "uint8_t" VALUE 0x400090E0 RL_VALUE_UBYTE 0 NO_COMPU_METHOD 0 255 /end CHARACTERISTIC
/begin CHARACTERISTIC CAL_ips_torque_reduction_slow_floor_nm "uint8_t" VALUE 0x400090E1 RL_VALUE_UBYTE 0 NO_COMPU_METHOD 0 255 /end CHARACTERISTIC
/begin CHARACTERISTIC CAL_idle_learn_coolant_min "u8_temp_5/8-40c" VALUE 0x400090E2 RL_VALUE_UBYTE 0 CM_u8_temp_5_8_40c -40 119.375 /end CHARACTERISTIC
/begin CHARACTERISTIC CAL_idle_learn_temp_range "Calibration: idle learn temperature range. Tunable map/constant (not a live channel); log to diagnose idle quality, hunting, and stalls. (deg C; raw*5/8-40)" VAL_BLK 0x400090E3 RL_VALUE_UBYTE 0 CM_u8_temp_5_8_40c -40 119.375 NUMBER 2 /end CHARACTERISTIC
/begin CHARACTERISTIC CAL_dca_enable_steering_max "Calibration: Drive-Cycle-Assist enable steering max. Tunable map/constant (not a live channel); log to observe Drive-Cycle-Assist activation (normally off)." VALUE 0x400090E5 RL_VALUE_UBYTE 0 NO_COMPU_METHOD 0 255 /end CHARACTERISTIC
/begin CHARACTERISTIC CAL_dca_enable_carspeed "Calibration: Drive-Cycle-Assist enable carspeed. Tunable map/constant (not a live channel); log to observe Drive-Cycle-Assist activation (normally off). (km/h)" VAL_BLK 0x400090E6 RL_VALUE_UBYTE 0 CM_u8_speed_kph 0 255 NUMBER 2 /end CHARACTERISTIC
/begin CHARACTERISTIC CAL_dca_stationary_wait_time "Calibration: Drive-Cycle-Assist stationary wait time. Tunable map/constant (not a live channel); log to observe Drive-Cycle-Assist activation (normally off). (ms; raw*100)" VALUE 0x400090E8 RL_VALUE_UBYTE 0 CM_u8_time_100ms 0 25500 /end CHARACTERISTIC
/begin CHARACTERISTIC CAL_dca_tps_initial_offset "Calibration: Drive-Cycle-Assist throttle position initial offset. Tunable map/constant (not a live channel); log to see throttle/pedal demand and throttle response." VALUE 0x400090E9 RL_VALUE_UBYTE 0 NO_COMPU_METHOD 0 255 /end CHARACTERISTIC
/begin CHARACTERISTIC CAL_dca_enable_tps_margin "Calibration: Drive-Cycle-Assist enable throttle position margin. Tunable map/constant (not a live channel); log to see throttle/pedal demand and throttle response." VALUE 0x400090EA RL_VALUE_UBYTE 0 NO_COMPU_METHOD 0 255 /end CHARACTERISTIC
/begin CHARACTERISTIC CAL_dca_activate_timer "Calibration: Drive-Cycle-Assist activate timer. Tunable map/constant (not a live channel); log to observe Drive-Cycle-Assist activation (normally off). (ms; raw*5)" VALUE 0x400090EB RL_VALUE_UBYTE 0 CM_u8_time_5ms 0 1275 /end CHARACTERISTIC
/begin CHARACTERISTIC CAL_dca_activate_tps_threshold "Calibration: Drive-Cycle-Assist activate throttle position threshold. Tunable map/constant (not a live channel); log to see throttle/pedal demand and throttle response. (0-1; raw/1023)" VALUE 0x400090EC RL_VALUE_UWORD 0 CM_u16_factor_1_1023 0 6406.15835777126 /end CHARACTERISTIC
/begin CHARACTERISTIC CAL_vvt_low_load_ips_enable "Calibration: VVT low load IPS enable. Tunable map/constant (not a live channel); log commanded vs actual cam timing to verify VVT response." VALUE 0x400090EE RL_VALUE_UBYTE 0 NO_COMPU_METHOD 0 255 /end CHARACTERISTIC
/begin CHARACTERISTIC CAL_dca_freerev_wait_time "Calibration: Drive-Cycle-Assist freerev wait time. Tunable map/constant (not a live channel); log to observe Drive-Cycle-Assist activation (normally off)." VALUE 0x400090EF RL_VALUE_UBYTE 0 NO_COMPU_METHOD 0 255 /end CHARACTERISTIC
/begin CHARACTERISTIC CAL_dca_tps_ramp_step_period "Calibration: Drive-Cycle-Assist throttle position ramp step period. Tunable map/constant (not a live channel); log to see throttle/pedal demand and throttle response." VALUE 0x400090F0 RL_VALUE_UBYTE 0 NO_COMPU_METHOD 0 255 /end CHARACTERISTIC
/begin CHARACTERISTIC CAL_dca_freerev_rpm_tolerance "Calibration: Drive-Cycle-Assist freerev RPM tolerance. Tunable map/constant (not a live channel); log to observe Drive-Cycle-Assist activation (normally off)." VALUE 0x400090F1 RL_VALUE_UBYTE 0 NO_COMPU_METHOD 0 255 /end CHARACTERISTIC
/begin CHARACTERISTIC CAL_engine_speed_coolant_temp_unknown7 "u8_temp_5/8-40c" VALUE 0x400090F2 RL_VALUE_UBYTE 0 CM_u8_temp_5_8_40c -40 119.375 /end CHARACTERISTIC
/begin CHARACTERISTIC CAL_revlimit_enforce_delay_after_start "Calibration: revlimit enforce delay after start. Tunable map/constant (not a live channel); log to confirm where and how the rev limiter intervenes. (ms; raw*50)" VALUE 0x400090F3 RL_VALUE_UBYTE 0 CM_u8_time_50ms 0 12750 /end CHARACTERISTIC
/begin CHARACTERISTIC CAL_engine_speed_calc_unknown2 "u16_rspeed_1/4rpm" VALUE 0x400090F4 RL_VALUE_UWORD 0 CM_u16_rspeed_1_4rpm 0 16383.75 /end CHARACTERISTIC
/begin CHARACTERISTIC CAL_idle_underspeed_latch_rpm_delta "u16_rspeed_1/4rpm" VALUE 0x400090F6 RL_VALUE_UWORD 0 CM_u16_rspeed_1_4rpm 0 16383.75 /end CHARACTERISTIC
/begin CHARACTERISTIC CAL_dca_freerev_rpm "Calibration: Drive-Cycle-Assist freerev RPM. Tunable map/constant (not a live channel); log to observe Drive-Cycle-Assist activation (normally off)." VALUE 0x400090F8 RL_VALUE_UBYTE 0 NO_COMPU_METHOD 0 255 /end CHARACTERISTIC
/begin CHARACTERISTIC CAL_exhaust_flap_load1 "Calibration: exhaust flap load1. Tunable map/constant (not a live channel); log to see exhaust bypass valve position (sound/backpressure). (mg/stroke; raw*4)" VALUE 0x400090FA RL_VALUE_UBYTE 0 CM_u8_load_4mg_stroke 0 1020 /end CHARACTERISTIC
/begin CHARACTERISTIC CAL_exhaust_flap_load2 "Calibration: exhaust flap load2. Tunable map/constant (not a live channel); log to see exhaust bypass valve position (sound/backpressure). (mg/stroke; raw*4)" VALUE 0x400090FB RL_VALUE_UBYTE 0 CM_u8_load_4mg_stroke 0 1020 /end CHARACTERISTIC
/begin CHARACTERISTIC CAL_torque_hysteresis_threshold1 "Calibration: torque hysteresis threshold1. Tunable map/constant (not a live channel); log to follow the ECU torque estimate and any torque limiting. (Nm)" VALUE 0x400090FC RL_VALUE_UBYTE 0 CM_u8_torque_nm 0 255 /end CHARACTERISTIC
/begin CHARACTERISTIC CAL_lfb_timer_entry "Calibration: long-term fuel timer entry. Tunable map/constant (not a live channel); log to track long-term fuel learning and spot a developing fuel fault." VALUE 0x400090FE RL_VALUE_UBYTE 0 NO_COMPU_METHOD 0 255 /end CHARACTERISTIC
/begin CHARACTERISTIC CAL_lfb_timer_hold "Calibration: long-term fuel timer hold. Tunable map/constant (not a live channel); log to track long-term fuel learning and spot a developing fuel fault." VALUE 0x400090FF RL_VALUE_UBYTE 0 NO_COMPU_METHOD 0 255 /end CHARACTERISTIC
/begin CHARACTERISTIC CAL_ecu_engine_speed_decel_hysteresis_rpm "uint8_t" VALUE 0x40009100 RL_VALUE_UBYTE 0 NO_COMPU_METHOD 0 255 /end CHARACTERISTIC
/begin CHARACTERISTIC CAL_lfb_tps_max "Calibration: long-term fuel throttle position max. Tunable map/constant (not a live channel); log to track long-term fuel learning and spot a developing fuel fault. (0-1; raw/255)" VALUE 0x40009101 RL_VALUE_UBYTE 0 CM_u8_factor_1_255 0 100 /end CHARACTERISTIC
/begin CHARACTERISTIC CAL_lfb_detect_carspeed_min "Calibration: long-term fuel detect carspeed min. Tunable map/constant (not a live channel); log to track long-term fuel learning and spot a developing fuel fault. (km/h)" VALUE 0x40009102 RL_VALUE_UBYTE 0 CM_u8_speed_kph 0 255 /end CHARACTERISTIC
/begin CHARACTERISTIC CAL_lfb_pedal_override_rate "uint8_t" VALUE 0x40009103 RL_VALUE_UBYTE 0 NO_COMPU_METHOD 0 255 /end CHARACTERISTIC
/begin CHARACTERISTIC CAL_lfb_release_rate "uint8_t" VALUE 0x40009104 RL_VALUE_UBYTE 0 NO_COMPU_METHOD 0 255 /end CHARACTERISTIC
/begin CHARACTERISTIC CAL_lfb_pedal_release_threshold "uint8_t" VALUE 0x40009105 RL_VALUE_UBYTE 0 NO_COMPU_METHOD 0 255 /end CHARACTERISTIC
/begin CHARACTERISTIC CAL_tpssmooth_parking_clutch_threshold "uint8_t" VALUE 0x40009106 RL_VALUE_UBYTE 0 NO_COMPU_METHOD 0 255 /end CHARACTERISTIC
/begin CHARACTERISTIC CAL_lfb_pulse_toggle_period "u8_time_100ms" VALUE 0x40009107 RL_VALUE_UBYTE 0 CM_u8_time_100ms 0 25500 /end CHARACTERISTIC
/begin CHARACTERISTIC CAL_lfb_pulse_enable "Calibration: long-term fuel pulse enable. Tunable map/constant (not a live channel); log to track long-term fuel learning and spot a developing fuel fault." VALUE 0x40009108 RL_VALUE_UBYTE 0 NO_COMPU_METHOD 0 255 /end CHARACTERISTIC
/begin CHARACTERISTIC CAL_lfb_clutch_threshold "Calibration: long-term fuel clutch threshold. Tunable map/constant (not a live channel); log to track long-term fuel learning and spot a developing fuel fault. (V; raw*5/1023)" VALUE 0x4000910A RL_VALUE_UWORD 0 CM_u16_voltage_5_1023v 0 320.307917888563 /end CHARACTERISTIC
/begin CHARACTERISTIC CAL_cruise_resume_pedal_handoff_threshold "u16_factor_1/1023" VALUE 0x4000910C RL_VALUE_UWORD 0 CM_u16_factor_1_1023 0 6406.15835777126 /end CHARACTERISTIC
/begin CHARACTERISTIC CAL_cruise_feedforward_blend_threshold "u8_factor_1/255" VALUE 0x4000910E RL_VALUE_UBYTE 0 CM_u8_factor_1_255 0 100 /end CHARACTERISTIC
/begin CHARACTERISTIC CAL_cooling_fan_iat_mid_timer_threshold "uint8_t" VALUE 0x4000910F RL_VALUE_UBYTE 0 NO_COMPU_METHOD 0 255 /end CHARACTERISTIC
/begin CHARACTERISTIC CAL_cooling_fan_high_iat "Calibration: cooling fan high intake-air temp. Tunable map/constant (not a live channel); log to confirm fans/pumps switch at the right temperatures. (deg C; raw*5/8-40)" VALUE 0x40009110 RL_VALUE_UBYTE 0 CM_u8_temp_5_8_40c -40 119.375 /end CHARACTERISTIC
/begin CHARACTERISTIC CAL_cooling_fan_iat_mid "Calibration: cooling fan intake-air temp mid. Tunable map/constant (not a live channel); log to confirm fans/pumps switch at the right temperatures. (deg C; raw*5/8-40)" VALUE 0x40009111 RL_VALUE_UBYTE 0 CM_u8_temp_5_8_40c -40 119.375 /end CHARACTERISTIC
/begin CHARACTERISTIC CAL_cooling_fan_iat_low "Calibration: cooling fan intake-air temp low. Tunable map/constant (not a live channel); log to confirm fans/pumps switch at the right temperatures. (deg C; raw*5/8-40)" VALUE 0x40009112 RL_VALUE_UBYTE 0 CM_u8_temp_5_8_40c -40 119.375 /end CHARACTERISTIC
/begin CHARACTERISTIC CAL_cooling_fan_carspeed_min "Calibration: cooling fan carspeed min. Tunable map/constant (not a live channel); log to confirm fans/pumps switch at the right temperatures. (km/h)" VALUE 0x40009113 RL_VALUE_UBYTE 0 CM_u8_speed_kph 0 255 /end CHARACTERISTIC
/begin CHARACTERISTIC CAL_idle_low_car_speed_exit "u8_speed_kph" VALUE 0x40009114 RL_VALUE_UBYTE 0 CM_u8_speed_kph 0 255 /end CHARACTERISTIC
/begin CHARACTERISTIC CAL_idle_low_car_speed_enter "u8_speed_kph" VALUE 0x40009115 RL_VALUE_UBYTE 0 CM_u8_speed_kph 0 255 /end CHARACTERISTIC
/begin CHARACTERISTIC CAL_dfco_recovery_enrich_max_rpm "In short: it suppresses the DFCO re-entry enrichment shot at high RPM where it isn't needed, preventing over-fueling during high-RPM overrun recovery." VALUE 0x40009116 RL_VALUE_UWORD 0 CM_u8_rspeed_rpm 0 65535 /end CHARACTERISTIC
/begin CHARACTERISTIC CAL_dfco_recovery_enrich_cooldown_ticks "u16_time_5ms" VALUE 0x40009118 RL_VALUE_UWORD 0 CM_u8_time_5ms 0 327675 /end CHARACTERISTIC
/begin CHARACTERISTIC CAL_oil_pressure_switch_voltage_scaling "u16_voltage_18/1023v" VALUE 0x4000911A RL_VALUE_UWORD 0 CM_u16_voltage_18_1023v 0 1153.10850439883 /end CHARACTERISTIC
/begin CHARACTERISTIC CAL_lfb_brake_off_hold_ticks "uint16_t" VALUE 0x4000911C RL_VALUE_UWORD 0 NO_COMPU_METHOD 0 65535 /end CHARACTERISTIC
/begin CHARACTERISTIC CAL_accessory_output_rpm_inhibit_off "u8_rspeed_4rpm" VALUE 0x4000911E RL_VALUE_UBYTE 0 CM_u8_rspeed_4rpm 0 1020 /end CHARACTERISTIC
/begin CHARACTERISTIC CAL_accessory_output_rpm_inhibit_on "Calibration: seat heater RPM threshold. Tunable map/constant (not a live channel); adjust to change this behavior. (RPM; raw*4)" VALUE 0x4000911F RL_VALUE_UBYTE 0 CM_u8_rspeed_4rpm 0 1020 /end CHARACTERISTIC
/begin CHARACTERISTIC CAL_ac_inhibit_cranking "Calibration: A/C inhibit cranking. Tunable map/constant (not a live channel); log to see A/C clutch engagement and its load/idle impact. (RPM; raw*4)" VAL_BLK 0x40009120 RL_VALUE_UBYTE 0 CM_u8_rspeed_4rpm 0 1020 NUMBER 2 /end CHARACTERISTIC
/begin CHARACTERISTIC CAL_cooling_fan_rpm_inhibit_off "Calibration: cooling fan RPM inhibit off. Tunable map/constant (not a live channel); log to confirm fans/pumps switch at the right temperatures. (RPM; raw*4)" VALUE 0x40009122 RL_VALUE_UBYTE 0 CM_u8_rspeed_4rpm 0 1020 /end CHARACTERISTIC
/begin CHARACTERISTIC CAL_cooling_fan_rpm_inhibit_on "Calibration: cooling fan RPM inhibit on. Tunable map/constant (not a live channel); log to confirm fans/pumps switch at the right temperatures. (RPM; raw*4)" VALUE 0x40009123 RL_VALUE_UBYTE 0 CM_u8_rspeed_4rpm 0 1020 /end CHARACTERISTIC
/begin CHARACTERISTIC CAL_cooling_fan_low_rpm_hysteresis_threshold "uint16_t" VALUE 0x40009124 RL_VALUE_UWORD 0 NO_COMPU_METHOD 0 65535 /end CHARACTERISTIC
/begin CHARACTERISTIC CAL_oil_pressure_switch_offset "uint16_t" VALUE 0x40009126 RL_VALUE_UWORD 0 NO_COMPU_METHOD 0 65535 /end CHARACTERISTIC
/begin CHARACTERISTIC CAL_inj_soak_time_max "uint16_t" VALUE 0x40009128 RL_VALUE_UWORD 0 NO_COMPU_METHOD 0 65535 /end CHARACTERISTIC
/begin CHARACTERISTIC CAL_evap_purge_idle_speed_error_deadband "uint8_t" VALUE 0x4000912A RL_VALUE_UBYTE 0 NO_COMPU_METHOD 0 255 /end CHARACTERISTIC
/begin CHARACTERISTIC CAL_evap_purge_idle_lean_recovery_holdoff_ticks "uint8_t" VALUE 0x4000912B RL_VALUE_UBYTE 0 NO_COMPU_METHOD 0 255 /end CHARACTERISTIC
/begin CHARACTERISTIC CAL_evap_purge_mass_ratio_stft_inhibit_threshold "uint8_t" VALUE 0x4000912C RL_VALUE_UBYTE 0 NO_COMPU_METHOD 0 255 /end CHARACTERISTIC
/begin CHARACTERISTIC CAL_evap_purge_idle_speed_error_deadband_alt "uint8_t" VALUE 0x4000912D RL_VALUE_UBYTE 0 NO_COMPU_METHOD 0 255 /end CHARACTERISTIC
/begin CHARACTERISTIC CAL_inj_post_start_enrichment_decay_divisor "uint8_t" VALUE 0x4000912E RL_VALUE_UBYTE 0 NO_COMPU_METHOD 0 255 /end CHARACTERISTIC
/begin CHARACTERISTIC CAL_cooling_fan_2_after_run_counter_threshold "uint8_t" VALUE 0x4000912F RL_VALUE_UBYTE 0 NO_COMPU_METHOD 0 255 /end CHARACTERISTIC
/begin CHARACTERISTIC CAL_inj_soak_time_max_40009130 "u16_time_100ms" VALUE 0x40009130 RL_VALUE_UWORD 0 CM_u8_time_100ms 0 6553500 /end CHARACTERISTIC
/begin AXIS_PTS CAL_racetc_slip_target_base_X_dpm_level "Slip target: used for RaceTC patch only." 0x40009132 NO_INPUT_QUANTITY RL_AXIS_UBYTE 0 NO_COMPU_METHOD 16 0 255 /end AXIS_PTS
/begin CHARACTERISTIC CAL_racetc_slip_target_base "Slip target: used for RaceTC patch only." CURVE 0x40009142 RL_VALUE_UBYTE 0 CM_u8_slip_1_8pct 0 31.875
 /begin AXIS_DESCR COM_AXIS NO_INPUT_QUANTITY NO_COMPU_METHOD 16 0 255 AXIS_PTS_REF CAL_racetc_slip_target_base_X_dpm_level /end AXIS_DESCR
/end CHARACTERISTIC
/begin CHARACTERISTIC CAL_unused_large1 "byte[376]" VAL_BLK 0x40009152 RL_VALUE_UBYTE 0 NO_COMPU_METHOD 0 255 NUMBER 376 /end CHARACTERISTIC
/begin AXIS_PTS CAL_inj_warmup_factor_ips_X_load "X-axis breakpoints for the 'injector enrichment factor load n coolant IPS' table. Defines the lookup grid (not a live channel); change only when re-axing the map. (mg/stroke; raw*4)" 0x400092CA NO_INPUT_QUANTITY RL_AXIS_UBYTE 0 CM_u8_load_4mg_stroke 12 0 1020 /end AXIS_PTS
/begin AXIS_PTS CAL_inj_warmup_factor_ips_Y_coolant_temp "Y-axis breakpoints for the 'injector enrichment factor load n coolant IPS' table. Defines the lookup grid (not a live channel); change only when re-axing the map. (deg C; raw*5/8-40)" 0x400092D6 NO_INPUT_QUANTITY RL_AXIS_UBYTE 0 CM_u8_temp_5_8_40c 16 -40 119.375 /end AXIS_PTS
/begin CHARACTERISTIC CAL_inj_warmup_factor_ips "Calibration: injector enrichment factor load n coolant IPS. Tunable map/constant (not a live channel); log to verify injector pulse width and fuel delivery vs target. (0-1; raw/64)" MAP 0x400092E6 RL_VALUE_UBYTE 0 CM_u8_factor_1_64 0 398.4375
 /begin AXIS_DESCR COM_AXIS NO_INPUT_QUANTITY CM_u8_load_4mg_stroke 12 0 1020 AXIS_PTS_REF CAL_inj_warmup_factor_ips_X_load /end AXIS_DESCR
 /begin AXIS_DESCR COM_AXIS NO_INPUT_QUANTITY CM_u8_temp_5_8_40c 16 -40 119.375 AXIS_PTS_REF CAL_inj_warmup_factor_ips_Y_coolant_temp /end AXIS_DESCR
/end CHARACTERISTIC
/begin AXIS_PTS CAL_cruise_proportional_gain_ips_X_gear "u8_gear[4]" 0x400093A6 NO_INPUT_QUANTITY RL_AXIS_UBYTE 0 NO_COMPU_METHOD 4 0 255 /end AXIS_PTS
/begin CHARACTERISTIC CAL_cruise_proportional_gain_ips "uint8_t[4]" CURVE 0x400093AA RL_VALUE_UBYTE 0 NO_COMPU_METHOD 0 255
 /begin AXIS_DESCR COM_AXIS NO_INPUT_QUANTITY NO_COMPU_METHOD 4 0 255 AXIS_PTS_REF CAL_cruise_proportional_gain_ips_X_gear /end AXIS_DESCR
/end CHARACTERISTIC
/begin AXIS_PTS CAL_cruise_integral_gain_ips_X_gear "u8_gear[4]" 0x400093AE NO_INPUT_QUANTITY RL_AXIS_UBYTE 0 NO_COMPU_METHOD 4 0 255 /end AXIS_PTS
/begin CHARACTERISTIC CAL_cruise_integral_gain_ips "uint8_t[4]" CURVE 0x400093B2 RL_VALUE_UBYTE 0 NO_COMPU_METHOD 0 255
 /begin AXIS_DESCR COM_AXIS NO_INPUT_QUANTITY NO_COMPU_METHOD 4 0 255 AXIS_PTS_REF CAL_cruise_integral_gain_ips_X_gear /end AXIS_DESCR
/end CHARACTERISTIC
/begin AXIS_PTS CAL_cruise_derivative_gain_ips_X_gear "u8_gear[4]" 0x400093B6 NO_INPUT_QUANTITY RL_AXIS_UBYTE 0 NO_COMPU_METHOD 4 0 255 /end AXIS_PTS
/begin CHARACTERISTIC CAL_cruise_derivative_gain_ips "uint8_t[4]" CURVE 0x400093BA RL_VALUE_UBYTE 0 NO_COMPU_METHOD 0 255
 /begin AXIS_DESCR COM_AXIS NO_INPUT_QUANTITY NO_COMPU_METHOD 4 0 255 AXIS_PTS_REF CAL_cruise_derivative_gain_ips_X_gear /end AXIS_DESCR
/end CHARACTERISTIC
/begin AXIS_PTS CAL_inj_afterstart_comp_air_temp_X_iat "X-axis breakpoints for the 'injector cranking enrichment2' table. Defines the lookup grid (not a live channel); change only when re-axing the map. (deg C; raw*5/8-40)" 0x400093BE NO_INPUT_QUANTITY RL_AXIS_UBYTE 0 CM_u8_temp_5_8_40c 10 -40 119.375 /end AXIS_PTS
/begin AXIS_PTS CAL_inj_afterstart_comp_air_temp_Y_maf_accum "Y-axis breakpoints for the 'injector cranking enrichment2' table. Defines the lookup grid (not a live channel); change only when re-axing the map. (g; raw*8)" 0x400093C8 NO_INPUT_QUANTITY RL_AXIS_UBYTE 0 CM_u8_mass_8g 10 0 2040 /end AXIS_PTS
/begin CHARACTERISTIC CAL_inj_afterstart_comp_air_temp "Calibration: injector cranking enrichment2. Tunable map/constant (not a live channel); log to verify injector pulse width and fuel delivery vs target. (0-1; raw/32)" MAP 0x400093D2 RL_VALUE_UBYTE 0 CM_u8_factor_1_32 0 796.875
 /begin AXIS_DESCR COM_AXIS NO_INPUT_QUANTITY CM_u8_temp_5_8_40c 10 -40 119.375 AXIS_PTS_REF CAL_inj_afterstart_comp_air_temp_X_iat /end AXIS_DESCR
 /begin AXIS_DESCR COM_AXIS NO_INPUT_QUANTITY CM_u8_mass_8g 10 0 2040 AXIS_PTS_REF CAL_inj_afterstart_comp_air_temp_Y_maf_accum /end AXIS_DESCR
/end CHARACTERISTIC
/begin CHARACTERISTIC CAL_sensor_airtemp_TMAF_temp "Calibration: sensor engine air scaling. Tunable map/constant (not a live channel); log the raw sensor signal to check sensor health and range. (deg C; raw*5/8-40)" VAL_BLK 0x40009436 RL_VALUE_UBYTE 0 CM_u8_temp_5_8_40c -40 119.375 NUMBER 34 /end CHARACTERISTIC
/begin CHARACTERISTIC CAL_sensor_coolant_scaling "Calibration: sensor coolant scaling. Tunable map/constant (not a live channel); log the raw sensor signal to check sensor health and range. (deg C; raw*5/8-40)" VAL_BLK 0x40009458 RL_VALUE_UBYTE 0 CM_u8_temp_5_8_40c -40 119.375 NUMBER 34 /end CHARACTERISTIC
/begin CHARACTERISTIC CAL_sensor_airtemp_not_wired "Calibration: sensor intake air scaling. Tunable map/constant (not a live channel); log the raw sensor signal to check sensor health and range. (deg C; raw*5/8-40)" VAL_BLK 0x4000947A RL_VALUE_UBYTE 0 CM_u8_temp_5_8_40c -40 119.375 NUMBER 33 /end CHARACTERISTIC
/begin AXIS_PTS CAL_sensor_fuel_pressure_sensor_unused_X_voltage "u8_voltage_5/255v[16]" 0x4000949C NO_INPUT_QUANTITY RL_AXIS_UBYTE 0 CM_u8_voltage_5_255v 16 0 5 /end AXIS_PTS
/begin CHARACTERISTIC CAL_sensor_fuel_pressure_sensor_unused "uint8_t[16]" CURVE 0x400094AC RL_VALUE_UBYTE 0 NO_COMPU_METHOD 0 255
 /begin AXIS_DESCR COM_AXIS NO_INPUT_QUANTITY CM_u8_voltage_5_255v 16 0 5 AXIS_PTS_REF CAL_sensor_fuel_pressure_sensor_unused_X_voltage /end AXIS_DESCR
/end CHARACTERISTIC
/begin AXIS_PTS CAL_dfco_entry_rpm_manual_X_coolant_temp "X-axis breakpoints for the 'DFCO entry RPM manual' table. Defines the lookup grid (not a live channel); change only when re-axing the map. (deg C; raw*5/8-40)" 0x400094BC NO_INPUT_QUANTITY RL_AXIS_UBYTE 0 CM_u8_temp_5_8_40c 4 -40 119.375 /end AXIS_PTS
/begin CHARACTERISTIC CAL_dfco_entry_rpm_manual "Calibration: DFCO entry RPM manual. Tunable map/constant (not a live channel); log to see when fuel is cut and restored on deceleration. (RPM; raw*10)" CURVE 0x400094C0 RL_VALUE_UBYTE 0 CM_u8_rspeed_10rpm 0 2550
 /begin AXIS_DESCR COM_AXIS NO_INPUT_QUANTITY CM_u8_temp_5_8_40c 4 -40 119.375 AXIS_PTS_REF CAL_dfco_entry_rpm_manual_X_coolant_temp /end AXIS_DESCR
/end CHARACTERISTIC
/begin AXIS_PTS CAL_dfco_exit_rpm_ingear_manual_X_coolant_temp "X-axis breakpoints for the 'DFCO exit RPM ingear manual' table. Defines the lookup grid (not a live channel); change only when re-axing the map. (deg C; raw*5/8-40)" 0x400094C4 NO_INPUT_QUANTITY RL_AXIS_UBYTE 0 CM_u8_temp_5_8_40c 4 -40 119.375 /end AXIS_PTS
/begin CHARACTERISTIC CAL_dfco_exit_rpm_ingear_manual "Calibration: DFCO exit RPM ingear manual. Tunable map/constant (not a live channel); log to see when fuel is cut and restored on deceleration. (RPM; raw*10)" CURVE 0x400094C8 RL_VALUE_UBYTE 0 CM_u8_rspeed_10rpm 0 2550
 /begin AXIS_DESCR COM_AXIS NO_INPUT_QUANTITY CM_u8_temp_5_8_40c 4 -40 119.375 AXIS_PTS_REF CAL_dfco_exit_rpm_ingear_manual_X_coolant_temp /end AXIS_DESCR
/end CHARACTERISTIC
/begin AXIS_PTS CAL_dfco_exit_rpm_neutral_X_coolant_temp "X-axis breakpoints for the 'DFCO exit RPM neutral' table. Defines the lookup grid (not a live channel); change only when re-axing the map. (deg C; raw*5/8-40)" 0x400094CC NO_INPUT_QUANTITY RL_AXIS_UBYTE 0 CM_u8_temp_5_8_40c 4 -40 119.375 /end AXIS_PTS
/begin CHARACTERISTIC CAL_dfco_exit_rpm_neutral "Calibration: DFCO exit RPM neutral. Tunable map/constant (not a live channel); log to see when fuel is cut and restored on deceleration. (RPM; raw*10)" CURVE 0x400094D0 RL_VALUE_UBYTE 0 CM_u8_rspeed_10rpm 0 2550
 /begin AXIS_DESCR COM_AXIS NO_INPUT_QUANTITY CM_u8_temp_5_8_40c 4 -40 119.375 AXIS_PTS_REF CAL_dfco_exit_rpm_neutral_X_coolant_temp /end AXIS_DESCR
/end CHARACTERISTIC
/begin AXIS_PTS CAL_idle_air_decay_period_X_phase "uint8_t[5]" 0x400094D4 NO_INPUT_QUANTITY RL_AXIS_UBYTE 0 NO_COMPU_METHOD 5 0 255 /end AXIS_PTS
/begin CHARACTERISTIC CAL_idle_air_decay_period "u8_time_ms[5]" CURVE 0x400094D9 RL_VALUE_UBYTE 0 CM_u8_time_ms 0 255
 /begin AXIS_DESCR COM_AXIS NO_INPUT_QUANTITY NO_COMPU_METHOD 5 0 255 AXIS_PTS_REF CAL_idle_air_decay_period_X_phase /end AXIS_DESCR
/end CHARACTERISTIC
/begin AXIS_PTS CAL_ign_comp_coldstart_X_coolant_temp "X-axis breakpoints for the 'ignition compensation coldstart' table. Defines the lookup grid (not a live channel); change only when re-axing the map. (deg C; raw*5/8-40)" 0x400094DE NO_INPUT_QUANTITY RL_AXIS_UBYTE 0 CM_u8_temp_5_8_40c 8 -40 119.375 /end AXIS_PTS
/begin CHARACTERISTIC CAL_ign_comp_coldstart "Calibration: ignition compensation coldstart. Tunable map/constant (not a live channel); log spark advance to confirm the timing strategy and headroom to knock. (deg; raw/4-10)" CURVE 0x400094E6 RL_VALUE_UBYTE 0 CM_u8_angle_1_4_10deg -10 53.75
 /begin AXIS_DESCR COM_AXIS NO_INPUT_QUANTITY CM_u8_temp_5_8_40c 8 -40 119.375 AXIS_PTS_REF CAL_ign_comp_coldstart_X_coolant_temp /end AXIS_DESCR
/end CHARACTERISTIC
/begin CHARACTERISTIC CAL_obd_ii_freeze_frame_pid_list "ushort[8]" VAL_BLK 0x400094EE RL_VALUE_UWORD 0 NO_COMPU_METHOD 0 65535 NUMBER 8 /end CHARACTERISTIC
/begin AXIS_PTS CAL_ips_revmatch_p_gain_X_rpm "X-axis breakpoints for the 'IPS revmatch target RPM' table. Defines the lookup grid (not a live channel); change only when re-axing the map. (RPM)" 0x400094FE NO_INPUT_QUANTITY RL_AXIS_UWORD 0 CM_u8_rspeed_rpm 4 0 65535 /end AXIS_PTS
/begin CHARACTERISTIC CAL_ips_revmatch_p_gain "Calibration: IPS revmatch target RPM. Tunable map/constant (not a live channel); log to follow IPS automated-manual shift behavior." CURVE 0x40009506 RL_VALUE_UWORD 0 NO_COMPU_METHOD 0 65535
 /begin AXIS_DESCR COM_AXIS NO_INPUT_QUANTITY CM_u8_rspeed_rpm 4 0 65535 AXIS_PTS_REF CAL_ips_revmatch_p_gain_X_rpm /end AXIS_DESCR
/end CHARACTERISTIC
/begin AXIS_PTS CAL_dfco_entry_rpm_manual_alt_X_coolant_temp "X-axis breakpoints for the 'DFCO entry RPM manual alt' table. Defines the lookup grid (not a live channel); change only when re-axing the map. (deg C; raw*5/8-40)" 0x4000950E NO_INPUT_QUANTITY RL_AXIS_UBYTE 0 CM_u8_temp_5_8_40c 4 -40 119.375 /end AXIS_PTS
/begin CHARACTERISTIC CAL_dfco_entry_rpm_manual_alt "Calibration: DFCO entry RPM manual alt. Tunable map/constant (not a live channel); log to see when fuel is cut and restored on deceleration. (RPM; raw*10)" CURVE 0x40009512 RL_VALUE_UBYTE 0 CM_u8_rspeed_10rpm 0 2550
 /begin AXIS_DESCR COM_AXIS NO_INPUT_QUANTITY CM_u8_temp_5_8_40c 4 -40 119.375 AXIS_PTS_REF CAL_dfco_entry_rpm_manual_alt_X_coolant_temp /end AXIS_DESCR
/end CHARACTERISTIC
/begin AXIS_PTS CAL_ac_load_limit_X_rpm "X-axis breakpoints for the 'A/C load limit' table. Defines the lookup grid (not a live channel); change only when re-axing the map. (RPM; raw*125/4+500)" 0x40009518 NO_INPUT_QUANTITY RL_AXIS_UBYTE 0 CM_u8_rspeed_125_4_500rpm 4 500 8468.75 /end AXIS_PTS
/begin CHARACTERISTIC CAL_ac_load_limit "Calibration: A/C load limit. Tunable map/constant (not a live channel); log engine load -- the main axis for fueling and ignition." CURVE 0x4000951C RL_VALUE_UBYTE 0 NO_COMPU_METHOD 0 255
 /begin AXIS_DESCR COM_AXIS NO_INPUT_QUANTITY CM_u8_rspeed_125_4_500rpm 4 500 8468.75 AXIS_PTS_REF CAL_ac_load_limit_X_rpm /end AXIS_DESCR
/end CHARACTERISTIC
/begin AXIS_PTS CAL_idle_comp_iat_X_iat "X-axis breakpoints for the 'idle compensation intake-air temp' table. Defines the lookup grid (not a live channel); change only when re-axing the map. (deg C; raw*5/8-40)" 0x40009526 NO_INPUT_QUANTITY RL_AXIS_UBYTE 0 CM_u8_temp_5_8_40c 8 -40 119.375 /end AXIS_PTS
/begin CHARACTERISTIC CAL_idle_comp_iat "Calibration: idle compensation intake-air temp. Tunable map/constant (not a live channel); log to diagnose idle quality, hunting, and stalls. (RPM)" CURVE 0x4000952E RL_VALUE_UBYTE 0 CM_u8_rspeed_rpm 0 255
 /begin AXIS_DESCR COM_AXIS NO_INPUT_QUANTITY CM_u8_temp_5_8_40c 8 -40 119.375 AXIS_PTS_REF CAL_idle_comp_iat_X_iat /end AXIS_DESCR
/end CHARACTERISTIC
/begin AXIS_PTS CAL_cruise_proportional_gain_manual_X_gear "u8_gear[4]" 0x40009536 NO_INPUT_QUANTITY RL_AXIS_UBYTE 0 NO_COMPU_METHOD 4 0 255 /end AXIS_PTS
/begin CHARACTERISTIC CAL_cruise_proportional_gain_manual "P term = kp * err(0.01 km/h) / 10 in 10 mg/s" CURVE 0x4000953A RL_VALUE_UBYTE 0 NO_COMPU_METHOD 0 255
 /begin AXIS_DESCR COM_AXIS NO_INPUT_QUANTITY NO_COMPU_METHOD 4 0 255 AXIS_PTS_REF CAL_cruise_proportional_gain_manual_X_gear /end AXIS_DESCR
/end CHARACTERISTIC
/begin AXIS_PTS CAL_cruise_integral_gain_manual_X_gear "u8_gear[4]" 0x4000953E NO_INPUT_QUANTITY RL_AXIS_UBYTE 0 NO_COMPU_METHOD 4 0 255 /end AXIS_PTS
/begin CHARACTERISTIC CAL_cruise_integral_gain_manual "I term = ki * cruise_speed_error_integral / 100" CURVE 0x40009542 RL_VALUE_UBYTE 0 NO_COMPU_METHOD 0 255
 /begin AXIS_DESCR COM_AXIS NO_INPUT_QUANTITY NO_COMPU_METHOD 4 0 255 AXIS_PTS_REF CAL_cruise_integral_gain_manual_X_gear /end AXIS_DESCR
/end CHARACTERISTIC
/begin AXIS_PTS CAL_cruise_derivative_gain_manual_X_gear "u8_gear[4]" 0x40009546 NO_INPUT_QUANTITY RL_AXIS_UBYTE 0 NO_COMPU_METHOD 4 0 255 /end AXIS_PTS
/begin CHARACTERISTIC CAL_cruise_derivative_gain_manual "D term = kd * cruise_speed_error_rate" CURVE 0x4000954A RL_VALUE_UBYTE 0 NO_COMPU_METHOD 0 255
 /begin AXIS_DESCR COM_AXIS NO_INPUT_QUANTITY NO_COMPU_METHOD 4 0 255 AXIS_PTS_REF CAL_cruise_derivative_gain_manual_X_gear /end AXIS_DESCR
/end CHARACTERISTIC
/begin CHARACTERISTIC CAL_dfco_recovery_enrich_X_cut_duration "uint8_t[16]" VAL_BLK 0x4000954E RL_VALUE_UBYTE 0 NO_COMPU_METHOD 0 255 NUMBER 16 /end CHARACTERISTIC
/begin AXIS_PTS CAL_ign_comp_idle_error_moving_X_idle_speed_error "X-axis breakpoints for the 'ignition compensation idle error moving' table. Defines the lookup grid (not a live channel); change only when re-axing the map. (RPM; raw*4-512)" 0x40009560 NO_INPUT_QUANTITY RL_AXIS_UBYTE 0 CM_u8_rspeed_4_512rpm 16 -512 508 /end AXIS_PTS
/begin CHARACTERISTIC CAL_ign_comp_idle_error_moving "Calibration: ignition compensation idle error moving. Tunable map/constant (not a live channel); log spark advance to confirm the timing strategy and headroom to knock. (deg; raw/4-32)" CURVE 0x40009570 RL_VALUE_UBYTE 0 CM_u8_angle_1_4_32deg -32 31.75
 /begin AXIS_DESCR COM_AXIS NO_INPUT_QUANTITY CM_u8_rspeed_4_512rpm 16 -512 508 AXIS_PTS_REF CAL_ign_comp_idle_error_moving_X_idle_speed_error /end AXIS_DESCR
/end CHARACTERISTIC
/begin AXIS_PTS CAL_ign_advance_step_tps_X_engine_speed "X-axis breakpoints for the 'ignition advance step throttle position' table. Defines the lookup grid (not a live channel); change only when re-axing the map. (RPM; raw*125/4+500)" 0x40009580 NO_INPUT_QUANTITY RL_AXIS_UBYTE 0 CM_u8_rspeed_125_4_500rpm 8 500 8468.75 /end AXIS_PTS
/begin AXIS_PTS CAL_ign_advance_step_tps_Y_pedal_pos "Y-axis breakpoints for the 'ignition advance step throttle position' table. Defines the lookup grid (not a live channel); change only when re-axing the map. (0-1; raw/255)" 0x40009588 NO_INPUT_QUANTITY RL_AXIS_UBYTE 0 CM_u8_factor_1_255 16 0 100 /end AXIS_PTS
/begin CHARACTERISTIC CAL_ign_advance_step_tps "Calibration: ignition advance step throttle position. Tunable map/constant (not a live channel); log spark advance to confirm the timing strategy and headroom to knock. (deg; raw/4)" MAP 0x40009598 RL_VALUE_SBYTE 0 CM_u8_angle_1_4deg -32 31.75
 /begin AXIS_DESCR COM_AXIS NO_INPUT_QUANTITY CM_u8_rspeed_125_4_500rpm 8 500 8468.75 AXIS_PTS_REF CAL_ign_advance_step_tps_X_engine_speed /end AXIS_DESCR
 /begin AXIS_DESCR COM_AXIS NO_INPUT_QUANTITY CM_u8_factor_1_255 16 0 100 AXIS_PTS_REF CAL_ign_advance_step_tps_Y_pedal_pos /end AXIS_DESCR
/end CHARACTERISTIC
/begin AXIS_PTS CAL_idle_comp_baro_X_baro "X-axis breakpoints for the 'idle compensation barometric' table. Defines the lookup grid (not a live channel); change only when re-axing the map. (mbar; raw*4)" 0x40009618 NO_INPUT_QUANTITY RL_AXIS_UBYTE 0 CM_u8_pressure_4mbar 8 0 1020 /end AXIS_PTS
/begin CHARACTERISTIC CAL_idle_comp_baro "Calibration: idle compensation barometric. Tunable map/constant (not a live channel); log to diagnose idle quality, hunting, and stalls. (RPM; raw-128)" CURVE 0x40009620 RL_VALUE_UBYTE 0 NO_COMPU_METHOD 0 255
 /begin AXIS_DESCR COM_AXIS NO_INPUT_QUANTITY CM_u8_pressure_4mbar 8 0 1020 AXIS_PTS_REF CAL_idle_comp_baro_X_baro /end AXIS_DESCR
/end CHARACTERISTIC
/begin AXIS_PTS CAL_engine_speed_filter_coeff_by_coolant_X_coolant "u8_temp_5/8-40c[4]" 0x40009628 NO_INPUT_QUANTITY RL_AXIS_UBYTE 0 CM_u8_temp_5_8_40c 4 -40 119.375 /end AXIS_PTS
/begin CHARACTERISTIC CAL_engine_speed_filter_coeff_by_coolant "u8_factor_1/255[4]" CURVE 0x4000962C RL_VALUE_UBYTE 0 CM_u8_factor_1_255 0 100
 /begin AXIS_DESCR COM_AXIS NO_INPUT_QUANTITY CM_u8_temp_5_8_40c 4 -40 119.375 AXIS_PTS_REF CAL_engine_speed_filter_coeff_by_coolant_X_coolant /end AXIS_DESCR
/end CHARACTERISTIC
/begin CHARACTERISTIC CAL_closedloop_activate_engine_timer "Calibration: closedloop activate engine timer. Tunable map/constant (not a live channel); log to watch O2 feedback trim the mixture and confirm the loop is active. (s)" VAL_BLK 0x40009632 RL_VALUE_UBYTE 0 CM_u8_time_s 0 255 NUMBER 16 /end CHARACTERISTIC
/begin AXIS_PTS CAL_vvt_intake_advance_base_X_rpm "X-axis breakpoints for the 'VVT intake advance base' table. Defines the lookup grid (not a live channel); change only when re-axing the map. (RPM; raw*125/4+500)" 0x4000964A NO_INPUT_QUANTITY RL_AXIS_UBYTE 0 CM_u8_rspeed_125_4_500rpm 16 500 8468.75 /end AXIS_PTS
/begin AXIS_PTS CAL_vvt_intake_advance_base_Y_load "Y-axis breakpoints for the 'VVT intake advance base' table. Defines the lookup grid (not a live channel); change only when re-axing the map. (mg/stroke; raw*4)" 0x4000965A NO_INPUT_QUANTITY RL_AXIS_UBYTE 0 CM_u8_load_4mg_stroke 16 0 1020 /end AXIS_PTS
/begin CHARACTERISTIC CAL_vvt_intake_advance_base "Calibration: VVT intake advance base. Tunable map/constant (not a live channel); log commanded vs actual cam timing to verify VVT response. (deg; raw/4)" MAP 0x4000966A RL_VALUE_UBYTE 0 CM_u8_angle_1_4deg 0 63.75
 /begin AXIS_DESCR COM_AXIS NO_INPUT_QUANTITY CM_u8_rspeed_125_4_500rpm 16 500 8468.75 AXIS_PTS_REF CAL_vvt_intake_advance_base_X_rpm /end AXIS_DESCR
 /begin AXIS_DESCR COM_AXIS NO_INPUT_QUANTITY CM_u8_load_4mg_stroke 16 0 1020 AXIS_PTS_REF CAL_vvt_intake_advance_base_Y_load /end AXIS_DESCR
/end CHARACTERISTIC
/begin AXIS_PTS CAL_vvt_intake_advance_coolant_offset_X_coolant_temp "X-axis breakpoints for the 'VVT intake advance coolant offset' table. Defines the lookup grid (not a live channel); change only when re-axing the map. (deg C; raw*5/8-40)" 0x4000976A NO_INPUT_QUANTITY RL_AXIS_UBYTE 0 CM_u8_temp_5_8_40c 16 -40 119.375 /end AXIS_PTS
/begin CHARACTERISTIC CAL_vvt_intake_advance_coolant_offset "Calibration: VVT intake advance coolant offset. Tunable map/constant (not a live channel); log commanded vs actual cam timing to verify VVT response. (deg; raw/4)" CURVE 0x4000977A RL_VALUE_UBYTE 0 CM_u8_angle_1_4deg 0 63.75
 /begin AXIS_DESCR COM_AXIS NO_INPUT_QUANTITY CM_u8_temp_5_8_40c 16 -40 119.375 AXIS_PTS_REF CAL_vvt_intake_advance_coolant_offset_X_coolant_temp /end AXIS_DESCR
/end CHARACTERISTIC
/begin AXIS_PTS CAL_inj_afterstart_enrichment_coolant_manual_X_coolant "X-axis breakpoints for the 'injector cranking enrichment coolant manual' table. Defines the lookup grid (not a live channel); change only when re-axing the map. (deg C; raw*5/8-40)" 0x4000978A NO_INPUT_QUANTITY RL_AXIS_UBYTE 0 CM_u8_temp_5_8_40c 12 -40 119.375 /end AXIS_PTS
/begin AXIS_PTS CAL_inj_afterstart_enrichment_coolant_manual_Y_maf_accum "Y-axis breakpoints for the 'injector cranking enrichment coolant manual' table. Defines the lookup grid (not a live channel); change only when re-axing the map. (g)" 0x40009796 NO_INPUT_QUANTITY RL_AXIS_UBYTE 0 CM_u16_mass_g 14 0 255 /end AXIS_PTS
/begin CHARACTERISTIC CAL_inj_afterstart_enrichment_coolant_manual "Calibration: injector cranking enrichment coolant manual. Tunable map/constant (not a live channel); log to verify injector pulse width and fuel delivery vs target. (0-1; raw/32)" MAP 0x400097A4 RL_VALUE_UBYTE 0 CM_u8_factor_1_32 0 796.875
 /begin AXIS_DESCR COM_AXIS NO_INPUT_QUANTITY CM_u8_temp_5_8_40c 12 -40 119.375 AXIS_PTS_REF CAL_inj_afterstart_enrichment_coolant_manual_X_coolant /end AXIS_DESCR
 /begin AXIS_DESCR COM_AXIS NO_INPUT_QUANTITY CM_u16_mass_g 14 0 255 AXIS_PTS_REF CAL_inj_afterstart_enrichment_coolant_manual_Y_maf_accum /end AXIS_DESCR
/end CHARACTERISTIC
/begin AXIS_PTS CAL_inj_afterstart_enrichment_coolant_ips_X_coolant "X-axis breakpoints for the 'injector cranking enrichment coolant IPS' table. Defines the lookup grid (not a live channel); change only when re-axing the map. (deg C; raw*5/8-40)" 0x4000984C NO_INPUT_QUANTITY RL_AXIS_UBYTE 0 CM_u8_temp_5_8_40c 12 -40 119.375 /end AXIS_PTS
/begin AXIS_PTS CAL_inj_afterstart_enrichment_coolant_ips_Y_maf_accum "Y-axis breakpoints for the 'injector cranking enrichment coolant IPS' table. Defines the lookup grid (not a live channel); change only when re-axing the map. (g)" 0x40009858 NO_INPUT_QUANTITY RL_AXIS_UBYTE 0 CM_u16_mass_g 14 0 255 /end AXIS_PTS
/begin CHARACTERISTIC CAL_inj_afterstart_enrichment_coolant_ips "Calibration: injector cranking enrichment coolant IPS. Tunable map/constant (not a live channel); log to verify injector pulse width and fuel delivery vs target. (0-1; raw/32)" MAP 0x40009866 RL_VALUE_UBYTE 0 CM_u8_factor_1_32 0 796.875
 /begin AXIS_DESCR COM_AXIS NO_INPUT_QUANTITY CM_u8_temp_5_8_40c 12 -40 119.375 AXIS_PTS_REF CAL_inj_afterstart_enrichment_coolant_ips_X_coolant /end AXIS_DESCR
 /begin AXIS_DESCR COM_AXIS NO_INPUT_QUANTITY CM_u16_mass_g 14 0 255 AXIS_PTS_REF CAL_inj_afterstart_enrichment_coolant_ips_Y_maf_accum /end AXIS_DESCR
/end CHARACTERISTIC
/begin AXIS_PTS CAL_torque_engine_ac_load_base_X_ac "X-axis breakpoints for the 'torque engine A/C load base' table. Defines the lookup grid (not a live channel); change only when re-axing the map." 0x4000990E NO_INPUT_QUANTITY RL_AXIS_UBYTE 0 NO_COMPU_METHOD 16 0 255 /end AXIS_PTS
/begin CHARACTERISTIC CAL_torque_engine_ac_load_base "Calibration: torque engine A/C load base. Tunable map/constant (not a live channel); log to follow the ECU torque estimate and any torque limiting." CURVE 0x4000991E RL_VALUE_UBYTE 0 NO_COMPU_METHOD 0 255
 /begin AXIS_DESCR COM_AXIS NO_INPUT_QUANTITY NO_COMPU_METHOD 16 0 255 AXIS_PTS_REF CAL_torque_engine_ac_load_base_X_ac /end AXIS_DESCR
/end CHARACTERISTIC
/begin AXIS_PTS CAL_load_alphaN_engine_off_X_tps "X-axis breakpoints for the 'load alphaN seed' table. Defines the lookup grid (not a live channel); change only when re-axing the map. (0-1; raw/255)" 0x40009932 NO_INPUT_QUANTITY RL_AXIS_UBYTE 0 CM_u8_factor_1_255 16 0 100 /end AXIS_PTS
/begin CHARACTERISTIC CAL_load_alphaN_engine_off "Calibration: load alphaN seed. Tunable map/constant (not a live channel); log engine load -- the main axis for fueling and ignition. (mg/stroke; raw*4)" CURVE 0x40009942 RL_VALUE_UBYTE 0 CM_u8_load_4mg_stroke 0 1020
 /begin AXIS_DESCR COM_AXIS NO_INPUT_QUANTITY CM_u8_factor_1_255 16 0 100 AXIS_PTS_REF CAL_load_alphaN_engine_off_X_tps /end AXIS_DESCR
/end CHARACTERISTIC
/begin AXIS_PTS CAL_dfco_entry_rpm_ips_X_coolant_temp "X-axis breakpoints for the 'DFCO entry RPM IPS' table. Defines the lookup grid (not a live channel); change only when re-axing the map. (deg C; raw*5/8-40)" 0x40009962 NO_INPUT_QUANTITY RL_AXIS_UBYTE 0 CM_u8_temp_5_8_40c 4 -40 119.375 /end AXIS_PTS
/begin CHARACTERISTIC CAL_dfco_entry_rpm_ips "Calibration: DFCO entry RPM IPS. Tunable map/constant (not a live channel); log to see when fuel is cut and restored on deceleration. (RPM; raw*10)" CURVE 0x40009966 RL_VALUE_UBYTE 0 CM_u8_rspeed_10rpm 0 2550
 /begin AXIS_DESCR COM_AXIS NO_INPUT_QUANTITY CM_u8_temp_5_8_40c 4 -40 119.375 AXIS_PTS_REF CAL_dfco_entry_rpm_ips_X_coolant_temp /end AXIS_DESCR
/end CHARACTERISTIC
/begin AXIS_PTS CAL_dfco_exit_rpm_ingear_ips_X_coolant_temp "X-axis breakpoints for the 'DFCO exit RPM ingear IPS' table. Defines the lookup grid (not a live channel); change only when re-axing the map. (deg C; raw*5/8-40)" 0x4000996A NO_INPUT_QUANTITY RL_AXIS_UBYTE 0 CM_u8_temp_5_8_40c 4 -40 119.375 /end AXIS_PTS
/begin CHARACTERISTIC CAL_dfco_exit_rpm_ingear_ips "Calibration: DFCO exit RPM ingear IPS. Tunable map/constant (not a live channel); log to see when fuel is cut and restored on deceleration. (RPM; raw*10)" CURVE 0x4000996E RL_VALUE_UBYTE 0 CM_u8_rspeed_10rpm 0 2550
 /begin AXIS_DESCR COM_AXIS NO_INPUT_QUANTITY CM_u8_temp_5_8_40c 4 -40 119.375 AXIS_PTS_REF CAL_dfco_exit_rpm_ingear_ips_X_coolant_temp /end AXIS_DESCR
/end CHARACTERISTIC
/begin AXIS_PTS CAL_ign_comp_iat_load_scaler_X_load "X-axis breakpoints for the 'ignition compensation intake-air temp load scaler' table. Defines the lookup grid (not a live channel); change only when re-axing the map. (mg/stroke; raw*4)" 0x40009972 NO_INPUT_QUANTITY RL_AXIS_UBYTE 0 CM_u8_load_4mg_stroke 16 0 1020 /end AXIS_PTS
/begin CHARACTERISTIC CAL_ign_comp_iat_load_scaler "Calibration: ignition compensation intake-air temp load scaler. Tunable map/constant (not a live channel); log spark advance to confirm the timing strategy and headroom to knock. (0-1; raw/128)" CURVE 0x40009982 RL_VALUE_UBYTE 0 CM_u8_factor_1_128 0 199.21875
 /begin AXIS_DESCR COM_AXIS NO_INPUT_QUANTITY CM_u8_load_4mg_stroke 16 0 1020 AXIS_PTS_REF CAL_ign_comp_iat_load_scaler_X_load /end AXIS_DESCR
/end CHARACTERISTIC
/begin AXIS_PTS CAL_idle_target_manual_tour_X_coolant_temp "X-axis breakpoints for the 'idle target manual tour' table. Defines the lookup grid (not a live channel); change only when re-axing the map. (deg C; raw*5/8-40)" 0x40009992 NO_INPUT_QUANTITY RL_AXIS_UBYTE 0 CM_u8_temp_5_8_40c 16 -40 119.375 /end AXIS_PTS
/begin CHARACTERISTIC CAL_idle_target_manual_tour "Calibration: idle target manual tour. Tunable map/constant (not a live channel); log to diagnose idle quality, hunting, and stalls. (RPM; raw*4+500)" CURVE 0x400099A2 RL_VALUE_UBYTE 0 CM_u8_rspeed_4_500rpm 500 1520
 /begin AXIS_DESCR COM_AXIS NO_INPUT_QUANTITY CM_u8_temp_5_8_40c 16 -40 119.375 AXIS_PTS_REF CAL_idle_target_manual_tour_X_coolant_temp /end AXIS_DESCR
/end CHARACTERISTIC
/begin AXIS_PTS CAL_idle_air_warmup_factor_manual_X_coolant_temp "u8_temp_5/8-40c[16]" 0x400099B2 NO_INPUT_QUANTITY RL_AXIS_UBYTE 0 CM_u8_temp_5_8_40c 16 -40 119.375 /end AXIS_PTS
/begin AXIS_PTS CAL_idle_air_warmup_factor_manual_Y_maf_accumulated "uint8_t[8]" 0x400099C2 NO_INPUT_QUANTITY RL_AXIS_UBYTE 0 NO_COMPU_METHOD 8 0 255 /end AXIS_PTS
/begin CHARACTERISTIC CAL_idle_air_warmup_factor_manual "u8_factor_1/64[128]" MAP 0x400099CA RL_VALUE_UBYTE 0 CM_u8_factor_1_64 0 398.4375
 /begin AXIS_DESCR COM_AXIS NO_INPUT_QUANTITY CM_u8_temp_5_8_40c 16 -40 119.375 AXIS_PTS_REF CAL_idle_air_warmup_factor_manual_X_coolant_temp /end AXIS_DESCR
 /begin AXIS_DESCR COM_AXIS NO_INPUT_QUANTITY NO_COMPU_METHOD 8 0 255 AXIS_PTS_REF CAL_idle_air_warmup_factor_manual_Y_maf_accumulated /end AXIS_DESCR
/end CHARACTERISTIC
/begin AXIS_PTS CAL_idle_comp_ecu_voltage_X_voltage "X-axis breakpoints for the 'idle compensation ECU voltage' table. Defines the lookup grid (not a live channel); change only when re-axing the map. (V; raw*5/255)" 0x40009A4A NO_INPUT_QUANTITY RL_AXIS_UBYTE 0 CM_u8_voltage_5_255v 8 0 5 /end AXIS_PTS
/begin CHARACTERISTIC CAL_idle_comp_ecu_voltage "Calibration: idle compensation ECU voltage. Tunable map/constant (not a live channel); log to diagnose idle quality, hunting, and stalls." CURVE 0x40009A52 RL_VALUE_UBYTE 0 NO_COMPU_METHOD 0 255
 /begin AXIS_DESCR COM_AXIS NO_INPUT_QUANTITY CM_u8_voltage_5_255v 8 0 5 AXIS_PTS_REF CAL_idle_comp_ecu_voltage_X_voltage /end AXIS_DESCR
/end CHARACTERISTIC
/begin AXIS_PTS CAL_tpssmooth_increment_sport_driving_X_tps_rate "X-axis breakpoints for the 'tpssmooth increment sport driving' table. Defines the lookup grid (not a live channel); change only when re-axing the map. (0-1; raw/255)" 0x40009A5A NO_INPUT_QUANTITY RL_AXIS_UBYTE 0 CM_u8_factor_1_255 8 0 100 /end AXIS_PTS
/begin CHARACTERISTIC CAL_tpssmooth_increment_sport_driving "Calibration: tpssmooth increment sport driving. Tunable map/constant (not a live channel); log to see throttle-signal smoothing/filtering behavior. (0-1; raw/1023)" CURVE 0x40009A62 RL_VALUE_UBYTE 0 CM_u16_factor_1_1023 0 24.9266862170088
 /begin AXIS_DESCR COM_AXIS NO_INPUT_QUANTITY CM_u8_factor_1_255 8 0 100 AXIS_PTS_REF CAL_tpssmooth_increment_sport_driving_X_tps_rate /end AXIS_DESCR
/end CHARACTERISTIC
/begin AXIS_PTS CAL_idle_air_prop_gain_X_speed_error "X-axis breakpoints for the 'idle air prop gain' table. Defines the lookup grid (not a live channel); change only when re-axing the map." 0x40009A6A NO_INPUT_QUANTITY RL_AXIS_UBYTE 0 NO_COMPU_METHOD 16 0 255 /end AXIS_PTS
/begin CHARACTERISTIC CAL_idle_air_prop_gain "Calibration: idle air prop gain. Tunable map/constant (not a live channel); log to diagnose idle quality, hunting, and stalls. (0-1; raw/255)" CURVE 0x40009A7A RL_VALUE_UBYTE 0 CM_u8_factor_1_255 0 100
 /begin AXIS_DESCR COM_AXIS NO_INPUT_QUANTITY NO_COMPU_METHOD 16 0 255 AXIS_PTS_REF CAL_idle_air_prop_gain_X_speed_error /end AXIS_DESCR
/end CHARACTERISTIC
/begin AXIS_PTS CAL_idle_air_integral_step_X_speed_error "X-axis breakpoints for the 'idle air integral step' table. Defines the lookup grid (not a live channel); change only when re-axing the map. (0-1; raw/255)" 0x40009A8A NO_INPUT_QUANTITY RL_AXIS_UBYTE 0 CM_u8_factor_1_255 16 0 100 /end AXIS_PTS
/begin CHARACTERISTIC CAL_idle_air_integral_step "Calibration: idle air integral step. Tunable map/constant (not a live channel); log to diagnose idle quality, hunting, and stalls. (0-1; raw/255)" CURVE 0x40009A9A RL_VALUE_UBYTE 0 CM_u8_factor_1_255 0 100
 /begin AXIS_DESCR COM_AXIS NO_INPUT_QUANTITY CM_u8_factor_1_255 16 0 100 AXIS_PTS_REF CAL_idle_air_integral_step_X_speed_error /end AXIS_DESCR
/end CHARACTERISTIC
/begin AXIS_PTS CAL_ign_comp_coolant_manual_cam_base_X_coolant_temp "X-axis breakpoints for the 'ignition compensation coolant manual1' table. Defines the lookup grid (not a live channel); change only when re-axing the map. (deg C; raw*5/8-40)" 0x40009AAA NO_INPUT_QUANTITY RL_AXIS_UBYTE 0 CM_u8_temp_5_8_40c 16 -40 119.375 /end AXIS_PTS
/begin CHARACTERISTIC CAL_ign_comp_coolant_manual_cam_base "Coolant-temperature ignition advance offset (u8_angle_1/4deg, advance-only) added to final spark timing in the idle and cruise ignition modes on manual-gearbox cars, indexed by ..._X_coolant_temp. Selected whenever the VVT scheduler is on the baselin" CURVE 0x40009ABA RL_VALUE_UBYTE 0 CM_u8_angle_1_4deg 0 63.75
 /begin AXIS_DESCR COM_AXIS NO_INPUT_QUANTITY CM_u8_temp_5_8_40c 16 -40 119.375 AXIS_PTS_REF CAL_ign_comp_coolant_manual_cam_base_X_coolant_temp /end AXIS_DESCR
/end CHARACTERISTIC
/begin AXIS_PTS CAL_ign_comp_idle_error_stationary_X_idle_speed_error "X-axis breakpoints for the 'ignition compensation idle error stationary' table. Defines the lookup grid (not a live channel); change only when re-axing the map. (RPM; raw*4-512)" 0x40009ACA NO_INPUT_QUANTITY RL_AXIS_UBYTE 0 CM_u8_rspeed_4_512rpm 16 -512 508 /end AXIS_PTS
/begin CHARACTERISTIC CAL_ign_comp_idle_error_stationary "Calibration: ignition compensation idle error stationary. Tunable map/constant (not a live channel); log spark advance to confirm the timing strategy and headroom to knock. (deg; raw/4-32)" CURVE 0x40009ADA RL_VALUE_UBYTE 0 CM_u8_angle_1_4_32deg -32 31.75
 /begin AXIS_DESCR COM_AXIS NO_INPUT_QUANTITY CM_u8_rspeed_4_512rpm 16 -512 508 AXIS_PTS_REF CAL_ign_comp_idle_error_stationary_X_idle_speed_error /end AXIS_DESCR
/end CHARACTERISTIC
/begin AXIS_PTS CAL_ign_comp_engine_air_X_air_temp "X-axis breakpoints for the 'ignition compensation engine air' table. Defines the lookup grid (not a live channel); change only when re-axing the map. (deg C; raw*5/8-40)" 0x40009AEA NO_INPUT_QUANTITY RL_AXIS_UBYTE 0 CM_u8_temp_5_8_40c 16 -40 119.375 /end AXIS_PTS
/begin CHARACTERISTIC CAL_ign_comp_engine_air "Calibration: ignition compensation engine air. Tunable map/constant (not a live channel); log spark advance to confirm the timing strategy and headroom to knock. (deg; raw/4-32)" CURVE 0x40009AFA RL_VALUE_UBYTE 0 CM_u8_angle_1_4_32deg -32 31.75
 /begin AXIS_DESCR COM_AXIS NO_INPUT_QUANTITY CM_u8_temp_5_8_40c 16 -40 119.375 AXIS_PTS_REF CAL_ign_comp_engine_air_X_air_temp /end AXIS_DESCR
/end CHARACTERISTIC
/begin AXIS_PTS CAL_injtip_in_rpm_scale_X_rpm "X-axis breakpoints for the 'injtip in RPM scale' table. Defines the lookup grid (not a live channel); change only when re-axing the map. (RPM; raw*125/4+500)" 0x40009B0A NO_INPUT_QUANTITY RL_AXIS_UBYTE 0 CM_u8_rspeed_125_4_500rpm 16 500 8468.75 /end AXIS_PTS
/begin CHARACTERISTIC CAL_injtip_in_rpm_scale "Calibration: injtip in RPM scale. Tunable map/constant (not a live channel); log to debug transient (tip-in/out) fueling stumbles and surge. (0-1; raw/128)" CURVE 0x40009B1A RL_VALUE_UBYTE 0 CM_u8_factor_1_128 0 199.21875
 /begin AXIS_DESCR COM_AXIS NO_INPUT_QUANTITY CM_u8_rspeed_125_4_500rpm 16 500 8468.75 AXIS_PTS_REF CAL_injtip_in_rpm_scale_X_rpm /end AXIS_DESCR
/end CHARACTERISTIC
/begin AXIS_PTS CAL_injtip_in_rpm_decay_X_rpm "X-axis breakpoints for the 'injtip in RPM decay' table. Defines the lookup grid (not a live channel); change only when re-axing the map. (RPM; raw*125/4+500)" 0x40009B2A NO_INPUT_QUANTITY RL_AXIS_UBYTE 0 CM_u8_rspeed_125_4_500rpm 16 500 8468.75 /end AXIS_PTS
/begin CHARACTERISTIC CAL_injtip_in_rpm_decay "Calibration: injtip in RPM decay. Tunable map/constant (not a live channel); log to debug transient (tip-in/out) fueling stumbles and surge. (/5ms tick; raw/100)" CURVE 0x40009B3A RL_VALUE_UBYTE 0 CM_u8_dt_factor_1_100_5ms 0 2.55
 /begin AXIS_DESCR COM_AXIS NO_INPUT_QUANTITY CM_u8_rspeed_125_4_500rpm 16 500 8468.75 AXIS_PTS_REF CAL_injtip_in_rpm_decay_X_rpm /end AXIS_DESCR
/end CHARACTERISTIC
/begin AXIS_PTS CAL_injtip_in_coolant_scale_X_coolant_temp "X-axis breakpoints for the 'injtip in coolant scale' table. Defines the lookup grid (not a live channel); change only when re-axing the map. (deg C; raw*5/8-40)" 0x40009B4A NO_INPUT_QUANTITY RL_AXIS_UBYTE 0 CM_u8_temp_5_8_40c 16 -40 119.375 /end AXIS_PTS
/begin CHARACTERISTIC CAL_injtip_in_coolant_scale "Calibration: injtip in coolant scale. Tunable map/constant (not a live channel); log to debug transient (tip-in/out) fueling stumbles and surge. (0-1; raw/64)" CURVE 0x40009B5A RL_VALUE_UBYTE 0 CM_u8_factor_1_64 0 398.4375
 /begin AXIS_DESCR COM_AXIS NO_INPUT_QUANTITY CM_u8_temp_5_8_40c 16 -40 119.375 AXIS_PTS_REF CAL_injtip_in_coolant_scale_X_coolant_temp /end AXIS_DESCR
/end CHARACTERISTIC
/begin AXIS_PTS CAL_injtip_out_rpm_scale_X_rpm "X-axis breakpoints for the 'injtip out RPM scale' table. Defines the lookup grid (not a live channel); change only when re-axing the map. (RPM; raw*125/4+500)" 0x40009B6A NO_INPUT_QUANTITY RL_AXIS_UBYTE 0 CM_u8_rspeed_125_4_500rpm 16 500 8468.75 /end AXIS_PTS
/begin CHARACTERISTIC CAL_injtip_out_rpm_scale "Calibration: injtip out RPM scale. Tunable map/constant (not a live channel); log to debug transient (tip-in/out) fueling stumbles and surge. (0-1; raw/128)" CURVE 0x40009B7A RL_VALUE_UBYTE 0 CM_u8_factor_1_128 0 199.21875
 /begin AXIS_DESCR COM_AXIS NO_INPUT_QUANTITY CM_u8_rspeed_125_4_500rpm 16 500 8468.75 AXIS_PTS_REF CAL_injtip_out_rpm_scale_X_rpm /end AXIS_DESCR
/end CHARACTERISTIC
/begin AXIS_PTS CAL_injtip_out_rpm_decay_X_rpm "X-axis breakpoints for the 'injtip out RPM decay' table. Defines the lookup grid (not a live channel); change only when re-axing the map. (RPM; raw*125/4+500)" 0x40009B8A NO_INPUT_QUANTITY RL_AXIS_UBYTE 0 CM_u8_rspeed_125_4_500rpm 16 500 8468.75 /end AXIS_PTS
/begin CHARACTERISTIC CAL_injtip_out_rpm_decay "Calibration: injtip out RPM decay. Tunable map/constant (not a live channel); log to debug transient (tip-in/out) fueling stumbles and surge. (/5ms tick; raw/100)" CURVE 0x40009B9A RL_VALUE_UBYTE 0 CM_u8_dt_factor_1_100_5ms 0 2.55
 /begin AXIS_DESCR COM_AXIS NO_INPUT_QUANTITY CM_u8_rspeed_125_4_500rpm 16 500 8468.75 AXIS_PTS_REF CAL_injtip_out_rpm_decay_X_rpm /end AXIS_DESCR
/end CHARACTERISTIC
/begin AXIS_PTS CAL_injtip_out_coolant_scale_X_coolant_temp "X-axis breakpoints for the 'injtip out coolant scale' table. Defines the lookup grid (not a live channel); change only when re-axing the map. (deg C; raw*5/8-40)" 0x40009BAA NO_INPUT_QUANTITY RL_AXIS_UBYTE 0 CM_u8_temp_5_8_40c 16 -40 119.375 /end AXIS_PTS
/begin CHARACTERISTIC CAL_injtip_out_coolant_scale "Calibration: injtip out coolant scale. Tunable map/constant (not a live channel); log to debug transient (tip-in/out) fueling stumbles and surge. (0-1; raw/64)" CURVE 0x40009BBA RL_VALUE_UBYTE 0 CM_u8_factor_1_64 0 398.4375
 /begin AXIS_DESCR COM_AXIS NO_INPUT_QUANTITY CM_u8_temp_5_8_40c 16 -40 119.375 AXIS_PTS_REF CAL_injtip_out_coolant_scale_X_coolant_temp /end AXIS_DESCR
/end CHARACTERISTIC
/begin AXIS_PTS CAL_idle_dashpot_rpm_lift_max_X_rpm "u8_rspeed_125/4+500rpm[8]" 0x40009BCA NO_INPUT_QUANTITY RL_AXIS_UBYTE 0 CM_u8_rspeed_125_4_500rpm 8 500 8468.75 /end AXIS_PTS
/begin CHARACTERISTIC CAL_idle_dashpot_rpm_lift_max "u8_rspeed_10rpm[8]" CURVE 0x40009BD2 RL_VALUE_UBYTE 0 CM_u8_rspeed_10rpm 0 2550
 /begin AXIS_DESCR COM_AXIS NO_INPUT_QUANTITY CM_u8_rspeed_125_4_500rpm 8 500 8468.75 AXIS_PTS_REF CAL_idle_dashpot_rpm_lift_max_X_rpm /end AXIS_DESCR
/end CHARACTERISTIC
/begin AXIS_PTS CAL_tpssmooth_increment_sport_shifting_X_tps_rate "X-axis breakpoints for the 'tpssmooth increment sport shifting' table. Defines the lookup grid (not a live channel); change only when re-axing the map. (0-1; raw/255)" 0x40009BDA NO_INPUT_QUANTITY RL_AXIS_UBYTE 0 CM_u8_factor_1_255 8 0 100 /end AXIS_PTS
/begin CHARACTERISTIC CAL_tpssmooth_increment_sport_shifting "Calibration: tpssmooth increment sport shifting. Tunable map/constant (not a live channel); log to see throttle-signal smoothing/filtering behavior. (0-1; raw/1023)" CURVE 0x40009BE2 RL_VALUE_UBYTE 0 CM_u16_factor_1_1023 0 24.9266862170088
 /begin AXIS_DESCR COM_AXIS NO_INPUT_QUANTITY CM_u8_factor_1_255 8 0 100 AXIS_PTS_REF CAL_tpssmooth_increment_sport_shifting_X_tps_rate /end AXIS_DESCR
/end CHARACTERISTIC
/begin AXIS_PTS CAL_idle_tps_from_air_demand_X_idle_air "X-axis breakpoints for the 'throttle position idle target' table. Defines the lookup grid (not a live channel); change only when re-axing the map. (g/s)" 0x40009BEA NO_INPUT_QUANTITY RL_AXIS_UBYTE 0 CM_u8_flow_100mg_s 8 0 25500 /end AXIS_PTS
/begin AXIS_PTS CAL_idle_tps_from_air_demand_Y_vacuum "Y-axis breakpoints for the 'throttle position idle target' table. Defines the lookup grid (not a live channel); change only when re-axing the map. (mbar; raw*4)" 0x40009BF2 NO_INPUT_QUANTITY RL_AXIS_UBYTE 0 CM_u8_pressure_4mbar 8 0 1020 /end AXIS_PTS
/begin CHARACTERISTIC CAL_idle_tps_from_air_demand "Calibration: throttle position idle target. Tunable map/constant (not a live channel); log to diagnose idle quality, hunting, and stalls. (0-1; raw/255)" MAP 0x40009BFA RL_VALUE_UBYTE 0 CM_u8_factor_1_255 0 100
 /begin AXIS_DESCR COM_AXIS NO_INPUT_QUANTITY CM_u8_flow_100mg_s 8 0 25500 AXIS_PTS_REF CAL_idle_tps_from_air_demand_X_idle_air /end AXIS_DESCR
 /begin AXIS_DESCR COM_AXIS NO_INPUT_QUANTITY CM_u8_pressure_4mbar 8 0 1020 AXIS_PTS_REF CAL_idle_tps_from_air_demand_Y_vacuum /end AXIS_DESCR
/end CHARACTERISTIC
/begin AXIS_PTS CAL_cruise_proportional_gain_close_ratio_X_gear "u8_gear[4]" 0x40009C3A NO_INPUT_QUANTITY RL_AXIS_UBYTE 0 NO_COMPU_METHOD 4 0 255 /end AXIS_PTS
/begin CHARACTERISTIC CAL_cruise_proportional_gain_close_ratio "COD[0] bit 16 = close-ratio gearbox" CURVE 0x40009C3E RL_VALUE_UBYTE 0 NO_COMPU_METHOD 0 255
 /begin AXIS_DESCR COM_AXIS NO_INPUT_QUANTITY NO_COMPU_METHOD 4 0 255 AXIS_PTS_REF CAL_cruise_proportional_gain_close_ratio_X_gear /end AXIS_DESCR
/end CHARACTERISTIC
/begin AXIS_PTS CAL_cruise_integral_gain_close_ratio_X_gear "u8_gear[4]" 0x40009C42 NO_INPUT_QUANTITY RL_AXIS_UBYTE 0 NO_COMPU_METHOD 4 0 255 /end AXIS_PTS
/begin CHARACTERISTIC CAL_cruise_integral_gain_close_ratio "uint8_t[4]" CURVE 0x40009C46 RL_VALUE_UBYTE 0 NO_COMPU_METHOD 0 255
 /begin AXIS_DESCR COM_AXIS NO_INPUT_QUANTITY NO_COMPU_METHOD 4 0 255 AXIS_PTS_REF CAL_cruise_integral_gain_close_ratio_X_gear /end AXIS_DESCR
/end CHARACTERISTIC
/begin AXIS_PTS CAL_cruise_derivative_gain_close_ratio_X_gear "u8_gear[4]" 0x40009C4A NO_INPUT_QUANTITY RL_AXIS_UBYTE 0 NO_COMPU_METHOD 4 0 255 /end AXIS_PTS
/begin CHARACTERISTIC CAL_cruise_derivative_gain_close_ratio "uint8_t[4]" CURVE 0x40009C4E RL_VALUE_UBYTE 0 NO_COMPU_METHOD 0 255
 /begin AXIS_DESCR COM_AXIS NO_INPUT_QUANTITY NO_COMPU_METHOD 4 0 255 AXIS_PTS_REF CAL_cruise_derivative_gain_close_ratio_X_gear /end AXIS_DESCR
/end CHARACTERISTIC
/begin AXIS_PTS CAL_tps_scaling_factor_rpm_X_rpm "X-axis breakpoints for the 'throttle position scaling factor RPM' table. Defines the lookup grid (not a live channel); change only when re-axing the map. (RPM; raw*125/4+500)" 0x40009C52 NO_INPUT_QUANTITY RL_AXIS_UBYTE 0 CM_u8_rspeed_125_4_500rpm 16 500 8468.75 /end AXIS_PTS
/begin CHARACTERISTIC CAL_tps_scaling_factor_rpm "Calibration: throttle position scaling factor RPM. Tunable map/constant (not a live channel); log to see throttle/pedal demand and throttle response. (0-1; raw/255)" CURVE 0x40009C62 RL_VALUE_UBYTE 0 CM_u8_factor_1_255 0 100
 /begin AXIS_DESCR COM_AXIS NO_INPUT_QUANTITY CM_u8_rspeed_125_4_500rpm 16 500 8468.75 AXIS_PTS_REF CAL_tps_scaling_factor_rpm_X_rpm /end AXIS_DESCR
/end CHARACTERISTIC
/begin AXIS_PTS CAL_tpssmooth_increment_tour_shifting_X_tps_rate "X-axis breakpoints for the 'tpssmooth increment tour shifting' table. Defines the lookup grid (not a live channel); change only when re-axing the map. (0-1; raw/255)" 0x40009C72 NO_INPUT_QUANTITY RL_AXIS_UBYTE 0 CM_u8_factor_1_255 8 0 100 /end AXIS_PTS
/begin CHARACTERISTIC CAL_tpssmooth_increment_tour_shifting "Calibration: tpssmooth increment tour shifting. Tunable map/constant (not a live channel); log to see throttle-signal smoothing/filtering behavior. (0-1; raw/1023)" CURVE 0x40009C7A RL_VALUE_UBYTE 0 CM_u16_factor_1_1023 0 24.9266862170088
 /begin AXIS_DESCR COM_AXIS NO_INPUT_QUANTITY CM_u8_factor_1_255 8 0 100 AXIS_PTS_REF CAL_tpssmooth_increment_tour_shifting_X_tps_rate /end AXIS_DESCR
/end CHARACTERISTIC
/begin AXIS_PTS CAL_dfco_entry_rpm_ips_alt_X_coolant_temp "X-axis breakpoints for the 'DFCO entry RPM IPS alt' table. Defines the lookup grid (not a live channel); change only when re-axing the map. (deg C; raw*5/8-40)" 0x40009C82 NO_INPUT_QUANTITY RL_AXIS_UBYTE 0 CM_u8_temp_5_8_40c 4 -40 119.375 /end AXIS_PTS
/begin CHARACTERISTIC CAL_dfco_entry_rpm_ips_alt "Calibration: DFCO entry RPM IPS alt. Tunable map/constant (not a live channel); log to see when fuel is cut and restored on deceleration. (RPM; raw*10)" CURVE 0x40009C86 RL_VALUE_UBYTE 0 CM_u8_rspeed_10rpm 0 2550
 /begin AXIS_DESCR COM_AXIS NO_INPUT_QUANTITY CM_u8_temp_5_8_40c 4 -40 119.375 AXIS_PTS_REF CAL_dfco_entry_rpm_ips_alt_X_coolant_temp /end AXIS_DESCR
/end CHARACTERISTIC
/begin AXIS_PTS CAL_closedloop_proportional_gain_rich_table_X_rpm "X-axis breakpoints for the 'closedloop proportional gain rich table' table. Defines the lookup grid (not a live channel); change only when re-axing the map. (RPM; raw*125/4+500)" 0x40009C8A NO_INPUT_QUANTITY RL_AXIS_UBYTE 0 CM_u8_rspeed_125_4_500rpm 8 500 8468.75 /end AXIS_PTS
/begin AXIS_PTS CAL_closedloop_proportional_gain_rich_table_Y_load "Y-axis breakpoints for the 'closedloop proportional gain rich table' table. Defines the lookup grid (not a live channel); change only when re-axing the map. (mg/stroke; raw*4)" 0x40009C92 NO_INPUT_QUANTITY RL_AXIS_UBYTE 0 CM_u8_load_4mg_stroke 8 0 1020 /end AXIS_PTS
/begin CHARACTERISTIC CAL_closedloop_proportional_gain_rich_table "Calibration: closedloop proportional gain rich table. Tunable map/constant (not a live channel); log to watch O2 feedback trim the mixture and confirm the loop is active." MAP 0x40009C9A RL_VALUE_UBYTE 0 NO_COMPU_METHOD 0 255
 /begin AXIS_DESCR COM_AXIS NO_INPUT_QUANTITY CM_u8_rspeed_125_4_500rpm 8 500 8468.75 AXIS_PTS_REF CAL_closedloop_proportional_gain_rich_table_X_rpm /end AXIS_DESCR
 /begin AXIS_DESCR COM_AXIS NO_INPUT_QUANTITY CM_u8_load_4mg_stroke 8 0 1020 AXIS_PTS_REF CAL_closedloop_proportional_gain_rich_table_Y_load /end AXIS_DESCR
/end CHARACTERISTIC
/begin AXIS_PTS CAL_closedloop_proportional_gain_lean_table_X_rpm "X-axis breakpoints for the 'closedloop proportional gain lean table' table. Defines the lookup grid (not a live channel); change only when re-axing the map. (RPM; raw*125/4+500)" 0x40009CDA NO_INPUT_QUANTITY RL_AXIS_UBYTE 0 CM_u8_rspeed_125_4_500rpm 8 500 8468.75 /end AXIS_PTS
/begin AXIS_PTS CAL_closedloop_proportional_gain_lean_table_Y_load "Y-axis breakpoints for the 'closedloop proportional gain lean table' table. Defines the lookup grid (not a live channel); change only when re-axing the map. (mg/stroke; raw*4)" 0x40009CE2 NO_INPUT_QUANTITY RL_AXIS_UBYTE 0 CM_u8_load_4mg_stroke 8 0 1020 /end AXIS_PTS
/begin CHARACTERISTIC CAL_closedloop_proportional_gain_lean_table "Calibration: closedloop proportional gain lean table. Tunable map/constant (not a live channel); log to watch O2 feedback trim the mixture and confirm the loop is active." MAP 0x40009CEA RL_VALUE_UBYTE 0 NO_COMPU_METHOD 0 255
 /begin AXIS_DESCR COM_AXIS NO_INPUT_QUANTITY CM_u8_rspeed_125_4_500rpm 8 500 8468.75 AXIS_PTS_REF CAL_closedloop_proportional_gain_lean_table_X_rpm /end AXIS_DESCR
 /begin AXIS_DESCR COM_AXIS NO_INPUT_QUANTITY CM_u8_load_4mg_stroke 8 0 1020 AXIS_PTS_REF CAL_closedloop_proportional_gain_lean_table_Y_load /end AXIS_DESCR
/end CHARACTERISTIC
/begin AXIS_PTS CAL_closedloop_integral_gain_table_X_rpm "X-axis breakpoints for the 'closedloop integral gain table' table. Defines the lookup grid (not a live channel); change only when re-axing the map. (RPM; raw*125/4+500)" 0x40009D2A NO_INPUT_QUANTITY RL_AXIS_UBYTE 0 CM_u8_rspeed_125_4_500rpm 8 500 8468.75 /end AXIS_PTS
/begin AXIS_PTS CAL_closedloop_integral_gain_table_Y_load "Y-axis breakpoints for the 'closedloop integral gain table' table. Defines the lookup grid (not a live channel); change only when re-axing the map. (mg/stroke; raw*4)" 0x40009D32 NO_INPUT_QUANTITY RL_AXIS_UBYTE 0 CM_u8_load_4mg_stroke 8 0 1020 /end AXIS_PTS
/begin CHARACTERISTIC CAL_closedloop_integral_gain_table "Calibration: closedloop integral gain table. Tunable map/constant (not a live channel); log to watch O2 feedback trim the mixture and confirm the loop is active." MAP 0x40009D3A RL_VALUE_UBYTE 0 NO_COMPU_METHOD 0 255
 /begin AXIS_DESCR COM_AXIS NO_INPUT_QUANTITY CM_u8_rspeed_125_4_500rpm 8 500 8468.75 AXIS_PTS_REF CAL_closedloop_integral_gain_table_X_rpm /end AXIS_DESCR
 /begin AXIS_DESCR COM_AXIS NO_INPUT_QUANTITY CM_u8_load_4mg_stroke 8 0 1020 AXIS_PTS_REF CAL_closedloop_integral_gain_table_Y_load /end AXIS_DESCR
/end CHARACTERISTIC
/begin AXIS_PTS CAL_closedloop_derivative_gain_table_X_rpm "X-axis breakpoints for the 'closedloop derivative gain table' table. Defines the lookup grid (not a live channel); change only when re-axing the map. (RPM; raw*125/4+500)" 0x40009D7A NO_INPUT_QUANTITY RL_AXIS_UBYTE 0 CM_u8_rspeed_125_4_500rpm 8 500 8468.75 /end AXIS_PTS
/begin AXIS_PTS CAL_closedloop_derivative_gain_table_Y_load "Y-axis breakpoints for the 'closedloop derivative gain table' table. Defines the lookup grid (not a live channel); change only when re-axing the map. (mg/stroke; raw*4)" 0x40009D82 NO_INPUT_QUANTITY RL_AXIS_UBYTE 0 CM_u8_load_4mg_stroke 8 0 1020 /end AXIS_PTS
/begin CHARACTERISTIC CAL_closedloop_derivative_gain_table "Calibration: closedloop derivative gain table. Tunable map/constant (not a live channel); log to watch O2 feedback trim the mixture and confirm the loop is active." MAP 0x40009D8A RL_VALUE_UBYTE 0 NO_COMPU_METHOD 0 255
 /begin AXIS_DESCR COM_AXIS NO_INPUT_QUANTITY CM_u8_rspeed_125_4_500rpm 8 500 8468.75 AXIS_PTS_REF CAL_closedloop_derivative_gain_table_X_rpm /end AXIS_DESCR
 /begin AXIS_DESCR COM_AXIS NO_INPUT_QUANTITY CM_u8_load_4mg_stroke 8 0 1020 AXIS_PTS_REF CAL_closedloop_derivative_gain_table_Y_load /end AXIS_DESCR
/end CHARACTERISTIC
/begin AXIS_PTS CAL_inj_efficiency_X_engine_speed "X-axis breakpoints for the 'injector efficiency' table. Defines the lookup grid (not a live channel); change only when re-axing the map. (RPM; raw*125/4+500)" 0x40009DCA NO_INPUT_QUANTITY RL_AXIS_UBYTE 0 CM_u8_rspeed_125_4_500rpm 32 500 8468.75 /end AXIS_PTS
/begin AXIS_PTS CAL_inj_efficiency_Y_engine_load "Y-axis breakpoints for the 'injector efficiency' table. Defines the lookup grid (not a live channel); change only when re-axing the map. (mg/stroke; raw*4)" 0x40009DEA NO_INPUT_QUANTITY RL_AXIS_UBYTE 0 CM_u8_load_4mg_stroke 32 0 1020 /end AXIS_PTS
/begin CHARACTERISTIC CAL_inj_efficiency "Calibration: injector efficiency. Tunable map/constant (not a live channel); log to verify injector pulse width and fuel delivery vs target. (0-1; raw/200)" MAP 0x40009E0A RL_VALUE_UBYTE 0 CM_u8_factor_1_200 0 127.5
 /begin AXIS_DESCR COM_AXIS NO_INPUT_QUANTITY CM_u8_rspeed_125_4_500rpm 32 500 8468.75 AXIS_PTS_REF CAL_inj_efficiency_X_engine_speed /end AXIS_DESCR
 /begin AXIS_DESCR COM_AXIS NO_INPUT_QUANTITY CM_u8_load_4mg_stroke 32 0 1020 AXIS_PTS_REF CAL_inj_efficiency_Y_engine_load /end AXIS_DESCR
/end CHARACTERISTIC
/begin AXIS_PTS CAL_idle_target_manual_sport_X_coolant_temp "X-axis breakpoints for the 'idle target manual sport' table. Defines the lookup grid (not a live channel); change only when re-axing the map. (deg C; raw*5/8-40)" 0x4000A20A NO_INPUT_QUANTITY RL_AXIS_UBYTE 0 CM_u8_temp_5_8_40c 16 -40 119.375 /end AXIS_PTS
/begin CHARACTERISTIC CAL_idle_target_manual_sport "Calibration: idle target manual sport. Tunable map/constant (not a live channel); log to diagnose idle quality, hunting, and stalls. (RPM; raw*4+500)" CURVE 0x4000A21A RL_VALUE_UBYTE 0 CM_u8_rspeed_4_500rpm 500 1520
 /begin AXIS_DESCR COM_AXIS NO_INPUT_QUANTITY CM_u8_temp_5_8_40c 16 -40 119.375 AXIS_PTS_REF CAL_idle_target_manual_sport_X_coolant_temp /end AXIS_DESCR
/end CHARACTERISTIC
/begin AXIS_PTS CAL_load_map_estimate_ve_X_rpm "X-axis (rpm; raw*125/4+500) for CAL_load_map_estimate_ve." 0x4000A22A NO_INPUT_QUANTITY RL_AXIS_UBYTE 0 CM_u8_rspeed_125_4_500rpm 16 500 8468.75 /end AXIS_PTS
/begin CHARACTERISTIC CAL_load_map_estimate_ve "Volumetric efficiency vs rpm for the estimated-MAP model (VE% = (raw+153)/2; exact (raw+153)/199.1 for 576 cc/cyl). Slope term: dMAP = load_mg*29565/((raw+153)*iat_ratio). Not a live channel." CURVE 0x4000A23A RL_VALUE_UBYTE 0 NO_COMPU_METHOD 0 255
 /begin AXIS_DESCR COM_AXIS NO_INPUT_QUANTITY CM_u8_rspeed_125_4_500rpm 16 500 8468.75 AXIS_PTS_REF CAL_load_map_estimate_ve_X_rpm /end AXIS_DESCR
/end CHARACTERISTIC
/begin AXIS_PTS CAL_vvt_exhaust_advance_base_X_rpm "X-axis breakpoints for the 'VVT exhaust advance base' table. Defines the lookup grid (not a live channel); change only when re-axing the map. (RPM; raw*125/4+500)" 0x4000A24A NO_INPUT_QUANTITY RL_AXIS_UBYTE 0 CM_u8_rspeed_125_4_500rpm 16 500 8468.75 /end AXIS_PTS
/begin AXIS_PTS CAL_vvt_exhaust_advance_base_Y_load "Y-axis breakpoints for the 'VVT exhaust advance base' table. Defines the lookup grid (not a live channel); change only when re-axing the map. (mg/stroke; raw*4)" 0x4000A25A NO_INPUT_QUANTITY RL_AXIS_UBYTE 0 CM_u8_load_4mg_stroke 16 0 1020 /end AXIS_PTS
/begin CHARACTERISTIC CAL_vvt_exhaust_advance_base "Calibration: VVT exhaust advance base. Tunable map/constant (not a live channel); log commanded vs actual cam timing to verify VVT response. (deg; raw/4)" MAP 0x4000A26A RL_VALUE_UBYTE 0 CM_u8_angle_1_4deg 0 63.75
 /begin AXIS_DESCR COM_AXIS NO_INPUT_QUANTITY CM_u8_rspeed_125_4_500rpm 16 500 8468.75 AXIS_PTS_REF CAL_vvt_exhaust_advance_base_X_rpm /end AXIS_DESCR
 /begin AXIS_DESCR COM_AXIS NO_INPUT_QUANTITY CM_u8_load_4mg_stroke 16 0 1020 AXIS_PTS_REF CAL_vvt_exhaust_advance_base_Y_load /end AXIS_DESCR
/end CHARACTERISTIC
/begin AXIS_PTS CAL_cluster_shiftlight_rpm_offset_manual_X_gear "Calibration: cluster shiftlight RPM offset manual. Tunable map/constant (not a live channel); log to check what the ECU sends the dash (gauges/warnings)." 0x4000A36A NO_INPUT_QUANTITY RL_AXIS_UBYTE 0 NO_COMPU_METHOD 8 0 255 /end AXIS_PTS
/begin CHARACTERISTIC CAL_cluster_shiftlight_rpm_offset_manual "u8_rspeed_8rpm[8]" CURVE 0x4000A372 RL_VALUE_UBYTE 0 CM_u8_rspeed_8rpm 0 2040
 /begin AXIS_DESCR COM_AXIS NO_INPUT_QUANTITY NO_COMPU_METHOD 8 0 255 AXIS_PTS_REF CAL_cluster_shiftlight_rpm_offset_manual_X_gear /end AXIS_DESCR
/end CHARACTERISTIC
/begin CHARACTERISTIC CAL_load_obd_divisor_X_rpm "X-axis breakpoints for the 'load OBD divisor' table. Defines the lookup grid (not a live channel); change only when re-axing the map. (RPM; raw*125/4+500)" VAL_BLK 0x4000A37A RL_VALUE_UBYTE 0 CM_u8_rspeed_125_4_500rpm 500 8468.75 NUMBER 16 /end CHARACTERISTIC
/begin CHARACTERISTIC CAL_obd_ii_calc_load_wot_airmass "WOT peak air charge at STP vs rpm; denominator of J1979 calculated load (PID 0x04). 255 = divisor × 255/64 mg." VAL_BLK 0x4000A38A RL_VALUE_UBYTE 0 CM_u8_load_4mg_stroke 0 1020 NUMBER 16 /end CHARACTERISTIC
/begin AXIS_PTS CAL_tpssmooth_increment_tour_driving_X_tps_rate "X-axis breakpoints for the 'tpssmooth increment tour driving' table. Defines the lookup grid (not a live channel); change only when re-axing the map. (0-1; raw/255)" 0x4000A39A NO_INPUT_QUANTITY RL_AXIS_UBYTE 0 CM_u8_factor_1_255 8 0 100 /end AXIS_PTS
/begin CHARACTERISTIC CAL_tpssmooth_increment_tour_driving "Calibration: tpssmooth increment tour driving. Tunable map/constant (not a live channel); log to see throttle-signal smoothing/filtering behavior. (0-1; raw/1023)" CURVE 0x4000A3A2 RL_VALUE_UBYTE 0 CM_u16_factor_1_1023 0 24.9266862170088
 /begin AXIS_DESCR COM_AXIS NO_INPUT_QUANTITY CM_u8_factor_1_255 8 0 100 AXIS_PTS_REF CAL_tpssmooth_increment_tour_driving_X_tps_rate /end AXIS_DESCR
/end CHARACTERISTIC
/begin AXIS_PTS CAL_sensor_P0106_min_tps_threshold_X_rpm "Calibration that arms/thresholds the P0106 monitor (MAP/baro rationality). Fixed value -- it sets when that DTC trips, not a live channel." 0x4000A3AA NO_INPUT_QUANTITY RL_AXIS_UBYTE 0 CM_u8_rspeed_125_4_500rpm 16 500 8468.75 /end AXIS_PTS
/begin CHARACTERISTIC CAL_sensor_P0106_min_tps_threshold "Calibration that arms/thresholds the P0106 monitor (MAP/baro rationality). Fixed value -- it sets when that DTC trips, not a live channel." CURVE 0x4000A3BA RL_VALUE_UBYTE 0 CM_u8_factor_1_255 0 100
 /begin AXIS_DESCR COM_AXIS NO_INPUT_QUANTITY CM_u8_rspeed_125_4_500rpm 16 500 8468.75 AXIS_PTS_REF CAL_sensor_P0106_min_tps_threshold_X_rpm /end AXIS_DESCR
/end CHARACTERISTIC
/begin AXIS_PTS CAL_inj_warmup_factor_manual_X_load "X-axis breakpoints for the 'injector enrichment factor load n coolant manual' table. Defines the lookup grid (not a live channel); change only when re-axing the map. (mg/stroke; raw*4)" 0x4000A3CA NO_INPUT_QUANTITY RL_AXIS_UBYTE 0 CM_u8_load_4mg_stroke 12 0 1020 /end AXIS_PTS
/begin AXIS_PTS CAL_inj_warmup_factor_manual_Y_coolant_temp "Y-axis breakpoints for the 'injector enrichment factor load n coolant manual' table. Defines the lookup grid (not a live channel); change only when re-axing the map. (deg C; raw*5/8-40)" 0x4000A3D6 NO_INPUT_QUANTITY RL_AXIS_UBYTE 0 CM_u8_temp_5_8_40c 16 -40 119.375 /end AXIS_PTS
/begin CHARACTERISTIC CAL_inj_warmup_factor_manual "Calibration: injector enrichment factor load n coolant manual. Tunable map/constant (not a live channel); log to verify injector pulse width and fuel delivery vs target. (0-1; raw/64)" MAP 0x4000A3E6 RL_VALUE_UBYTE 0 CM_u8_factor_1_64 0 398.4375
 /begin AXIS_DESCR COM_AXIS NO_INPUT_QUANTITY CM_u8_load_4mg_stroke 12 0 1020 AXIS_PTS_REF CAL_inj_warmup_factor_manual_X_load /end AXIS_DESCR
 /begin AXIS_DESCR COM_AXIS NO_INPUT_QUANTITY CM_u8_temp_5_8_40c 16 -40 119.375 AXIS_PTS_REF CAL_inj_warmup_factor_manual_Y_coolant_temp /end AXIS_DESCR
/end CHARACTERISTIC
/begin AXIS_PTS CAL_torque_engine_ac_load_scaler_X_rpm "X-axis breakpoints for the 'torque engine A/C load scaler' table. Defines the lookup grid (not a live channel); change only when re-axing the map." 0x4000A4A6 NO_INPUT_QUANTITY RL_AXIS_UBYTE 0 NO_COMPU_METHOD 8 0 255 /end AXIS_PTS
/begin CHARACTERISTIC CAL_torque_engine_ac_load_scaler "Calibration: torque engine A/C load scaler. Tunable map/constant (not a live channel); log to follow the ECU torque estimate and any torque limiting. (0-1; raw/255)" CURVE 0x4000A4AE RL_VALUE_UBYTE 0 CM_u8_factor_1_255 0 100
 /begin AXIS_DESCR COM_AXIS NO_INPUT_QUANTITY NO_COMPU_METHOD 8 0 255 AXIS_PTS_REF CAL_torque_engine_ac_load_scaler_X_rpm /end AXIS_DESCR
/end CHARACTERISTIC
/begin AXIS_PTS CAL_ecu_engine_speed_target_sport_X_pps "X-axis breakpoints for the 'ECU engine speed target sport' table. Defines the lookup grid (not a live channel); change only when re-axing the map." 0x4000A4B6 NO_INPUT_QUANTITY RL_AXIS_UWORD 0 CM_u16_factor_1_1023 10 0 6406.15835777126 /end AXIS_PTS
/begin CHARACTERISTIC CAL_ecu_engine_speed_target_sport "Calibration: ECU engine speed target sport. Tunable map/constant (not a live channel); mostly housekeeping/diagnostic state." CURVE 0x4000A4CA RL_VALUE_UWORD 0 CM_u16_rspeed_1_4rpm 0 16383.75
 /begin AXIS_DESCR COM_AXIS NO_INPUT_QUANTITY CM_u16_factor_1_1023 10 0 6406.15835777126 AXIS_PTS_REF CAL_ecu_engine_speed_target_sport_X_pps /end AXIS_DESCR
/end CHARACTERISTIC
/begin AXIS_PTS CAL_inj_comp_iat_X_load "X-axis breakpoints for the 'injector compensation intake-air temp' table. Defines the lookup grid (not a live channel); change only when re-axing the map. (mg/stroke; raw*4)" 0x4000A4EA NO_INPUT_QUANTITY RL_AXIS_UBYTE 0 CM_u8_load_4mg_stroke 8 0 1020 /end AXIS_PTS
/begin AXIS_PTS CAL_inj_comp_iat_Y_iat "Y-axis breakpoints for the 'injector compensation intake-air temp' table. Defines the lookup grid (not a live channel); change only when re-axing the map. (deg C; raw*5/8-40)" 0x4000A4F2 NO_INPUT_QUANTITY RL_AXIS_UBYTE 0 CM_u8_temp_5_8_40c 16 -40 119.375 /end AXIS_PTS
/begin CHARACTERISTIC CAL_inj_comp_iat "Calibration: injector compensation intake-air temp. Tunable map/constant (not a live channel); log to verify injector pulse width and fuel delivery vs target. (0-1; raw/128)" MAP 0x4000A502 RL_VALUE_UBYTE 0 CM_u8_factor_1_128 0 199.21875
 /begin AXIS_DESCR COM_AXIS NO_INPUT_QUANTITY CM_u8_load_4mg_stroke 8 0 1020 AXIS_PTS_REF CAL_inj_comp_iat_X_load /end AXIS_DESCR
 /begin AXIS_DESCR COM_AXIS NO_INPUT_QUANTITY CM_u8_temp_5_8_40c 16 -40 119.375 AXIS_PTS_REF CAL_inj_comp_iat_Y_iat /end AXIS_DESCR
/end CHARACTERISTIC
/begin AXIS_PTS CAL_load_source_selection_threshold_by_tps_X_rpm "X-axis breakpoints for the 'load source selection threshold by throttle position' table. Defines the lookup grid (not a live channel); change only when re-axing the map. (RPM; raw*125/4+500)" 0x4000A582 NO_INPUT_QUANTITY RL_AXIS_UBYTE 0 CM_u8_rspeed_125_4_500rpm 16 500 8468.75 /end AXIS_PTS
/begin CHARACTERISTIC CAL_load_source_selection_threshold_by_tps "Calibration: load source selection threshold by throttle position. Tunable map/constant (not a live channel); log to see throttle/pedal demand and throttle response. (0-1; raw/255)" CURVE 0x4000A592 RL_VALUE_UBYTE 0 CM_u8_factor_1_255 0 100
 /begin AXIS_DESCR COM_AXIS NO_INPUT_QUANTITY CM_u8_rspeed_125_4_500rpm 16 500 8468.75 AXIS_PTS_REF CAL_load_source_selection_threshold_by_tps_X_rpm /end AXIS_DESCR
/end CHARACTERISTIC
/begin AXIS_PTS CAL_tps_idle_target_cranking_X_baro "X-axis breakpoints for the 'throttle position idle target cranking' table. Defines the lookup grid (not a live channel); change only when re-axing the map. (mbar; raw*4)" 0x4000A5A2 NO_INPUT_QUANTITY RL_AXIS_UBYTE 0 CM_u8_pressure_4mbar 4 0 1020 /end AXIS_PTS
/begin AXIS_PTS CAL_tps_idle_target_cranking_Y_coolant "Y-axis breakpoints for the 'throttle position idle target cranking' table. Defines the lookup grid (not a live channel); change only when re-axing the map. (deg C; raw*5/8-40)" 0x4000A5A6 NO_INPUT_QUANTITY RL_AXIS_UBYTE 0 CM_u8_temp_5_8_40c 16 -40 119.375 /end AXIS_PTS
/begin CHARACTERISTIC CAL_tps_idle_target_cranking "Calibration: throttle position idle target cranking. Tunable map/constant (not a live channel); log to diagnose idle quality, hunting, and stalls. (0-1; raw/1023)" MAP 0x4000A5B6 RL_VALUE_UBYTE 0 CM_u16_factor_1_1023 0 24.9266862170088
 /begin AXIS_DESCR COM_AXIS NO_INPUT_QUANTITY CM_u8_pressure_4mbar 4 0 1020 AXIS_PTS_REF CAL_tps_idle_target_cranking_X_baro /end AXIS_DESCR
 /begin AXIS_DESCR COM_AXIS NO_INPUT_QUANTITY CM_u8_temp_5_8_40c 16 -40 119.375 AXIS_PTS_REF CAL_tps_idle_target_cranking_Y_coolant /end AXIS_DESCR
/end CHARACTERISTIC
/begin AXIS_PTS CAL_knock_inhibit_tps_max_X_rpm "X-axis breakpoints for the 'knock inhibit throttle position max' table. Defines the lookup grid (not a live channel); change only when re-axing the map. (RPM; raw*125/4+500)" 0x4000A5FA NO_INPUT_QUANTITY RL_AXIS_UBYTE 0 CM_u8_rspeed_125_4_500rpm 16 500 8468.75 /end AXIS_PTS
/begin CHARACTERISTIC CAL_knock_inhibit_tps_max "Calibration: knock inhibit throttle position max. Tunable map/constant (not a live channel); log to catch knock events and see how much timing is being pulled. (0-1; raw/255)" CURVE 0x4000A60A RL_VALUE_UBYTE 0 CM_u8_factor_1_255 0 100
 /begin AXIS_DESCR COM_AXIS NO_INPUT_QUANTITY CM_u8_rspeed_125_4_500rpm 16 500 8468.75 AXIS_PTS_REF CAL_knock_inhibit_tps_max_X_rpm /end AXIS_DESCR
/end CHARACTERISTIC
/begin AXIS_PTS CAL_idle_air_base_manual_X_rpm "u16_rspeed_rpm[16]" 0x4000A61A NO_INPUT_QUANTITY RL_AXIS_UWORD 0 CM_u8_rspeed_rpm 16 0 65535 /end AXIS_PTS
/begin CHARACTERISTIC CAL_idle_air_base_manual "u16_flow_100/256mg/s[16]" CURVE 0x4000A63A RL_VALUE_UWORD 0 CM_u16_flow_100_256mg_s 0 25599.609375
 /begin AXIS_DESCR COM_AXIS NO_INPUT_QUANTITY CM_u8_rspeed_rpm 16 0 65535 AXIS_PTS_REF CAL_idle_air_base_manual_X_rpm /end AXIS_DESCR
/end CHARACTERISTIC
/end MODULE
/end PROJECT
