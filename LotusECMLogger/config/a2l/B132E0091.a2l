/*
* Drafted by LotusECMLogger A2lGenerator v1 from the B132E0091 symbol catalog for B132E0091.
* 238 axes have an InputQuantity from the reviewed <build>.inputs.csv; the rest have
* NO_INPUT_QUANTITY. Bind more only after checking the lookup in the decompile
* (scope, conditions, input transforms; CCP-client-plan.md section 5). Inputs are raw values, as the lookups compare them.
* Maps are ROW_DIR: the first AXIS_DESCR is X, stored fastest, as the firmware reads lut[y * size_x + x].
* Generator warnings:
* load_to_tps_trim_factor: also at another address; this one (0x400019F8) is named load_to_tps_trim_factor_400019F8.
* cam_park_offset_fault_inlet_b2: also at another address; this one (0x40002192) is named cam_park_offset_fault_inlet_b2_40002192.
* steering_angle_rate: also at another address; this one (0x400022D0) is named steering_angle_rate_400022D0.
* accel_pedal_track_d_selected: also at another address; this one (0x400024AB) is named accel_pedal_track_d_selected_400024AB.
* ADC_TSCR: also at another address; this one (0x4000299C) is named ADC_TSCR_4000299C.
* ADC_TBCR: also at another address; this one (0x400029A0) is named ADC_TBCR_400029A0.
* timer_main_start1: also at another address; this one (0x40002B68) is named timer_main_start1_40002B68.
* timer_main_start2: also at another address; this one (0x40002B6C) is named timer_main_start2_40002B6C.
* LEA_obd_ii_P0141_flags: also at another address; this one (0x400046B6) is named LEA_obd_ii_P0141_flags_400046B6.
* LEA_obd_ii_P0141_fail_counter: also at another address; this one (0x400046B7) is named LEA_obd_ii_P0141_fail_counter_400046B7.
* LEA_obd_ii_P0141_pass_counter: also at another address; this one (0x400046B8) is named LEA_obd_ii_P0141_pass_counter_400046B8.
* CAL_idle_flow_integral_adj_max: also at another address; this one (0x40008E91) is named CAL_idle_flow_integral_adj_max_40008E91.
* CAL_ac_inhibit_rpm_cutoff_min_hold: also at another address; this one (0x40008F57) is named CAL_ac_inhibit_rpm_cutoff_min_hold_40008F57.
* CAL_inj_soak_time_max: also at another address; this one (0x40009130) is named CAL_inj_soak_time_max_40009130.
* CAL_evap_unknown2: also at another address; this one (0x4000D2C1) is named CAL_evap_unknown2_4000D2C1.
* CAL_obd_ii_unknown7: also at another address; this one (0x4000D364) is named CAL_obd_ii_unknown7_4000D364.
* CAL_obd_ii_unknown5: also at another address; this one (0x4000D381) is named CAL_obd_ii_unknown5_4000D381.
* CAL_obd_ii_o2_imbalance_sample_count: also at another address; this one (0x4000D3B8) is named CAL_obd_ii_o2_imbalance_sample_count_4000D3B8.
* CAL_knock_threshold_obd_ii_check_enable_load: also at another address; this one (0x4000D3CD) is named CAL_knock_threshold_obd_ii_check_enable_load_4000D3CD.
* CAL_gsi_max_gear_step: also at another address; this one (0x4000D418) is named CAL_gsi_max_gear_step_4000D418.
* CAL_obd_ii_P0141: also at another address; this one (0x4000DA38) is named CAL_obd_ii_P0141_4000DA38.
* CAL_obd_ii_P0451_debounce_count: also at another address; this one (0x4000DBA1) is named CAL_obd_ii_P0451_debounce_count_4000DBA1.
* CAL_ecu_cvn: 0x4000EFFC+2 is outside calibration RAM; left out.
*/
ASAP2_VERSION 1 61
/begin PROJECT B132E0091 "Lotus T6 B132E0091"
/begin HEADER "" VERSION "generated v1" /end HEADER
/begin MODULE B132E0091 ""
/begin MOD_COMMON "" BYTE_ORDER MSB_FIRST ALIGNMENT_BYTE 1 ALIGNMENT_WORD 2 ALIGNMENT_LONG 4 /end MOD_COMMON
/begin MOD_PAR "" EPK "B132E0091" ADDR_EPK 0x40008E24
 /begin MEMORY_SEGMENT CAL "Calibration RAM" DATA RAM INTERN 0x40008E24 0x61D8 -1 -1 -1 -1 -1 /end MEMORY_SEGMENT
/end MOD_PAR
/begin RECORD_LAYOUT RL_VALUE_UBYTE FNC_VALUES 1 UBYTE ROW_DIR DIRECT /end RECORD_LAYOUT
/begin RECORD_LAYOUT RL_AXIS_UBYTE AXIS_PTS_X 1 UBYTE INDEX_INCR DIRECT /end RECORD_LAYOUT
/begin RECORD_LAYOUT RL_VALUE_SBYTE FNC_VALUES 1 SBYTE ROW_DIR DIRECT /end RECORD_LAYOUT
/begin RECORD_LAYOUT RL_VALUE_UWORD FNC_VALUES 1 UWORD ROW_DIR DIRECT /end RECORD_LAYOUT
/begin RECORD_LAYOUT RL_AXIS_UWORD AXIS_PTS_X 1 UWORD INDEX_INCR DIRECT /end RECORD_LAYOUT
/begin RECORD_LAYOUT RL_VALUE_SWORD FNC_VALUES 1 SWORD ROW_DIR DIRECT /end RECORD_LAYOUT
/begin RECORD_LAYOUT RL_VALUE_ULONG FNC_VALUES 1 ULONG ROW_DIR DIRECT /end RECORD_LAYOUT
/begin COMPU_METHOD CM_i16_factor_1_20 "i16_factor_1/20" RAT_FUNC "%8.0" "%" COEFFS 0 1 0 0 0 5 /end COMPU_METHOD
/begin COMPU_METHOD CM_i16_percent_1_20 "i16_percent_1/20" RAT_FUNC "%10.2" "%" COEFFS 0 1 0 0 0 0.05 /end COMPU_METHOD
/begin COMPU_METHOD CM_i16_pressure_mbar "i16_pressure_mbar" RAT_FUNC "%8.0" "mbar" COEFFS 0 1 0 0 0 1 /end COMPU_METHOD
/begin COMPU_METHOD CM_u16_current_mA "u16_current_mA" RAT_FUNC "%8.0" "mA" COEFFS 0 1 0 0 0 1 /end COMPU_METHOD
/begin COMPU_METHOD CM_u16_factor_1_10000 "u16_factor_1/10000" RAT_FUNC "%10.2" "%" COEFFS 0 1 0 0 0 0.01 /end COMPU_METHOD
/begin COMPU_METHOD CM_u16_factor_1_1023 "u16_factor_1/1023" RAT_FUNC "%12.4" "%" COEFFS 0 1 0 0 0 0.0977517106549365 /end COMPU_METHOD
/begin COMPU_METHOD CM_u16_factor_1_65536 "u16_factor_1/65536" RAT_FUNC "%12.4" "%" COEFFS 0 1 0 0 0 0.00152587890625 /end COMPU_METHOD
/begin COMPU_METHOD CM_u16_flow_10mg_s "u16_flow_10mg/s" RAT_FUNC "%8.0" "mg/s" COEFFS 0 1 0 0 0 10 /end COMPU_METHOD
/begin COMPU_METHOD CM_u16_flow_mg_s "u16_flow_mg/s" RAT_FUNC "%8.0" "mg/s" COEFFS 0 1 0 0 0 1 /end COMPU_METHOD
/begin COMPU_METHOD CM_u16_freq_hz "u16_freq_hz" RAT_FUNC "%8.0" "Hz" COEFFS 0 1 0 0 0 1 /end COMPU_METHOD
/begin COMPU_METHOD CM_u16_load_mg_stroke "u16_load_mg/stroke" RAT_FUNC "%8.0" "mg/stroke" COEFFS 0 1 0 0 0 1 /end COMPU_METHOD
/begin COMPU_METHOD CM_u16_mass_g "u16_mass_g" RAT_FUNC "%8.0" "g" COEFFS 0 1 0 0 0 1 /end COMPU_METHOD
/begin COMPU_METHOD CM_u16_mass_mg "u16_mass_mg" RAT_FUNC "%8.0" "mg" COEFFS 0 1 0 0 0 1 /end COMPU_METHOD
/begin COMPU_METHOD CM_u16_ratio_mbar_5v "u16_ratio_mbar/5v" RAT_FUNC "%8.0" "mbar/5v" COEFFS 0 1 0 0 0 1 /end COMPU_METHOD
/begin COMPU_METHOD CM_u16_rspeed_1_4rpm "u16_rspeed_1/4rpm" RAT_FUNC "%10.2" "rpm" COEFFS 0 1 0 0 0 0.25 /end COMPU_METHOD
/begin COMPU_METHOD CM_u16_voltage_18_1023v "u16_voltage_18/1023v" RAT_FUNC "%12.4" "V" COEFFS 0 1 0 0 0 0.0175953079178886 /end COMPU_METHOD
/begin COMPU_METHOD CM_u16_voltage_5_1023v "u16_voltage_5/1023v" RAT_FUNC "%12.4" "V" COEFFS 0 1 0 0 0 0.00488758553274682 /end COMPU_METHOD
/begin COMPU_METHOD CM_u8_accel_1_100g "u8_accel_1/100g" RAT_FUNC "%10.2" "g" COEFFS 0 1 0 0 0 0.01 /end COMPU_METHOD
/begin COMPU_METHOD CM_u8_afr_1_100 "u8_afr_1/100" RAT_FUNC "%10.2" "AFR" COEFFS 0 1 0 0 0 0.01 /end COMPU_METHOD
/begin COMPU_METHOD CM_u8_afr_1_20_5 "u8_afr_1/20+5" RAT_FUNC "%10.2" "AFR" COEFFS 0 1 -5 0 0 0.05 /end COMPU_METHOD
/begin COMPU_METHOD CM_u8_angle_1_4_10deg "u8_angle_1/4-10deg" RAT_FUNC "%10.2" "deg" COEFFS 0 1 10 0 0 0.25 /end COMPU_METHOD
/begin COMPU_METHOD CM_u8_angle_1_4_20deg "u8_angle_1/4-20deg" RAT_FUNC "%10.2" "deg" COEFFS 0 1 20 0 0 0.25 /end COMPU_METHOD
/begin COMPU_METHOD CM_u8_angle_1_4_32deg "u8_angle_1/4-32deg" RAT_FUNC "%10.2" "deg" COEFFS 0 1 32 0 0 0.25 /end COMPU_METHOD
/begin COMPU_METHOD CM_u8_angle_1_4deg "u8_angle_1/4deg" RAT_FUNC "%10.2" "deg" COEFFS 0 1 0 0 0 0.25 /end COMPU_METHOD
/begin COMPU_METHOD CM_u8_angle_720_256deg "u8_angle_720/256deg" RAT_FUNC "%12.4" "deg" COEFFS 0 1 0 0 0 2.8125 /end COMPU_METHOD
/begin COMPU_METHOD CM_u8_dt_factor_1_100_5ms "u8_dt_factor_1/100/5ms" RAT_FUNC "%10.2" "/5ms" COEFFS 0 1 0 0 0 0.01 /end COMPU_METHOD
/begin COMPU_METHOD CM_u8_factor_1_100 "u8_factor_1/100" RAT_FUNC "%8.0" "%" COEFFS 0 1 0 0 0 1 /end COMPU_METHOD
/begin COMPU_METHOD CM_u8_factor_1_128 "u8_factor_1/128" RAT_FUNC "%12.4" "%" COEFFS 0 1 0 0 0 0.78125 /end COMPU_METHOD
/begin COMPU_METHOD CM_u8_factor_1_200 "u8_factor_1/200" RAT_FUNC "%9.1" "%" COEFFS 0 1 0 0 0 0.5 /end COMPU_METHOD
/begin COMPU_METHOD CM_u8_factor_1_255 "u8_factor_1/255" RAT_FUNC "%12.4" "%" COEFFS 0 1 0 0 0 0.392156862745098 /end COMPU_METHOD
/begin COMPU_METHOD CM_u8_factor_1_2560 "u8_factor_1/2560" RAT_FUNC "%12.4" "%" COEFFS 0 1 0 0 0 0.0390625 /end COMPU_METHOD
/begin COMPU_METHOD CM_u8_factor_1_32 "u8_factor_1/32" RAT_FUNC "%11.3" "%" COEFFS 0 1 0 0 0 3.125 /end COMPU_METHOD
/begin COMPU_METHOD CM_u8_factor_1_64 "u8_factor_1/64" RAT_FUNC "%12.4" "%" COEFFS 0 1 0 0 0 1.5625 /end COMPU_METHOD
/begin COMPU_METHOD CM_u8_load_4mg_stroke "u8_load_4mg/stroke" RAT_FUNC "%8.0" "mg/stroke" COEFFS 0 1 0 0 0 4 /end COMPU_METHOD
/begin COMPU_METHOD CM_u8_mass_8g "u8_mass_8g" RAT_FUNC "%8.0" "g" COEFFS 0 1 0 0 0 8 /end COMPU_METHOD
/begin COMPU_METHOD CM_u8_percent_100_256_50 "u8_percent_100/256-50" RAT_FUNC "%12.4" "%" COEFFS 0 1 50 0 0 0.390625 /end COMPU_METHOD
/begin COMPU_METHOD CM_u8_pressure_2mbar "u8_pressure_2mbar" RAT_FUNC "%8.0" "mbar" COEFFS 0 1 0 0 0 2 /end COMPU_METHOD
/begin COMPU_METHOD CM_u8_pressure_4mbar "u8_pressure_4mbar" RAT_FUNC "%8.0" "mbar" COEFFS 0 1 0 0 0 4 /end COMPU_METHOD
/begin COMPU_METHOD CM_u8_rspeed_10rpm "u8_rspeed_10rpm" RAT_FUNC "%8.0" "rpm" COEFFS 0 1 0 0 0 10 /end COMPU_METHOD
/begin COMPU_METHOD CM_u8_rspeed_125_4_500rpm "u8_rspeed_125/4+500rpm" RAT_FUNC "%10.2" "rpm" COEFFS 0 1 -500 0 0 31.25 /end COMPU_METHOD
/begin COMPU_METHOD CM_u8_rspeed_125_4rpm "u8_rspeed_125/4rpm" RAT_FUNC "%10.2" "rpm" COEFFS 0 1 0 0 0 31.25 /end COMPU_METHOD
/begin COMPU_METHOD CM_u8_rspeed_4_512rpm "u8_rspeed_4-512rpm" RAT_FUNC "%8.0" "rpm" COEFFS 0 1 512 0 0 4 /end COMPU_METHOD
/begin COMPU_METHOD CM_u8_rspeed_rpm "u8_rspeed_rpm" RAT_FUNC "%8.0" "rpm" COEFFS 0 1 0 0 0 1 /end COMPU_METHOD
/begin COMPU_METHOD CM_u8_speed_kph "u8_speed_kph" RAT_FUNC "%8.0" "km/h" COEFFS 0 1 0 0 0 1 /end COMPU_METHOD
/begin COMPU_METHOD CM_u8_temp_5_8_40c "u8_temp_5/8-40c" RAT_FUNC "%11.3" "°C" COEFFS 0 1 40 0 0 0.625 /end COMPU_METHOD
/begin COMPU_METHOD CM_u8_time_100ms "u8_time_100ms" RAT_FUNC "%8.0" "ms" COEFFS 0 1 0 0 0 100 /end COMPU_METHOD
/begin COMPU_METHOD CM_u8_time_10us "u8_time_10us" RAT_FUNC "%8.0" "us" COEFFS 0 1 0 0 0 10 /end COMPU_METHOD
/begin COMPU_METHOD CM_u8_time_20us "u8_time_20us" RAT_FUNC "%8.0" "us" COEFFS 0 1 0 0 0 20 /end COMPU_METHOD
/begin COMPU_METHOD CM_u8_time_256us "u8_time_256us" RAT_FUNC "%8.0" "us" COEFFS 0 1 0 0 0 256 /end COMPU_METHOD
/begin COMPU_METHOD CM_u8_time_50ms "u8_time_50ms" RAT_FUNC "%8.0" "ms" COEFFS 0 1 0 0 0 50 /end COMPU_METHOD
/begin COMPU_METHOD CM_u8_time_5ms "u8_time_5ms" RAT_FUNC "%8.0" "ms" COEFFS 0 1 0 0 0 5 /end COMPU_METHOD
/begin COMPU_METHOD CM_u8_time_64us "u8_time_64us" RAT_FUNC "%8.0" "us" COEFFS 0 1 0 0 0 64 /end COMPU_METHOD
/begin COMPU_METHOD CM_u8_time_hours "u8_time_hours" RAT_FUNC "%8.0" "hours" COEFFS 0 1 0 0 0 1 /end COMPU_METHOD
/begin COMPU_METHOD CM_u8_time_s "u8_time_s" RAT_FUNC "%8.0" "s" COEFFS 0 1 0 0 0 1 /end COMPU_METHOD
/begin COMPU_METHOD CM_u8_time_us "u8_time_us" RAT_FUNC "%8.0" "us" COEFFS 0 1 0 0 0 1 /end COMPU_METHOD
/begin COMPU_METHOD CM_u8_voltage_5_255v "u8_voltage_5/255v" RAT_FUNC "%12.4" "V" COEFFS 0 1 0 0 0 0.0196078431372549 /end COMPU_METHOD
/begin COMPU_METHOD CM_u8_voltage_72_1023v "u8_voltage_72/1023v" RAT_FUNC "%12.4" "V" COEFFS 0 1 0 0 0 0.0703812316715543 /end COMPU_METHOD
/begin COMPU_METHOD CM_u8_volume_1_10gallon "u8_volume_1/10gallon" RAT_FUNC "%9.1" "gallon" COEFFS 0 1 0 0 0 0.1 /end COMPU_METHOD
/begin COMPU_METHOD CM_u8_volume_liter "u8_volume_liter" RAT_FUNC "%8.0" "liter" COEFFS 0 1 0 0 0 1 /end COMPU_METHOD
/begin CHARACTERISTIC CAL_sensor_baro_gain "Calibration: sensor barometric gain. Tunable map/constant (not a live channel); log the raw sensor signal to check sensor health and range. (mbar/5V)" VALUE 0x40008E4C RL_VALUE_UWORD 0 CM_u16_ratio_mbar_5v 0 65535 /end CHARACTERISTIC
/begin CHARACTERISTIC CAL_sensor_baro_offset "Calibration: sensor barometric offset. Tunable map/constant (not a live channel); log the raw sensor signal to check sensor health and range. (mbar)" VALUE 0x40008E4E RL_VALUE_SWORD 0 CM_i16_pressure_mbar -32768 32767 /end CHARACTERISTIC
/begin CHARACTERISTIC CAL_sensor_evap_gain "Calibration: sensor EVAP gain. Tunable map/constant (not a live channel); log the raw sensor signal to check sensor health and range. (mbar/5V)" VALUE 0x40008E50 RL_VALUE_UWORD 0 CM_u16_ratio_mbar_5v 0 65535 /end CHARACTERISTIC
/begin CHARACTERISTIC CAL_sensor_evap_offset "Calibration: sensor EVAP offset. Tunable map/constant (not a live channel); log the raw sensor signal to check sensor health and range. (mbar)" VALUE 0x40008E52 RL_VALUE_SWORD 0 CM_i16_pressure_mbar -32768 32767 /end CHARACTERISTIC
/begin CHARACTERISTIC CAL_sensor_adc_map_gain "u16_ratio_mbar/5v" VALUE 0x40008E54 RL_VALUE_UWORD 0 CM_u16_ratio_mbar_5v 0 65535 /end CHARACTERISTIC
/begin CHARACTERISTIC CAL_sensor_adc_map_offset "i16_pressure_mbar" VALUE 0x40008E56 RL_VALUE_SWORD 0 CM_i16_pressure_mbar -32768 32767 /end CHARACTERISTIC
/begin CHARACTERISTIC CAL_fuel_level_debounce_window_low "Calibration: fuel level debounce window low. Tunable map/constant (not a live channel); log to follow fuel delivery and mixture control. (gal; raw/10)" VALUE 0x40008E63 RL_VALUE_UBYTE 0 CM_u8_volume_1_10gallon 0 25.5 /end CHARACTERISTIC
/begin CHARACTERISTIC CAL_fuel_level_debounce_window_high "Calibration: fuel level debounce window high. Tunable map/constant (not a live channel); log to follow fuel delivery and mixture control. (gal; raw/10)" VALUE 0x40008E65 RL_VALUE_UBYTE 0 CM_u8_volume_1_10gallon 0 25.5 /end CHARACTERISTIC
/begin CHARACTERISTIC CAL_fuel_level_update_holdoff "u8_count" VALUE 0x40008E66 RL_VALUE_UBYTE 0 NO_COMPU_METHOD 0 255 /end CHARACTERISTIC
/begin CHARACTERISTIC CAL_fuel_level_stable_count "u8_count" VALUE 0x40008E67 RL_VALUE_UBYTE 0 NO_COMPU_METHOD 0 255 /end CHARACTERISTIC
/begin CHARACTERISTIC CAL_load_alphaN_hold_time "Calibration: load alphaN hold time. Tunable map/constant (not a live channel); log engine load -- the main axis for fueling and ignition. (ms; raw*5)" VALUE 0x40008E68 RL_VALUE_UBYTE 0 CM_u8_time_5ms 0 1275 /end CHARACTERISTIC
/begin CHARACTERISTIC CAL_ign_target_update_inhibit_timer "uint8_t" VALUE 0x40008E6A RL_VALUE_UBYTE 0 NO_COMPU_METHOD 0 255 /end CHARACTERISTIC
/begin CHARACTERISTIC CAL_tpssmooth_rate_calc_window_size "Calibration: tpssmooth rate calculated window size. Tunable map/constant (not a live channel); log to see throttle-signal smoothing/filtering behavior." VALUE 0x40008E6B RL_VALUE_UBYTE 0 NO_COMPU_METHOD 0 255 /end CHARACTERISTIC
/begin CHARACTERISTIC CAL_dfco_pedal_ramp_step_interval "u8_time_5ms" VALUE 0x40008E6F RL_VALUE_UBYTE 0 CM_u8_time_5ms 0 1275 /end CHARACTERISTIC
/begin CHARACTERISTIC CAL_load_filter_coeff "Calibration: injector fuel fillm xtau coeff. Tunable map/constant (not a live channel); log to verify injector pulse width and fuel delivery vs target. (0-1; raw/255)" VALUE 0x40008E70 RL_VALUE_UBYTE 0 CM_u8_factor_1_255 0 100 /end CHARACTERISTIC
/begin CHARACTERISTIC CAL_ign_startup_comp_coolant_min "Calibration: ignition startup compensation coolant min. Tunable map/constant (not a live channel); log spark advance to confirm the timing strategy and headroom to knock. (deg C; raw*5/8-40)" VALUE 0x40008E71 RL_VALUE_UBYTE 0 CM_u8_temp_5_8_40c -40 119.375 /end CHARACTERISTIC
/begin CHARACTERISTIC CAL_ign_startup_comp_coolant_max "Calibration: ignition startup compensation coolant max. Tunable map/constant (not a live channel); log spark advance to confirm the timing strategy and headroom to knock. (deg C; raw*5/8-40)" VALUE 0x40008E72 RL_VALUE_UBYTE 0 CM_u8_temp_5_8_40c -40 119.375 /end CHARACTERISTIC
/begin CHARACTERISTIC CAL_ign_fixed_manual "Calibration: ignition fixed manual. Tunable map/constant (not a live channel); log spark advance to confirm the timing strategy and headroom to knock. (deg; raw/4-10)" VALUE 0x40008E73 RL_VALUE_UBYTE 0 CM_u8_angle_1_4_10deg -10 53.75 /end CHARACTERISTIC
/begin CHARACTERISTIC CAL_injtip_in_adj_gears "Calibration: injtip in adj gears. Tunable map/constant (not a live channel); log to debug transient (tip-in/out) fueling stumbles and surge. (0-1; raw/128)" VAL_BLK 0x40008E75 RL_VALUE_UBYTE 0 CM_u8_factor_1_128 0 199.21875 NUMBER 6 /end CHARACTERISTIC
/begin CHARACTERISTIC CAL_knock_baseline_min_clamp "uint8_t" VALUE 0x40008E7C RL_VALUE_UBYTE 0 NO_COMPU_METHOD 0 255 /end CHARACTERISTIC
/begin CHARACTERISTIC CAL_sensor_ac_evap_temp_filter_alpha "uint8_t" VALUE 0x40008E7D RL_VALUE_UBYTE 0 NO_COMPU_METHOD 0 255 /end CHARACTERISTIC
/begin CHARACTERISTIC CAL_ign_trim_per_cyl "Calibration: ignition trim per cylinder. Tunable map/constant (not a live channel); log spark advance to confirm the timing strategy and headroom to knock. (deg; raw/4-32)" VAL_BLK 0x40008E7E RL_VALUE_UBYTE 0 CM_u8_angle_1_4_32deg -32 31.75 NUMBER 6 /end CHARACTERISTIC
/begin CHARACTERISTIC CAL_closedloop_activate_air_temp "Calibration: closedloop activate air temperature. Tunable map/constant (not a live channel); log to watch O2 feedback trim the mixture and confirm the loop is active. (deg C; raw*5/8-40)" VALUE 0x40008E94 RL_VALUE_UBYTE 0 CM_u8_temp_5_8_40c -40 119.375 /end CHARACTERISTIC
/begin CHARACTERISTIC CAL_closedloop_stft_steady_state_holdoff_ticks "u8_time_100ms" VALUE 0x40008E95 RL_VALUE_UBYTE 0 CM_u8_time_100ms 0 25500 /end CHARACTERISTIC
/begin CHARACTERISTIC CAL_closedloop_ramp_interval_scale "uint8_t" VALUE 0x40008E97 RL_VALUE_UBYTE 0 NO_COMPU_METHOD 0 255 /end CHARACTERISTIC
/begin CHARACTERISTIC CAL_dfco_entry_pedal_max_clutch_coast "Calibration: DFCO entry pedal max clutch coast. Tunable map/constant (not a live channel); log to see when fuel is cut and restored on deceleration. (0-1; raw/255)" VALUE 0x40008E9E RL_VALUE_UBYTE 0 CM_u8_factor_1_255 0 100 /end CHARACTERISTIC
/begin CHARACTERISTIC CAL_load_alphaN_learn_trim_limits "Calibration: torque torque to throttle position scaling RPM range unknown. Tunable map/constant (not a live channel); log to see throttle/pedal demand and throttle response. (RPM; raw*125/4+500)" VAL_BLK 0x40008E9F RL_VALUE_UBYTE 0 CM_u8_factor_1_100 0 255 NUMBER 2 /end CHARACTERISTIC
/begin CHARACTERISTIC CAL_load_learning_enable_coolant_min "u8_temp_5/8-40c" VALUE 0x40008EA4 RL_VALUE_UBYTE 0 CM_u8_temp_5_8_40c -40 119.375 /end CHARACTERISTIC
/begin CHARACTERISTIC CAL_sensor_airtemp_tmaf_filter_alpha "Calibration: sensor engine air reactivity. Tunable map/constant (not a live channel); log the raw sensor signal to check sensor health and range. (0-1; raw/2560)" VALUE 0x40008EA7 RL_VALUE_UBYTE 0 CM_u8_factor_1_2560 0 9.9609375 /end CHARACTERISTIC
/begin CHARACTERISTIC CAL_sensor_coolant_filter_alpha "Calibration: sensor coolant reactivity. Tunable map/constant (not a live channel); log the raw sensor signal to check sensor health and range. (0-1; raw/2560)" VALUE 0x40008EA8 RL_VALUE_UBYTE 0 CM_u8_factor_1_2560 0 9.9609375 /end CHARACTERISTIC
/begin CHARACTERISTIC CAL_sensor_airtemp_not_wired_filter_alpha "Calibration: sensor intake air reactivity. Tunable map/constant (not a live channel); log the raw sensor signal to check sensor health and range. (0-1; raw/2560)" VALUE 0x40008EA9 RL_VALUE_UBYTE 0 CM_u8_factor_1_2560 0 9.9609375 /end CHARACTERISTIC
/begin CHARACTERISTIC CAL_closedloop_low_rpm_stft_reset_rpm "u8_rspeed_125/4+500rpm" VALUE 0x40008EAA RL_VALUE_UBYTE 0 CM_u8_rspeed_125_4_500rpm 500 8468.75 /end CHARACTERISTIC
/begin CHARACTERISTIC CAL_fuel_level_filter_coeff_rise "u8_factor_1/255" VALUE 0x40008EAB RL_VALUE_UBYTE 0 CM_u8_factor_1_255 0 100 /end CHARACTERISTIC
/begin CHARACTERISTIC CAL_dfco_entry_speed_min "Calibration: DFCO entry speed min. Tunable map/constant (not a live channel); log to see when fuel is cut and restored on deceleration. (km/h)" VALUE 0x40008EB0 RL_VALUE_UBYTE 0 CM_u8_speed_kph 0 255 /end CHARACTERISTIC
/begin CHARACTERISTIC CAL_dfco_exit_speed_min_ips "Calibration: DFCO exit speed min IPS. Tunable map/constant (not a live channel); log to see when fuel is cut and restored on deceleration. (km/h)" VALUE 0x40008EB1 RL_VALUE_UBYTE 0 CM_u8_speed_kph 0 255 /end CHARACTERISTIC
/begin CHARACTERISTIC CAL_ign_enable_lea_knock_retard "Calibration: ignition enable lea knock retard. Tunable map/constant (not a live channel); log spark advance to confirm the timing strategy and headroom to knock." VALUE 0x40008EB2 RL_VALUE_UBYTE 0 NO_COMPU_METHOD 0 255 /end CHARACTERISTIC
/begin CHARACTERISTIC CAL_sensor_o2_heater_softstart_pwm_period "uint8_t" VALUE 0x40008EB3 RL_VALUE_UBYTE 0 NO_COMPU_METHOD 0 255 /end CHARACTERISTIC
/begin CHARACTERISTIC CAL_sensor_o2_heater_softstart_duration "u16_time_5ms" VALUE 0x40008EB4 RL_VALUE_UWORD 0 CM_u8_time_5ms 0 327675 /end CHARACTERISTIC
/begin CHARACTERISTIC CAL_knock_retard1_limit "Calibration: knock retard1 limit. Tunable map/constant (not a live channel); log to catch knock events and see how much timing is being pulled. (deg; raw/4)" VALUE 0x40008EB6 RL_VALUE_UBYTE 0 CM_u8_angle_1_4deg 0 63.75 /end CHARACTERISTIC
/begin CHARACTERISTIC CAL_knock_ign_retard_initial "Calibration: knock ignition retard initial. Tunable map/constant (not a live channel); log spark advance to confirm the timing strategy and headroom to knock." VALUE 0x40008EB7 RL_VALUE_UBYTE 0 NO_COMPU_METHOD 0 255 /end CHARACTERISTIC
/begin CHARACTERISTIC CAL_knock_ign_retard_decay_rate "Calibration: knock ignition retard decay rate. Tunable map/constant (not a live channel); log spark advance to confirm the timing strategy and headroom to knock. (deg; raw/4)" VALUE 0x40008EB8 RL_VALUE_UBYTE 0 CM_u8_angle_1_4deg 0 63.75 /end CHARACTERISTIC
/begin CHARACTERISTIC CAL_knock_octane_scaler_increment "Calibration: knock octane scaler increment. Tunable map/constant (not a live channel); log to catch knock events and see how much timing is being pulled." VALUE 0x40008EB9 RL_VALUE_UBYTE 0 NO_COMPU_METHOD 0 255 /end CHARACTERISTIC
/begin CHARACTERISTIC CAL_knock_octane_scaler_decrement "Calibration: knock octane scaler decrement. Tunable map/constant (not a live channel); log to catch knock events and see how much timing is being pulled." VALUE 0x40008EBA RL_VALUE_UBYTE 0 NO_COMPU_METHOD 0 255 /end CHARACTERISTIC
/begin CHARACTERISTIC CAL_knock_detection_engine_speed_max "Calibration: knock detection engine speed max. Tunable map/constant (not a live channel); log to catch knock events and see how much timing is being pulled. (RPM; raw*125/4+500)" VALUE 0x40008EBB RL_VALUE_UBYTE 0 CM_u8_rspeed_125_4_500rpm 500 8468.75 /end CHARACTERISTIC
/begin CHARACTERISTIC CAL_knock_detection_engine_speed_min "Calibration: knock detection engine speed min. Tunable map/constant (not a live channel); log to catch knock events and see how much timing is being pulled. (RPM; raw*125/4+500)" VALUE 0x40008EBC RL_VALUE_UBYTE 0 CM_u8_rspeed_125_4_500rpm 500 8468.75 /end CHARACTERISTIC
/begin CHARACTERISTIC CAL_knock_learning_enable_coolant_temp_min "u8_temp_5/8-40c" VALUE 0x40008EBD RL_VALUE_UBYTE 0 CM_u8_temp_5_8_40c -40 119.375 /end CHARACTERISTIC
/begin CHARACTERISTIC CAL_knock_octane_short_term_retard_max "It sets how much retard a fully saturated short-term octane scaler adds." VALUE 0x40008EBE RL_VALUE_UBYTE 0 CM_u8_angle_1_4deg 0 63.75 /end CHARACTERISTIC
/begin CHARACTERISTIC CAL_knock_evaluate_cylinder_filter_coef "uint8_t" VALUE 0x40008EBF RL_VALUE_UBYTE 0 NO_COMPU_METHOD 0 255 /end CHARACTERISTIC
/begin CHARACTERISTIC CAL_knock_detection_engine_speed_margin "Calibration: knock detection engine speed margin. Tunable map/constant (not a live channel); log to catch knock events and see how much timing is being pulled. (RPM; raw*125/4)" VALUE 0x40008EC0 RL_VALUE_UBYTE 0 CM_u8_rspeed_125_4rpm 0 7968.75 /end CHARACTERISTIC
/begin CHARACTERISTIC CAL_knock_detection_load_margin_debounce "Calibration: knock detection load margin debounce. Tunable map/constant (not a live channel); log to catch knock events and see how much timing is being pulled. (mg/stroke; raw*4)" VALUE 0x40008EC1 RL_VALUE_UBYTE 0 CM_u8_load_4mg_stroke 0 1020 /end CHARACTERISTIC
/begin CHARACTERISTIC CAL_knock_inhibit_timer_tps_rate "Calibration: knock inhibit timer throttle position rate. Tunable map/constant (not a live channel); log to catch knock events and see how much timing is being pulled. (ms; raw*5)" VALUE 0x40008EC2 RL_VALUE_UBYTE 0 CM_u8_time_5ms 0 1275 /end CHARACTERISTIC
/begin CHARACTERISTIC CAL_knock_inhibit_tps_rate1 "Calibration: knock inhibit throttle position rate1. Tunable map/constant (not a live channel); log to catch knock events and see how much timing is being pulled. (0-1; raw/1023)" VALUE 0x40008EC4 RL_VALUE_UWORD 0 CM_u16_factor_1_1023 0 6406.15835777126 /end CHARACTERISTIC
/begin CHARACTERISTIC CAL_closedloop_stft_filter_unknown "uint8_t" VALUE 0x40008EC7 RL_VALUE_UBYTE 0 NO_COMPU_METHOD 0 255 /end CHARACTERISTIC
/begin CHARACTERISTIC CAL_ign_comp_ac_compressor_active "Calibration: ignition compensation A/C compressor active. Tunable map/constant (not a live channel); log spark advance to confirm the timing strategy and headroom to knock. (deg; raw/4)" VALUE 0x40008ED3 RL_VALUE_SBYTE 0 CM_u8_angle_1_4deg -32 31.75 /end CHARACTERISTIC
/begin CHARACTERISTIC CAL_injtip_in_adj_gears_6 "Calibration: injtip in adj gears 6. Tunable map/constant (not a live channel); log to debug transient (tip-in/out) fueling stumbles and surge. (0-1; raw/128)" VALUE 0x40008ED5 RL_VALUE_UBYTE 0 CM_u8_factor_1_128 0 199.21875 /end CHARACTERISTIC
/begin CHARACTERISTIC CAL_inj_comp_enrichment_per_degree_ign_retard "Calibration: injector compensation enrichment per degree ignition retard. Tunable map/constant (not a live channel); log to verify injector pulse width and fuel delivery vs target. (AFR; raw/100)" VALUE 0x40008EDF RL_VALUE_UBYTE 0 CM_u8_afr_1_100 0 2.55 /end CHARACTERISTIC
/begin CHARACTERISTIC CAL_inj_fuel_learn_zone_1_offset_step "This is the step size of the idle/low-load injector offset learn." VALUE 0x40008EE1 RL_VALUE_UBYTE 0 CM_u8_time_us 0 255 /end CHARACTERISTIC
/begin CHARACTERISTIC CAL_sensor_pps_unknown1 "uint8_t" VALUE 0x40008EE2 RL_VALUE_UBYTE 0 NO_COMPU_METHOD 0 255 /end CHARACTERISTIC
/begin CHARACTERISTIC CAL_sensor_accel_pedal_d_gain "u8_factor_1/64" VALUE 0x40008EE3 RL_VALUE_UBYTE 0 CM_u8_factor_1_64 0 398.4375 /end CHARACTERISTIC
/begin CHARACTERISTIC CAL_sensor_accel_pedal_e_gain "u8_factor_1/64" VALUE 0x40008EE4 RL_VALUE_UBYTE 0 CM_u8_factor_1_64 0 398.4375 /end CHARACTERISTIC
/begin CHARACTERISTIC CAL_tps_accel_pedal_zero_calibrate_timer "uint8_t" VALUE 0x40008EE5 RL_VALUE_UBYTE 0 NO_COMPU_METHOD 0 255 /end CHARACTERISTIC
/begin CHARACTERISTIC CAL_sensor_map_avg_window_size "u8_count" VALUE 0x40008EE7 RL_VALUE_UBYTE 0 NO_COMPU_METHOD 0 255 /end CHARACTERISTIC
/begin CHARACTERISTIC CAL_knock_agc_threshold "Calibration: knock AGC threshold. Tunable map/constant (not a live channel); log to catch knock events and see how much timing is being pulled. (RPM; raw*125/4+500)" VAL_BLK 0x40008EEA RL_VALUE_UBYTE 0 CM_u8_rspeed_125_4_500rpm 500 8468.75 NUMBER 3 /end CHARACTERISTIC
/begin CHARACTERISTIC CAL_knock_agc_hysteresis_band "Calibration: knock AGC hysteresis band. Tunable map/constant (not a live channel); log to catch knock events and see how much timing is being pulled. (RPM; raw*125/4+500)" VALUE 0x40008EED RL_VALUE_UBYTE 0 CM_u8_rspeed_125_4_500rpm 500 8468.75 /end CHARACTERISTIC
/begin CHARACTERISTIC CAL_ign_zero_rpm_threshold "uint8_t" VALUE 0x40008EFA RL_VALUE_UBYTE 0 NO_COMPU_METHOD 0 255 /end CHARACTERISTIC
/begin CHARACTERISTIC CAL_ign_comp_idle_transient_max_advance "Calibration: ignition compensation idle transient max advance. Tunable map/constant (not a live channel); log spark advance to confirm the timing strategy and headroom to knock. (deg; raw/4)" VALUE 0x40008EFB RL_VALUE_UBYTE 0 CM_u8_angle_1_4deg 0 63.75 /end CHARACTERISTIC
/begin CHARACTERISTIC CAL_knock_octane_scaler_shortterm_multiplier "uint8_t" VALUE 0x40008F04 RL_VALUE_UBYTE 0 NO_COMPU_METHOD 0 255 /end CHARACTERISTIC
/begin CHARACTERISTIC CAL_knock_octane_scaler_shortterm_decrement "Calibration: knock octane scaler shortterm decrement. Tunable map/constant (not a live channel); log to catch knock events and see how much timing is being pulled." VALUE 0x40008F05 RL_VALUE_UBYTE 0 NO_COMPU_METHOD 0 255 /end CHARACTERISTIC
/begin CHARACTERISTIC CAL_ign_dfco_recovery_hold_time "For up to 3 seconds after a fuel cut ends, the ignition target keeps slewing on its normal path instead of handing authority to the idle spark controller — even once RPM has fallen far enough that idle mode would otherwise take over." VALUE 0x40008F08 RL_VALUE_UWORD 0 CM_u8_time_5ms 0 327675 /end CHARACTERISTIC
/begin CHARACTERISTIC CAL_tps_etb_pid_kd "uint16_t" VALUE 0x40008F0A RL_VALUE_UWORD 0 NO_COMPU_METHOD 0 65535 /end CHARACTERISTIC
/begin CHARACTERISTIC CAL_tps_etb_tps1_max_count "uint16_t" VALUE 0x40008F0E RL_VALUE_UWORD 0 NO_COMPU_METHOD 0 65535 /end CHARACTERISTIC
/begin CHARACTERISTIC CAL_tps_etb_tps2_max_count "uint16_t" VALUE 0x40008F12 RL_VALUE_UWORD 0 NO_COMPU_METHOD 0 65535 /end CHARACTERISTIC
/begin CHARACTERISTIC CAL_tps_etb_pwm_period "u16_time_us" VALUE 0x40008F14 RL_VALUE_UWORD 0 CM_u8_time_us 0 65535 /end CHARACTERISTIC
/begin CHARACTERISTIC CAL_tps_etb_pid_kp "u16_factor_1/100" VALUE 0x40008F1A RL_VALUE_UWORD 0 CM_u8_factor_1_100 0 65535 /end CHARACTERISTIC
/begin CHARACTERISTIC CAL_tps_etb_pid_ki "u16_factor_1/10000" VALUE 0x40008F1E RL_VALUE_UWORD 0 CM_u16_factor_1_10000 0 655.35 /end CHARACTERISTIC
/begin CHARACTERISTIC CAL_injtip_overrun_hysteresis_timer "Calibration: injtip overrun hysteresis timer. Tunable map/constant (not a live channel); log to debug transient (tip-in/out) fueling stumbles and surge. (ms; raw*5)" VALUE 0x40008F20 RL_VALUE_UWORD 0 CM_u8_time_5ms 0 327675 /end CHARACTERISTIC
/begin CHARACTERISTIC CAL_tps1_range_lo_frac "u16_factor_1/1023" VALUE 0x40008F22 RL_VALUE_UWORD 0 CM_u16_factor_1_1023 0 6406.15835777126 /end CHARACTERISTIC
/begin CHARACTERISTIC CAL_tps1_range_hi_frac "u16_factor_1/1023" VALUE 0x40008F24 RL_VALUE_UWORD 0 CM_u16_factor_1_1023 0 6406.15835777126 /end CHARACTERISTIC
/begin CHARACTERISTIC CAL_tps_etb_pid_i_clamp "u16_factor_1/10000" VALUE 0x40008F2A RL_VALUE_UWORD 0 CM_u16_factor_1_10000 0 655.35 /end CHARACTERISTIC
/begin CHARACTERISTIC CAL_tps_decrement_base "Calibration: throttle position decrement base. Tunable map/constant (not a live channel); log to see throttle/pedal demand and throttle response. (0-1; raw/1023)" VALUE 0x40008F2C RL_VALUE_UWORD 0 CM_u16_factor_1_1023 0 6406.15835777126 /end CHARACTERISTIC
/begin CHARACTERISTIC CAL_dfco_rpm_offset_above_idle "u8_rspeed_rpm" VALUE 0x40008F2E RL_VALUE_UBYTE 0 CM_u8_rspeed_rpm 0 255 /end CHARACTERISTIC
/begin CHARACTERISTIC CAL_closedloop_bank_sync_max_hold "u8_time_100ms" VALUE 0x40008F31 RL_VALUE_UBYTE 0 CM_u8_time_100ms 0 25500 /end CHARACTERISTIC
/begin CHARACTERISTIC CAL_sensor_clutch_engaged_threshold "Calibration: sensor clutch engaged threshold. Tunable map/constant (not a live channel); log the raw sensor signal to check sensor health and range. (V; raw*5/1023)" VALUE 0x40008F38 RL_VALUE_UWORD 0 CM_u16_voltage_5_1023v 0 320.307917888563 /end CHARACTERISTIC
/begin CHARACTERISTIC CAL_sensor_clutch_disengaged_threshold "Calibration: sensor clutch disengaged threshold. Tunable map/constant (not a live channel); log the raw sensor signal to check sensor health and range. (V; raw*5/1023)" VALUE 0x40008F3A RL_VALUE_UWORD 0 CM_u16_voltage_5_1023v 0 320.307917888563 /end CHARACTERISTIC
/begin CHARACTERISTIC CAL_tpssmooth_decrement_comp_gears_manual "Calibration: tpssmooth decrement compensation gears manual. Tunable map/constant (not a live channel); log to see throttle-signal smoothing/filtering behavior. (0-1; raw/255)" VAL_BLK 0x40008F3D RL_VALUE_UBYTE 0 CM_u8_factor_1_255 0 100 NUMBER 7 /end CHARACTERISTIC
/begin CHARACTERISTIC CAL_load_learning_engine_accel_max "uint16_t" VALUE 0x40008F4A RL_VALUE_UWORD 0 NO_COMPU_METHOD 0 65535 /end CHARACTERISTIC
/begin CHARACTERISTIC CAL_closedloop_o2_warmup_time "Calibration: closedloop O2 warmup time. Tunable map/constant (not a live channel); log to watch O2 feedback trim the mixture and confirm the loop is active. (ms; raw*5)" VALUE 0x40008F54 RL_VALUE_UWORD 0 CM_u8_time_5ms 0 327675 /end CHARACTERISTIC
/begin CHARACTERISTIC CAL_closedloop_afr "Calibration: closedloop AFR. Tunable map/constant (not a live channel); log to watch O2 feedback trim the mixture and confirm the loop is active. (AFR; raw/100)" VALUE 0x40008F6C RL_VALUE_UWORD 0 CM_u8_afr_1_100 0 655.35 /end CHARACTERISTIC
/begin CHARACTERISTIC CAL_closedloop_o2_sensor_voltage_switching_lean "u16_voltage_5/1023v" VALUE 0x40008F6E RL_VALUE_UWORD 0 CM_u16_voltage_5_1023v 0 320.307917888563 /end CHARACTERISTIC
/begin CHARACTERISTIC CAL_closedloop_o2_sensor_voltage_switch_rich "u16_voltage_5/1023v" VALUE 0x40008F70 RL_VALUE_UWORD 0 CM_u16_voltage_5_1023v 0 320.307917888563 /end CHARACTERISTIC
/begin CHARACTERISTIC CAL_inj_stft_limit "Calibration: injector stft limit. Tunable map/constant (not a live channel); log to verify injector pulse width and fuel delivery vs target. (raw/20)" VALUE 0x40008F72 RL_VALUE_SWORD 0 CM_i16_percent_1_20 -1638.4 1638.35 /end CHARACTERISTIC
/begin CHARACTERISTIC CAL_load_learning_stabilization_delay "Calibration: load learning stabilization delay. Tunable map/constant (not a live channel); log engine load -- the main axis for fueling and ignition." VALUE 0x40008F82 RL_VALUE_UWORD 0 CM_u8_time_5ms 0 327675 /end CHARACTERISTIC
/begin CHARACTERISTIC CAL_load_alphaN_learn_ratio_deadband "Calibration: throttle position idle to current ratio threshold. Tunable map/constant (not a live channel); log to diagnose idle quality, hunting, and stalls." VAL_BLK 0x40008F84 RL_VALUE_UWORD 0 CM_u8_factor_1_100 0 65535 NUMBER 2 /end CHARACTERISTIC
/begin CHARACTERISTIC CAL_load_learning_min_maf_accumulated "u16_mass_mg" VALUE 0x40008F88 RL_VALUE_UWORD 0 CM_u16_mass_mg 0 65535 /end CHARACTERISTIC
/begin CHARACTERISTIC CAL_load_learning_holdoff_delay "Calibration: load learning holdoff delay. Tunable map/constant (not a live channel); log engine load -- the main axis for fueling and ignition." VALUE 0x40008F8A RL_VALUE_UWORD 0 CM_u8_time_5ms 0 327675 /end CHARACTERISTIC
/begin CHARACTERISTIC CAL_injtip_tipout_decay_rate_divider "uint8_t" VALUE 0x40008F94 RL_VALUE_UBYTE 0 NO_COMPU_METHOD 0 255 /end CHARACTERISTIC
/begin CHARACTERISTIC CAL_tpssmooth_decrement_cruise_scale "u8_factor_1/255" VALUE 0x40008F96 RL_VALUE_UBYTE 0 CM_u8_factor_1_255 0 100 /end CHARACTERISTIC
/begin CHARACTERISTIC CAL_closedloop_prop_gain_lean_slow_switch_scale "u8_factor_1/64" VALUE 0x40008F99 RL_VALUE_UBYTE 0 CM_u8_factor_1_64 0 398.4375 /end CHARACTERISTIC
/begin CHARACTERISTIC CAL_sensor_maf_adc_avg_window_depth "Calibration: sensor MAF ADC avg window depth. Tunable map/constant (not a live channel); log the raw sensor signal to check sensor health and range." VALUE 0x40008F9C RL_VALUE_UBYTE 0 NO_COMPU_METHOD 0 255 /end CHARACTERISTIC
/begin CHARACTERISTIC CAL_inj_transient_us_per_count "Calibration: injtip time base. Tunable map/constant (not a live channel); log to debug transient (tip-in/out) fueling stumbles and surge. (us)" VALUE 0x40008F9E RL_VALUE_UBYTE 0 CM_u8_time_us 0 255 /end CHARACTERISTIC
/begin CHARACTERISTIC CAL_tps_delta_rate_window_size "Calibration: throttle position delta rate window size. Tunable map/constant (not a live channel); log to see throttle/pedal demand and throttle response." VALUE 0x40008F9F RL_VALUE_UBYTE 0 NO_COMPU_METHOD 0 255 /end CHARACTERISTIC
/begin CHARACTERISTIC CAL_injtip_in_decay_count "u8_count" VALUE 0x40008FA0 RL_VALUE_UBYTE 0 NO_COMPU_METHOD 0 255 /end CHARACTERISTIC
/begin CHARACTERISTIC CAL_injtip_out_decay_count "u8_count" VALUE 0x40008FA1 RL_VALUE_UBYTE 0 NO_COMPU_METHOD 0 255 /end CHARACTERISTIC
/begin CHARACTERISTIC CAL_injtip_in_threshold "Calibration: injtip in threshold. Tunable map/constant (not a live channel); log to debug transient (tip-in/out) fueling stumbles and surge. (0-1; raw/1023)" VAL_BLK 0x40008FA2 RL_VALUE_UWORD 0 CM_u16_factor_1_1023 0 6406.15835777126 NUMBER 2 /end CHARACTERISTIC
/begin CHARACTERISTIC CAL_tps_delta_neg_clamp "uint16_t" VALUE 0x40008FA6 RL_VALUE_UWORD 0 NO_COMPU_METHOD 0 65535 /end CHARACTERISTIC
/begin CHARACTERISTIC CAL_tps_delta_neg_threshold "uint16_t" VALUE 0x40008FA8 RL_VALUE_UWORD 0 NO_COMPU_METHOD 0 65535 /end CHARACTERISTIC
/begin CHARACTERISTIC CAL_closedloop_integration_period "Calibration: closedloop integration period. Tunable map/constant (not a live channel); log to watch O2 feedback trim the mixture and confirm the loop is active. (ms; raw*5)" VALUE 0x40008FAA RL_VALUE_UBYTE 0 CM_u8_time_5ms 0 1275 /end CHARACTERISTIC
/begin CHARACTERISTIC CAL_closedloop_prop_gain_rich_slow_switch_scale "Calibration: closed loop prop gain rich slow switch scale. Tunable map/constant (not a live channel); adjust to change this behavior. (0-1; raw/64)" VALUE 0x40008FAB RL_VALUE_UBYTE 0 CM_u8_factor_1_64 0 398.4375 /end CHARACTERISTIC
/begin CHARACTERISTIC CAL_closedloop_enable_iat_min "Calibration: closed loop enable intake-air temp min. Tunable map/constant (not a live channel); adjust to change this behavior. (deg C; raw*5/8-40)" VALUE 0x40008FAC RL_VALUE_UBYTE 0 CM_u8_temp_5_8_40c -40 119.375 /end CHARACTERISTIC
/begin CHARACTERISTIC CAL_closedloop_fuel_level_min "Calibration: closed loop fuel level min. Tunable map/constant (not a live channel); log to follow fuel delivery and mixture control. (L)" VALUE 0x40008FAD RL_VALUE_UBYTE 0 CM_u8_volume_liter 0 255 /end CHARACTERISTIC
/begin CHARACTERISTIC CAL_tps_warmup_max "u16_factor_1/1023" VALUE 0x40008FB0 RL_VALUE_UWORD 0 CM_u16_factor_1_1023 0 6406.15835777126 /end CHARACTERISTIC
/begin CHARACTERISTIC CAL_tps_commanded_wamup_min "Calibration: throttle position commanded wamup min. Tunable map/constant (not a live channel); log to see throttle/pedal demand and throttle response. (0-1; raw/1023)" VALUE 0x40008FB2 RL_VALUE_UWORD 0 CM_u16_factor_1_1023 0 6406.15835777126 /end CHARACTERISTIC
/begin CHARACTERISTIC CAL_dfco_exit_pedal_min "Calibration: DFCO exit pedal min. Tunable map/constant (not a live channel); log to see when fuel is cut and restored on deceleration. (0-1; raw/1023)" VALUE 0x40008FB6 RL_VALUE_UBYTE 0 CM_u16_factor_1_1023 0 24.9266862170088 /end CHARACTERISTIC
/begin CHARACTERISTIC CAL_dfco_entry_pedal_max "Calibration: DFCO entry pedal max. Tunable map/constant (not a live channel); log to see when fuel is cut and restored on deceleration. (0-1; raw/1023)" VALUE 0x40008FB7 RL_VALUE_UBYTE 0 CM_u16_factor_1_1023 0 24.9266862170088 /end CHARACTERISTIC
/begin CHARACTERISTIC CAL_fuel_reserve_size "Calibration: fuel reserve size. Tunable map/constant (not a live channel); log to follow fuel delivery and mixture control. (L)" VALUE 0x40008FB8 RL_VALUE_UBYTE 0 CM_u8_volume_liter 0 255 /end CHARACTERISTIC
/begin CHARACTERISTIC CAL_fuel_level_filter_coeff_fall "u8_factor_1/255" VALUE 0x40008FB9 RL_VALUE_UBYTE 0 CM_u8_factor_1_255 0 100 /end CHARACTERISTIC
/begin CHARACTERISTIC CAL_dfco_entry_temp_min "Calibration: DFCO entry temperature min. Tunable map/constant (not a live channel); log to see when fuel is cut and restored on deceleration. (deg C; raw*5/8-40)" VALUE 0x40008FBC RL_VALUE_UBYTE 0 CM_u8_temp_5_8_40c -40 119.375 /end CHARACTERISTIC
/begin CHARACTERISTIC CAL_dfco_exit_temp_max "Calibration: DFCO exit temperature max. Tunable map/constant (not a live channel); log to see when fuel is cut and restored on deceleration. (deg C; raw*5/8-40)" VALUE 0x40008FBD RL_VALUE_UBYTE 0 CM_u8_temp_5_8_40c -40 119.375 /end CHARACTERISTIC
/begin CHARACTERISTIC CAL_dfco_cyl_ramp_length "Calibration: DFCO cylinder ramp length. Tunable map/constant (not a live channel); log to see when fuel is cut and restored on deceleration." VALUE 0x40008FBE RL_VALUE_UBYTE 0 NO_COMPU_METHOD 0 255 /end CHARACTERISTIC
/begin CHARACTERISTIC CAL_dfco_recovery_enrich_decay "uint8_t" VALUE 0x40008FC0 RL_VALUE_UBYTE 0 NO_COMPU_METHOD 0 255 /end CHARACTERISTIC
/begin CHARACTERISTIC CAL_dfco_entry_min_runtime "Calibration: DFCO entry min runtime. Tunable map/constant (not a live channel); log to see when fuel is cut and restored on deceleration. (ms; raw*50)" VALUE 0x40008FC1 RL_VALUE_UBYTE 0 CM_u8_time_50ms 0 12750 /end CHARACTERISTIC
/begin CHARACTERISTIC CAL_load_alphaN_max_rpm "Calibration: load alphaN max RPM. Tunable map/constant (not a live channel); log engine load -- the main axis for fueling and ignition. (RPM)" VALUE 0x40008FC2 RL_VALUE_UWORD 0 CM_u8_rspeed_rpm 0 65535 /end CHARACTERISTIC
/begin CHARACTERISTIC CAL_load_alphaN_tps_rate_closing_threshold "Calibration: load alphaN throttle position rate closing threshold. Tunable map/constant (not a live channel); log to see throttle/pedal demand and throttle response. (0-1; raw/255)" VALUE 0x40008FC4 RL_VALUE_UWORD 0 CM_u8_factor_1_255 0 25700 /end CHARACTERISTIC
/begin CHARACTERISTIC CAL_closedloop_enable_baro_min "Calibration: closed loop enable barometric min. Tunable map/constant (not a live channel); adjust to change this behavior. (mbar)" VALUE 0x40008FCC RL_VALUE_UWORD 0 CM_i16_pressure_mbar 0 65535 /end CHARACTERISTIC
/begin CHARACTERISTIC CAL_injtip_dfco_min_runtime "uint8_t" VALUE 0x40008FCE RL_VALUE_UBYTE 0 NO_COMPU_METHOD 0 255 /end CHARACTERISTIC
/begin CHARACTERISTIC CAL_acis_open_rpm "Calibration: acis open RPM. Tunable map/constant (not a live channel); adjust to change this behavior. (RPM)" VALUE 0x40008FD6 RL_VALUE_UWORD 0 CM_u8_rspeed_rpm 0 65535 /end CHARACTERISTIC
/begin CHARACTERISTIC CAL_acis_close_rpm "Calibration: acis close RPM. Tunable map/constant (not a live channel); adjust to change this behavior. (RPM)" VALUE 0x40008FD8 RL_VALUE_UWORD 0 CM_u8_rspeed_rpm 0 65535 /end CHARACTERISTIC
/begin CHARACTERISTIC CAL_acis_close_load "Calibration: acis close load. Tunable map/constant (not a live channel); log engine load -- the main axis for fueling and ignition. (mg/stroke; raw*4)" VALUE 0x40008FDA RL_VALUE_UBYTE 0 CM_u8_load_4mg_stroke 0 1020 /end CHARACTERISTIC
/begin CHARACTERISTIC CAL_acis_open_load "Calibration: acis open load. Tunable map/constant (not a live channel); log engine load -- the main axis for fueling and ignition. (mg/stroke; raw*4)" VALUE 0x40008FDB RL_VALUE_UBYTE 0 CM_u8_load_4mg_stroke 0 1020 /end CHARACTERISTIC
/begin CHARACTERISTIC CAL_dfco_entry_rpm_clutch_coast "Calibration: DFCO entry RPM clutch coast. Tunable map/constant (not a live channel); log to see when fuel is cut and restored on deceleration. (RPM; raw*10)" VALUE 0x40008FE1 RL_VALUE_UBYTE 0 CM_u8_rspeed_10rpm 0 2550 /end CHARACTERISTIC
/begin CHARACTERISTIC CAL_load_learning_tps_rate_max "u16_factor_1/255" VALUE 0x40008FE8 RL_VALUE_UWORD 0 CM_u8_factor_1_255 0 25700 /end CHARACTERISTIC
/begin CHARACTERISTIC CAL_closedloop_stft_increment_period "uint16_t" VALUE 0x40008FEC RL_VALUE_UWORD 0 NO_COMPU_METHOD 0 65535 /end CHARACTERISTIC
/begin CHARACTERISTIC CAL_load_alphaN_tps_rate_opening_threshold "Calibration: load alphaN throttle position rate opening threshold. Tunable map/constant (not a live channel); log to see throttle/pedal demand and throttle response. (0-1; raw/255)" VALUE 0x40008FF2 RL_VALUE_UWORD 0 CM_u8_factor_1_255 0 25700 /end CHARACTERISTIC
/begin CHARACTERISTIC CAL_inj_fuel_learn_offset_maf_max "u16_flow_10mg/s" VALUE 0x40008FFA RL_VALUE_UWORD 0 CM_u16_flow_10mg_s 0 655350 /end CHARACTERISTIC
/begin CHARACTERISTIC CAL_inj_fuel_learn_offset_rpm_max "u16_rspeed_rpm" VALUE 0x40008FFC RL_VALUE_UWORD 0 CM_u8_rspeed_rpm 0 65535 /end CHARACTERISTIC
/begin CHARACTERISTIC CAL_inj_fuel_learn_zone_2_maf_max "u16_flow_10mg/s" VALUE 0x40008FFE RL_VALUE_UWORD 0 CM_u16_flow_10mg_s 0 655350 /end CHARACTERISTIC
/begin CHARACTERISTIC CAL_inj_fuel_learn_zone_2_maf_min "u16_flow_10mg/s" VALUE 0x40009000 RL_VALUE_UWORD 0 CM_u16_flow_10mg_s 0 655350 /end CHARACTERISTIC
/begin CHARACTERISTIC CAL_inj_fuel_learn_zone_2_load_max "u16_load_mg/stroke" VALUE 0x40009002 RL_VALUE_UWORD 0 CM_u16_load_mg_stroke 0 65535 /end CHARACTERISTIC
/begin CHARACTERISTIC CAL_inj_fuel_learn_zone_2_load_min "u16_load_mg/stroke" VALUE 0x40009004 RL_VALUE_UWORD 0 CM_u16_load_mg_stroke 0 65535 /end CHARACTERISTIC
/begin CHARACTERISTIC CAL_inj_fuel_learn_zone_3_maf_min "u16_flow_10mg/s" VALUE 0x40009006 RL_VALUE_UWORD 0 CM_u16_flow_10mg_s 0 655350 /end CHARACTERISTIC
/begin CHARACTERISTIC CAL_inj_fuel_learn_zone_3_load_min "u16_load_mg/stroke" VALUE 0x40009008 RL_VALUE_UWORD 0 CM_u16_load_mg_stroke 0 65535 /end CHARACTERISTIC
/begin CHARACTERISTIC CAL_closedloop_enable_ect_min "Calibration: closed loop enable coolant temp min. Tunable map/constant (not a live channel); adjust to change this behavior. (deg C; raw*5/8-40)" VALUE 0x4000900A RL_VALUE_UBYTE 0 CM_u8_temp_5_8_40c -40 119.375 /end CHARACTERISTIC
/begin CHARACTERISTIC CAL_inj_fuel_learn_step_period "uint8_t" VALUE 0x4000900B RL_VALUE_UBYTE 0 NO_COMPU_METHOD 0 255 /end CHARACTERISTIC
/begin CHARACTERISTIC CAL_inj_fuel_learn_stft_lean_limit "i16_percent_1/20" VALUE 0x4000900C RL_VALUE_SWORD 0 CM_i16_percent_1_20 -1638.4 1638.35 /end CHARACTERISTIC
/begin CHARACTERISTIC CAL_inj_fuel_learn_stft_rich_limit "i16_percent_1/20" VALUE 0x4000900E RL_VALUE_SWORD 0 CM_i16_percent_1_20 -1638.4 1638.35 /end CHARACTERISTIC
/begin CHARACTERISTIC CAL_inj_fuel_learn_lean_time_limit "u8_time_10us" VALUE 0x40009010 RL_VALUE_UBYTE 0 CM_u8_time_10us 0 2550 /end CHARACTERISTIC
/begin CHARACTERISTIC CAL_inj_fuel_learn_rich_time_limit "u8_time_10us" VALUE 0x40009011 RL_VALUE_UBYTE 0 CM_u8_time_10us 0 2550 /end CHARACTERISTIC
/begin CHARACTERISTIC CAL_inj_fuel_learn_zone_2_max "u8_percent_100/256-50" VALUE 0x40009012 RL_VALUE_UBYTE 0 CM_u8_percent_100_256_50 -50 49.609375 /end CHARACTERISTIC
/begin CHARACTERISTIC CAL_inj_fuel_learn_zone_2_min "u8_percent_100/256-50" VALUE 0x40009013 RL_VALUE_UBYTE 0 CM_u8_percent_100_256_50 -50 49.609375 /end CHARACTERISTIC
/begin CHARACTERISTIC CAL_inj_fuel_learn_zone_3_max "uint8_t" VALUE 0x40009014 RL_VALUE_UBYTE 0 NO_COMPU_METHOD 0 255 /end CHARACTERISTIC
/begin CHARACTERISTIC CAL_inj_fuel_learn_zone_3_min "uint8_t" VALUE 0x40009015 RL_VALUE_UBYTE 0 NO_COMPU_METHOD 0 255 /end CHARACTERISTIC
/begin CHARACTERISTIC CAL_closedloop_proportional_gain_lean_ips "Calibration: closedloop proportional gain rich IPS. Tunable map/constant (not a live channel); log to watch O2 feedback trim the mixture and confirm the loop is active." VALUE 0x40009016 RL_VALUE_SWORD 0 CM_i16_factor_1_20 -163840 163835 /end CHARACTERISTIC
/begin CHARACTERISTIC CAL_closedloop_proportional_gain_rich_ips "Calibration: closedloop proportional gain lean IPS. Tunable map/constant (not a live channel); log to watch O2 feedback trim the mixture and confirm the loop is active." VALUE 0x40009018 RL_VALUE_SWORD 0 CM_i16_factor_1_20 -163840 163835 /end CHARACTERISTIC
/begin CHARACTERISTIC CAL_closedloop_integral_gain_ips "Calibration: closedloop integral gain IPS. Tunable map/constant (not a live channel); log to watch O2 feedback trim the mixture and confirm the loop is active." VALUE 0x4000901A RL_VALUE_SWORD 0 CM_i16_factor_1_20 -163840 163835 /end CHARACTERISTIC
/begin CHARACTERISTIC CAL_closedloop_derivative_gain_ips "Calibration: closedloop derivative gain IPS. Tunable map/constant (not a live channel); log to watch O2 feedback trim the mixture and confirm the loop is active." VALUE 0x4000901C RL_VALUE_SWORD 0 CM_i16_factor_1_20 -163840 163835 /end CHARACTERISTIC
/begin CHARACTERISTIC CAL_closedloop_o2_rich_threshold "Calibration: closedloop O2 rich threshold. Tunable map/constant (not a live channel); log to watch O2 feedback trim the mixture and confirm the loop is active. (V; raw*5/1023)" VALUE 0x4000901E RL_VALUE_UWORD 0 CM_u16_voltage_5_1023v 0 320.307917888563 /end CHARACTERISTIC
/begin CHARACTERISTIC CAL_closedloop_o2_lean_threshold "Calibration: closedloop O2 lean threshold. Tunable map/constant (not a live channel); log to watch O2 feedback trim the mixture and confirm the loop is active. (V; raw*5/1023)" VALUE 0x40009020 RL_VALUE_UWORD 0 CM_u16_voltage_5_1023v 0 320.307917888563 /end CHARACTERISTIC
/begin CHARACTERISTIC CAL_inj_flow_rate "Calibration: injector flow rate. Tunable map/constant (not a live channel); log to verify injector pulse width and fuel delivery vs target. (mg/s)" VALUE 0x40009024 RL_VALUE_UWORD 0 CM_u16_flow_mg_s 0 65535 /end CHARACTERISTIC
/begin CHARACTERISTIC CAL_tps_limit_idle_request_max "Calibration: throttle position idle request max. Tunable map/constant (not a live channel); log to diagnose idle quality, hunting, and stalls. (0-1; raw/1023)" VALUE 0x40009026 RL_VALUE_UWORD 0 CM_u16_factor_1_1023 0 6406.15835777126 /end CHARACTERISTIC
/begin CHARACTERISTIC CAL_tps_limit_misfire_single_bank "Calibration: throttle position limit misfire single bank. Tunable map/constant (not a live channel); log to find misfires and which cylinder is responsible. (0-1; raw/255)" VALUE 0x40009029 RL_VALUE_UBYTE 0 CM_u8_factor_1_255 0 100 /end CHARACTERISTIC
/begin CHARACTERISTIC CAL_airbox_flapper_engine_speed_tour "Calibration: airbox flapper engine speed tour. Tunable map/constant (not a live channel); log to follow core engine state." VAL_BLK 0x4000902A RL_VALUE_UWORD 0 NO_COMPU_METHOD 0 65535 NUMBER 2 /end CHARACTERISTIC
/begin CHARACTERISTIC CAL_ign_idle_recovery_period "Calibration: ignition idle recovery period 5ms. Tunable map/constant (not a live channel); log spark advance to confirm the timing strategy and headroom to knock. (ms; raw*5)" VALUE 0x4000902E RL_VALUE_UBYTE 0 CM_u8_time_5ms 0 1275 /end CHARACTERISTIC
/begin CHARACTERISTIC CAL_tps_limit_severe_misfire_multi_cut "Calibration: throttle position limit severe misfire multi cut. Tunable map/constant (not a live channel); log to find misfires and which cylinder is responsible. (0-1; raw/255)" VALUE 0x40009037 RL_VALUE_UBYTE 0 CM_u8_factor_1_255 0 100 /end CHARACTERISTIC
/begin CHARACTERISTIC CAL_tps_limit_severe_misfire_1_cut "Calibration: throttle position limit severe misfire 1 cut. Tunable map/constant (not a live channel); log to find misfires and which cylinder is responsible. (0-1; raw/255)" VALUE 0x40009038 RL_VALUE_UBYTE 0 CM_u8_factor_1_255 0 100 /end CHARACTERISTIC
/begin CHARACTERISTIC CAL_tps_limit_severe_misfire_no_cut "Calibration: throttle position limit severe misfire no cut. Tunable map/constant (not a live channel); log to find misfires and which cylinder is responsible. (0-1; raw/255)" VALUE 0x40009039 RL_VALUE_UBYTE 0 CM_u8_factor_1_255 0 100 /end CHARACTERISTIC
/begin CHARACTERISTIC CAL_tps_limit_warmup_coolant_max "u8_temp_5/8-40c" VALUE 0x40009040 RL_VALUE_UBYTE 0 CM_u8_temp_5_8_40c -40 119.375 /end CHARACTERISTIC
/begin CHARACTERISTIC CAL_tps_limit_warmup_stepsize "Calibration: throttle position limit warmup stepsize. Tunable map/constant (not a live channel); log to see throttle/pedal demand and throttle response. (0-1; raw/1023)" VALUE 0x40009041 RL_VALUE_UBYTE 0 CM_u16_factor_1_1023 0 24.9266862170088 /end CHARACTERISTIC
/begin CHARACTERISTIC CAL_closedloop_jump_lean_scaling_ips "uint8_t" VALUE 0x40009044 RL_VALUE_UBYTE 0 NO_COMPU_METHOD 0 255 /end CHARACTERISTIC
/begin CHARACTERISTIC CAL_fuel_level_change_threshold "u8_volume_liter" VALUE 0x40009047 RL_VALUE_UBYTE 0 CM_u8_volume_liter 0 255 /end CHARACTERISTIC
/begin CHARACTERISTIC CAL_fuel_trim_integral_max "uint16_t" VALUE 0x40009048 RL_VALUE_UWORD 0 NO_COMPU_METHOD 0 65535 /end CHARACTERISTIC
/begin CHARACTERISTIC CAL_tpssmooth_decrement_comp_gears_ips "Calibration: tpssmooth decrement compensation gears IPS. Tunable map/constant (not a live channel); log to see throttle-signal smoothing/filtering behavior. (0-1; raw/255)" VAL_BLK 0x4000904E RL_VALUE_UBYTE 0 CM_u8_factor_1_255 0 100 NUMBER 7 /end CHARACTERISTIC
/begin CHARACTERISTIC CAL_closedloop_integral_gain_startup_duration "uint8_t" VALUE 0x40009055 RL_VALUE_UBYTE 0 NO_COMPU_METHOD 0 255 /end CHARACTERISTIC
/begin CHARACTERISTIC CAL_closedloop_o2_breakin_window_hours "u8_time_hours; maximum engine run time before long-term fuel trim adaptation stops updating" VALUE 0x40009056 RL_VALUE_UBYTE 0 CM_u8_time_hours 0 255 /end CHARACTERISTIC
/begin CHARACTERISTIC CAL_closedloop_jump_lean_scaling "uint8_t" VALUE 0x40009057 RL_VALUE_UBYTE 0 NO_COMPU_METHOD 0 255 /end CHARACTERISTIC
/begin CHARACTERISTIC CAL_closedloop_hold_time "Calibration: closedloop hold time. Tunable map/constant (not a live channel); log to watch O2 feedback trim the mixture and confirm the loop is active." VALUE 0x40009058 RL_VALUE_UBYTE 0 NO_COMPU_METHOD 0 255 /end CHARACTERISTIC
/begin CHARACTERISTIC CAL_inj_fuel_learn_power_enrich_load_min "u8_load_4mg/stroke" VALUE 0x4000905F RL_VALUE_UBYTE 0 CM_u8_load_4mg_stroke 0 1020 /end CHARACTERISTIC
/begin CHARACTERISTIC CAL_inj_fuel_learn_power_enrich_rpm_min "u8_rspeed_125/4+500rpm" VALUE 0x40009060 RL_VALUE_UBYTE 0 CM_u8_rspeed_125_4_500rpm 500 8468.75 /end CHARACTERISTIC
/begin CHARACTERISTIC CAL_roughness_enable_rpm "Calibration: roughness enable RPM. Tunable map/constant (not a live channel); log to find misfires and rough-running cylinders. (RPM; raw/4)" VAL_BLK 0x4000906A RL_VALUE_UWORD 0 CM_u16_rspeed_1_4rpm 0 16383.75 NUMBER 2 /end CHARACTERISTIC
/begin CHARACTERISTIC CAL_roughness_enable_load "Calibration: roughness enable load. Tunable map/constant (not a live channel); log to find misfires and rough-running cylinders. (mg/stroke; raw*4)" VAL_BLK 0x4000906E RL_VALUE_UBYTE 0 CM_u8_load_4mg_stroke 0 1020 NUMBER 2 /end CHARACTERISTIC
/begin CHARACTERISTIC CAL_roughness_unknown6 "uint8_t" VALUE 0x40009070 RL_VALUE_UBYTE 0 NO_COMPU_METHOD 0 255 /end CHARACTERISTIC
/begin CHARACTERISTIC CAL_roughness_unknown8 "uint8_t" VALUE 0x40009071 RL_VALUE_UBYTE 0 NO_COMPU_METHOD 0 255 /end CHARACTERISTIC
/begin CHARACTERISTIC CAL_roughness_delta_rpm_smoothing_factor "Calibration: roughness delta RPM smoothing factor. Tunable map/constant (not a live channel); log to find misfires and rough-running cylinders. (0-1; raw/100)" VALUE 0x40009072 RL_VALUE_UBYTE 0 CM_u8_factor_1_100 0 255 /end CHARACTERISTIC
/begin CHARACTERISTIC CAL_roughness_min_edge_count "u8_count" VALUE 0x40009073 RL_VALUE_UBYTE 0 NO_COMPU_METHOD 0 255 /end CHARACTERISTIC
/begin CHARACTERISTIC CAL_roughness_cycle_count_threshold "Calibration: roughness cycle count threshold. Tunable map/constant (not a live channel); log to find misfires and rough-running cylinders." VALUE 0x40009074 RL_VALUE_UBYTE 0 NO_COMPU_METHOD 0 255 /end CHARACTERISTIC
/begin CHARACTERISTIC CAL_roughness_peak_valley_imblance_threshold "uint8_t" VALUE 0x40009075 RL_VALUE_UBYTE 0 NO_COMPU_METHOD 0 255 /end CHARACTERISTIC
/begin CHARACTERISTIC CAL_roughness_unknown2 "uint8_t" VALUE 0x40009076 RL_VALUE_UBYTE 0 NO_COMPU_METHOD 0 255 /end CHARACTERISTIC
/begin CHARACTERISTIC CAL_roughness_peak_valley_imbalance_threshold "Calibration: roughness peak valley imbalance threshold. Tunable map/constant (not a live channel); log to find misfires and rough-running cylinders." VALUE 0x40009077 RL_VALUE_UBYTE 0 NO_COMPU_METHOD 0 255 /end CHARACTERISTIC
/begin CHARACTERISTIC CAL_roughness_unknown5 "uint8_t" VALUE 0x40009078 RL_VALUE_UBYTE 0 NO_COMPU_METHOD 0 255 /end CHARACTERISTIC
/begin CHARACTERISTIC CAL_roughness_unknown4 "uint8_t" VALUE 0x40009079 RL_VALUE_UBYTE 0 NO_COMPU_METHOD 0 255 /end CHARACTERISTIC
/begin CHARACTERISTIC CAL_roughness_ign_adv_min_sign_flipped "Calibration: roughness ignition advance min sign flipped. Tunable map/constant (not a live channel); log spark advance to confirm the timing strategy and headroom to knock. (deg; raw/4)" VALUE 0x4000907A RL_VALUE_UBYTE 0 CM_u8_angle_1_4deg 0 63.75 /end CHARACTERISTIC
/begin CHARACTERISTIC CAL_roughness_ign_adv_max "Calibration: roughness ignition advance max. Tunable map/constant (not a live channel); log spark advance to confirm the timing strategy and headroom to knock. (deg; raw/4)" VALUE 0x4000907B RL_VALUE_UBYTE 0 CM_u8_angle_1_4deg 0 63.75 /end CHARACTERISTIC
/begin CHARACTERISTIC CAL_roughness_unknown7 "uint8_t" VALUE 0x4000907C RL_VALUE_UBYTE 0 NO_COMPU_METHOD 0 255 /end CHARACTERISTIC
/begin CHARACTERISTIC CAL_ign_fixed_ips "Calibration: ignition fixed IPS. Tunable map/constant (not a live channel); log spark advance to confirm the timing strategy and headroom to knock. (deg; raw/4-10)" VALUE 0x40009091 RL_VALUE_UBYTE 0 CM_u8_angle_1_4_10deg -10 53.75 /end CHARACTERISTIC
/begin CHARACTERISTIC CAL_knock_freq_bands "u16_freq_hz[11]" VAL_BLK 0x40009092 RL_VALUE_UWORD 0 CM_u16_freq_hz 0 65535 NUMBER 11 /end CHARACTERISTIC
/begin CHARACTERISTIC CAL_tps_brake_wheeldecel_threshold "u8_accel_1/100g" VALUE 0x400090A8 RL_VALUE_UBYTE 0 CM_u8_accel_1_100g 0 2.55 /end CHARACTERISTIC
/begin CHARACTERISTIC CAL_tps_brake_safety_floor "Calibration: throttle position brake safety floor. Tunable map/constant (not a live channel); log to see throttle/pedal demand and throttle response. (0-1; raw/100)" VALUE 0x400090A9 RL_VALUE_UBYTE 0 CM_u8_factor_1_100 0 255 /end CHARACTERISTIC
/begin CHARACTERISTIC CAL_tps_brake_wheeldecel_tps_cut_threshold "uint8_t" VALUE 0x400090AC RL_VALUE_UBYTE 0 NO_COMPU_METHOD 0 255 /end CHARACTERISTIC
/begin CHARACTERISTIC CAL_knock_dsp_nyquist_hz "Calibration: knock AGC scaling threshold. Tunable map/constant (not a live channel); log to catch knock events and see how much timing is being pulled." VALUE 0x400090B0 RL_VALUE_UWORD 0 CM_u16_freq_hz 0 65535 /end CHARACTERISTIC
/begin CHARACTERISTIC CAL_knock_mode "Calibration: knock mode. Tunable map/constant (not a live channel); log to catch knock events and see how much timing is being pulled." VALUE 0x400090B2 RL_VALUE_UBYTE 0 NO_COMPU_METHOD 0 255 /end CHARACTERISTIC
/begin CHARACTERISTIC CAL_tpssmooth_parking_threshold_carspeed "uint8_t" VALUE 0x400090B4 RL_VALUE_UBYTE 0 NO_COMPU_METHOD 0 255 /end CHARACTERISTIC
/begin CHARACTERISTIC CAL_tpssmooth_parking_threshold_tps "uint8_t" VALUE 0x400090B8 RL_VALUE_UBYTE 0 NO_COMPU_METHOD 0 255 /end CHARACTERISTIC
/begin CHARACTERISTIC CAL_tpssmooth_accel_pedal_modes_enable "Calibration: tpssmooth accelerator pedal modes enable. Tunable map/constant (not a live channel); log to see throttle-signal smoothing/filtering behavior." VALUE 0x400090B9 RL_VALUE_UBYTE 0 NO_COMPU_METHOD 0 255 /end CHARACTERISTIC
/begin CHARACTERISTIC CAL_tpssmooth_parking_pedal_max "Calibration: tpssmooth parking pedal max. Tunable map/constant (not a live channel); log to see throttle-signal smoothing/filtering behavior. (0-1; raw/255)" VALUE 0x400090BD RL_VALUE_UBYTE 0 CM_u8_factor_1_255 0 100 /end CHARACTERISTIC
/begin CHARACTERISTIC CAL_tpssmooth_parking_speed_max "Calibration: tpssmooth parking speed max. Tunable map/constant (not a live channel); log to see throttle-signal smoothing/filtering behavior. (km/h)" VALUE 0x400090BE RL_VALUE_UBYTE 0 CM_u8_speed_kph 0 255 /end CHARACTERISTIC
/begin CHARACTERISTIC CAL_tpssmooth_parking_gear_max "Calibration: tpssmooth parking gear max. Tunable map/constant (not a live channel); log to see throttle-signal smoothing/filtering behavior." VALUE 0x400090BF RL_VALUE_UBYTE 0 NO_COMPU_METHOD 0 255 /end CHARACTERISTIC
/begin CHARACTERISTIC CAL_lfb_timer_entry "Calibration: long-term fuel timer entry. Tunable map/constant (not a live channel); log to track long-term fuel learning and spot a developing fuel fault." VALUE 0x400090FE RL_VALUE_UBYTE 0 NO_COMPU_METHOD 0 255 /end CHARACTERISTIC
/begin CHARACTERISTIC CAL_lfb_timer_hold "Calibration: long-term fuel timer hold. Tunable map/constant (not a live channel); log to track long-term fuel learning and spot a developing fuel fault." VALUE 0x400090FF RL_VALUE_UBYTE 0 NO_COMPU_METHOD 0 255 /end CHARACTERISTIC
/begin CHARACTERISTIC CAL_lfb_tps_max "Calibration: long-term fuel throttle position max. Tunable map/constant (not a live channel); log to track long-term fuel learning and spot a developing fuel fault. (0-1; raw/255)" VALUE 0x40009101 RL_VALUE_UBYTE 0 CM_u8_factor_1_255 0 100 /end CHARACTERISTIC
/begin CHARACTERISTIC CAL_lfb_detect_carspeed_min "Calibration: long-term fuel detect carspeed min. Tunable map/constant (not a live channel); log to track long-term fuel learning and spot a developing fuel fault. (km/h)" VALUE 0x40009102 RL_VALUE_UBYTE 0 CM_u8_speed_kph 0 255 /end CHARACTERISTIC
/begin CHARACTERISTIC CAL_lfb_pedal_override_rate "uint8_t" VALUE 0x40009103 RL_VALUE_UBYTE 0 NO_COMPU_METHOD 0 255 /end CHARACTERISTIC
/begin CHARACTERISTIC CAL_lfb_release_rate "uint8_t" VALUE 0x40009104 RL_VALUE_UBYTE 0 NO_COMPU_METHOD 0 255 /end CHARACTERISTIC
/begin CHARACTERISTIC CAL_lfb_pedal_release_threshold "uint8_t" VALUE 0x40009105 RL_VALUE_UBYTE 0 NO_COMPU_METHOD 0 255 /end CHARACTERISTIC
/begin CHARACTERISTIC CAL_lfb_pedal_override_max "uint8_t" VALUE 0x40009106 RL_VALUE_UBYTE 0 NO_COMPU_METHOD 0 255 /end CHARACTERISTIC
/begin CHARACTERISTIC CAL_lfb_pulse_toggle_period "u8_time_100ms" VALUE 0x40009107 RL_VALUE_UBYTE 0 CM_u8_time_100ms 0 25500 /end CHARACTERISTIC
/begin CHARACTERISTIC CAL_lfb_pulse_enable "Calibration: long-term fuel pulse enable. Tunable map/constant (not a live channel); log to track long-term fuel learning and spot a developing fuel fault." VALUE 0x40009108 RL_VALUE_UBYTE 0 NO_COMPU_METHOD 0 255 /end CHARACTERISTIC
/begin CHARACTERISTIC CAL_lfb_clutch_threshold "Calibration: long-term fuel clutch threshold. Tunable map/constant (not a live channel); log to track long-term fuel learning and spot a developing fuel fault. (V; raw*5/1023)" VALUE 0x4000910A RL_VALUE_UWORD 0 CM_u16_voltage_5_1023v 0 320.307917888563 /end CHARACTERISTIC
/begin CHARACTERISTIC CAL_dfco_recovery_enrich_max_rpm "In short: it suppresses the DFCO re-entry enrichment shot at high RPM where it isn't needed, preventing over-fueling during high-RPM overrun recovery." VALUE 0x40009116 RL_VALUE_UWORD 0 CM_u8_rspeed_rpm 0 65535 /end CHARACTERISTIC
/begin CHARACTERISTIC CAL_dfco_recovery_enrich_cooldown_ticks "u16_time_5ms" VALUE 0x40009118 RL_VALUE_UWORD 0 CM_u8_time_5ms 0 327675 /end CHARACTERISTIC
/begin CHARACTERISTIC CAL_tps_etb_low_voltage_threshold "u16_voltage_18/1023v" VALUE 0x4000911A RL_VALUE_UWORD 0 CM_u16_voltage_18_1023v 0 1153.10850439883 /end CHARACTERISTIC
/begin CHARACTERISTIC CAL_lfb_brake_off_hold_ticks "uint16_t" VALUE 0x4000911C RL_VALUE_UWORD 0 NO_COMPU_METHOD 0 65535 /end CHARACTERISTIC
/begin CHARACTERISTIC CAL_inj_soak_time_max "uint16_t" VALUE 0x40009128 RL_VALUE_UWORD 0 NO_COMPU_METHOD 0 65535 /end CHARACTERISTIC
/begin CHARACTERISTIC CAL_inj_post_start_enrichment_decay_divisor "uint8_t" VALUE 0x4000912E RL_VALUE_UBYTE 0 NO_COMPU_METHOD 0 255 /end CHARACTERISTIC
/begin CHARACTERISTIC CAL_inj_soak_time_max_40009130 "u16_time_100ms" VALUE 0x40009130 RL_VALUE_UWORD 0 CM_u8_time_100ms 0 6553500 /end CHARACTERISTIC
/begin AXIS_PTS CAL_inj_warmup_factor_ips_X_load "X-axis breakpoints for the 'injector enrichment factor load n coolant IPS' table. Defines the lookup grid (not a live channel); change only when re-axing the map. (mg/stroke; raw*4)" 0x400092CA load_mass_per_stroke RL_AXIS_UBYTE 0 CM_u8_load_4mg_stroke 12 0 1020 /end AXIS_PTS
/begin AXIS_PTS CAL_inj_warmup_factor_ips_Y_coolant_temp "Y-axis breakpoints for the 'injector enrichment factor load n coolant IPS' table. Defines the lookup grid (not a live channel); change only when re-axing the map. (deg C; raw*5/8-40)" 0x400092D6 coolant_temp RL_AXIS_UBYTE 0 CM_u8_temp_5_8_40c 16 -40 119.375 /end AXIS_PTS
/begin CHARACTERISTIC CAL_inj_warmup_factor_ips "Calibration: injector enrichment factor load n coolant IPS. Tunable map/constant (not a live channel); log to verify injector pulse width and fuel delivery vs target. (0-1; raw/64)" MAP 0x400092E6 RL_VALUE_UBYTE 0 CM_u8_factor_1_64 0 398.4375
 /begin AXIS_DESCR COM_AXIS load_mass_per_stroke CM_u8_load_4mg_stroke 12 0 1020 AXIS_PTS_REF CAL_inj_warmup_factor_ips_X_load /end AXIS_DESCR
 /begin AXIS_DESCR COM_AXIS coolant_temp CM_u8_temp_5_8_40c 16 -40 119.375 AXIS_PTS_REF CAL_inj_warmup_factor_ips_Y_coolant_temp /end AXIS_DESCR
/end CHARACTERISTIC
/begin AXIS_PTS CAL_inj_afterstart_comp_air_temp_X_iat "X-axis breakpoints for the 'injector cranking enrichment2' table. Defines the lookup grid (not a live channel); change only when re-axing the map. (deg C; raw*5/8-40)" 0x400093BE airtemp_tmaf RL_AXIS_UBYTE 0 CM_u8_temp_5_8_40c 10 -40 119.375 /end AXIS_PTS
/begin AXIS_PTS CAL_inj_afterstart_comp_air_temp_Y_maf_accum "Y-axis breakpoints for the 'injector cranking enrichment2' table. Defines the lookup grid (not a live channel); change only when re-axing the map. (g; raw*8)" 0x400093C8 V_CAL_inj_afterstart_comp_air_temp_Y_maf_accum RL_AXIS_UBYTE 0 CM_u8_mass_8g 10 0 2040 /end AXIS_PTS
/begin CHARACTERISTIC CAL_inj_afterstart_comp_air_temp "Calibration: injector cranking enrichment2. Tunable map/constant (not a live channel); log to verify injector pulse width and fuel delivery vs target. (0-1; raw/32)" MAP 0x400093D2 RL_VALUE_UBYTE 0 CM_u8_factor_1_32 0 796.875
 /begin AXIS_DESCR COM_AXIS airtemp_tmaf CM_u8_temp_5_8_40c 10 -40 119.375 AXIS_PTS_REF CAL_inj_afterstart_comp_air_temp_X_iat /end AXIS_DESCR
 /begin AXIS_DESCR COM_AXIS V_CAL_inj_afterstart_comp_air_temp_Y_maf_accum CM_u8_mass_8g 10 0 2040 AXIS_PTS_REF CAL_inj_afterstart_comp_air_temp_Y_maf_accum /end AXIS_DESCR
/end CHARACTERISTIC
/begin CHARACTERISTIC CAL_sensor_airtemp_TMAF_temp "Calibration: sensor engine air scaling. Tunable map/constant (not a live channel); log the raw sensor signal to check sensor health and range. (deg C; raw*5/8-40)" VAL_BLK 0x40009436 RL_VALUE_UBYTE 0 CM_u8_temp_5_8_40c -40 119.375 NUMBER 34 /end CHARACTERISTIC
/begin CHARACTERISTIC CAL_sensor_coolant_scaling "Calibration: sensor coolant scaling. Tunable map/constant (not a live channel); log the raw sensor signal to check sensor health and range. (deg C; raw*5/8-40)" VAL_BLK 0x40009458 RL_VALUE_UBYTE 0 CM_u8_temp_5_8_40c -40 119.375 NUMBER 34 /end CHARACTERISTIC
/begin CHARACTERISTIC CAL_sensor_airtemp_not_wired "Calibration: sensor intake air scaling. Tunable map/constant (not a live channel); log the raw sensor signal to check sensor health and range. (deg C; raw*5/8-40)" VAL_BLK 0x4000947A RL_VALUE_UBYTE 0 CM_u8_temp_5_8_40c -40 119.375 NUMBER 33 /end CHARACTERISTIC
/begin AXIS_PTS CAL_sensor_fuel_pressure_sensor_unused_X_voltage "u8_voltage_5/255v[16]" 0x4000949C NO_INPUT_QUANTITY RL_AXIS_UBYTE 0 CM_u8_voltage_5_255v 16 0 5 /end AXIS_PTS
/begin CHARACTERISTIC CAL_sensor_fuel_pressure_sensor_unused "uint8_t[16]" CURVE 0x400094AC RL_VALUE_UBYTE 0 NO_COMPU_METHOD 0 255
 /begin AXIS_DESCR COM_AXIS NO_INPUT_QUANTITY CM_u8_voltage_5_255v 16 0 5 AXIS_PTS_REF CAL_sensor_fuel_pressure_sensor_unused_X_voltage /end AXIS_DESCR
/end CHARACTERISTIC
/begin AXIS_PTS CAL_dfco_entry_rpm_manual_X_coolant_temp "X-axis breakpoints for the 'DFCO entry RPM manual' table. Defines the lookup grid (not a live channel); change only when re-axing the map. (deg C; raw*5/8-40)" 0x400094BC coolant_temp RL_AXIS_UBYTE 0 CM_u8_temp_5_8_40c 4 -40 119.375 /end AXIS_PTS
/begin CHARACTERISTIC CAL_dfco_entry_rpm_manual "Calibration: DFCO entry RPM manual. Tunable map/constant (not a live channel); log to see when fuel is cut and restored on deceleration. (RPM; raw*10)" CURVE 0x400094C0 RL_VALUE_UBYTE 0 CM_u8_rspeed_10rpm 0 2550
 /begin AXIS_DESCR COM_AXIS coolant_temp CM_u8_temp_5_8_40c 4 -40 119.375 AXIS_PTS_REF CAL_dfco_entry_rpm_manual_X_coolant_temp /end AXIS_DESCR
/end CHARACTERISTIC
/begin AXIS_PTS CAL_dfco_exit_rpm_ingear_manual_X_coolant_temp "X-axis breakpoints for the 'DFCO exit RPM ingear manual' table. Defines the lookup grid (not a live channel); change only when re-axing the map. (deg C; raw*5/8-40)" 0x400094C4 coolant_temp RL_AXIS_UBYTE 0 CM_u8_temp_5_8_40c 4 -40 119.375 /end AXIS_PTS
/begin CHARACTERISTIC CAL_dfco_exit_rpm_ingear_manual "Calibration: DFCO exit RPM ingear manual. Tunable map/constant (not a live channel); log to see when fuel is cut and restored on deceleration. (RPM; raw*10)" CURVE 0x400094C8 RL_VALUE_UBYTE 0 CM_u8_rspeed_10rpm 0 2550
 /begin AXIS_DESCR COM_AXIS coolant_temp CM_u8_temp_5_8_40c 4 -40 119.375 AXIS_PTS_REF CAL_dfco_exit_rpm_ingear_manual_X_coolant_temp /end AXIS_DESCR
/end CHARACTERISTIC
/begin AXIS_PTS CAL_dfco_exit_rpm_neutral_X_coolant_temp "X-axis breakpoints for the 'DFCO exit RPM neutral' table. Defines the lookup grid (not a live channel); change only when re-axing the map. (deg C; raw*5/8-40)" 0x400094CC coolant_temp RL_AXIS_UBYTE 0 CM_u8_temp_5_8_40c 4 -40 119.375 /end AXIS_PTS
/begin CHARACTERISTIC CAL_dfco_exit_rpm_neutral "Calibration: DFCO exit RPM neutral. Tunable map/constant (not a live channel); log to see when fuel is cut and restored on deceleration. (RPM; raw*10)" CURVE 0x400094D0 RL_VALUE_UBYTE 0 CM_u8_rspeed_10rpm 0 2550
 /begin AXIS_DESCR COM_AXIS coolant_temp CM_u8_temp_5_8_40c 4 -40 119.375 AXIS_PTS_REF CAL_dfco_exit_rpm_neutral_X_coolant_temp /end AXIS_DESCR
/end CHARACTERISTIC
/begin AXIS_PTS CAL_ign_comp_coldstart_X_coolant_temp "X-axis breakpoints for the 'ignition compensation coldstart' table. Defines the lookup grid (not a live channel); change only when re-axing the map. (deg C; raw*5/8-40)" 0x400094DE coolant_temp_engine_stopped RL_AXIS_UBYTE 0 CM_u8_temp_5_8_40c 8 -40 119.375 /end AXIS_PTS
/begin CHARACTERISTIC CAL_ign_comp_coldstart "Calibration: ignition compensation coldstart. Tunable map/constant (not a live channel); log spark advance to confirm the timing strategy and headroom to knock. (deg; raw/4-10)" CURVE 0x400094E6 RL_VALUE_UBYTE 0 CM_u8_angle_1_4_10deg -10 53.75
 /begin AXIS_DESCR COM_AXIS coolant_temp_engine_stopped CM_u8_temp_5_8_40c 8 -40 119.375 AXIS_PTS_REF CAL_ign_comp_coldstart_X_coolant_temp /end AXIS_DESCR
/end CHARACTERISTIC
/begin AXIS_PTS CAL_dfco_entry_rpm_manual_alt_X_coolant_temp "X-axis breakpoints for the 'DFCO entry RPM manual alt' table. Defines the lookup grid (not a live channel); change only when re-axing the map. (deg C; raw*5/8-40)" 0x4000950E coolant_temp RL_AXIS_UBYTE 0 CM_u8_temp_5_8_40c 4 -40 119.375 /end AXIS_PTS
/begin CHARACTERISTIC CAL_dfco_entry_rpm_manual_alt "Calibration: DFCO entry RPM manual alt. Tunable map/constant (not a live channel); log to see when fuel is cut and restored on deceleration. (RPM; raw*10)" CURVE 0x40009512 RL_VALUE_UBYTE 0 CM_u8_rspeed_10rpm 0 2550
 /begin AXIS_DESCR COM_AXIS coolant_temp CM_u8_temp_5_8_40c 4 -40 119.375 AXIS_PTS_REF CAL_dfco_entry_rpm_manual_alt_X_coolant_temp /end AXIS_DESCR
/end CHARACTERISTIC
/begin CHARACTERISTIC CAL_dfco_recovery_enrich_X_cut_duration "uint8_t[16]" VAL_BLK 0x4000954E RL_VALUE_UBYTE 0 NO_COMPU_METHOD 0 255 NUMBER 16 /end CHARACTERISTIC
/begin AXIS_PTS CAL_ign_comp_idle_error_moving_X_idle_speed_error "X-axis breakpoints for the 'ignition compensation idle error moving' table. Defines the lookup grid (not a live channel); change only when re-axing the map. (RPM; raw*4-512)" 0x40009560 NO_INPUT_QUANTITY RL_AXIS_UBYTE 0 CM_u8_rspeed_4_512rpm 16 -512 508 /end AXIS_PTS
/begin CHARACTERISTIC CAL_ign_comp_idle_error_moving "Calibration: ignition compensation idle error moving. Tunable map/constant (not a live channel); log spark advance to confirm the timing strategy and headroom to knock. (deg; raw/4-32)" CURVE 0x40009570 RL_VALUE_UBYTE 0 CM_u8_angle_1_4_32deg -32 31.75
 /begin AXIS_DESCR COM_AXIS NO_INPUT_QUANTITY CM_u8_rspeed_4_512rpm 16 -512 508 AXIS_PTS_REF CAL_ign_comp_idle_error_moving_X_idle_speed_error /end AXIS_DESCR
/end CHARACTERISTIC
/begin AXIS_PTS CAL_ign_advance_step_tps_X_engine_speed "X-axis breakpoints for the 'ignition advance step throttle position' table. Defines the lookup grid (not a live channel); change only when re-axing the map. (RPM; raw*125/4+500)" 0x40009580 engine_speed_3 RL_AXIS_UBYTE 0 CM_u8_rspeed_125_4_500rpm 8 500 8468.75 /end AXIS_PTS
/begin AXIS_PTS CAL_ign_advance_step_tps_Y_pedal_pos "Y-axis breakpoints for the 'ignition advance step throttle position' table. Defines the lookup grid (not a live channel); change only when re-axing the map. (0-1; raw/255)" 0x40009588 NO_INPUT_QUANTITY RL_AXIS_UBYTE 0 CM_u8_factor_1_255 16 0 100 /end AXIS_PTS
/begin CHARACTERISTIC CAL_ign_advance_step_tps "Calibration: ignition advance step throttle position. Tunable map/constant (not a live channel); log spark advance to confirm the timing strategy and headroom to knock. (deg; raw/4)" MAP 0x40009598 RL_VALUE_SBYTE 0 CM_u8_angle_1_4deg -32 31.75
 /begin AXIS_DESCR COM_AXIS engine_speed_3 CM_u8_rspeed_125_4_500rpm 8 500 8468.75 AXIS_PTS_REF CAL_ign_advance_step_tps_X_engine_speed /end AXIS_DESCR
 /begin AXIS_DESCR COM_AXIS NO_INPUT_QUANTITY CM_u8_factor_1_255 16 0 100 AXIS_PTS_REF CAL_ign_advance_step_tps_Y_pedal_pos /end AXIS_DESCR
/end CHARACTERISTIC
/begin CHARACTERISTIC CAL_closedloop_activate_engine_timer "Calibration: closedloop activate engine timer. Tunable map/constant (not a live channel); log to watch O2 feedback trim the mixture and confirm the loop is active. (s)" VAL_BLK 0x40009632 RL_VALUE_UBYTE 0 CM_u8_time_s 0 255 NUMBER 16 /end CHARACTERISTIC
/begin AXIS_PTS CAL_inj_afterstart_enrichment_coolant_manual_X_coolant "X-axis breakpoints for the 'injector cranking enrichment coolant manual' table. Defines the lookup grid (not a live channel); change only when re-axing the map. (deg C; raw*5/8-40)" 0x4000978A coolant_temp_engine_stopped RL_AXIS_UBYTE 0 CM_u8_temp_5_8_40c 12 -40 119.375 /end AXIS_PTS
/begin AXIS_PTS CAL_inj_afterstart_enrichment_coolant_manual_Y_maf_accum "Y-axis breakpoints for the 'injector cranking enrichment coolant manual' table. Defines the lookup grid (not a live channel); change only when re-axing the map. (g)" 0x40009796 V_CAL_inj_afterstart_enrichment_coolant_manual_Y_maf_accum RL_AXIS_UBYTE 0 CM_u16_mass_g 14 0 255 /end AXIS_PTS
/begin CHARACTERISTIC CAL_inj_afterstart_enrichment_coolant_manual "Calibration: injector cranking enrichment coolant manual. Tunable map/constant (not a live channel); log to verify injector pulse width and fuel delivery vs target. (0-1; raw/32)" MAP 0x400097A4 RL_VALUE_UBYTE 0 CM_u8_factor_1_32 0 796.875
 /begin AXIS_DESCR COM_AXIS coolant_temp_engine_stopped CM_u8_temp_5_8_40c 12 -40 119.375 AXIS_PTS_REF CAL_inj_afterstart_enrichment_coolant_manual_X_coolant /end AXIS_DESCR
 /begin AXIS_DESCR COM_AXIS V_CAL_inj_afterstart_enrichment_coolant_manual_Y_maf_accum CM_u16_mass_g 14 0 255 AXIS_PTS_REF CAL_inj_afterstart_enrichment_coolant_manual_Y_maf_accum /end AXIS_DESCR
/end CHARACTERISTIC
/begin AXIS_PTS CAL_inj_afterstart_enrichment_coolant_ips_X_coolant "X-axis breakpoints for the 'injector cranking enrichment coolant IPS' table. Defines the lookup grid (not a live channel); change only when re-axing the map. (deg C; raw*5/8-40)" 0x4000984C coolant_temp_engine_stopped RL_AXIS_UBYTE 0 CM_u8_temp_5_8_40c 12 -40 119.375 /end AXIS_PTS
/begin AXIS_PTS CAL_inj_afterstart_enrichment_coolant_ips_Y_maf_accum "Y-axis breakpoints for the 'injector cranking enrichment coolant IPS' table. Defines the lookup grid (not a live channel); change only when re-axing the map. (g)" 0x40009858 V_CAL_inj_afterstart_enrichment_coolant_ips_Y_maf_accum RL_AXIS_UBYTE 0 CM_u16_mass_g 14 0 255 /end AXIS_PTS
/begin CHARACTERISTIC CAL_inj_afterstart_enrichment_coolant_ips "Calibration: injector cranking enrichment coolant IPS. Tunable map/constant (not a live channel); log to verify injector pulse width and fuel delivery vs target. (0-1; raw/32)" MAP 0x40009866 RL_VALUE_UBYTE 0 CM_u8_factor_1_32 0 796.875
 /begin AXIS_DESCR COM_AXIS coolant_temp_engine_stopped CM_u8_temp_5_8_40c 12 -40 119.375 AXIS_PTS_REF CAL_inj_afterstart_enrichment_coolant_ips_X_coolant /end AXIS_DESCR
 /begin AXIS_DESCR COM_AXIS V_CAL_inj_afterstart_enrichment_coolant_ips_Y_maf_accum CM_u16_mass_g 14 0 255 AXIS_PTS_REF CAL_inj_afterstart_enrichment_coolant_ips_Y_maf_accum /end AXIS_DESCR
/end CHARACTERISTIC
/begin AXIS_PTS CAL_load_alphaN_engine_off_X_tps "X-axis breakpoints for the 'load alphaN seed' table. Defines the lookup grid (not a live channel); change only when re-axing the map. (0-1; raw/255)" 0x40009932 tps_8bit RL_AXIS_UBYTE 0 CM_u8_factor_1_255 16 0 100 /end AXIS_PTS
/begin CHARACTERISTIC CAL_load_alphaN_engine_off "Calibration: load alphaN seed. Tunable map/constant (not a live channel); log engine load -- the main axis for fueling and ignition. (mg/stroke; raw*4)" CURVE 0x40009942 RL_VALUE_UBYTE 0 CM_u8_load_4mg_stroke 0 1020
 /begin AXIS_DESCR COM_AXIS tps_8bit CM_u8_factor_1_255 16 0 100 AXIS_PTS_REF CAL_load_alphaN_engine_off_X_tps /end AXIS_DESCR
/end CHARACTERISTIC
/begin AXIS_PTS CAL_dfco_entry_rpm_ips_X_coolant_temp "X-axis breakpoints for the 'DFCO entry RPM IPS' table. Defines the lookup grid (not a live channel); change only when re-axing the map. (deg C; raw*5/8-40)" 0x40009962 coolant_temp RL_AXIS_UBYTE 0 CM_u8_temp_5_8_40c 4 -40 119.375 /end AXIS_PTS
/begin CHARACTERISTIC CAL_dfco_entry_rpm_ips "Calibration: DFCO entry RPM IPS. Tunable map/constant (not a live channel); log to see when fuel is cut and restored on deceleration. (RPM; raw*10)" CURVE 0x40009966 RL_VALUE_UBYTE 0 CM_u8_rspeed_10rpm 0 2550
 /begin AXIS_DESCR COM_AXIS coolant_temp CM_u8_temp_5_8_40c 4 -40 119.375 AXIS_PTS_REF CAL_dfco_entry_rpm_ips_X_coolant_temp /end AXIS_DESCR
/end CHARACTERISTIC
/begin AXIS_PTS CAL_dfco_exit_rpm_ingear_ips_X_coolant_temp "X-axis breakpoints for the 'DFCO exit RPM ingear IPS' table. Defines the lookup grid (not a live channel); change only when re-axing the map. (deg C; raw*5/8-40)" 0x4000996A coolant_temp RL_AXIS_UBYTE 0 CM_u8_temp_5_8_40c 4 -40 119.375 /end AXIS_PTS
/begin CHARACTERISTIC CAL_dfco_exit_rpm_ingear_ips "Calibration: DFCO exit RPM ingear IPS. Tunable map/constant (not a live channel); log to see when fuel is cut and restored on deceleration. (RPM; raw*10)" CURVE 0x4000996E RL_VALUE_UBYTE 0 CM_u8_rspeed_10rpm 0 2550
 /begin AXIS_DESCR COM_AXIS coolant_temp CM_u8_temp_5_8_40c 4 -40 119.375 AXIS_PTS_REF CAL_dfco_exit_rpm_ingear_ips_X_coolant_temp /end AXIS_DESCR
/end CHARACTERISTIC
/begin AXIS_PTS CAL_ign_comp_iat_load_scaler_X_load "X-axis breakpoints for the 'ignition compensation intake-air temp load scaler' table. Defines the lookup grid (not a live channel); change only when re-axing the map. (mg/stroke; raw*4)" 0x40009972 load_mass_per_stroke RL_AXIS_UBYTE 0 CM_u8_load_4mg_stroke 16 0 1020 /end AXIS_PTS
/begin CHARACTERISTIC CAL_ign_comp_iat_load_scaler "Calibration: ignition compensation intake-air temp load scaler. Tunable map/constant (not a live channel); log spark advance to confirm the timing strategy and headroom to knock. (0-1; raw/128)" CURVE 0x40009982 RL_VALUE_UBYTE 0 CM_u8_factor_1_128 0 199.21875
 /begin AXIS_DESCR COM_AXIS load_mass_per_stroke CM_u8_load_4mg_stroke 16 0 1020 AXIS_PTS_REF CAL_ign_comp_iat_load_scaler_X_load /end AXIS_DESCR
/end CHARACTERISTIC
/begin AXIS_PTS CAL_tpssmooth_increment_sport_driving_X_tps_rate "X-axis breakpoints for the 'tpssmooth increment sport driving' table. Defines the lookup grid (not a live channel); change only when re-axing the map. (0-1; raw/255)" 0x40009A5A NO_INPUT_QUANTITY RL_AXIS_UBYTE 0 CM_u8_factor_1_255 8 0 100 /end AXIS_PTS
/begin CHARACTERISTIC CAL_tpssmooth_increment_sport_driving "Calibration: tpssmooth increment sport driving. Tunable map/constant (not a live channel); log to see throttle-signal smoothing/filtering behavior. (0-1; raw/1023)" CURVE 0x40009A62 RL_VALUE_UBYTE 0 CM_u16_factor_1_1023 0 24.9266862170088
 /begin AXIS_DESCR COM_AXIS NO_INPUT_QUANTITY CM_u8_factor_1_255 8 0 100 AXIS_PTS_REF CAL_tpssmooth_increment_sport_driving_X_tps_rate /end AXIS_DESCR
/end CHARACTERISTIC
/begin AXIS_PTS CAL_ign_closed_throttle_base_manual_X_coolant_temp "X-axis breakpoints for the 'ignition compensation coolant manual1' table. Defines the lookup grid (not a live channel); change only when re-axing the map. (deg C; raw*5/8-40)" 0x40009AAA coolant_temp RL_AXIS_UBYTE 0 CM_u8_temp_5_8_40c 16 -40 119.375 /end AXIS_PTS
/begin CHARACTERISTIC CAL_ign_closed_throttle_base_manual "Coolant-temperature ignition advance offset (u8_angle_1/4deg, advance-only) added to final spark timing in the idle and cruise ignition modes on manual-gearbox cars, indexed by ..._X_coolant_temp. Selected whenever the VVT scheduler is on the baselin" CURVE 0x40009ABA RL_VALUE_UBYTE 0 CM_u8_angle_1_4deg 0 63.75
 /begin AXIS_DESCR COM_AXIS coolant_temp CM_u8_temp_5_8_40c 16 -40 119.375 AXIS_PTS_REF CAL_ign_closed_throttle_base_manual_X_coolant_temp /end AXIS_DESCR
/end CHARACTERISTIC
/begin AXIS_PTS CAL_ign_comp_idle_error_stationary_X_idle_speed_error "X-axis breakpoints for the 'ignition compensation idle error stationary' table. Defines the lookup grid (not a live channel); change only when re-axing the map. (RPM; raw*4-512)" 0x40009ACA NO_INPUT_QUANTITY RL_AXIS_UBYTE 0 CM_u8_rspeed_4_512rpm 16 -512 508 /end AXIS_PTS
/begin CHARACTERISTIC CAL_ign_comp_idle_error_stationary "Calibration: ignition compensation idle error stationary. Tunable map/constant (not a live channel); log spark advance to confirm the timing strategy and headroom to knock. (deg; raw/4-32)" CURVE 0x40009ADA RL_VALUE_UBYTE 0 CM_u8_angle_1_4_32deg -32 31.75
 /begin AXIS_DESCR COM_AXIS NO_INPUT_QUANTITY CM_u8_rspeed_4_512rpm 16 -512 508 AXIS_PTS_REF CAL_ign_comp_idle_error_stationary_X_idle_speed_error /end AXIS_DESCR
/end CHARACTERISTIC
/begin AXIS_PTS CAL_ign_comp_engine_air_X_air_temp "X-axis breakpoints for the 'ignition compensation engine air' table. Defines the lookup grid (not a live channel); change only when re-axing the map. (deg C; raw*5/8-40)" 0x40009AEA airtemp_tmaf RL_AXIS_UBYTE 0 CM_u8_temp_5_8_40c 16 -40 119.375 /end AXIS_PTS
/begin CHARACTERISTIC CAL_ign_comp_engine_air "Calibration: ignition compensation engine air. Tunable map/constant (not a live channel); log spark advance to confirm the timing strategy and headroom to knock. (deg; raw/4-32)" CURVE 0x40009AFA RL_VALUE_UBYTE 0 CM_u8_angle_1_4_32deg -32 31.75
 /begin AXIS_DESCR COM_AXIS airtemp_tmaf CM_u8_temp_5_8_40c 16 -40 119.375 AXIS_PTS_REF CAL_ign_comp_engine_air_X_air_temp /end AXIS_DESCR
/end CHARACTERISTIC
/begin AXIS_PTS CAL_injtip_in_rpm_scale_X_rpm "X-axis breakpoints for the 'injtip in RPM scale' table. Defines the lookup grid (not a live channel); change only when re-axing the map. (RPM; raw*125/4+500)" 0x40009B0A engine_speed_3 RL_AXIS_UBYTE 0 CM_u8_rspeed_125_4_500rpm 16 500 8468.75 /end AXIS_PTS
/begin CHARACTERISTIC CAL_injtip_in_rpm_scale "Calibration: injtip in RPM scale. Tunable map/constant (not a live channel); log to debug transient (tip-in/out) fueling stumbles and surge. (0-1; raw/128)" CURVE 0x40009B1A RL_VALUE_UBYTE 0 CM_u8_factor_1_128 0 199.21875
 /begin AXIS_DESCR COM_AXIS engine_speed_3 CM_u8_rspeed_125_4_500rpm 16 500 8468.75 AXIS_PTS_REF CAL_injtip_in_rpm_scale_X_rpm /end AXIS_DESCR
/end CHARACTERISTIC
/begin AXIS_PTS CAL_injtip_in_rpm_decay_X_rpm "X-axis breakpoints for the 'injtip in RPM decay' table. Defines the lookup grid (not a live channel); change only when re-axing the map. (RPM; raw*125/4+500)" 0x40009B2A engine_speed_3 RL_AXIS_UBYTE 0 CM_u8_rspeed_125_4_500rpm 16 500 8468.75 /end AXIS_PTS
/begin CHARACTERISTIC CAL_injtip_in_rpm_decay "Calibration: injtip in RPM decay. Tunable map/constant (not a live channel); log to debug transient (tip-in/out) fueling stumbles and surge. (/5ms tick; raw/100)" CURVE 0x40009B3A RL_VALUE_UBYTE 0 CM_u8_dt_factor_1_100_5ms 0 2.55
 /begin AXIS_DESCR COM_AXIS engine_speed_3 CM_u8_rspeed_125_4_500rpm 16 500 8468.75 AXIS_PTS_REF CAL_injtip_in_rpm_decay_X_rpm /end AXIS_DESCR
/end CHARACTERISTIC
/begin AXIS_PTS CAL_injtip_in_coolant_scale_X_coolant_temp "X-axis breakpoints for the 'injtip in coolant scale' table. Defines the lookup grid (not a live channel); change only when re-axing the map. (deg C; raw*5/8-40)" 0x40009B4A coolant_temp RL_AXIS_UBYTE 0 CM_u8_temp_5_8_40c 16 -40 119.375 /end AXIS_PTS
/begin CHARACTERISTIC CAL_injtip_in_coolant_scale "Calibration: injtip in coolant scale. Tunable map/constant (not a live channel); log to debug transient (tip-in/out) fueling stumbles and surge. (0-1; raw/64)" CURVE 0x40009B5A RL_VALUE_UBYTE 0 CM_u8_factor_1_64 0 398.4375
 /begin AXIS_DESCR COM_AXIS coolant_temp CM_u8_temp_5_8_40c 16 -40 119.375 AXIS_PTS_REF CAL_injtip_in_coolant_scale_X_coolant_temp /end AXIS_DESCR
/end CHARACTERISTIC
/begin AXIS_PTS CAL_injtip_out_rpm_scale_X_rpm "X-axis breakpoints for the 'injtip out RPM scale' table. Defines the lookup grid (not a live channel); change only when re-axing the map. (RPM; raw*125/4+500)" 0x40009B6A engine_speed_3 RL_AXIS_UBYTE 0 CM_u8_rspeed_125_4_500rpm 16 500 8468.75 /end AXIS_PTS
/begin CHARACTERISTIC CAL_injtip_out_rpm_scale "Calibration: injtip out RPM scale. Tunable map/constant (not a live channel); log to debug transient (tip-in/out) fueling stumbles and surge. (0-1; raw/128)" CURVE 0x40009B7A RL_VALUE_UBYTE 0 CM_u8_factor_1_128 0 199.21875
 /begin AXIS_DESCR COM_AXIS engine_speed_3 CM_u8_rspeed_125_4_500rpm 16 500 8468.75 AXIS_PTS_REF CAL_injtip_out_rpm_scale_X_rpm /end AXIS_DESCR
/end CHARACTERISTIC
/begin AXIS_PTS CAL_injtip_out_rpm_decay_X_rpm "X-axis breakpoints for the 'injtip out RPM decay' table. Defines the lookup grid (not a live channel); change only when re-axing the map. (RPM; raw*125/4+500)" 0x40009B8A engine_speed_3 RL_AXIS_UBYTE 0 CM_u8_rspeed_125_4_500rpm 16 500 8468.75 /end AXIS_PTS
/begin CHARACTERISTIC CAL_injtip_out_rpm_decay "Calibration: injtip out RPM decay. Tunable map/constant (not a live channel); log to debug transient (tip-in/out) fueling stumbles and surge. (/5ms tick; raw/100)" CURVE 0x40009B9A RL_VALUE_UBYTE 0 CM_u8_dt_factor_1_100_5ms 0 2.55
 /begin AXIS_DESCR COM_AXIS engine_speed_3 CM_u8_rspeed_125_4_500rpm 16 500 8468.75 AXIS_PTS_REF CAL_injtip_out_rpm_decay_X_rpm /end AXIS_DESCR
/end CHARACTERISTIC
/begin AXIS_PTS CAL_injtip_out_coolant_scale_X_coolant_temp "X-axis breakpoints for the 'injtip out coolant scale' table. Defines the lookup grid (not a live channel); change only when re-axing the map. (deg C; raw*5/8-40)" 0x40009BAA coolant_temp RL_AXIS_UBYTE 0 CM_u8_temp_5_8_40c 16 -40 119.375 /end AXIS_PTS
/begin CHARACTERISTIC CAL_injtip_out_coolant_scale "Calibration: injtip out coolant scale. Tunable map/constant (not a live channel); log to debug transient (tip-in/out) fueling stumbles and surge. (0-1; raw/64)" CURVE 0x40009BBA RL_VALUE_UBYTE 0 CM_u8_factor_1_64 0 398.4375
 /begin AXIS_DESCR COM_AXIS coolant_temp CM_u8_temp_5_8_40c 16 -40 119.375 AXIS_PTS_REF CAL_injtip_out_coolant_scale_X_coolant_temp /end AXIS_DESCR
/end CHARACTERISTIC
/begin AXIS_PTS CAL_tpssmooth_increment_sport_shifting_X_tps_rate "X-axis breakpoints for the 'tpssmooth increment sport shifting' table. Defines the lookup grid (not a live channel); change only when re-axing the map. (0-1; raw/255)" 0x40009BDA NO_INPUT_QUANTITY RL_AXIS_UBYTE 0 CM_u8_factor_1_255 8 0 100 /end AXIS_PTS
/begin CHARACTERISTIC CAL_tpssmooth_increment_sport_shifting "Calibration: tpssmooth increment sport shifting. Tunable map/constant (not a live channel); log to see throttle-signal smoothing/filtering behavior. (0-1; raw/1023)" CURVE 0x40009BE2 RL_VALUE_UBYTE 0 CM_u16_factor_1_1023 0 24.9266862170088
 /begin AXIS_DESCR COM_AXIS NO_INPUT_QUANTITY CM_u8_factor_1_255 8 0 100 AXIS_PTS_REF CAL_tpssmooth_increment_sport_shifting_X_tps_rate /end AXIS_DESCR
/end CHARACTERISTIC
/begin AXIS_PTS CAL_tps_scaling_factor_rpm_X_rpm "X-axis breakpoints for the 'throttle position scaling factor RPM' table. Defines the lookup grid (not a live channel); change only when re-axing the map. (RPM; raw*125/4+500)" 0x40009C52 engine_speed_3 RL_AXIS_UBYTE 0 CM_u8_rspeed_125_4_500rpm 16 500 8468.75 /end AXIS_PTS
/begin CHARACTERISTIC CAL_tps_scaling_factor_rpm "Calibration: throttle position scaling factor RPM. Tunable map/constant (not a live channel); log to see throttle/pedal demand and throttle response. (0-1; raw/255)" CURVE 0x40009C62 RL_VALUE_UBYTE 0 CM_u8_factor_1_255 0 100
 /begin AXIS_DESCR COM_AXIS engine_speed_3 CM_u8_rspeed_125_4_500rpm 16 500 8468.75 AXIS_PTS_REF CAL_tps_scaling_factor_rpm_X_rpm /end AXIS_DESCR
/end CHARACTERISTIC
/begin AXIS_PTS CAL_tpssmooth_increment_tour_shifting_X_tps_rate "X-axis breakpoints for the 'tpssmooth increment tour shifting' table. Defines the lookup grid (not a live channel); change only when re-axing the map. (0-1; raw/255)" 0x40009C72 NO_INPUT_QUANTITY RL_AXIS_UBYTE 0 CM_u8_factor_1_255 8 0 100 /end AXIS_PTS
/begin CHARACTERISTIC CAL_tpssmooth_increment_tour_shifting "Calibration: tpssmooth increment tour shifting. Tunable map/constant (not a live channel); log to see throttle-signal smoothing/filtering behavior. (0-1; raw/1023)" CURVE 0x40009C7A RL_VALUE_UBYTE 0 CM_u16_factor_1_1023 0 24.9266862170088
 /begin AXIS_DESCR COM_AXIS NO_INPUT_QUANTITY CM_u8_factor_1_255 8 0 100 AXIS_PTS_REF CAL_tpssmooth_increment_tour_shifting_X_tps_rate /end AXIS_DESCR
/end CHARACTERISTIC
/begin AXIS_PTS CAL_dfco_entry_rpm_ips_alt_X_coolant_temp "X-axis breakpoints for the 'DFCO entry RPM IPS alt' table. Defines the lookup grid (not a live channel); change only when re-axing the map. (deg C; raw*5/8-40)" 0x40009C82 coolant_temp RL_AXIS_UBYTE 0 CM_u8_temp_5_8_40c 4 -40 119.375 /end AXIS_PTS
/begin CHARACTERISTIC CAL_dfco_entry_rpm_ips_alt "Calibration: DFCO entry RPM IPS alt. Tunable map/constant (not a live channel); log to see when fuel is cut and restored on deceleration. (RPM; raw*10)" CURVE 0x40009C86 RL_VALUE_UBYTE 0 CM_u8_rspeed_10rpm 0 2550
 /begin AXIS_DESCR COM_AXIS coolant_temp CM_u8_temp_5_8_40c 4 -40 119.375 AXIS_PTS_REF CAL_dfco_entry_rpm_ips_alt_X_coolant_temp /end AXIS_DESCR
/end CHARACTERISTIC
/begin AXIS_PTS CAL_closedloop_proportional_gain_lean_X_rpm "X-axis breakpoints for the 'closedloop proportional gain rich table' table. Defines the lookup grid (not a live channel); change only when re-axing the map. (RPM; raw*125/4+500)" 0x40009C8A engine_speed_3 RL_AXIS_UBYTE 0 CM_u8_rspeed_125_4_500rpm 8 500 8468.75 /end AXIS_PTS
/begin AXIS_PTS CAL_closedloop_proportional_gain_lean_Y_load "Y-axis breakpoints for the 'closedloop proportional gain rich table' table. Defines the lookup grid (not a live channel); change only when re-axing the map. (mg/stroke; raw*4)" 0x40009C92 load_mass_per_stroke RL_AXIS_UBYTE 0 CM_u8_load_4mg_stroke 8 0 1020 /end AXIS_PTS
/begin CHARACTERISTIC CAL_closedloop_proportional_gain_lean "Calibration: closedloop proportional gain rich table. Tunable map/constant (not a live channel); log to watch O2 feedback trim the mixture and confirm the loop is active." MAP 0x40009C9A RL_VALUE_UBYTE 0 NO_COMPU_METHOD 0 255
 /begin AXIS_DESCR COM_AXIS engine_speed_3 CM_u8_rspeed_125_4_500rpm 8 500 8468.75 AXIS_PTS_REF CAL_closedloop_proportional_gain_lean_X_rpm /end AXIS_DESCR
 /begin AXIS_DESCR COM_AXIS load_mass_per_stroke CM_u8_load_4mg_stroke 8 0 1020 AXIS_PTS_REF CAL_closedloop_proportional_gain_lean_Y_load /end AXIS_DESCR
/end CHARACTERISTIC
/begin AXIS_PTS CAL_closedloop_proportional_gain_rich_X_rpm "X-axis breakpoints for the 'closedloop proportional gain lean table' table. Defines the lookup grid (not a live channel); change only when re-axing the map. (RPM; raw*125/4+500)" 0x40009CDA engine_speed_3 RL_AXIS_UBYTE 0 CM_u8_rspeed_125_4_500rpm 8 500 8468.75 /end AXIS_PTS
/begin AXIS_PTS CAL_closedloop_proportional_gain_rich_Y_load "Y-axis breakpoints for the 'closedloop proportional gain lean table' table. Defines the lookup grid (not a live channel); change only when re-axing the map. (mg/stroke; raw*4)" 0x40009CE2 load_mass_per_stroke RL_AXIS_UBYTE 0 CM_u8_load_4mg_stroke 8 0 1020 /end AXIS_PTS
/begin CHARACTERISTIC CAL_closedloop_proportional_gain_rich "Calibration: closedloop proportional gain lean table. Tunable map/constant (not a live channel); log to watch O2 feedback trim the mixture and confirm the loop is active." MAP 0x40009CEA RL_VALUE_UBYTE 0 NO_COMPU_METHOD 0 255
 /begin AXIS_DESCR COM_AXIS engine_speed_3 CM_u8_rspeed_125_4_500rpm 8 500 8468.75 AXIS_PTS_REF CAL_closedloop_proportional_gain_rich_X_rpm /end AXIS_DESCR
 /begin AXIS_DESCR COM_AXIS load_mass_per_stroke CM_u8_load_4mg_stroke 8 0 1020 AXIS_PTS_REF CAL_closedloop_proportional_gain_rich_Y_load /end AXIS_DESCR
/end CHARACTERISTIC
/begin AXIS_PTS CAL_closedloop_integral_gain_table_X_rpm "X-axis breakpoints for the 'closedloop integral gain table' table. Defines the lookup grid (not a live channel); change only when re-axing the map. (RPM; raw*125/4+500)" 0x40009D2A engine_speed_3 RL_AXIS_UBYTE 0 CM_u8_rspeed_125_4_500rpm 8 500 8468.75 /end AXIS_PTS
/begin AXIS_PTS CAL_closedloop_integral_gain_table_Y_load "Y-axis breakpoints for the 'closedloop integral gain table' table. Defines the lookup grid (not a live channel); change only when re-axing the map. (mg/stroke; raw*4)" 0x40009D32 load_mass_per_stroke RL_AXIS_UBYTE 0 CM_u8_load_4mg_stroke 8 0 1020 /end AXIS_PTS
/begin CHARACTERISTIC CAL_closedloop_integral_gain_table "Calibration: closedloop integral gain table. Tunable map/constant (not a live channel); log to watch O2 feedback trim the mixture and confirm the loop is active." MAP 0x40009D3A RL_VALUE_UBYTE 0 NO_COMPU_METHOD 0 255
 /begin AXIS_DESCR COM_AXIS engine_speed_3 CM_u8_rspeed_125_4_500rpm 8 500 8468.75 AXIS_PTS_REF CAL_closedloop_integral_gain_table_X_rpm /end AXIS_DESCR
 /begin AXIS_DESCR COM_AXIS load_mass_per_stroke CM_u8_load_4mg_stroke 8 0 1020 AXIS_PTS_REF CAL_closedloop_integral_gain_table_Y_load /end AXIS_DESCR
/end CHARACTERISTIC
/begin AXIS_PTS CAL_closedloop_derivative_gain_table_X_rpm "X-axis breakpoints for the 'closedloop derivative gain table' table. Defines the lookup grid (not a live channel); change only when re-axing the map. (RPM; raw*125/4+500)" 0x40009D7A engine_speed_3 RL_AXIS_UBYTE 0 CM_u8_rspeed_125_4_500rpm 8 500 8468.75 /end AXIS_PTS
/begin AXIS_PTS CAL_closedloop_derivative_gain_table_Y_load "Y-axis breakpoints for the 'closedloop derivative gain table' table. Defines the lookup grid (not a live channel); change only when re-axing the map. (mg/stroke; raw*4)" 0x40009D82 load_mass_per_stroke RL_AXIS_UBYTE 0 CM_u8_load_4mg_stroke 8 0 1020 /end AXIS_PTS
/begin CHARACTERISTIC CAL_closedloop_derivative_gain_table "Calibration: closedloop derivative gain table. Tunable map/constant (not a live channel); log to watch O2 feedback trim the mixture and confirm the loop is active." MAP 0x40009D8A RL_VALUE_UBYTE 0 NO_COMPU_METHOD 0 255
 /begin AXIS_DESCR COM_AXIS engine_speed_3 CM_u8_rspeed_125_4_500rpm 8 500 8468.75 AXIS_PTS_REF CAL_closedloop_derivative_gain_table_X_rpm /end AXIS_DESCR
 /begin AXIS_DESCR COM_AXIS load_mass_per_stroke CM_u8_load_4mg_stroke 8 0 1020 AXIS_PTS_REF CAL_closedloop_derivative_gain_table_Y_load /end AXIS_DESCR
/end CHARACTERISTIC
/begin AXIS_PTS CAL_inj_efficiency_X_engine_speed "X-axis breakpoints for the 'injector efficiency' table. Defines the lookup grid (not a live channel); change only when re-axing the map. (RPM; raw*125/4+500)" 0x40009DCA engine_speed_3 RL_AXIS_UBYTE 0 CM_u8_rspeed_125_4_500rpm 32 500 8468.75 /end AXIS_PTS
/begin AXIS_PTS CAL_inj_efficiency_Y_engine_load "Y-axis breakpoints for the 'injector efficiency' table. Defines the lookup grid (not a live channel); change only when re-axing the map. (mg/stroke; raw*4)" 0x40009DEA load_mass_per_stroke RL_AXIS_UBYTE 0 CM_u8_load_4mg_stroke 32 0 1020 /end AXIS_PTS
/begin CHARACTERISTIC CAL_inj_efficiency "Calibration: injector efficiency. Tunable map/constant (not a live channel); log to verify injector pulse width and fuel delivery vs target. (0-1; raw/200)" MAP 0x40009E0A RL_VALUE_UBYTE 0 CM_u8_factor_1_200 0 127.5
 /begin AXIS_DESCR COM_AXIS engine_speed_3 CM_u8_rspeed_125_4_500rpm 32 500 8468.75 AXIS_PTS_REF CAL_inj_efficiency_X_engine_speed /end AXIS_DESCR
 /begin AXIS_DESCR COM_AXIS load_mass_per_stroke CM_u8_load_4mg_stroke 32 0 1020 AXIS_PTS_REF CAL_inj_efficiency_Y_engine_load /end AXIS_DESCR
/end CHARACTERISTIC
/begin AXIS_PTS CAL_load_map_estimate_ve_X_rpm "X-axis (rpm; raw*125/4+500) for CAL_load_map_estimate_ve." 0x4000A22A engine_speed_3 RL_AXIS_UBYTE 0 CM_u8_rspeed_125_4_500rpm 16 500 8468.75 /end AXIS_PTS
/begin CHARACTERISTIC CAL_load_map_estimate_ve "Volumetric efficiency vs rpm for the estimated-MAP model (VE% = (raw+153)/2; exact (raw+153)/199.1 for 576 cc/cyl). Slope term: dMAP = load_mg*29565/((raw+153)*iat_ratio). Not a live channel." CURVE 0x4000A23A RL_VALUE_UBYTE 0 NO_COMPU_METHOD 0 255
 /begin AXIS_DESCR COM_AXIS engine_speed_3 CM_u8_rspeed_125_4_500rpm 16 500 8468.75 AXIS_PTS_REF CAL_load_map_estimate_ve_X_rpm /end AXIS_DESCR
/end CHARACTERISTIC
/begin CHARACTERISTIC CAL_load_obd_divisor_X_rpm "X-axis breakpoints for the 'load OBD divisor' table. Defines the lookup grid (not a live channel); change only when re-axing the map. (RPM; raw*125/4+500)" VAL_BLK 0x4000A37A RL_VALUE_UBYTE 0 CM_u8_rspeed_125_4_500rpm 500 8468.75 NUMBER 16 /end CHARACTERISTIC
/begin AXIS_PTS CAL_tpssmooth_increment_tour_driving_X_tps_rate "X-axis breakpoints for the 'tpssmooth increment tour driving' table. Defines the lookup grid (not a live channel); change only when re-axing the map. (0-1; raw/255)" 0x4000A39A NO_INPUT_QUANTITY RL_AXIS_UBYTE 0 CM_u8_factor_1_255 8 0 100 /end AXIS_PTS
/begin CHARACTERISTIC CAL_tpssmooth_increment_tour_driving "Calibration: tpssmooth increment tour driving. Tunable map/constant (not a live channel); log to see throttle-signal smoothing/filtering behavior. (0-1; raw/1023)" CURVE 0x4000A3A2 RL_VALUE_UBYTE 0 CM_u16_factor_1_1023 0 24.9266862170088
 /begin AXIS_DESCR COM_AXIS NO_INPUT_QUANTITY CM_u8_factor_1_255 8 0 100 AXIS_PTS_REF CAL_tpssmooth_increment_tour_driving_X_tps_rate /end AXIS_DESCR
/end CHARACTERISTIC
/begin AXIS_PTS CAL_sensor_P0106_min_tps_threshold_X_rpm "Calibration that arms/thresholds the P0106 monitor (MAP/baro rationality). Fixed value -- it sets when that DTC trips, not a live channel." 0x4000A3AA engine_speed_3 RL_AXIS_UBYTE 0 CM_u8_rspeed_125_4_500rpm 16 500 8468.75 /end AXIS_PTS
/begin CHARACTERISTIC CAL_sensor_P0106_min_tps_threshold "Calibration that arms/thresholds the P0106 monitor (MAP/baro rationality). Fixed value -- it sets when that DTC trips, not a live channel." CURVE 0x4000A3BA RL_VALUE_UBYTE 0 CM_u8_factor_1_255 0 100
 /begin AXIS_DESCR COM_AXIS engine_speed_3 CM_u8_rspeed_125_4_500rpm 16 500 8468.75 AXIS_PTS_REF CAL_sensor_P0106_min_tps_threshold_X_rpm /end AXIS_DESCR
/end CHARACTERISTIC
/begin AXIS_PTS CAL_inj_warmup_factor_manual_X_load "X-axis breakpoints for the 'injector enrichment factor load n coolant manual' table. Defines the lookup grid (not a live channel); change only when re-axing the map. (mg/stroke; raw*4)" 0x4000A3CA load_mass_per_stroke RL_AXIS_UBYTE 0 CM_u8_load_4mg_stroke 12 0 1020 /end AXIS_PTS
/begin AXIS_PTS CAL_inj_warmup_factor_manual_Y_coolant_temp "Y-axis breakpoints for the 'injector enrichment factor load n coolant manual' table. Defines the lookup grid (not a live channel); change only when re-axing the map. (deg C; raw*5/8-40)" 0x4000A3D6 coolant_temp RL_AXIS_UBYTE 0 CM_u8_temp_5_8_40c 16 -40 119.375 /end AXIS_PTS
/begin CHARACTERISTIC CAL_inj_warmup_factor_manual "Calibration: injector enrichment factor load n coolant manual. Tunable map/constant (not a live channel); log to verify injector pulse width and fuel delivery vs target. (0-1; raw/64)" MAP 0x4000A3E6 RL_VALUE_UBYTE 0 CM_u8_factor_1_64 0 398.4375
 /begin AXIS_DESCR COM_AXIS load_mass_per_stroke CM_u8_load_4mg_stroke 12 0 1020 AXIS_PTS_REF CAL_inj_warmup_factor_manual_X_load /end AXIS_DESCR
 /begin AXIS_DESCR COM_AXIS coolant_temp CM_u8_temp_5_8_40c 16 -40 119.375 AXIS_PTS_REF CAL_inj_warmup_factor_manual_Y_coolant_temp /end AXIS_DESCR
/end CHARACTERISTIC
/begin AXIS_PTS CAL_inj_comp_iat_X_load "X-axis breakpoints for the 'injector compensation intake-air temp' table. Defines the lookup grid (not a live channel); change only when re-axing the map. (mg/stroke; raw*4)" 0x4000A4EA load_mass_per_stroke RL_AXIS_UBYTE 0 CM_u8_load_4mg_stroke 8 0 1020 /end AXIS_PTS
/begin AXIS_PTS CAL_inj_comp_iat_Y_iat "Y-axis breakpoints for the 'injector compensation intake-air temp' table. Defines the lookup grid (not a live channel); change only when re-axing the map. (deg C; raw*5/8-40)" 0x4000A4F2 airtemp_tmaf RL_AXIS_UBYTE 0 CM_u8_temp_5_8_40c 16 -40 119.375 /end AXIS_PTS
/begin CHARACTERISTIC CAL_inj_comp_iat "Calibration: injector compensation intake-air temp. Tunable map/constant (not a live channel); log to verify injector pulse width and fuel delivery vs target. (0-1; raw/128)" MAP 0x4000A502 RL_VALUE_UBYTE 0 CM_u8_factor_1_128 0 199.21875
 /begin AXIS_DESCR COM_AXIS load_mass_per_stroke CM_u8_load_4mg_stroke 8 0 1020 AXIS_PTS_REF CAL_inj_comp_iat_X_load /end AXIS_DESCR
 /begin AXIS_DESCR COM_AXIS airtemp_tmaf CM_u8_temp_5_8_40c 16 -40 119.375 AXIS_PTS_REF CAL_inj_comp_iat_Y_iat /end AXIS_DESCR
/end CHARACTERISTIC
/begin AXIS_PTS CAL_load_source_selection_threshold_by_tps_X_rpm "X-axis breakpoints for the 'load source selection threshold by throttle position' table. Defines the lookup grid (not a live channel); change only when re-axing the map. (RPM; raw*125/4+500)" 0x4000A582 engine_speed_3 RL_AXIS_UBYTE 0 CM_u8_rspeed_125_4_500rpm 16 500 8468.75 /end AXIS_PTS
/begin CHARACTERISTIC CAL_load_source_selection_threshold_by_tps "Calibration: load source selection threshold by throttle position. Tunable map/constant (not a live channel); log to see throttle/pedal demand and throttle response. (0-1; raw/255)" CURVE 0x4000A592 RL_VALUE_UBYTE 0 CM_u8_factor_1_255 0 100
 /begin AXIS_DESCR COM_AXIS engine_speed_3 CM_u8_rspeed_125_4_500rpm 16 500 8468.75 AXIS_PTS_REF CAL_load_source_selection_threshold_by_tps_X_rpm /end AXIS_DESCR
/end CHARACTERISTIC
/begin AXIS_PTS CAL_tps_idle_target_cranking_X_baro "X-axis breakpoints for the 'throttle position idle target cranking' table. Defines the lookup grid (not a live channel); change only when re-axing the map. (mbar; raw*4)" 0x4000A5A2 NO_INPUT_QUANTITY RL_AXIS_UBYTE 0 CM_u8_pressure_4mbar 4 0 1020 /end AXIS_PTS
/begin AXIS_PTS CAL_tps_idle_target_cranking_Y_coolant "Y-axis breakpoints for the 'throttle position idle target cranking' table. Defines the lookup grid (not a live channel); change only when re-axing the map. (deg C; raw*5/8-40)" 0x4000A5A6 coolant_temp RL_AXIS_UBYTE 0 CM_u8_temp_5_8_40c 16 -40 119.375 /end AXIS_PTS
/begin CHARACTERISTIC CAL_tps_idle_target_cranking "Calibration: throttle position idle target cranking. Tunable map/constant (not a live channel); log to diagnose idle quality, hunting, and stalls. (0-1; raw/1023)" MAP 0x4000A5B6 RL_VALUE_UBYTE 0 CM_u16_factor_1_1023 0 24.9266862170088
 /begin AXIS_DESCR COM_AXIS NO_INPUT_QUANTITY CM_u8_pressure_4mbar 4 0 1020 AXIS_PTS_REF CAL_tps_idle_target_cranking_X_baro /end AXIS_DESCR
 /begin AXIS_DESCR COM_AXIS coolant_temp CM_u8_temp_5_8_40c 16 -40 119.375 AXIS_PTS_REF CAL_tps_idle_target_cranking_Y_coolant /end AXIS_DESCR
/end CHARACTERISTIC
/begin AXIS_PTS CAL_knock_inhibit_tps_max_X_rpm "X-axis breakpoints for the 'knock inhibit throttle position max' table. Defines the lookup grid (not a live channel); change only when re-axing the map. (RPM; raw*125/4+500)" 0x4000A5FA engine_speed_3 RL_AXIS_UBYTE 0 CM_u8_rspeed_125_4_500rpm 16 500 8468.75 /end AXIS_PTS
/begin CHARACTERISTIC CAL_knock_inhibit_tps_max "Calibration: knock inhibit throttle position max. Tunable map/constant (not a live channel); log to catch knock events and see how much timing is being pulled. (0-1; raw/255)" CURVE 0x4000A60A RL_VALUE_UBYTE 0 CM_u8_factor_1_255 0 100
 /begin AXIS_DESCR COM_AXIS engine_speed_3 CM_u8_rspeed_125_4_500rpm 16 500 8468.75 AXIS_PTS_REF CAL_knock_inhibit_tps_max_X_rpm /end AXIS_DESCR
/end CHARACTERISTIC
/begin AXIS_PTS CAL_inj_startup_enrichment_offset_X_coolant_temp_engine_stopped "X-axis breakpoints for the 'injector startup enrichment offset' table. Defines the lookup grid (not a live channel); change only when re-axing the map. (deg C; raw*5/8-40)" 0x4000A6DA coolant_temp_engine_stopped RL_AXIS_UBYTE 0 CM_u8_temp_5_8_40c 16 -40 119.375 /end AXIS_PTS
/begin CHARACTERISTIC CAL_inj_startup_enrichment_offset "Calibration: injector startup enrichment offset. Tunable map/constant (not a live channel); log to verify injector pulse width and fuel delivery vs target. (us; raw*256)" CURVE 0x4000A6EA RL_VALUE_UBYTE 0 CM_u8_time_256us 0 65280
 /begin AXIS_DESCR COM_AXIS coolant_temp_engine_stopped CM_u8_temp_5_8_40c 16 -40 119.375 AXIS_PTS_REF CAL_inj_startup_enrichment_offset_X_coolant_temp_engine_stopped /end AXIS_DESCR
/end CHARACTERISTIC
/begin AXIS_PTS CAL_dfco_recovery_fuel_frac_vs_pedal_X_pedal_pos "X-axis breakpoints for the 'DFCO recovery fuel frac vs pedal' table. Defines the lookup grid (not a live channel); change only when re-axing the map. (0-1; raw/255)" 0x4000A76A V_CAL_dfco_recovery_fuel_frac_vs_pedal_X_pedal_pos RL_AXIS_UBYTE 0 CM_u8_factor_1_255 4 0 100 /end AXIS_PTS
/begin CHARACTERISTIC CAL_dfco_recovery_fuel_frac_vs_pedal "Calibration: DFCO recovery fuel frac vs pedal. Tunable map/constant (not a live channel); log to see when fuel is cut and restored on deceleration." CURVE 0x4000A76E RL_VALUE_UBYTE 0 NO_COMPU_METHOD 0 255
 /begin AXIS_DESCR COM_AXIS V_CAL_dfco_recovery_fuel_frac_vs_pedal_X_pedal_pos CM_u8_factor_1_255 4 0 100 AXIS_PTS_REF CAL_dfco_recovery_fuel_frac_vs_pedal_X_pedal_pos /end AXIS_DESCR
/end CHARACTERISTIC
/begin AXIS_PTS CAL_ign_comp_maf_accum_X_maf_accum "X-axis breakpoints for the 'ignition compensation MAF accum' table. Defines the lookup grid (not a live channel); change only when re-axing the map. (g)" 0x4000A772 V_CAL_ign_comp_maf_accum_X_maf_accum RL_AXIS_UBYTE 0 CM_u16_mass_g 8 0 255 /end AXIS_PTS
/begin AXIS_PTS CAL_ign_comp_maf_accum_Y_tps "Y-axis breakpoints for the 'ignition compensation MAF accum' table. Defines the lookup grid (not a live channel); change only when re-axing the map. (0-1; raw/255)" 0x4000A77A tps_8bit RL_AXIS_UBYTE 0 CM_u8_factor_1_255 8 0 100 /end AXIS_PTS
/begin CHARACTERISTIC CAL_ign_comp_maf_accum "Calibration: ignition compensation MAF accum. Tunable map/constant (not a live channel); log spark advance to confirm the timing strategy and headroom to knock. (0-1; raw/255)" MAP 0x4000A782 RL_VALUE_UBYTE 0 CM_u8_factor_1_255 0 100
 /begin AXIS_DESCR COM_AXIS V_CAL_ign_comp_maf_accum_X_maf_accum CM_u16_mass_g 8 0 255 AXIS_PTS_REF CAL_ign_comp_maf_accum_X_maf_accum /end AXIS_DESCR
 /begin AXIS_DESCR COM_AXIS tps_8bit CM_u8_factor_1_255 8 0 100 AXIS_PTS_REF CAL_ign_comp_maf_accum_Y_tps /end AXIS_DESCR
/end CHARACTERISTIC
/begin AXIS_PTS CAL_ign_dwell_time_X_rpm "X-axis breakpoints for the 'ignition dwell time' table. Defines the lookup grid (not a live channel); change only when re-axing the map. (RPM; raw*125/4+500)" 0x4000A7C2 engine_speed_3 RL_AXIS_UBYTE 0 CM_u8_rspeed_125_4_500rpm 8 500 8468.75 /end AXIS_PTS
/begin AXIS_PTS CAL_ign_dwell_time_Y_ecu_voltage "Y-axis breakpoints for the 'ignition dwell time' table. Defines the lookup grid (not a live channel); change only when re-axing the map. (V; raw*72/1023)" 0x4000A7CA V_CAL_ign_dwell_time_Y_ecu_voltage RL_AXIS_UBYTE 0 CM_u8_voltage_72_1023v 8 0 17.9472140762463 /end AXIS_PTS
/begin CHARACTERISTIC CAL_ign_dwell_time "Calibration: ignition dwell time. Tunable map/constant (not a live channel); log spark advance to confirm the timing strategy and headroom to knock. (us; raw*64)" MAP 0x4000A7D2 RL_VALUE_UBYTE 0 CM_u8_time_64us 0 16320
 /begin AXIS_DESCR COM_AXIS engine_speed_3 CM_u8_rspeed_125_4_500rpm 8 500 8468.75 AXIS_PTS_REF CAL_ign_dwell_time_X_rpm /end AXIS_DESCR
 /begin AXIS_DESCR COM_AXIS V_CAL_ign_dwell_time_Y_ecu_voltage CM_u8_voltage_72_1023v 8 0 17.9472140762463 AXIS_PTS_REF CAL_ign_dwell_time_Y_ecu_voltage /end AXIS_DESCR
/end CHARACTERISTIC
/begin AXIS_PTS CAL_ign_knock_safe_X_rpm "X-axis breakpoints for the 'ignition knock safe' table. Defines the lookup grid (not a live channel); change only when re-axing the map. (RPM; raw*125/4+500)" 0x4000A812 engine_speed_3 RL_AXIS_UBYTE 0 CM_u8_rspeed_125_4_500rpm 32 500 8468.75 /end AXIS_PTS
/begin AXIS_PTS CAL_ign_knock_safe_Y_load "Y-axis breakpoints for the 'ignition knock safe' table. Defines the lookup grid (not a live channel); change only when re-axing the map. (mg/stroke; raw*4)" 0x4000A832 load_mass_per_stroke RL_AXIS_UBYTE 0 CM_u8_load_4mg_stroke 32 0 1020 /end AXIS_PTS
/begin CHARACTERISTIC CAL_ign_knock_safe "Calibration: ignition knock safe. Tunable map/constant (not a live channel); log spark advance to confirm the timing strategy and headroom to knock. (deg; raw/4-10)" MAP 0x4000A852 RL_VALUE_UBYTE 0 CM_u8_angle_1_4_10deg -10 53.75
 /begin AXIS_DESCR COM_AXIS engine_speed_3 CM_u8_rspeed_125_4_500rpm 32 500 8468.75 AXIS_PTS_REF CAL_ign_knock_safe_X_rpm /end AXIS_DESCR
 /begin AXIS_DESCR COM_AXIS load_mass_per_stroke CM_u8_load_4mg_stroke 32 0 1020 AXIS_PTS_REF CAL_ign_knock_safe_Y_load /end AXIS_DESCR
/end CHARACTERISTIC
/begin AXIS_PTS CAL_ign_base_manual_X_rpm "X-axis breakpoints for the 'ignition base manual' table. Defines the lookup grid (not a live channel); change only when re-axing the map. (RPM; raw*125/4+500)" 0x4000AC52 engine_speed_3 RL_AXIS_UBYTE 0 CM_u8_rspeed_125_4_500rpm 32 500 8468.75 /end AXIS_PTS
/begin AXIS_PTS CAL_ign_base_manual_Y_load "Y-axis breakpoints for the 'ignition base manual' table. Defines the lookup grid (not a live channel); change only when re-axing the map. (mg/stroke; raw*4)" 0x4000AC72 load_mass_per_stroke RL_AXIS_UBYTE 0 CM_u8_load_4mg_stroke 32 0 1020 /end AXIS_PTS
/begin CHARACTERISTIC CAL_ign_base_manual "Calibration: ignition base manual. Tunable map/constant (not a live channel); log spark advance to confirm the timing strategy and headroom to knock. (deg; raw/4-10)" MAP 0x4000AC92 RL_VALUE_UBYTE 0 CM_u8_angle_1_4_10deg -10 53.75
 /begin AXIS_DESCR COM_AXIS engine_speed_3 CM_u8_rspeed_125_4_500rpm 32 500 8468.75 AXIS_PTS_REF CAL_ign_base_manual_X_rpm /end AXIS_DESCR
 /begin AXIS_DESCR COM_AXIS load_mass_per_stroke CM_u8_load_4mg_stroke 32 0 1020 AXIS_PTS_REF CAL_ign_base_manual_Y_load /end AXIS_DESCR
/end CHARACTERISTIC
/begin AXIS_PTS CAL_sensor_maf_scaling_X_voltage "X-axis breakpoints for the 'sensor MAF scaling' table. Defines the lookup grid (not a live channel); change only when re-axing the map. (V; raw*5/1023)" 0x4000B092 NO_INPUT_QUANTITY RL_AXIS_UWORD 0 CM_u16_voltage_5_1023v 32 0 320.307917888563 /end AXIS_PTS
/begin CHARACTERISTIC CAL_sensor_maf_scaling "Calibration: sensor MAF scaling. Tunable map/constant (not a live channel); log the raw sensor signal to check sensor health and range. (mg/s; raw*10)" CURVE 0x4000B0D2 RL_VALUE_UWORD 0 CM_u16_flow_10mg_s 0 655350
 /begin AXIS_DESCR COM_AXIS NO_INPUT_QUANTITY CM_u16_voltage_5_1023v 32 0 320.307917888563 AXIS_PTS_REF CAL_sensor_maf_scaling_X_voltage /end AXIS_DESCR
/end CHARACTERISTIC
/begin AXIS_PTS CAL_tpssmooth_decrement_by_delta_X_tps_delta "X-axis breakpoints for the 'tpssmooth decrement by delta' table. Defines the lookup grid (not a live channel); change only when re-axing the map. (0-1; raw/255)" 0x4000B132 NO_INPUT_QUANTITY RL_AXIS_UBYTE 0 CM_u8_factor_1_255 8 0 100 /end AXIS_PTS
/begin CHARACTERISTIC CAL_tpssmooth_decrement_by_delta "Calibration: tpssmooth decrement by delta. Tunable map/constant (not a live channel); log to see throttle-signal smoothing/filtering behavior. (0-1; raw/255)" CURVE 0x4000B13A RL_VALUE_UBYTE 0 CM_u8_factor_1_255 0 100
 /begin AXIS_DESCR COM_AXIS NO_INPUT_QUANTITY CM_u8_factor_1_255 8 0 100 AXIS_PTS_REF CAL_tpssmooth_decrement_by_delta_X_tps_delta /end AXIS_DESCR
/end CHARACTERISTIC
/begin AXIS_PTS CAL_ign_comp_overtemp_X_rpm "X-axis breakpoints for the 'ignition compensation overtemp' table. Defines the lookup grid (not a live channel); change only when re-axing the map. (RPM; raw*125/4+500)" 0x4000B192 engine_speed_3 RL_AXIS_UBYTE 0 CM_u8_rspeed_125_4_500rpm 16 500 8468.75 /end AXIS_PTS
/begin CHARACTERISTIC CAL_ign_comp_overtemp "Calibration: ignition compensation overtemp. Tunable map/constant (not a live channel); log spark advance to confirm the timing strategy and headroom to knock. (deg; raw/4-32)" CURVE 0x4000B1A2 RL_VALUE_UBYTE 0 CM_u8_angle_1_4_32deg -32 31.75
 /begin AXIS_DESCR COM_AXIS engine_speed_3 CM_u8_rspeed_125_4_500rpm 16 500 8468.75 AXIS_PTS_REF CAL_ign_comp_overtemp_X_rpm /end AXIS_DESCR
/end CHARACTERISTIC
/begin AXIS_PTS CAL_ign_comp_overtemp_coeff_X_coolant_temp "X-axis breakpoints for the 'ignition compensation overtemp coeff' table. Defines the lookup grid (not a live channel); change only when re-axing the map. (deg C; raw*5/8-40)" 0x4000B1B2 coolant_temp RL_AXIS_UBYTE 0 CM_u8_temp_5_8_40c 8 -40 119.375 /end AXIS_PTS
/begin CHARACTERISTIC CAL_ign_comp_overtemp_coeff "Calibration: ignition compensation overtemp coeff. Tunable map/constant (not a live channel); log spark advance to confirm the timing strategy and headroom to knock. (0-1; raw/128)" CURVE 0x4000B1BA RL_VALUE_UBYTE 0 CM_u8_factor_1_128 0 199.21875
 /begin AXIS_DESCR COM_AXIS coolant_temp CM_u8_temp_5_8_40c 8 -40 119.375 AXIS_PTS_REF CAL_ign_comp_overtemp_coeff_X_coolant_temp /end AXIS_DESCR
/end CHARACTERISTIC
/begin AXIS_PTS CAL_ign_comp_speed_variation_X_rpm_delta "X-axis breakpoints for the 'ignition compensation speed variation' table. Defines the lookup grid (not a live channel); change only when re-axing the map." 0x4000B1C2 V_CAL_ign_comp_speed_variation_X_rpm_delta RL_AXIS_UBYTE 0 NO_COMPU_METHOD 16 0 255 /end AXIS_PTS
/begin CHARACTERISTIC CAL_ign_comp_speed_variation "ignition compensation indexed by engine speed variation (RPM delta)" CURVE 0x4000B1D2 RL_VALUE_UBYTE 0 NO_COMPU_METHOD 0 255
 /begin AXIS_DESCR COM_AXIS V_CAL_ign_comp_speed_variation_X_rpm_delta NO_COMPU_METHOD 16 0 255 AXIS_PTS_REF CAL_ign_comp_speed_variation_X_rpm_delta /end AXIS_DESCR
/end CHARACTERISTIC
/begin AXIS_PTS CAL_closedloop_o2_switch_threshold_X_rpm "X-axis breakpoints for the 'closedloop O2 switch threshold' table. Defines the lookup grid (not a live channel); change only when re-axing the map. (RPM; raw*125/4+500)" 0x4000B1F2 engine_speed_3 RL_AXIS_UBYTE 0 CM_u8_rspeed_125_4_500rpm 8 500 8468.75 /end AXIS_PTS
/begin CHARACTERISTIC CAL_closedloop_o2_switch_threshold "Calibration: closedloop O2 switch threshold. Tunable map/constant (not a live channel); log to watch O2 feedback trim the mixture and confirm the loop is active." CURVE 0x4000B1FA RL_VALUE_UBYTE 0 NO_COMPU_METHOD 0 255
 /begin AXIS_DESCR COM_AXIS engine_speed_3 CM_u8_rspeed_125_4_500rpm 8 500 8468.75 AXIS_PTS_REF CAL_closedloop_o2_switch_threshold_X_rpm /end AXIS_DESCR
/end CHARACTERISTIC
/begin AXIS_PTS CAL_ign_comp_tps_rate_X_tps_rate "X-axis breakpoints for the 'ignition compensation throttle position rate' table. Defines the lookup grid (not a live channel); change only when re-axing the map." 0x4000B202 NO_INPUT_QUANTITY RL_AXIS_UBYTE 0 NO_COMPU_METHOD 8 0 255 /end AXIS_PTS
/begin CHARACTERISTIC CAL_ign_comp_tps_rate "Calibration: ignition compensation throttle position rate. Tunable map/constant (not a live channel); log spark advance to confirm the timing strategy and headroom to knock. (deg; raw/4)" CURVE 0x4000B20A RL_VALUE_SBYTE 0 CM_u8_angle_1_4deg -32 31.75
 /begin AXIS_DESCR COM_AXIS NO_INPUT_QUANTITY NO_COMPU_METHOD 8 0 255 AXIS_PTS_REF CAL_ign_comp_tps_rate_X_tps_rate /end AXIS_DESCR
/end CHARACTERISTIC
/begin AXIS_PTS CAL_knock_sampling_window_X_rpm "X-axis breakpoints for the 'knock sampling window' table. Defines the lookup grid (not a live channel); change only when re-axing the map. (RPM; raw*125/4+500)" 0x4000B212 engine_speed_3 RL_AXIS_UBYTE 0 CM_u8_rspeed_125_4_500rpm 16 500 8468.75 /end AXIS_PTS
/begin AXIS_PTS CAL_knock_sampling_window_Y_load "Y-axis breakpoints for the 'knock sampling window' table. Defines the lookup grid (not a live channel); change only when re-axing the map. (mg/stroke; raw*4)" 0x4000B222 load_mass_per_stroke RL_AXIS_UBYTE 0 CM_u8_load_4mg_stroke 16 0 1020 /end AXIS_PTS
/begin CHARACTERISTIC CAL_knock_sampling_window "Calibration: knock sampling window. Tunable map/constant (not a live channel); log to catch knock events and see how much timing is being pulled." MAP 0x4000B232 RL_VALUE_UBYTE 0 NO_COMPU_METHOD 0 255
 /begin AXIS_DESCR COM_AXIS engine_speed_3 CM_u8_rspeed_125_4_500rpm 16 500 8468.75 AXIS_PTS_REF CAL_knock_sampling_window_X_rpm /end AXIS_DESCR
 /begin AXIS_DESCR COM_AXIS load_mass_per_stroke CM_u8_load_4mg_stroke 16 0 1020 AXIS_PTS_REF CAL_knock_sampling_window_Y_load /end AXIS_DESCR
/end CHARACTERISTIC
/begin AXIS_PTS CAL_knock_buffer_size_X_rpm "X-axis breakpoints for the 'knock buffer size' table. Defines the lookup grid (not a live channel); change only when re-axing the map. (RPM; raw*125/4+500)" 0x4000B332 engine_speed_3 RL_AXIS_UBYTE 0 CM_u8_rspeed_125_4_500rpm 16 500 8468.75 /end AXIS_PTS
/begin AXIS_PTS CAL_knock_buffer_size_Y_load "Y-axis breakpoints for the 'knock buffer size' table. Defines the lookup grid (not a live channel); change only when re-axing the map. (mg/stroke; raw*4)" 0x4000B342 load_mass_per_stroke RL_AXIS_UBYTE 0 CM_u8_load_4mg_stroke 16 0 1020 /end AXIS_PTS
/begin CHARACTERISTIC CAL_knock_buffer_size "Calibration: knock buffer size. Tunable map/constant (not a live channel); log to catch knock events and see how much timing is being pulled." MAP 0x4000B352 RL_VALUE_UBYTE 0 NO_COMPU_METHOD 0 255
 /begin AXIS_DESCR COM_AXIS engine_speed_3 CM_u8_rspeed_125_4_500rpm 16 500 8468.75 AXIS_PTS_REF CAL_knock_buffer_size_X_rpm /end AXIS_DESCR
 /begin AXIS_DESCR COM_AXIS load_mass_per_stroke CM_u8_load_4mg_stroke 16 0 1020 AXIS_PTS_REF CAL_knock_buffer_size_Y_load /end AXIS_DESCR
/end CHARACTERISTIC
/begin AXIS_PTS CAL_inj_deadtime_base_X_voltage "X-axis breakpoints for the 'injector time base' table. Defines the lookup grid (not a live channel); change only when re-axing the map. (V; raw*72/1023)" 0x4000B4A2 V_CAL_inj_deadtime_base_X_voltage RL_AXIS_UBYTE 0 CM_u8_voltage_72_1023v 8 0 17.9472140762463 /end AXIS_PTS
/begin AXIS_PTS CAL_inj_deadtime_base_Y_airtemp_maf "Y-axis breakpoints for the 'injector time base' table. Defines the lookup grid (not a live channel); change only when re-axing the map. (deg C; raw*5/8-40)" 0x4000B4AA airtemp_tmaf RL_AXIS_UBYTE 0 CM_u8_temp_5_8_40c 8 -40 119.375 /end AXIS_PTS
/begin CHARACTERISTIC CAL_inj_deadtime_base "Calibration: injector time base. Tunable map/constant (not a live channel); log to verify injector pulse width and fuel delivery vs target. (us; raw*20)" MAP 0x4000B4B2 RL_VALUE_UBYTE 0 CM_u8_time_20us 0 5100
 /begin AXIS_DESCR COM_AXIS V_CAL_inj_deadtime_base_X_voltage CM_u8_voltage_72_1023v 8 0 17.9472140762463 AXIS_PTS_REF CAL_inj_deadtime_base_X_voltage /end AXIS_DESCR
 /begin AXIS_DESCR COM_AXIS airtemp_tmaf CM_u8_temp_5_8_40c 8 -40 119.375 AXIS_PTS_REF CAL_inj_deadtime_base_Y_airtemp_maf /end AXIS_DESCR
/end CHARACTERISTIC
/begin AXIS_PTS CAL_sensor_ac_evap_temp_scaling_X_voltage "X-axis breakpoints for the 'sensor A/C EVAP temperature scaling' table. Defines the lookup grid (not a live channel); change only when re-axing the map." 0x4000B4F2 ac_evap_temp_voltage RL_AXIS_UWORD 0 NO_COMPU_METHOD 16 0 65535 /end AXIS_PTS
/begin CHARACTERISTIC CAL_sensor_ac_evap_temp_scaling "Calibration: sensor A/C EVAP temperature scaling. Tunable map/constant (not a live channel); log the raw sensor signal to check sensor health and range." CURVE 0x4000B512 RL_VALUE_UWORD 0 NO_COMPU_METHOD 0 65535
 /begin AXIS_DESCR COM_AXIS ac_evap_temp_voltage NO_COMPU_METHOD 16 0 65535 AXIS_PTS_REF CAL_sensor_ac_evap_temp_scaling_X_voltage /end AXIS_DESCR
/end CHARACTERISTIC
/begin AXIS_PTS CAL_sensor_fuel_level_X_voltage "X-axis breakpoints for the 'sensor fuel level' table. Defines the lookup grid (not a live channel); change only when re-axing the map. (V; raw*5/1023)" 0x4000B542 NO_INPUT_QUANTITY RL_AXIS_UWORD 0 CM_u16_voltage_5_1023v 8 0 320.307917888563 /end AXIS_PTS
/begin CHARACTERISTIC CAL_sensor_fuel_level "Calibration: sensor fuel level. Tunable map/constant (not a live channel); log to follow fuel delivery and mixture control. (gal; raw/10)" CURVE 0x4000B552 RL_VALUE_UWORD 0 CM_u8_volume_1_10gallon 0 6553.5
 /begin AXIS_DESCR COM_AXIS NO_INPUT_QUANTITY CM_u16_voltage_5_1023v 8 0 320.307917888563 AXIS_PTS_REF CAL_sensor_fuel_level_X_voltage /end AXIS_DESCR
/end CHARACTERISTIC
/begin AXIS_PTS CAL_ign_comp_startup_manual_X_maf_accum "X-axis breakpoints for the 'ignition compensation startup manual' table. Defines the lookup grid (not a live channel); change only when re-axing the map. (mg)" 0x4000B572 maf_accumulated_2 RL_AXIS_UWORD 0 CM_u16_mass_mg 8 0 65535 /end AXIS_PTS
/begin CHARACTERISTIC CAL_ign_comp_startup_manual "Calibration: ignition compensation startup manual. Tunable map/constant (not a live channel); log spark advance to confirm the timing strategy and headroom to knock. (deg; raw/4)" CURVE 0x4000B582 RL_VALUE_SWORD 0 CM_u8_angle_1_4deg -8192 8191.75
 /begin AXIS_DESCR COM_AXIS maf_accumulated_2 CM_u16_mass_mg 8 0 65535 AXIS_PTS_REF CAL_ign_comp_startup_manual_X_maf_accum /end AXIS_DESCR
/end CHARACTERISTIC
/begin AXIS_PTS CAL_load_alphaN_base_X_engine_speed "X-axis breakpoints for the 'load alphaN base' table. Defines the lookup grid (not a live channel); change only when re-axing the map. (RPM; raw*125/4+500)" 0x4000B5C2 engine_speed_3 RL_AXIS_UBYTE 0 CM_u8_rspeed_125_4_500rpm 16 500 8468.75 /end AXIS_PTS
/begin AXIS_PTS CAL_load_alphaN_base_Y_tps "Y-axis breakpoints for the 'load alphaN base' table. Defines the lookup grid (not a live channel); change only when re-axing the map. (0-1; raw/255)" 0x4000B5D2 NO_INPUT_QUANTITY RL_AXIS_UBYTE 0 CM_u8_factor_1_255 16 0 100 /end AXIS_PTS
/begin CHARACTERISTIC CAL_load_alphaN_base "Calibration: load alphaN base. Tunable map/constant (not a live channel); log engine load -- the main axis for fueling and ignition. (mg/stroke; raw*4)" MAP 0x4000B5E2 RL_VALUE_UBYTE 0 CM_u8_load_4mg_stroke 0 1020
 /begin AXIS_DESCR COM_AXIS engine_speed_3 CM_u8_rspeed_125_4_500rpm 16 500 8468.75 AXIS_PTS_REF CAL_load_alphaN_base_X_engine_speed /end AXIS_DESCR
 /begin AXIS_DESCR COM_AXIS NO_INPUT_QUANTITY CM_u8_factor_1_255 16 0 100 AXIS_PTS_REF CAL_load_alphaN_base_Y_tps /end AXIS_DESCR
/end CHARACTERISTIC
/begin AXIS_PTS CAL_inj_afr_base_X_engine_speed "X-axis breakpoints for the 'injector AFR base' table. Defines the lookup grid (not a live channel); change only when re-axing the map. (RPM; raw*125/4+500)" 0x4000B6E2 engine_speed_3 RL_AXIS_UBYTE 0 CM_u8_rspeed_125_4_500rpm 16 500 8468.75 /end AXIS_PTS
/begin AXIS_PTS CAL_inj_afr_base_Y_engine_load "Y-axis breakpoints for the 'injector AFR base' table. Defines the lookup grid (not a live channel); change only when re-axing the map. (mg/stroke; raw*4)" 0x4000B6F2 load_mass_per_stroke RL_AXIS_UBYTE 0 CM_u8_load_4mg_stroke 16 0 1020 /end AXIS_PTS
/begin CHARACTERISTIC CAL_inj_afr_base "Calibration: injector AFR base. Tunable map/constant (not a live channel); log to verify injector pulse width and fuel delivery vs target. (AFR; raw/20+5)" MAP 0x4000B702 RL_VALUE_UBYTE 0 CM_u8_afr_1_20_5 5 17.75
 /begin AXIS_DESCR COM_AXIS engine_speed_3 CM_u8_rspeed_125_4_500rpm 16 500 8468.75 AXIS_PTS_REF CAL_inj_afr_base_X_engine_speed /end AXIS_DESCR
 /begin AXIS_DESCR COM_AXIS load_mass_per_stroke CM_u8_load_4mg_stroke 16 0 1020 AXIS_PTS_REF CAL_inj_afr_base_Y_engine_load /end AXIS_DESCR
/end CHARACTERISTIC
/begin AXIS_PTS CAL_tpstarget_low_gear_tour_ips_X_pps "X-axis breakpoints for the 'tpstarget low gear tour IPS' table. Defines the lookup grid (not a live channel); change only when re-axing the map. (0-1; raw/1023)" 0x4000B802 accel_pedal_pos RL_AXIS_UWORD 0 CM_u16_factor_1_1023 16 0 6406.15835777126 /end AXIS_PTS
/begin CHARACTERISTIC CAL_tpstarget_low_gear_tour_ips "Calibration: tpstarget low gear tour IPS. Tunable map/constant (not a live channel); log to compare requested throttle target to pedal demand. (0-1; raw/1023)" CURVE 0x4000B822 RL_VALUE_UWORD 0 CM_u16_factor_1_1023 0 6406.15835777126
 /begin AXIS_DESCR COM_AXIS accel_pedal_pos CM_u16_factor_1_1023 16 0 6406.15835777126 AXIS_PTS_REF CAL_tpstarget_low_gear_tour_ips_X_pps /end AXIS_DESCR
/end CHARACTERISTIC
/begin AXIS_PTS CAL_tpstarget_sport_ips_X_pps "X-axis breakpoints for the 'tpstarget sport IPS' table. Defines the lookup grid (not a live channel); change only when re-axing the map. (0-1; raw/1023)" 0x4000B842 accel_pedal_pos RL_AXIS_UWORD 0 CM_u16_factor_1_1023 16 0 6406.15835777126 /end AXIS_PTS
/begin CHARACTERISTIC CAL_tpstarget_sport_ips "Calibration: tpstarget sport IPS. Tunable map/constant (not a live channel); log to compare requested throttle target to pedal demand. (0-1; raw/1023)" CURVE 0x4000B862 RL_VALUE_UWORD 0 CM_u16_factor_1_1023 0 6406.15835777126
 /begin AXIS_DESCR COM_AXIS accel_pedal_pos CM_u16_factor_1_1023 16 0 6406.15835777126 AXIS_PTS_REF CAL_tpstarget_sport_ips_X_pps /end AXIS_DESCR
/end CHARACTERISTIC
/begin AXIS_PTS CAL_knock_sensitivity_X_engine_speed "X-axis breakpoints for the 'knock sensitivity' table. Defines the lookup grid (not a live channel); change only when re-axing the map. (RPM; raw*125/4+500)" 0x4000B882 engine_speed_3 RL_AXIS_UBYTE 0 CM_u8_rspeed_125_4_500rpm 8 500 8468.75 /end AXIS_PTS
/begin AXIS_PTS CAL_knock_sensitivity_Y_engine_load "Y-axis breakpoints for the 'knock sensitivity' table. Defines the lookup grid (not a live channel); change only when re-axing the map. (mg/stroke; raw*4)" 0x4000B88A load_mass_per_stroke RL_AXIS_UBYTE 0 CM_u8_load_4mg_stroke 8 0 1020 /end AXIS_PTS
/begin CHARACTERISTIC CAL_knock_sensitivity "Calibration: knock sensitivity. Tunable map/constant (not a live channel); log to catch knock events and see how much timing is being pulled." MAP 0x4000B892 RL_VALUE_UBYTE 0 NO_COMPU_METHOD 0 255
 /begin AXIS_DESCR COM_AXIS engine_speed_3 CM_u8_rspeed_125_4_500rpm 8 500 8468.75 AXIS_PTS_REF CAL_knock_sensitivity_X_engine_speed /end AXIS_DESCR
 /begin AXIS_DESCR COM_AXIS load_mass_per_stroke CM_u8_load_4mg_stroke 8 0 1020 AXIS_PTS_REF CAL_knock_sensitivity_Y_engine_load /end AXIS_DESCR
/end CHARACTERISTIC
/begin AXIS_PTS CAL_knock_peak_threshold_X_engine_speed "X-axis breakpoints for the 'knock peak threshold' table. Defines the lookup grid (not a live channel); change only when re-axing the map. (RPM; raw*125/4+500)" 0x4000B8D2 engine_speed_3 RL_AXIS_UBYTE 0 CM_u8_rspeed_125_4_500rpm 8 500 8468.75 /end AXIS_PTS
/begin AXIS_PTS CAL_knock_peak_threshold_Y_load "Y-axis breakpoints for the 'knock peak threshold' table. Defines the lookup grid (not a live channel); change only when re-axing the map. (mg/stroke; raw*4)" 0x4000B8DA load_mass_per_stroke RL_AXIS_UBYTE 0 CM_u8_load_4mg_stroke 8 0 1020 /end AXIS_PTS
/begin CHARACTERISTIC CAL_knock_peak_threshold "Calibration: knock peak threshold. Tunable map/constant (not a live channel); log to catch knock events and see how much timing is being pulled." MAP 0x4000B8E2 RL_VALUE_UBYTE 0 NO_COMPU_METHOD 0 255
 /begin AXIS_DESCR COM_AXIS engine_speed_3 CM_u8_rspeed_125_4_500rpm 8 500 8468.75 AXIS_PTS_REF CAL_knock_peak_threshold_X_engine_speed /end AXIS_DESCR
 /begin AXIS_DESCR COM_AXIS load_mass_per_stroke CM_u8_load_4mg_stroke 8 0 1020 AXIS_PTS_REF CAL_knock_peak_threshold_Y_load /end AXIS_DESCR
/end CHARACTERISTIC
/begin AXIS_PTS CAL_knock_retard1_step_X_peak_over_threshold "X-axis breakpoints for the 'knock retard1 step' table. Defines the lookup grid (not a live channel); change only when re-axing the map." 0x4000B922 NO_INPUT_QUANTITY RL_AXIS_UBYTE 0 NO_COMPU_METHOD 8 0 255 /end AXIS_PTS
/begin CHARACTERISTIC CAL_knock_retard1_step "Calibration: knock retard1 step. Tunable map/constant (not a live channel); log to catch knock events and see how much timing is being pulled. (deg; raw/4)" CURVE 0x4000B92A RL_VALUE_UBYTE 0 CM_u8_angle_1_4deg 0 63.75
 /begin AXIS_DESCR COM_AXIS NO_INPUT_QUANTITY NO_COMPU_METHOD 8 0 255 AXIS_PTS_REF CAL_knock_retard1_step_X_peak_over_threshold /end AXIS_DESCR
/end CHARACTERISTIC
/begin AXIS_PTS CAL_knock_detection_load_threshold_X_rpm "X-axis breakpoints for the 'knock detection load threshold' table. Defines the lookup grid (not a live channel); change only when re-axing the map. (RPM; raw*125/4+500)" 0x4000B932 engine_speed_3 RL_AXIS_UBYTE 0 CM_u8_rspeed_125_4_500rpm 8 500 8468.75 /end AXIS_PTS
/begin CHARACTERISTIC CAL_knock_detection_load_threshold "Calibration: knock detection load threshold. Tunable map/constant (not a live channel); log to catch knock events and see how much timing is being pulled. (mg/stroke; raw*4)" CURVE 0x4000B93A RL_VALUE_UBYTE 0 CM_u8_load_4mg_stroke 0 1020
 /begin AXIS_DESCR COM_AXIS engine_speed_3 CM_u8_rspeed_125_4_500rpm 8 500 8468.75 AXIS_PTS_REF CAL_knock_detection_load_threshold_X_rpm /end AXIS_DESCR
/end CHARACTERISTIC
/begin AXIS_PTS CAL_knock_learning_load_threshold_X_rpm "X-axis breakpoints for the 'knock learning load threshold' table. Defines the lookup grid (not a live channel); change only when re-axing the map. (RPM; raw*125/4+500)" 0x4000B942 engine_speed_3 RL_AXIS_UBYTE 0 CM_u8_rspeed_125_4_500rpm 8 500 8468.75 /end AXIS_PTS
/begin CHARACTERISTIC CAL_knock_learning_load_threshold "Calibration: knock learning load threshold. Tunable map/constant (not a live channel); log to catch knock events and see how much timing is being pulled. (mg/stroke; raw*4)" CURVE 0x4000B94A RL_VALUE_UBYTE 0 CM_u8_load_4mg_stroke 0 1020
 /begin AXIS_DESCR COM_AXIS engine_speed_3 CM_u8_rspeed_125_4_500rpm 8 500 8468.75 AXIS_PTS_REF CAL_knock_learning_load_threshold_X_rpm /end AXIS_DESCR
/end CHARACTERISTIC
/begin AXIS_PTS CAL_tpstarget_tour_manual_X_pps "X-axis breakpoints for the 'tpstarget tour manual' table. Defines the lookup grid (not a live channel); change only when re-axing the map. (0-1; raw/1023)" 0x4000BA82 accel_pedal_pos RL_AXIS_UWORD 0 CM_u16_factor_1_1023 16 0 6406.15835777126 /end AXIS_PTS
/begin CHARACTERISTIC CAL_tpstarget_tour_manual "Calibration: tpstarget tour manual. Tunable map/constant (not a live channel); log to compare requested throttle target to pedal demand. (0-1; raw/1023)" CURVE 0x4000BAA2 RL_VALUE_UWORD 0 CM_u16_factor_1_1023 0 6406.15835777126
 /begin AXIS_DESCR COM_AXIS accel_pedal_pos CM_u16_factor_1_1023 16 0 6406.15835777126 AXIS_PTS_REF CAL_tpstarget_tour_manual_X_pps /end AXIS_DESCR
/end CHARACTERISTIC
/begin AXIS_PTS CAL_closedloop_tps_correction_tour_manual_X_unknown "uint16_t[16]" 0x4000BAC2 NO_INPUT_QUANTITY RL_AXIS_UWORD 0 NO_COMPU_METHOD 16 0 65535 /end AXIS_PTS
/begin CHARACTERISTIC CAL_closedloop_tps_correction_tour_manual "uint16_t[16]" CURVE 0x4000BAE2 RL_VALUE_UWORD 0 NO_COMPU_METHOD 0 65535
 /begin AXIS_DESCR COM_AXIS NO_INPUT_QUANTITY NO_COMPU_METHOD 16 0 65535 AXIS_PTS_REF CAL_closedloop_tps_correction_tour_manual_X_unknown /end AXIS_DESCR
/end CHARACTERISTIC
/begin AXIS_PTS CAL_tpstarget_sport_manual_X_pps "X-axis breakpoints for the 'tpstarget sport manual' table. Defines the lookup grid (not a live channel); change only when re-axing the map. (0-1; raw/1023)" 0x4000BB02 accel_pedal_pos RL_AXIS_UWORD 0 CM_u16_factor_1_1023 16 0 6406.15835777126 /end AXIS_PTS
/begin CHARACTERISTIC CAL_tpstarget_sport_manual "Calibration: tpstarget sport manual. Tunable map/constant (not a live channel); log to compare requested throttle target to pedal demand. (0-1; raw/1023)" CURVE 0x4000BB22 RL_VALUE_UWORD 0 CM_u16_factor_1_1023 0 6406.15835777126
 /begin AXIS_DESCR COM_AXIS accel_pedal_pos CM_u16_factor_1_1023 16 0 6406.15835777126 AXIS_PTS_REF CAL_tpstarget_sport_manual_X_pps /end AXIS_DESCR
/end CHARACTERISTIC
/begin AXIS_PTS CAL_ign_retard_step_tps_X_engine_speed "X-axis breakpoints for the 'ignition retard step throttle position' table. Defines the lookup grid (not a live channel); change only when re-axing the map. (RPM; raw*125/4+500)" 0x4000BB42 engine_speed_3 RL_AXIS_UBYTE 0 CM_u8_rspeed_125_4_500rpm 8 500 8468.75 /end AXIS_PTS
/begin AXIS_PTS CAL_ign_retard_step_tps_Y_pedal_pos "Y-axis breakpoints for the 'ignition retard step throttle position' table. Defines the lookup grid (not a live channel); change only when re-axing the map. (0-1; raw/255)" 0x4000BB4A NO_INPUT_QUANTITY RL_AXIS_UBYTE 0 CM_u8_factor_1_255 16 0 100 /end AXIS_PTS
/begin CHARACTERISTIC CAL_ign_retard_step_tps "Calibration: ignition retard step throttle position. Tunable map/constant (not a live channel); log spark advance to confirm the timing strategy and headroom to knock. (deg; raw/4)" MAP 0x4000BB5A RL_VALUE_SBYTE 0 CM_u8_angle_1_4deg -32 31.75
 /begin AXIS_DESCR COM_AXIS engine_speed_3 CM_u8_rspeed_125_4_500rpm 8 500 8468.75 AXIS_PTS_REF CAL_ign_retard_step_tps_X_engine_speed /end AXIS_DESCR
 /begin AXIS_DESCR COM_AXIS NO_INPUT_QUANTITY CM_u8_factor_1_255 16 0 100 AXIS_PTS_REF CAL_ign_retard_step_tps_Y_pedal_pos /end AXIS_DESCR
/end CHARACTERISTIC
/begin AXIS_PTS CAL_load_to_tps_mapping_X_rpm "X-axis breakpoints for the 'load to throttle position mapping' table. Defines the lookup grid (not a live channel); change only when re-axing the map. (RPM; raw*125/4+500)" 0x4000BF3A engine_speed_3 RL_AXIS_UBYTE 0 CM_u8_rspeed_125_4_500rpm 16 500 8468.75 /end AXIS_PTS
/begin AXIS_PTS CAL_load_to_tps_mapping_Y_load "Y-axis breakpoints for the 'load to throttle position mapping' table. Defines the lookup grid (not a live channel); change only when re-axing the map. (mg/stroke; raw*4)" 0x4000BF4A NO_INPUT_QUANTITY RL_AXIS_UBYTE 0 CM_u8_load_4mg_stroke 16 0 1020 /end AXIS_PTS
/begin CHARACTERISTIC CAL_load_to_tps_mapping "Calibration: load to throttle position mapping. Tunable map/constant (not a live channel); log to see throttle/pedal demand and throttle response. (0-1; raw/255)" MAP 0x4000BF5A RL_VALUE_UBYTE 0 CM_u8_factor_1_255 0 100
 /begin AXIS_DESCR COM_AXIS engine_speed_3 CM_u8_rspeed_125_4_500rpm 16 500 8468.75 AXIS_PTS_REF CAL_load_to_tps_mapping_X_rpm /end AXIS_DESCR
 /begin AXIS_DESCR COM_AXIS NO_INPUT_QUANTITY CM_u8_load_4mg_stroke 16 0 1020 AXIS_PTS_REF CAL_load_to_tps_mapping_Y_load /end AXIS_DESCR
/end CHARACTERISTIC
/begin AXIS_PTS CAL_ign_advance_min_X_engine_speed "X-axis breakpoints for the 'ignition advance min' table. Defines the lookup grid (not a live channel); change only when re-axing the map. (RPM; raw*125/4+500)" 0x4000C17A engine_speed_3 RL_AXIS_UBYTE 0 CM_u8_rspeed_125_4_500rpm 16 500 8468.75 /end AXIS_PTS
/begin AXIS_PTS CAL_ign_advance_min_Y_engine_load "Y-axis breakpoints for the 'ignition advance min' table. Defines the lookup grid (not a live channel); change only when re-axing the map. (mg/stroke; raw*4)" 0x4000C18A load_mass_per_stroke RL_AXIS_UBYTE 0 CM_u8_load_4mg_stroke 16 0 1020 /end AXIS_PTS
/begin CHARACTERISTIC CAL_ign_advance_min "Calibration: ignition advance min. Tunable map/constant (not a live channel); log spark advance to confirm the timing strategy and headroom to knock. (deg; raw/4-20)" MAP 0x4000C19A RL_VALUE_UBYTE 0 CM_u8_angle_1_4_20deg -20 43.75
 /begin AXIS_DESCR COM_AXIS engine_speed_3 CM_u8_rspeed_125_4_500rpm 16 500 8468.75 AXIS_PTS_REF CAL_ign_advance_min_X_engine_speed /end AXIS_DESCR
 /begin AXIS_DESCR COM_AXIS load_mass_per_stroke CM_u8_load_4mg_stroke 16 0 1020 AXIS_PTS_REF CAL_ign_advance_min_Y_engine_load /end AXIS_DESCR
/end CHARACTERISTIC
/begin AXIS_PTS CAL_ign_mbt_modeled_X_rpm "X-axis breakpoints for the 'ignition MBT modeled' table. Defines the lookup grid (not a live channel); change only when re-axing the map. (RPM; raw*125/4+500)" 0x4000C66A engine_speed_3 RL_AXIS_UBYTE 0 CM_u8_rspeed_125_4_500rpm 16 500 8468.75 /end AXIS_PTS
/begin AXIS_PTS CAL_ign_mbt_modeled_Y_load "Y-axis breakpoints for the 'ignition MBT modeled' table. Defines the lookup grid (not a live channel); change only when re-axing the map. (mg/stroke; raw*4)" 0x4000C67A load_mass_per_stroke RL_AXIS_UBYTE 0 CM_u8_load_4mg_stroke 16 0 1020 /end AXIS_PTS
/begin CHARACTERISTIC CAL_ign_mbt_modeled "Calibration: ignition MBT modeled. Tunable map/constant (not a live channel); log spark advance to confirm the timing strategy and headroom to knock. (deg; raw/4-10)" MAP 0x4000C68A RL_VALUE_UBYTE 0 CM_u8_angle_1_4_10deg -10 53.75
 /begin AXIS_DESCR COM_AXIS engine_speed_3 CM_u8_rspeed_125_4_500rpm 16 500 8468.75 AXIS_PTS_REF CAL_ign_mbt_modeled_X_rpm /end AXIS_DESCR
 /begin AXIS_DESCR COM_AXIS load_mass_per_stroke CM_u8_load_4mg_stroke 16 0 1020 AXIS_PTS_REF CAL_ign_mbt_modeled_Y_load /end AXIS_DESCR
/end CHARACTERISTIC
/begin AXIS_PTS CAL_ign_closed_throttle_base_ips_X_coolant_temp "X-axis breakpoints for the 'ignition compensation coolant IPS noflags' table. Defines the lookup grid (not a live channel); change only when re-axing the map. (deg C; raw*5/8-40)" 0x4000C7CA coolant_temp RL_AXIS_UBYTE 0 CM_u8_temp_5_8_40c 16 -40 119.375 /end AXIS_PTS
/begin CHARACTERISTIC CAL_ign_closed_throttle_base_ips "Calibration: ignition compensation coolant IPS noflags. Tunable map/constant (not a live channel); log spark advance to confirm the timing strategy and headroom to knock. (deg; raw/4)" CURVE 0x4000C7DA RL_VALUE_UBYTE 0 CM_u8_angle_1_4deg 0 63.75
 /begin AXIS_DESCR COM_AXIS coolant_temp CM_u8_temp_5_8_40c 16 -40 119.375 AXIS_PTS_REF CAL_ign_closed_throttle_base_ips_X_coolant_temp /end AXIS_DESCR
/end CHARACTERISTIC
/begin AXIS_PTS CAL_inj_bank_balance_X_rpm "X-axis breakpoints for the 'injector bank balance' table. Defines the lookup grid (not a live channel); change only when re-axing the map. (RPM; raw*125/4+500)" 0x4000C8AA engine_speed_3 RL_AXIS_UBYTE 0 CM_u8_rspeed_125_4_500rpm 32 500 8468.75 /end AXIS_PTS
/begin AXIS_PTS CAL_inj_bank_balance_Y_load "Y-axis breakpoints for the 'injector bank balance' table. Defines the lookup grid (not a live channel); change only when re-axing the map. (mg/stroke; raw*4)" 0x4000C8CA load_mass_per_stroke RL_AXIS_UBYTE 0 CM_u8_load_4mg_stroke 32 0 1020 /end AXIS_PTS
/begin CHARACTERISTIC CAL_inj_bank_balance "Calibration: injector bank balance. Tunable map/constant (not a live channel); log to verify injector pulse width and fuel delivery vs target. (0-1; raw/200)" MAP 0x4000C8EA RL_VALUE_UBYTE 0 CM_u8_factor_1_200 0 127.5
 /begin AXIS_DESCR COM_AXIS engine_speed_3 CM_u8_rspeed_125_4_500rpm 32 500 8468.75 AXIS_PTS_REF CAL_inj_bank_balance_X_rpm /end AXIS_DESCR
 /begin AXIS_DESCR COM_AXIS load_mass_per_stroke CM_u8_load_4mg_stroke 32 0 1020 AXIS_PTS_REF CAL_inj_bank_balance_Y_load /end AXIS_DESCR
/end CHARACTERISTIC
/begin AXIS_PTS CAL_load_map_estimate_intercept_X_load "X-axis (load, mg/stroke; raw*4) for the MAP-estimate intercept table. Stock axis is collapsed (all 68 except last), i.e. unused." 0x4000CCEA load_mass_per_stroke RL_AXIS_UBYTE 0 CM_u8_load_4mg_stroke 16 0 1020 /end AXIS_PTS
/begin AXIS_PTS CAL_load_map_estimate_intercept_Y_rpm "Y-axis (rpm; raw*125/4+500) for the MAP-estimate intercept table (table rows)." 0x4000CCFA engine_speed_3 RL_AXIS_UBYTE 0 CM_u8_rspeed_125_4_500rpm 16 500 8468.75 /end AXIS_PTS
/begin CHARACTERISTIC CAL_load_map_estimate_intercept "Estimated-MAP model intercept (mbar; raw*2). Rows = rpm (Y), cols = load (X); stock rows are constant across load, so effectively intercept vs rpm. Scaled by baro/1013 and added to the load/VE term: MAP_est = intercept*baro/1013 + load*R*T/(VE*Vd). N" MAP 0x4000CD0A RL_VALUE_UBYTE 0 CM_u8_pressure_2mbar 0 510
 /begin AXIS_DESCR COM_AXIS load_mass_per_stroke CM_u8_load_4mg_stroke 16 0 1020 AXIS_PTS_REF CAL_load_map_estimate_intercept_X_load /end AXIS_DESCR
 /begin AXIS_DESCR COM_AXIS engine_speed_3 CM_u8_rspeed_125_4_500rpm 16 500 8468.75 AXIS_PTS_REF CAL_load_map_estimate_intercept_Y_rpm /end AXIS_DESCR
/end CHARACTERISTIC
/begin AXIS_PTS CAL_ign_comp_coolant_manual_cam_lowload_X_coolant_temp "X-axis breakpoints for the 'ignition compensation coolant manual VVT alt' table. Defines the lookup grid (not a live channel); change only when re-axing the map. (deg C; raw*5/8-40)" 0x4000CE82 coolant_temp RL_AXIS_UBYTE 0 CM_u8_temp_5_8_40c 16 -40 119.375 /end AXIS_PTS
/begin CHARACTERISTIC CAL_ign_comp_coolant_manual_cam_lowload "Calibration: ignition compensation coolant manual VVT alt. Tunable map/constant (not a live channel); log spark advance to confirm the timing strategy and headroom to knock. (deg; raw/4)" CURVE 0x4000CE92 RL_VALUE_UBYTE 0 CM_u8_angle_1_4deg 0 63.75
 /begin AXIS_DESCR COM_AXIS coolant_temp CM_u8_temp_5_8_40c 16 -40 119.375 AXIS_PTS_REF CAL_ign_comp_coolant_manual_cam_lowload_X_coolant_temp /end AXIS_DESCR
/end CHARACTERISTIC
/begin AXIS_PTS CAL_ign_closed_throttle_base_ips_cam_lowload_X_coolant_temp "X-axis breakpoints for the 'ignition compensation coolant IPS flags' table. Defines the lookup grid (not a live channel); change only when re-axing the map. (deg C; raw*5/8-40)" 0x4000CEA2 coolant_temp RL_AXIS_UBYTE 0 CM_u8_temp_5_8_40c 16 -40 119.375 /end AXIS_PTS
/begin CHARACTERISTIC CAL_ign_closed_throttle_base_ips_cam_lowload "Calibration: ignition compensation coolant IPS flags. Tunable map/constant (not a live channel); log spark advance to confirm the timing strategy and headroom to knock. (deg; raw/4)" CURVE 0x4000CEB2 RL_VALUE_UBYTE 0 CM_u8_angle_1_4deg 0 63.75
 /begin AXIS_DESCR COM_AXIS coolant_temp CM_u8_temp_5_8_40c 16 -40 119.375 AXIS_PTS_REF CAL_ign_closed_throttle_base_ips_cam_lowload_X_coolant_temp /end AXIS_DESCR
/end CHARACTERISTIC
/begin AXIS_PTS CAL_ign_comp_startup_ips_X_coolant_temp_engine_stopped "X-axis breakpoints for the 'ignition compensation startup IPS' table. Defines the lookup grid (not a live channel); change only when re-axing the map. (deg C; raw*5/8-40)" 0x4000CFB2 coolant_temp_engine_stopped RL_AXIS_UWORD 0 CM_u8_temp_5_8_40c 4 -40 40919.375 /end AXIS_PTS
/begin AXIS_PTS CAL_ign_comp_startup_ips_Y_maf_accumulated "Y-axis breakpoints for the 'ignition compensation startup IPS' table. Defines the lookup grid (not a live channel); change only when re-axing the map. (mg)" 0x4000CFBA maf_accumulated_2 RL_AXIS_UWORD 0 CM_u16_mass_mg 10 0 65535 /end AXIS_PTS
/begin CHARACTERISTIC CAL_ign_comp_startup_ips "Calibration: ignition compensation startup IPS. Tunable map/constant (not a live channel); log spark advance to confirm the timing strategy and headroom to knock. (deg; raw/4)" MAP 0x4000CFCE RL_VALUE_SWORD 0 CM_u8_angle_1_4deg -8192 8191.75
 /begin AXIS_DESCR COM_AXIS coolant_temp_engine_stopped CM_u8_temp_5_8_40c 4 -40 40919.375 AXIS_PTS_REF CAL_ign_comp_startup_ips_X_coolant_temp_engine_stopped /end AXIS_DESCR
 /begin AXIS_DESCR COM_AXIS maf_accumulated_2 CM_u16_mass_mg 10 0 65535 AXIS_PTS_REF CAL_ign_comp_startup_ips_Y_maf_accumulated /end AXIS_DESCR
/end CHARACTERISTIC
/begin AXIS_PTS CAL_tpstarget_tour_shifting_X_pps "X-axis breakpoints for the 'tpstarget tour shifting' table. Defines the lookup grid (not a live channel); change only when re-axing the map. (0-1; raw/1023)" 0x4000D0E2 accel_pedal_pos RL_AXIS_UWORD 0 CM_u16_factor_1_1023 16 0 6406.15835777126 /end AXIS_PTS
/begin CHARACTERISTIC CAL_tpstarget_tour_shifting "Calibration: tpstarget tour shifting. Tunable map/constant (not a live channel); log to compare requested throttle target to pedal demand. (0-1; raw/1023)" CURVE 0x4000D102 RL_VALUE_UWORD 0 CM_u16_factor_1_1023 0 6406.15835777126
 /begin AXIS_DESCR COM_AXIS accel_pedal_pos CM_u16_factor_1_1023 16 0 6406.15835777126 AXIS_PTS_REF CAL_tpstarget_tour_shifting_X_pps /end AXIS_DESCR
/end CHARACTERISTIC
/begin AXIS_PTS CAL_tpstarget_sport_shifting_X_pps "X-axis breakpoints for the 'tpstarget sport shifting' table. Defines the lookup grid (not a live channel); change only when re-axing the map. (0-1; raw/1023)" 0x4000D122 accel_pedal_pos RL_AXIS_UWORD 0 CM_u16_factor_1_1023 16 0 6406.15835777126 /end AXIS_PTS
/begin CHARACTERISTIC CAL_tpstarget_sport_shifting "Calibration: tpstarget sport shifting. Tunable map/constant (not a live channel); log to compare requested throttle target to pedal demand. (0-1; raw/1023)" CURVE 0x4000D142 RL_VALUE_UWORD 0 CM_u16_factor_1_1023 0 6406.15835777126
 /begin AXIS_DESCR COM_AXIS accel_pedal_pos CM_u16_factor_1_1023 16 0 6406.15835777126 AXIS_PTS_REF CAL_tpstarget_sport_shifting_X_pps /end AXIS_DESCR
/end CHARACTERISTIC
/begin CHARACTERISTIC CAL_sensor_iat_voltage_threshold "u16_voltage_5/1023v" VALUE 0x4000D1BE RL_VALUE_UWORD 0 CM_u16_voltage_5_1023v 0 320.307917888563 /end CHARACTERISTIC
/begin CHARACTERISTIC CAL_sensor_adc_engine_air_threshold "u16_voltage_5/1023v" VALUE 0x4000D1C0 RL_VALUE_UWORD 0 CM_u16_voltage_5_1023v 0 320.307917888563 /end CHARACTERISTIC
/begin CHARACTERISTIC CAL_sensor_adc_baro_limit "u16_voltage_5/1023v" VALUE 0x4000D1D0 RL_VALUE_UWORD 0 CM_u16_voltage_5_1023v 0 320.307917888563 /end CHARACTERISTIC
/begin CHARACTERISTIC CAL_sensor_adc_baro_threshold "u16_voltage_5/1023v" VALUE 0x4000D1D2 RL_VALUE_UWORD 0 CM_u16_voltage_5_1023v 0 320.307917888563 /end CHARACTERISTIC
/begin CHARACTERISTIC CAL_sensor_coolant_voltage_threshold "u16_voltage_5/1023v" VALUE 0x4000D1D4 RL_VALUE_UWORD 0 CM_u16_voltage_5_1023v 0 320.307917888563 /end CHARACTERISTIC
/begin CHARACTERISTIC CAL_sensor_adc_ecu_voltage_threshold "u16_voltage_18/1023v" VALUE 0x4000D1DE RL_VALUE_UWORD 0 CM_u16_voltage_18_1023v 0 1153.10850439883 /end CHARACTERISTIC
/begin CHARACTERISTIC CAL_sensor_baro_sensor_failure_fallback "uint8_t" VALUE 0x4000D1E2 RL_VALUE_UBYTE 0 NO_COMPU_METHOD 0 255 /end CHARACTERISTIC
/begin CHARACTERISTIC CAL_sensor_atmo_pressure_default "Calibration: sensor atmo pressure default. Tunable map/constant (not a live channel); log the raw sensor signal to check sensor health and range. (mbar)" VALUE 0x4000D1E4 RL_VALUE_UWORD 0 CM_i16_pressure_mbar 0 65535 /end CHARACTERISTIC
/begin CHARACTERISTIC CAL_sensor_o2_heater_undercurrent_threshold "uint16_t" VALUE 0x4000D23A RL_VALUE_UWORD 0 NO_COMPU_METHOD 0 65535 /end CHARACTERISTIC
/begin CHARACTERISTIC CAL_sensor_o2_heater_overcurrent_threshold_mA "u16_current_mA" VALUE 0x4000D23C RL_VALUE_UWORD 0 CM_u16_current_mA 0 65535 /end CHARACTERISTIC
/begin CHARACTERISTIC CAL_load_mass_per_stroke_raw_limit_1 "u16_load_mg/stroke" VALUE 0x4000D242 RL_VALUE_UWORD 0 CM_u16_load_mg_stroke 0 65535 /end CHARACTERISTIC
/begin CHARACTERISTIC CAL_load_mass_per_stroke_raw_limit_2 "u16_load_mg/stroke" VALUE 0x4000D244 RL_VALUE_UWORD 0 CM_u16_load_mg_stroke 0 65535 /end CHARACTERISTIC
/begin CHARACTERISTIC CAL_sensor_accel_pedal_pos_d_threshold "Calibration: sensor accelerator pedal position d threshold. Tunable map/constant (not a live channel); log the raw sensor signal to check sensor health and range." VAL_BLK 0x4000D24A RL_VALUE_UWORD 0 NO_COMPU_METHOD 0 65535 NUMBER 2 /end CHARACTERISTIC
/begin CHARACTERISTIC CAL_sensor_accel_pedal_pos_e_threshold "Calibration: sensor accelerator pedal position e threshold. Tunable map/constant (not a live channel); log the raw sensor signal to check sensor health and range." VAL_BLK 0x4000D24E RL_VALUE_UWORD 0 NO_COMPU_METHOD 0 65535 NUMBER 2 /end CHARACTERISTIC
/begin CHARACTERISTIC CAL_sensor_pps_correlation_max_delta "uint16_t" VALUE 0x4000D252 RL_VALUE_UWORD 0 NO_COMPU_METHOD 0 65535 /end CHARACTERISTIC
/begin CHARACTERISTIC CAL_sensor_pps_correlation_enable_max "uint16_t" VALUE 0x4000D254 RL_VALUE_UWORD 0 NO_COMPU_METHOD 0 65535 /end CHARACTERISTIC
/begin CHARACTERISTIC CAL_tps_commanded_during_fault "Calibration: throttle position commanded during fault. Tunable map/constant (not a live channel); log to see throttle/pedal demand and throttle response. (0-1; raw/255)" VALUE 0x4000D26B RL_VALUE_UBYTE 0 CM_u8_factor_1_255 0 100 /end CHARACTERISTIC
/begin CHARACTERISTIC CAL_sensor_iat_fallback "Calibration: sensor intake-air temp fallback. Tunable map/constant (not a live channel); log the raw sensor signal to check sensor health and range. (deg C; raw*5/8-40)" VALUE 0x4000D26C RL_VALUE_UBYTE 0 CM_u8_temp_5_8_40c -40 119.375 /end CHARACTERISTIC
/begin CHARACTERISTIC CAL_sensor_coolant_temp_fallback_value "Calibration: sensor coolant temperature fallback value. Tunable map/constant (not a live channel); log the raw sensor signal to check sensor health and range. (deg C; raw*5/8-40)" VALUE 0x4000D26D RL_VALUE_UBYTE 0 CM_u8_temp_5_8_40c -40 119.375 /end CHARACTERISTIC
/begin CHARACTERISTIC CAL_o2_threshold "Calibration: O2 threshold precat. Tunable map/constant (not a live channel); adjust to change this behavior." VALUE 0x4000D29C RL_VALUE_UBYTE 0 NO_COMPU_METHOD 0 255 READ_ONLY /end CHARACTERISTIC
/begin CHARACTERISTIC CAL_o2_threshold_precat "Calibration: O2 threshold precat. Tunable map/constant (not a live channel); adjust to change this behavior." VALUE 0x4000D29C RL_VALUE_ULONG 0 NO_COMPU_METHOD 0 4294967295 READ_ONLY /end CHARACTERISTIC
/begin CHARACTERISTIC CAL_o2_threshold_postcat "Calibration: O2 threshold postcat. Tunable map/constant (not a live channel); adjust to change this behavior." VALUE 0x4000D2A2 RL_VALUE_ULONG 0 NO_COMPU_METHOD 0 4294967295 READ_ONLY /end CHARACTERISTIC
/begin CHARACTERISTIC CAL_sensor_o2_lean_voltage_threshold "uint16_t" VALUE 0x4000D2A6 RL_VALUE_UWORD 0 NO_COMPU_METHOD 0 65535 /end CHARACTERISTIC
/begin CHARACTERISTIC CAL_sensor_fuel_level_sensor_voltage_threshold "Calibration: sensor fuel level sensor voltage threshold. Tunable map/constant (not a live channel); log to follow fuel delivery and mixture control. (V; raw*5/1023)" VAL_BLK 0x4000D2BA RL_VALUE_UWORD 0 CM_u16_voltage_5_1023v 0 320.307917888563 NUMBER 2 /end CHARACTERISTIC
/begin CHARACTERISTIC CAL_sensor_knock_voltage_threshold "uint16_t" VALUE 0x4000D2F4 RL_VALUE_UWORD 0 NO_COMPU_METHOD 0 65535 /end CHARACTERISTIC
/begin CHARACTERISTIC CAL_knock_sensor_b1_dc_bias_threshold "u16_voltage_5/1023v" VALUE 0x4000D2F6 RL_VALUE_UWORD 0 CM_u16_voltage_5_1023v 0 320.307917888563 /end CHARACTERISTIC
/begin CHARACTERISTIC CAL_fuel_sender_diag_level_lo "u8_volume_1/10gallon" VALUE 0x4000D314 RL_VALUE_UBYTE 0 CM_u8_volume_1_10gallon 0 25.5 /end CHARACTERISTIC
/begin CHARACTERISTIC CAL_sensor_temp_diagnostic_startup_delay "Calibration: sensor temperature diagnostic startup delay. Tunable map/constant (not a live channel); log the raw sensor signal to check sensor health and range. (ms; raw*5)" VALUE 0x4000D31A RL_VALUE_UWORD 0 CM_u8_time_5ms 0 327675 /end CHARACTERISTIC
/begin CHARACTERISTIC CAL_fuel_level_wobble_threshold "u8_volume_1/10gallon" VALUE 0x4000D31D RL_VALUE_UBYTE 0 CM_u8_volume_1_10gallon 0 25.5 /end CHARACTERISTIC
/begin CHARACTERISTIC CAL_sensor_tps_voltage_theshold1 "Calibration: sensor throttle position voltage theshold1. Tunable map/constant (not a live channel); log to see throttle/pedal demand and throttle response. (V; raw*5/1023)" VAL_BLK 0x4000D320 RL_VALUE_UWORD 0 CM_u16_voltage_5_1023v 0 320.307917888563 NUMBER 2 /end CHARACTERISTIC
/begin CHARACTERISTIC CAL_sensor_tps_voltage_theshold2 "Calibration: sensor throttle position voltage theshold2. Tunable map/constant (not a live channel); log to see throttle/pedal demand and throttle response. (V; raw*5/1023)" VAL_BLK 0x4000D324 RL_VALUE_UWORD 0 CM_u16_voltage_5_1023v 0 320.307917888563 NUMBER 2 /end CHARACTERISTIC
/begin CHARACTERISTIC CAL_airbox_flapper_engine_speed_sport "Calibration: airbox flapper engine speed sport. Tunable map/constant (not a live channel); log to follow core engine state. (RPM)" VAL_BLK 0x4000D352 RL_VALUE_UWORD 0 CM_u8_rspeed_rpm 0 65535 NUMBER 2 /end CHARACTERISTIC
/begin CHARACTERISTIC CAL_airbox_flapper_engine_speed_tour2 "Calibration: airbox flapper engine speed tour2. Tunable map/constant (not a live channel); log to follow core engine state. (RPM)" VAL_BLK 0x4000D356 RL_VALUE_UWORD 0 CM_u8_rspeed_rpm 0 65535 NUMBER 2 /end CHARACTERISTIC
/begin CHARACTERISTIC CAL_airbox_flapper_engine_speed_sport2 "Calibration: airbox flapper engine speed sport2. Tunable map/constant (not a live channel); log to follow core engine state. (RPM)" VAL_BLK 0x4000D35A RL_VALUE_UWORD 0 CM_u8_rspeed_rpm 0 65535 NUMBER 2 /end CHARACTERISTIC
/begin CHARACTERISTIC CAL_fuel_usage_density "Fuel density for the trip computer (raw × 0.075 g/L; stock 9867 = 740 g/L). The ECU never uses it for fuelling. It only converts injector flow × commanded pulse into reported fuel consumption: the dash economy figure (CAN 0x400) and the fuel-used cou" VALUE 0x4000D35E RL_VALUE_UWORD 0 NO_COMPU_METHOD 0 65535 /end CHARACTERISTIC
/begin CHARACTERISTIC CAL_sensor_accel_pedal_ref_voltage_threshold "u16_voltage_5/1023v[2]" VAL_BLK 0x4000D39C RL_VALUE_UWORD 0 CM_u16_voltage_5_1023v 0 320.307917888563 NUMBER 2 /end CHARACTERISTIC
/begin CHARACTERISTIC CAL_knock_octane_scaler_short_term_limit "u16_factor_1/65536" VALUE 0x4000D3C8 RL_VALUE_UWORD 0 CM_u16_factor_1_65536 0 99.9984741210938 /end CHARACTERISTIC
/begin CHARACTERISTIC CAL_knock_threshold_obd_ii_check_enable_engine_speed "uint16_t" VALUE 0x4000D3CA RL_VALUE_UWORD 0 NO_COMPU_METHOD 0 65535 /end CHARACTERISTIC
/begin CHARACTERISTIC CAL_knock_threshold_obd_ii_check_enable_load "uint8_t" VALUE 0x4000D3CC RL_VALUE_UBYTE 0 NO_COMPU_METHOD 0 255 /end CHARACTERISTIC
/begin CHARACTERISTIC CAL_knock_threshold_obd_ii_check_enable_load_4000D3CD "uint8_t" VALUE 0x4000D3CD RL_VALUE_UBYTE 0 NO_COMPU_METHOD 0 255 /end CHARACTERISTIC
/begin CHARACTERISTIC CAL_sensor_lat_accel_raw_threshold "uint8_t" VALUE 0x4000D3D1 RL_VALUE_UBYTE 0 NO_COMPU_METHOD 0 255 /end CHARACTERISTIC
/begin CHARACTERISTIC CAL_sensor_lat_accel_smoothing_factor "Calibration: sensor lat accelerator smoothing factor. Tunable map/constant (not a live channel); log the raw sensor signal to check sensor health and range. (0-1; raw/255)" VALUE 0x4000D3D2 RL_VALUE_UBYTE 0 CM_u8_factor_1_255 0 100 /end CHARACTERISTIC
/begin CHARACTERISTIC CAL_tps_obd_throttle_model_step_max_opening "uint8_t" VALUE 0x4000D417 RL_VALUE_UBYTE 0 NO_COMPU_METHOD 0 255 /end CHARACTERISTIC
/begin AXIS_PTS CAL_ign_base_ips_X_rpm "X-axis breakpoints for the 'ignition base IPS' table. Defines the lookup grid (not a live channel); change only when re-axing the map. (RPM; raw*125/4+500)" 0x4000D7C4 engine_speed_3 RL_AXIS_UBYTE 0 CM_u8_rspeed_125_4_500rpm 20 500 8468.75 /end AXIS_PTS
/begin AXIS_PTS CAL_ign_base_ips_Y_load "Y-axis breakpoints for the 'ignition base IPS' table. Defines the lookup grid (not a live channel); change only when re-axing the map. (mg/stroke; raw*4)" 0x4000D7D8 load_mass_per_stroke RL_AXIS_UBYTE 0 CM_u8_load_4mg_stroke 20 0 1020 /end AXIS_PTS
/begin CHARACTERISTIC CAL_ign_base_ips "Calibration: ignition base IPS. Tunable map/constant (not a live channel); log spark advance to confirm the timing strategy and headroom to knock. (deg; raw/4-10)" MAP 0x4000D7EC RL_VALUE_UBYTE 0 CM_u8_angle_1_4_10deg -10 53.75
 /begin AXIS_DESCR COM_AXIS engine_speed_3 CM_u8_rspeed_125_4_500rpm 20 500 8468.75 AXIS_PTS_REF CAL_ign_base_ips_X_rpm /end AXIS_DESCR
 /begin AXIS_DESCR COM_AXIS load_mass_per_stroke CM_u8_load_4mg_stroke 20 0 1020 AXIS_PTS_REF CAL_ign_base_ips_Y_load /end AXIS_DESCR
/end CHARACTERISTIC
/begin AXIS_PTS CAL_tps_scaling_factor_rpm_prototype_X_rpm "X-axis breakpoints for the 'throttle position scaling factor RPM prototype' table. Defines the lookup grid (not a live channel); change only when re-axing the map. (RPM; raw*125/4+500)" 0x4000DE14 engine_speed_3 RL_AXIS_UBYTE 0 CM_u8_rspeed_125_4_500rpm 16 500 8468.75 /end AXIS_PTS
/begin CHARACTERISTIC CAL_tps_scaling_factor_rpm_prototype "Calibration: throttle position scaling factor RPM prototype. Tunable map/constant (not a live channel); log to see throttle/pedal demand and throttle response. (0-1; raw/255)" CURVE 0x4000DE24 RL_VALUE_UBYTE 0 CM_u8_factor_1_255 0 100
 /begin AXIS_DESCR COM_AXIS engine_speed_3 CM_u8_rspeed_125_4_500rpm 16 500 8468.75 AXIS_PTS_REF CAL_tps_scaling_factor_rpm_prototype_X_rpm /end AXIS_DESCR
/end CHARACTERISTIC
/begin AXIS_PTS CAL_sensor_o2_afr_diag_scaling_X_voltage "X-axis breakpoints for the 'sensor O2 AFR diag scaling' table. Defines the lookup grid (not a live channel); change only when re-axing the map. (V; raw*5/1023)" 0x4000DE34 NO_INPUT_QUANTITY RL_AXIS_UWORD 0 CM_u16_voltage_5_1023v 16 0 320.307917888563 /end AXIS_PTS
/begin CHARACTERISTIC CAL_sensor_o2_afr_diag_scaling "Narrowband O2 sensor linearization curve: converts the highly nonlinear O2 voltage into a linear AFR value so the absolute difference between banks has physical meaning. Without this, comparing raw voltages directly would be misleading — a 0.1V diffe" CURVE 0x4000DE54 RL_VALUE_UWORD 0 CM_u8_afr_1_100 0 655.35
 /begin AXIS_DESCR COM_AXIS NO_INPUT_QUANTITY CM_u16_voltage_5_1023v 16 0 320.307917888563 AXIS_PTS_REF CAL_sensor_o2_afr_diag_scaling_X_voltage /end AXIS_DESCR
/end CHARACTERISTIC
/begin AXIS_PTS CAL_inj_cranking_enrichment_air_temp_X_airtemp "X-axis breakpoints for the 'injector cranking enrichment air temperature' table. Defines the lookup grid (not a live channel); change only when re-axing the map. (deg C; raw*5/8-40)" 0x4000DE74 air_temp_engine_stopped RL_AXIS_UBYTE 0 CM_u8_temp_5_8_40c 8 -40 119.375 /end AXIS_PTS
/begin AXIS_PTS CAL_inj_cranking_enrichment_air_temp_Y_coolant_temp "Y-axis breakpoints for the 'injector cranking enrichment air temperature' table. Defines the lookup grid (not a live channel); change only when re-axing the map. (deg C; raw*5/8-40)" 0x4000DE7C coolant_temp_engine_stopped RL_AXIS_UBYTE 0 CM_u8_temp_5_8_40c 8 -40 119.375 /end AXIS_PTS
/begin CHARACTERISTIC CAL_inj_cranking_enrichment_air_temp "Calibration: injector cranking enrichment air temperature. Tunable map/constant (not a live channel); log to verify injector pulse width and fuel delivery vs target." MAP 0x4000DE84 RL_VALUE_UBYTE 0 NO_COMPU_METHOD 0 255
 /begin AXIS_DESCR COM_AXIS air_temp_engine_stopped CM_u8_temp_5_8_40c 8 -40 119.375 AXIS_PTS_REF CAL_inj_cranking_enrichment_air_temp_X_airtemp /end AXIS_DESCR
 /begin AXIS_DESCR COM_AXIS coolant_temp_engine_stopped CM_u8_temp_5_8_40c 8 -40 119.375 AXIS_PTS_REF CAL_inj_cranking_enrichment_air_temp_Y_coolant_temp /end AXIS_DESCR
/end CHARACTERISTIC
/begin AXIS_PTS CAL_inj_cranking_enrich_mass_accum_X_mass "X-axis breakpoints for the 'injector cranking enrich mass accum' table. Defines the lookup grid (not a live channel); change only when re-axing the map. (g)" 0x4000DEC4 V_CAL_inj_cranking_enrich_mass_accum_X_mass RL_AXIS_UBYTE 0 CM_u16_mass_g 10 0 255 /end AXIS_PTS
/begin CHARACTERISTIC CAL_inj_cranking_enrich_mass_accum "Calibration: injector cranking enrich mass accum. Tunable map/constant (not a live channel); log to verify injector pulse width and fuel delivery vs target." CURVE 0x4000DECE RL_VALUE_UBYTE 0 NO_COMPU_METHOD 0 255
 /begin AXIS_DESCR COM_AXIS V_CAL_inj_cranking_enrich_mass_accum_X_mass CM_u16_mass_g 10 0 255 AXIS_PTS_REF CAL_inj_cranking_enrich_mass_accum_X_mass /end AXIS_DESCR
/end CHARACTERISTIC
/begin AXIS_PTS CAL_inj_cranking_enrich_soak_time_X_time "X-axis breakpoints for the 'injector cranking enrich soak time' table. Defines the lookup grid (not a live channel); change only when re-axing the map." 0x4000DED8 V_CAL_inj_cranking_enrich_soak_time_X_time RL_AXIS_UBYTE 0 NO_COMPU_METHOD 10 0 255 /end AXIS_PTS
/begin CHARACTERISTIC CAL_inj_cranking_enrich_soak_time "Calibration: injector cranking enrich soak time. Tunable map/constant (not a live channel); log to verify injector pulse width and fuel delivery vs target." CURVE 0x4000DEE2 RL_VALUE_UBYTE 0 CM_u8_factor_1_255 0 100
 /begin AXIS_DESCR COM_AXIS V_CAL_inj_cranking_enrich_soak_time_X_time NO_COMPU_METHOD 10 0 255 AXIS_PTS_REF CAL_inj_cranking_enrich_soak_time_X_time /end AXIS_DESCR
/end CHARACTERISTIC
/begin AXIS_PTS CAL_ign_retard_recovery_step_X_engine_speed "X-axis breakpoints for the 'ignition retard recovery step' table. Defines the lookup grid (not a live channel); change only when re-axing the map. (RPM; raw*125/4+500)" 0x4000DF0C engine_speed_3 RL_AXIS_UBYTE 0 CM_u8_rspeed_125_4_500rpm 8 500 8468.75 /end AXIS_PTS
/begin AXIS_PTS CAL_ign_retard_recovery_step_Y_load "Y-axis breakpoints for the 'ignition retard recovery step' table. Defines the lookup grid (not a live channel); change only when re-axing the map. (mg/stroke; raw*4)" 0x4000DF14 load_mass_per_stroke RL_AXIS_UBYTE 0 CM_u8_load_4mg_stroke 8 0 1020 /end AXIS_PTS
/begin CHARACTERISTIC CAL_ign_retard_recovery_step "Calibration: ignition retard recovery step. Tunable map/constant (not a live channel); log spark advance to confirm the timing strategy and headroom to knock." MAP 0x4000DF1C RL_VALUE_UBYTE 0 NO_COMPU_METHOD 0 255
 /begin AXIS_DESCR COM_AXIS engine_speed_3 CM_u8_rspeed_125_4_500rpm 8 500 8468.75 AXIS_PTS_REF CAL_ign_retard_recovery_step_X_engine_speed /end AXIS_DESCR
 /begin AXIS_DESCR COM_AXIS load_mass_per_stroke CM_u8_load_4mg_stroke 8 0 1020 AXIS_PTS_REF CAL_ign_retard_recovery_step_Y_load /end AXIS_DESCR
/end CHARACTERISTIC
/begin AXIS_PTS CAL_tpstarget_low_gear_tour_manual_X_pps "X-axis breakpoints for the 'tpstarget low gear tour manual' table. Defines the lookup grid (not a live channel); change only when re-axing the map. (0-1; raw/1023)" 0x4000E9F8 accel_pedal_pos RL_AXIS_UWORD 0 CM_u16_factor_1_1023 16 0 6406.15835777126 /end AXIS_PTS
/begin CHARACTERISTIC CAL_tpstarget_low_gear_tour_manual "Calibration: tpstarget low gear tour manual. Tunable map/constant (not a live channel); log to compare requested throttle target to pedal demand. (0-1; raw/1023)" CURVE 0x4000EA18 RL_VALUE_UWORD 0 CM_u16_factor_1_1023 0 6406.15835777126
 /begin AXIS_DESCR COM_AXIS accel_pedal_pos CM_u16_factor_1_1023 16 0 6406.15835777126 AXIS_PTS_REF CAL_tpstarget_low_gear_tour_manual_X_pps /end AXIS_DESCR
/end CHARACTERISTIC
/begin AXIS_PTS CAL_tpssmooth_increment_tour_parking_X_tps_rate "X-axis breakpoints for the 'tpssmooth increment tour parking' table. Defines the lookup grid (not a live channel); change only when re-axing the map. (0-1; raw/255)" 0x4000EA38 NO_INPUT_QUANTITY RL_AXIS_UBYTE 0 CM_u8_factor_1_255 8 0 100 /end AXIS_PTS
/begin CHARACTERISTIC CAL_tpssmooth_increment_tour_parking "Calibration: tpssmooth increment tour parking. Tunable map/constant (not a live channel); log to see throttle-signal smoothing/filtering behavior. (0-1; raw/1023)" CURVE 0x4000EA40 RL_VALUE_UBYTE 0 CM_u16_factor_1_1023 0 24.9266862170088
 /begin AXIS_DESCR COM_AXIS NO_INPUT_QUANTITY CM_u8_factor_1_255 8 0 100 AXIS_PTS_REF CAL_tpssmooth_increment_tour_parking_X_tps_rate /end AXIS_DESCR
/end CHARACTERISTIC
/begin AXIS_PTS CAL_inj_angle_X_engine_speed "X-axis breakpoints for the 'injector angle' table. Defines the lookup grid (not a live channel); change only when re-axing the map. (RPM; raw*125/4+500)" 0x4000EB88 engine_speed_3 RL_AXIS_UBYTE 0 CM_u8_rspeed_125_4_500rpm 16 500 8468.75 /end AXIS_PTS
/begin AXIS_PTS CAL_inj_angle_Y_engine_load "Y-axis breakpoints for the 'injector angle' table. Defines the lookup grid (not a live channel); change only when re-axing the map. (mg/stroke; raw*4)" 0x4000EB98 load_mass_per_stroke RL_AXIS_UBYTE 0 CM_u8_load_4mg_stroke 16 0 1020 /end AXIS_PTS
/begin CHARACTERISTIC CAL_inj_angle "Calibration: injector angle. Tunable map/constant (not a live channel); log to verify injector pulse width and fuel delivery vs target. (deg; raw*720/256)" MAP 0x4000EBA8 RL_VALUE_UBYTE 0 CM_u8_angle_720_256deg 0 717.1875
 /begin AXIS_DESCR COM_AXIS engine_speed_3 CM_u8_rspeed_125_4_500rpm 16 500 8468.75 AXIS_PTS_REF CAL_inj_angle_X_engine_speed /end AXIS_DESCR
 /begin AXIS_DESCR COM_AXIS load_mass_per_stroke CM_u8_load_4mg_stroke 16 0 1020 AXIS_PTS_REF CAL_inj_angle_Y_engine_load /end AXIS_DESCR
/end CHARACTERISTIC
/begin AXIS_PTS CAL_ign_comp_iat_X_rpm "X-axis breakpoints for the 'ignition compensation intake-air temp' table. Defines the lookup grid (not a live channel); change only when re-axing the map. (RPM; raw*125/4+500)" 0x4000EDD8 engine_speed_3 RL_AXIS_UBYTE 0 CM_u8_rspeed_125_4_500rpm 16 500 8468.75 /end AXIS_PTS
/begin AXIS_PTS CAL_ign_comp_iat_Y_iat "Y-axis breakpoints for the 'ignition compensation intake-air temp' table. Defines the lookup grid (not a live channel); change only when re-axing the map. (deg C; raw*5/8-40)" 0x4000EDE8 airtemp_tmaf RL_AXIS_UBYTE 0 CM_u8_temp_5_8_40c 8 -40 119.375 /end AXIS_PTS
/begin CHARACTERISTIC CAL_ign_comp_iat "Calibration: ignition compensation intake-air temp. Tunable map/constant (not a live channel); log spark advance to confirm the timing strategy and headroom to knock. (deg; raw/4-32)" MAP 0x4000EDF0 RL_VALUE_UBYTE 0 CM_u8_angle_1_4_32deg -32 31.75
 /begin AXIS_DESCR COM_AXIS engine_speed_3 CM_u8_rspeed_125_4_500rpm 16 500 8468.75 AXIS_PTS_REF CAL_ign_comp_iat_X_rpm /end AXIS_DESCR
 /begin AXIS_DESCR COM_AXIS airtemp_tmaf CM_u8_temp_5_8_40c 8 -40 119.375 AXIS_PTS_REF CAL_ign_comp_iat_Y_iat /end AXIS_DESCR
/end CHARACTERISTIC
/begin GROUP G_Fuel "Fuel and injection" ROOT
 /begin SUB_GROUP G_Fuel_closedloop G_Fuel_dfco G_Fuel_fuel G_Fuel_inj G_Fuel_injtip G_Fuel_lfb G_Fuel_o2 /end SUB_GROUP
/end GROUP
/begin GROUP G_Fuel_closedloop "closedloop"
 /begin REF_CHARACTERISTIC CAL_closedloop_activate_air_temp CAL_closedloop_activate_engine_timer CAL_closedloop_afr CAL_closedloop_bank_sync_max_hold CAL_closedloop_derivative_gain_ips CAL_closedloop_derivative_gain_table CAL_closedloop_derivative_gain_table_X_rpm CAL_closedloop_derivative_gain_table_Y_load CAL_closedloop_enable_baro_min CAL_closedloop_enable_ect_min CAL_closedloop_enable_iat_min CAL_closedloop_fuel_level_min CAL_closedloop_hold_time CAL_closedloop_integral_gain_ips CAL_closedloop_integral_gain_startup_duration CAL_closedloop_integral_gain_table CAL_closedloop_integral_gain_table_X_rpm CAL_closedloop_integral_gain_table_Y_load CAL_closedloop_integration_period CAL_closedloop_jump_lean_scaling CAL_closedloop_jump_lean_scaling_ips CAL_closedloop_low_rpm_stft_reset_rpm CAL_closedloop_o2_breakin_window_hours CAL_closedloop_o2_lean_threshold CAL_closedloop_o2_rich_threshold CAL_closedloop_o2_sensor_voltage_switch_rich CAL_closedloop_o2_sensor_voltage_switching_lean CAL_closedloop_o2_switch_threshold CAL_closedloop_o2_switch_threshold_X_rpm CAL_closedloop_o2_warmup_time CAL_closedloop_prop_gain_lean_slow_switch_scale CAL_closedloop_prop_gain_rich_slow_switch_scale CAL_closedloop_proportional_gain_lean CAL_closedloop_proportional_gain_lean_X_rpm CAL_closedloop_proportional_gain_lean_Y_load CAL_closedloop_proportional_gain_lean_ips CAL_closedloop_proportional_gain_rich CAL_closedloop_proportional_gain_rich_X_rpm CAL_closedloop_proportional_gain_rich_Y_load CAL_closedloop_proportional_gain_rich_ips CAL_closedloop_ramp_interval_scale CAL_closedloop_stft_filter_unknown CAL_closedloop_stft_increment_period CAL_closedloop_stft_steady_state_holdoff_ticks CAL_closedloop_tps_correction_tour_manual CAL_closedloop_tps_correction_tour_manual_X_unknown /end REF_CHARACTERISTIC
/end GROUP
/begin GROUP G_Fuel_dfco "dfco"
 /begin REF_CHARACTERISTIC CAL_dfco_cyl_ramp_length CAL_dfco_entry_min_runtime CAL_dfco_entry_pedal_max CAL_dfco_entry_pedal_max_clutch_coast CAL_dfco_entry_rpm_clutch_coast CAL_dfco_entry_rpm_ips CAL_dfco_entry_rpm_ips_X_coolant_temp CAL_dfco_entry_rpm_ips_alt CAL_dfco_entry_rpm_ips_alt_X_coolant_temp CAL_dfco_entry_rpm_manual CAL_dfco_entry_rpm_manual_X_coolant_temp CAL_dfco_entry_rpm_manual_alt CAL_dfco_entry_rpm_manual_alt_X_coolant_temp CAL_dfco_entry_speed_min CAL_dfco_entry_temp_min CAL_dfco_exit_pedal_min CAL_dfco_exit_rpm_ingear_ips CAL_dfco_exit_rpm_ingear_ips_X_coolant_temp CAL_dfco_exit_rpm_ingear_manual CAL_dfco_exit_rpm_ingear_manual_X_coolant_temp CAL_dfco_exit_rpm_neutral CAL_dfco_exit_rpm_neutral_X_coolant_temp CAL_dfco_exit_speed_min_ips CAL_dfco_exit_temp_max CAL_dfco_pedal_ramp_step_interval CAL_dfco_recovery_enrich_X_cut_duration CAL_dfco_recovery_enrich_cooldown_ticks CAL_dfco_recovery_enrich_decay CAL_dfco_recovery_enrich_max_rpm CAL_dfco_recovery_fuel_frac_vs_pedal CAL_dfco_recovery_fuel_frac_vs_pedal_X_pedal_pos CAL_dfco_rpm_offset_above_idle /end REF_CHARACTERISTIC
/end GROUP
/begin GROUP G_Fuel_fuel "fuel"
 /begin REF_CHARACTERISTIC CAL_fuel_level_change_threshold CAL_fuel_level_debounce_window_high CAL_fuel_level_debounce_window_low CAL_fuel_level_filter_coeff_fall CAL_fuel_level_filter_coeff_rise CAL_fuel_level_stable_count CAL_fuel_level_update_holdoff CAL_fuel_level_wobble_threshold CAL_fuel_reserve_size CAL_fuel_sender_diag_level_lo CAL_fuel_trim_integral_max CAL_fuel_usage_density /end REF_CHARACTERISTIC
/end GROUP
/begin GROUP G_Fuel_inj "inj"
 /begin REF_CHARACTERISTIC CAL_inj_afr_base CAL_inj_afr_base_X_engine_speed CAL_inj_afr_base_Y_engine_load CAL_inj_afterstart_comp_air_temp CAL_inj_afterstart_comp_air_temp_X_iat CAL_inj_afterstart_comp_air_temp_Y_maf_accum CAL_inj_afterstart_enrichment_coolant_ips CAL_inj_afterstart_enrichment_coolant_ips_X_coolant CAL_inj_afterstart_enrichment_coolant_ips_Y_maf_accum CAL_inj_afterstart_enrichment_coolant_manual CAL_inj_afterstart_enrichment_coolant_manual_X_coolant CAL_inj_afterstart_enrichment_coolant_manual_Y_maf_accum CAL_inj_angle CAL_inj_angle_X_engine_speed CAL_inj_angle_Y_engine_load CAL_inj_bank_balance CAL_inj_bank_balance_X_rpm CAL_inj_bank_balance_Y_load CAL_inj_comp_enrichment_per_degree_ign_retard CAL_inj_comp_iat CAL_inj_comp_iat_X_load CAL_inj_comp_iat_Y_iat CAL_inj_cranking_enrich_mass_accum CAL_inj_cranking_enrich_mass_accum_X_mass CAL_inj_cranking_enrich_soak_time CAL_inj_cranking_enrich_soak_time_X_time CAL_inj_cranking_enrichment_air_temp CAL_inj_cranking_enrichment_air_temp_X_airtemp CAL_inj_cranking_enrichment_air_temp_Y_coolant_temp CAL_inj_deadtime_base CAL_inj_deadtime_base_X_voltage CAL_inj_deadtime_base_Y_airtemp_maf CAL_inj_efficiency CAL_inj_efficiency_X_engine_speed CAL_inj_efficiency_Y_engine_load CAL_inj_flow_rate CAL_inj_fuel_learn_lean_time_limit CAL_inj_fuel_learn_offset_maf_max CAL_inj_fuel_learn_offset_rpm_max CAL_inj_fuel_learn_power_enrich_load_min CAL_inj_fuel_learn_power_enrich_rpm_min CAL_inj_fuel_learn_rich_time_limit CAL_inj_fuel_learn_step_period CAL_inj_fuel_learn_stft_lean_limit CAL_inj_fuel_learn_stft_rich_limit CAL_inj_fuel_learn_zone_1_offset_step CAL_inj_fuel_learn_zone_2_load_max CAL_inj_fuel_learn_zone_2_load_min CAL_inj_fuel_learn_zone_2_maf_max CAL_inj_fuel_learn_zone_2_maf_min CAL_inj_fuel_learn_zone_2_max CAL_inj_fuel_learn_zone_2_min CAL_inj_fuel_learn_zone_3_load_min CAL_inj_fuel_learn_zone_3_maf_min CAL_inj_fuel_learn_zone_3_max CAL_inj_fuel_learn_zone_3_min CAL_inj_post_start_enrichment_decay_divisor CAL_inj_soak_time_max CAL_inj_soak_time_max_40009130 CAL_inj_startup_enrichment_offset CAL_inj_startup_enrichment_offset_X_coolant_temp_engine_stopped CAL_inj_stft_limit CAL_inj_transient_us_per_count CAL_inj_warmup_factor_ips CAL_inj_warmup_factor_ips_X_load CAL_inj_warmup_factor_ips_Y_coolant_temp CAL_inj_warmup_factor_manual CAL_inj_warmup_factor_manual_X_load CAL_inj_warmup_factor_manual_Y_coolant_temp /end REF_CHARACTERISTIC
/end GROUP
/begin GROUP G_Fuel_injtip "injtip"
 /begin REF_CHARACTERISTIC CAL_injtip_dfco_min_runtime CAL_injtip_in_adj_gears CAL_injtip_in_adj_gears_6 CAL_injtip_in_coolant_scale CAL_injtip_in_coolant_scale_X_coolant_temp CAL_injtip_in_decay_count CAL_injtip_in_rpm_decay CAL_injtip_in_rpm_decay_X_rpm CAL_injtip_in_rpm_scale CAL_injtip_in_rpm_scale_X_rpm CAL_injtip_in_threshold CAL_injtip_out_coolant_scale CAL_injtip_out_coolant_scale_X_coolant_temp CAL_injtip_out_decay_count CAL_injtip_out_rpm_decay CAL_injtip_out_rpm_decay_X_rpm CAL_injtip_out_rpm_scale CAL_injtip_out_rpm_scale_X_rpm CAL_injtip_overrun_hysteresis_timer CAL_injtip_tipout_decay_rate_divider /end REF_CHARACTERISTIC
/end GROUP
/begin GROUP G_Fuel_lfb "lfb"
 /begin REF_CHARACTERISTIC CAL_lfb_brake_off_hold_ticks CAL_lfb_clutch_threshold CAL_lfb_detect_carspeed_min CAL_lfb_pedal_override_max CAL_lfb_pedal_override_rate CAL_lfb_pedal_release_threshold CAL_lfb_pulse_enable CAL_lfb_pulse_toggle_period CAL_lfb_release_rate CAL_lfb_timer_entry CAL_lfb_timer_hold CAL_lfb_tps_max /end REF_CHARACTERISTIC
/end GROUP
/begin GROUP G_Fuel_o2 "o2"
 /begin REF_CHARACTERISTIC CAL_o2_threshold CAL_o2_threshold_postcat CAL_o2_threshold_precat /end REF_CHARACTERISTIC
/end GROUP
/begin GROUP G_Ignition "Ignition and knock" ROOT /begin SUB_GROUP G_Ignition_ign G_Ignition_knock G_Ignition_roughness /end SUB_GROUP /end GROUP
/begin GROUP G_Ignition_ign "ign"
 /begin REF_CHARACTERISTIC CAL_ign_advance_min CAL_ign_advance_min_X_engine_speed CAL_ign_advance_min_Y_engine_load CAL_ign_advance_step_tps CAL_ign_advance_step_tps_X_engine_speed CAL_ign_advance_step_tps_Y_pedal_pos CAL_ign_base_ips CAL_ign_base_ips_X_rpm CAL_ign_base_ips_Y_load CAL_ign_base_manual CAL_ign_base_manual_X_rpm CAL_ign_base_manual_Y_load CAL_ign_closed_throttle_base_ips CAL_ign_closed_throttle_base_ips_X_coolant_temp CAL_ign_closed_throttle_base_ips_cam_lowload CAL_ign_closed_throttle_base_ips_cam_lowload_X_coolant_temp CAL_ign_closed_throttle_base_manual CAL_ign_closed_throttle_base_manual_X_coolant_temp CAL_ign_comp_ac_compressor_active CAL_ign_comp_coldstart CAL_ign_comp_coldstart_X_coolant_temp CAL_ign_comp_coolant_manual_cam_lowload CAL_ign_comp_coolant_manual_cam_lowload_X_coolant_temp CAL_ign_comp_engine_air CAL_ign_comp_engine_air_X_air_temp CAL_ign_comp_iat CAL_ign_comp_iat_X_rpm CAL_ign_comp_iat_Y_iat CAL_ign_comp_iat_load_scaler CAL_ign_comp_iat_load_scaler_X_load CAL_ign_comp_idle_error_moving CAL_ign_comp_idle_error_moving_X_idle_speed_error CAL_ign_comp_idle_error_stationary CAL_ign_comp_idle_error_stationary_X_idle_speed_error CAL_ign_comp_idle_transient_max_advance CAL_ign_comp_maf_accum CAL_ign_comp_maf_accum_X_maf_accum CAL_ign_comp_maf_accum_Y_tps CAL_ign_comp_overtemp CAL_ign_comp_overtemp_X_rpm CAL_ign_comp_overtemp_coeff CAL_ign_comp_overtemp_coeff_X_coolant_temp CAL_ign_comp_speed_variation CAL_ign_comp_speed_variation_X_rpm_delta CAL_ign_comp_startup_ips CAL_ign_comp_startup_ips_X_coolant_temp_engine_stopped CAL_ign_comp_startup_ips_Y_maf_accumulated CAL_ign_comp_startup_manual CAL_ign_comp_startup_manual_X_maf_accum CAL_ign_comp_tps_rate CAL_ign_comp_tps_rate_X_tps_rate CAL_ign_dfco_recovery_hold_time CAL_ign_dwell_time CAL_ign_dwell_time_X_rpm CAL_ign_dwell_time_Y_ecu_voltage CAL_ign_enable_lea_knock_retard CAL_ign_fixed_ips CAL_ign_fixed_manual CAL_ign_idle_recovery_period CAL_ign_knock_safe CAL_ign_knock_safe_X_rpm CAL_ign_knock_safe_Y_load CAL_ign_mbt_modeled CAL_ign_mbt_modeled_X_rpm CAL_ign_mbt_modeled_Y_load CAL_ign_retard_recovery_step CAL_ign_retard_recovery_step_X_engine_speed CAL_ign_retard_recovery_step_Y_load CAL_ign_retard_step_tps CAL_ign_retard_step_tps_X_engine_speed CAL_ign_retard_step_tps_Y_pedal_pos CAL_ign_startup_comp_coolant_max CAL_ign_startup_comp_coolant_min CAL_ign_target_update_inhibit_timer CAL_ign_trim_per_cyl CAL_ign_zero_rpm_threshold /end REF_CHARACTERISTIC
/end GROUP
/begin GROUP G_Ignition_knock "knock"
 /begin REF_CHARACTERISTIC CAL_knock_agc_hysteresis_band CAL_knock_agc_threshold CAL_knock_baseline_min_clamp CAL_knock_buffer_size CAL_knock_buffer_size_X_rpm CAL_knock_buffer_size_Y_load CAL_knock_detection_engine_speed_margin CAL_knock_detection_engine_speed_max CAL_knock_detection_engine_speed_min CAL_knock_detection_load_margin_debounce CAL_knock_detection_load_threshold CAL_knock_detection_load_threshold_X_rpm CAL_knock_dsp_nyquist_hz CAL_knock_evaluate_cylinder_filter_coef CAL_knock_freq_bands CAL_knock_ign_retard_decay_rate CAL_knock_ign_retard_initial CAL_knock_inhibit_timer_tps_rate CAL_knock_inhibit_tps_max CAL_knock_inhibit_tps_max_X_rpm CAL_knock_inhibit_tps_rate1 CAL_knock_learning_enable_coolant_temp_min CAL_knock_learning_load_threshold CAL_knock_learning_load_threshold_X_rpm CAL_knock_mode CAL_knock_octane_scaler_decrement CAL_knock_octane_scaler_increment CAL_knock_octane_scaler_short_term_limit CAL_knock_octane_scaler_shortterm_decrement CAL_knock_octane_scaler_shortterm_multiplier CAL_knock_octane_short_term_retard_max CAL_knock_peak_threshold CAL_knock_peak_threshold_X_engine_speed CAL_knock_peak_threshold_Y_load CAL_knock_retard1_limit CAL_knock_retard1_step CAL_knock_retard1_step_X_peak_over_threshold CAL_knock_sampling_window CAL_knock_sampling_window_X_rpm CAL_knock_sampling_window_Y_load CAL_knock_sensitivity CAL_knock_sensitivity_X_engine_speed CAL_knock_sensitivity_Y_engine_load CAL_knock_sensor_b1_dc_bias_threshold CAL_knock_threshold_obd_ii_check_enable_engine_speed CAL_knock_threshold_obd_ii_check_enable_load CAL_knock_threshold_obd_ii_check_enable_load_4000D3CD /end REF_CHARACTERISTIC
/end GROUP
/begin GROUP G_Ignition_roughness "roughness"
 /begin REF_CHARACTERISTIC CAL_roughness_cycle_count_threshold CAL_roughness_delta_rpm_smoothing_factor CAL_roughness_enable_load CAL_roughness_enable_rpm CAL_roughness_ign_adv_max CAL_roughness_ign_adv_min_sign_flipped CAL_roughness_min_edge_count CAL_roughness_peak_valley_imbalance_threshold CAL_roughness_peak_valley_imblance_threshold CAL_roughness_unknown2 CAL_roughness_unknown4 CAL_roughness_unknown5 CAL_roughness_unknown6 CAL_roughness_unknown7 CAL_roughness_unknown8 /end REF_CHARACTERISTIC
/end GROUP
/begin GROUP G_Airflow "Airflow and load" ROOT
 /begin SUB_GROUP G_Airflow_acis G_Airflow_airbox G_Airflow_load G_Airflow_sensor /end SUB_GROUP
/end GROUP
/begin GROUP G_Airflow_acis "acis"
 /begin REF_CHARACTERISTIC CAL_acis_close_load CAL_acis_close_rpm CAL_acis_open_load CAL_acis_open_rpm /end REF_CHARACTERISTIC
/end GROUP
/begin GROUP G_Airflow_airbox "airbox"
 /begin REF_CHARACTERISTIC CAL_airbox_flapper_engine_speed_sport CAL_airbox_flapper_engine_speed_sport2 CAL_airbox_flapper_engine_speed_tour CAL_airbox_flapper_engine_speed_tour2 /end REF_CHARACTERISTIC
/end GROUP
/begin GROUP G_Airflow_load "load"
 /begin REF_CHARACTERISTIC CAL_load_alphaN_base CAL_load_alphaN_base_X_engine_speed CAL_load_alphaN_base_Y_tps CAL_load_alphaN_engine_off CAL_load_alphaN_engine_off_X_tps CAL_load_alphaN_hold_time CAL_load_alphaN_learn_ratio_deadband CAL_load_alphaN_learn_trim_limits CAL_load_alphaN_max_rpm CAL_load_alphaN_tps_rate_closing_threshold CAL_load_alphaN_tps_rate_opening_threshold CAL_load_filter_coeff CAL_load_learning_enable_coolant_min CAL_load_learning_engine_accel_max CAL_load_learning_holdoff_delay CAL_load_learning_min_maf_accumulated CAL_load_learning_stabilization_delay CAL_load_learning_tps_rate_max CAL_load_map_estimate_intercept CAL_load_map_estimate_intercept_X_load CAL_load_map_estimate_intercept_Y_rpm CAL_load_map_estimate_ve CAL_load_map_estimate_ve_X_rpm CAL_load_mass_per_stroke_raw_limit_1 CAL_load_mass_per_stroke_raw_limit_2 CAL_load_obd_divisor_X_rpm CAL_load_source_selection_threshold_by_tps CAL_load_source_selection_threshold_by_tps_X_rpm CAL_load_to_tps_mapping CAL_load_to_tps_mapping_X_rpm CAL_load_to_tps_mapping_Y_load /end REF_CHARACTERISTIC
/end GROUP
/begin GROUP G_Airflow_sensor "sensor"
 /begin REF_CHARACTERISTIC CAL_sensor_P0106_min_tps_threshold CAL_sensor_P0106_min_tps_threshold_X_rpm CAL_sensor_ac_evap_temp_filter_alpha CAL_sensor_ac_evap_temp_scaling CAL_sensor_ac_evap_temp_scaling_X_voltage CAL_sensor_accel_pedal_d_gain CAL_sensor_accel_pedal_e_gain CAL_sensor_accel_pedal_pos_d_threshold CAL_sensor_accel_pedal_pos_e_threshold CAL_sensor_accel_pedal_ref_voltage_threshold CAL_sensor_adc_baro_limit CAL_sensor_adc_baro_threshold CAL_sensor_adc_ecu_voltage_threshold CAL_sensor_adc_engine_air_threshold CAL_sensor_adc_map_gain CAL_sensor_adc_map_offset CAL_sensor_airtemp_TMAF_temp CAL_sensor_airtemp_not_wired CAL_sensor_airtemp_not_wired_filter_alpha CAL_sensor_airtemp_tmaf_filter_alpha CAL_sensor_atmo_pressure_default CAL_sensor_baro_gain CAL_sensor_baro_offset CAL_sensor_baro_sensor_failure_fallback CAL_sensor_clutch_disengaged_threshold CAL_sensor_clutch_engaged_threshold CAL_sensor_coolant_filter_alpha CAL_sensor_coolant_scaling CAL_sensor_coolant_temp_fallback_value CAL_sensor_coolant_voltage_threshold CAL_sensor_evap_gain CAL_sensor_evap_offset CAL_sensor_fuel_level CAL_sensor_fuel_level_X_voltage CAL_sensor_fuel_level_sensor_voltage_threshold CAL_sensor_fuel_pressure_sensor_unused CAL_sensor_fuel_pressure_sensor_unused_X_voltage CAL_sensor_iat_fallback CAL_sensor_iat_voltage_threshold CAL_sensor_knock_voltage_threshold CAL_sensor_lat_accel_raw_threshold CAL_sensor_lat_accel_smoothing_factor CAL_sensor_maf_adc_avg_window_depth CAL_sensor_maf_scaling CAL_sensor_maf_scaling_X_voltage CAL_sensor_map_avg_window_size CAL_sensor_o2_afr_diag_scaling CAL_sensor_o2_afr_diag_scaling_X_voltage CAL_sensor_o2_heater_overcurrent_threshold_mA CAL_sensor_o2_heater_softstart_duration CAL_sensor_o2_heater_softstart_pwm_period CAL_sensor_o2_heater_undercurrent_threshold CAL_sensor_o2_lean_voltage_threshold CAL_sensor_pps_correlation_enable_max CAL_sensor_pps_correlation_max_delta CAL_sensor_pps_unknown1 CAL_sensor_temp_diagnostic_startup_delay CAL_sensor_tps_voltage_theshold1 CAL_sensor_tps_voltage_theshold2 /end REF_CHARACTERISTIC
/end GROUP
/begin GROUP G_Throttle "Throttle" ROOT
 /begin SUB_GROUP G_Throttle_tps G_Throttle_tps1 G_Throttle_tpssmooth G_Throttle_tpstarget /end SUB_GROUP
/end GROUP
/begin GROUP G_Throttle_tps "tps"
 /begin REF_CHARACTERISTIC CAL_tps_accel_pedal_zero_calibrate_timer CAL_tps_brake_safety_floor CAL_tps_brake_wheeldecel_threshold CAL_tps_brake_wheeldecel_tps_cut_threshold CAL_tps_commanded_during_fault CAL_tps_commanded_wamup_min CAL_tps_decrement_base CAL_tps_delta_neg_clamp CAL_tps_delta_neg_threshold CAL_tps_delta_rate_window_size CAL_tps_etb_low_voltage_threshold CAL_tps_etb_pid_i_clamp CAL_tps_etb_pid_kd CAL_tps_etb_pid_ki CAL_tps_etb_pid_kp CAL_tps_etb_pwm_period CAL_tps_etb_tps1_max_count CAL_tps_etb_tps2_max_count CAL_tps_idle_target_cranking CAL_tps_idle_target_cranking_X_baro CAL_tps_idle_target_cranking_Y_coolant CAL_tps_limit_idle_request_max CAL_tps_limit_misfire_single_bank CAL_tps_limit_severe_misfire_1_cut CAL_tps_limit_severe_misfire_multi_cut CAL_tps_limit_severe_misfire_no_cut CAL_tps_limit_warmup_coolant_max CAL_tps_limit_warmup_stepsize CAL_tps_obd_throttle_model_step_max_opening CAL_tps_scaling_factor_rpm CAL_tps_scaling_factor_rpm_X_rpm CAL_tps_scaling_factor_rpm_prototype CAL_tps_scaling_factor_rpm_prototype_X_rpm CAL_tps_warmup_max /end REF_CHARACTERISTIC
/end GROUP
/begin GROUP G_Throttle_tps1 "tps1" /begin REF_CHARACTERISTIC CAL_tps1_range_hi_frac CAL_tps1_range_lo_frac /end REF_CHARACTERISTIC /end GROUP
/begin GROUP G_Throttle_tpssmooth "tpssmooth"
 /begin REF_CHARACTERISTIC CAL_tpssmooth_accel_pedal_modes_enable CAL_tpssmooth_decrement_by_delta CAL_tpssmooth_decrement_by_delta_X_tps_delta CAL_tpssmooth_decrement_comp_gears_ips CAL_tpssmooth_decrement_comp_gears_manual CAL_tpssmooth_decrement_cruise_scale CAL_tpssmooth_increment_sport_driving CAL_tpssmooth_increment_sport_driving_X_tps_rate CAL_tpssmooth_increment_sport_shifting CAL_tpssmooth_increment_sport_shifting_X_tps_rate CAL_tpssmooth_increment_tour_driving CAL_tpssmooth_increment_tour_driving_X_tps_rate CAL_tpssmooth_increment_tour_parking CAL_tpssmooth_increment_tour_parking_X_tps_rate CAL_tpssmooth_increment_tour_shifting CAL_tpssmooth_increment_tour_shifting_X_tps_rate CAL_tpssmooth_parking_gear_max CAL_tpssmooth_parking_pedal_max CAL_tpssmooth_parking_speed_max CAL_tpssmooth_parking_threshold_carspeed CAL_tpssmooth_parking_threshold_tps CAL_tpssmooth_rate_calc_window_size /end REF_CHARACTERISTIC
/end GROUP
/begin GROUP G_Throttle_tpstarget "tpstarget"
 /begin REF_CHARACTERISTIC CAL_tpstarget_low_gear_tour_ips CAL_tpstarget_low_gear_tour_ips_X_pps CAL_tpstarget_low_gear_tour_manual CAL_tpstarget_low_gear_tour_manual_X_pps CAL_tpstarget_sport_ips CAL_tpstarget_sport_ips_X_pps CAL_tpstarget_sport_manual CAL_tpstarget_sport_manual_X_pps CAL_tpstarget_sport_shifting CAL_tpstarget_sport_shifting_X_pps CAL_tpstarget_tour_manual CAL_tpstarget_tour_manual_X_pps CAL_tpstarget_tour_shifting CAL_tpstarget_tour_shifting_X_pps /end REF_CHARACTERISTIC
/end GROUP
/end MODULE
/end PROJECT
