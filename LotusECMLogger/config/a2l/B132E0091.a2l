ASAP2_VERSION 1 61
/begin PROJECT B132E0091 "Lotus T6 B132E0091"
/begin HEADER "" VERSION "generated v1" /end HEADER
/begin MODULE B132E0091 ""
/begin MOD_COMMON "" BYTE_ORDER MSB_FIRST ALIGNMENT_BYTE 1 ALIGNMENT_WORD 2 ALIGNMENT_LONG 4 /end MOD_COMMON
/begin RECORD_LAYOUT RL_VALUE_UBYTE FNC_VALUES 1 UBYTE ROW_DIR DIRECT /end RECORD_LAYOUT
/begin RECORD_LAYOUT RL_AXIS_UBYTE AXIS_PTS_X 1 UBYTE INDEX_INCR DIRECT /end RECORD_LAYOUT
/begin RECORD_LAYOUT RL_AXIS_SBYTE AXIS_PTS_X 1 SBYTE INDEX_INCR DIRECT /end RECORD_LAYOUT
/begin RECORD_LAYOUT RL_VALUE_UWORD FNC_VALUES 1 UWORD ROW_DIR DIRECT /end RECORD_LAYOUT
/begin RECORD_LAYOUT RL_AXIS_UWORD AXIS_PTS_X 1 UWORD INDEX_INCR DIRECT /end RECORD_LAYOUT
/begin RECORD_LAYOUT RL_AXIS_SWORD AXIS_PTS_X 1 SWORD INDEX_INCR DIRECT /end RECORD_LAYOUT
/begin RECORD_LAYOUT RL_VALUE_ULONG FNC_VALUES 1 ULONG ROW_DIR DIRECT /end RECORD_LAYOUT
/begin COMPU_METHOD CM_i16_factor_1_20 "i16_factor_1/20" RAT_FUNC "%8.0" "%" COEFFS 0 1 0 0 0 5 /end COMPU_METHOD
/begin COMPU_METHOD CM_i16_percent_1_20 "i16_percent_1/20" RAT_FUNC "%10.2" "%" COEFFS 0 1 0 0 0 0.05 /end COMPU_METHOD
/begin COMPU_METHOD CM_i16_pressure_mbar "i16_pressure_mbar" RAT_FUNC "%8.0" "mbar" COEFFS 0 1 0 0 0 1 /end COMPU_METHOD
/begin COMPU_METHOD CM_i32_accel_1_255g "i32_accel_1/255g" RAT_FUNC "%12.4" "g" COEFFS 0 1 0 0 0 0.00392156862745098 /end COMPU_METHOD
/begin COMPU_METHOD CM_u16_angle_1_10deg "u16_angle_1/10deg" RAT_FUNC "%9.1" "deg" COEFFS 0 1 0 0 0 0.1 /end COMPU_METHOD
/begin COMPU_METHOD CM_u16_economy_1_10ml_per_km "u16_economy_1/10ml_per_km" RAT_FUNC "%9.1" "ml/km" COEFFS 0 1 0 0 0 0.1 /end COMPU_METHOD
/begin COMPU_METHOD CM_u16_factor_1_1000 "u16_factor_1/1000" RAT_FUNC "%9.1" "%" COEFFS 0 1 0 0 0 0.1 /end COMPU_METHOD
/begin COMPU_METHOD CM_u16_factor_1_1023 "u16_factor_1/1023" RAT_FUNC "%12.4" "%" COEFFS 0 1 0 0 0 0.0977517106549365 /end COMPU_METHOD
/begin COMPU_METHOD CM_u16_flow_10mg_s "u16_flow_10mg/s" RAT_FUNC "%8.0" "mg/s" COEFFS 0 1 0 0 0 10 /end COMPU_METHOD
/begin COMPU_METHOD CM_u16_flow_mg_s "u16_flow_mg/s" RAT_FUNC "%8.0" "mg/s" COEFFS 0 1 0 0 0 1 /end COMPU_METHOD
/begin COMPU_METHOD CM_u16_load_mg_stroke "u16_load_mg/stroke" RAT_FUNC "%8.0" "mg/stroke" COEFFS 0 1 0 0 0 1 /end COMPU_METHOD
/begin COMPU_METHOD CM_u16_mass_10ug "u16_mass_10ug" RAT_FUNC "%8.0" "ug" COEFFS 0 1 0 0 0 10 /end COMPU_METHOD
/begin COMPU_METHOD CM_u16_mass_g "u16_mass_g" RAT_FUNC "%8.0" "g" COEFFS 0 1 0 0 0 1 /end COMPU_METHOD
/begin COMPU_METHOD CM_u16_mass_mg "u16_mass_mg" RAT_FUNC "%8.0" "mg" COEFFS 0 1 0 0 0 1 /end COMPU_METHOD
/begin COMPU_METHOD CM_u16_rspeed_1_4rpm "u16_rspeed_1/4rpm" RAT_FUNC "%10.2" "rpm" COEFFS 0 1 0 0 0 0.25 /end COMPU_METHOD
/begin COMPU_METHOD CM_u16_time_4us "u16_time_4us" RAT_FUNC "%8.0" "us" COEFFS 0 1 0 0 0 4 /end COMPU_METHOD
/begin COMPU_METHOD CM_u16_voltage_18_1023v "u16_voltage_18/1023v" RAT_FUNC "%12.4" "V" COEFFS 0 1 0 0 0 0.0175953079178886 /end COMPU_METHOD
/begin COMPU_METHOD CM_u16_voltage_5_1023v "u16_voltage_5/1023v" RAT_FUNC "%12.4" "V" COEFFS 0 1 0 0 0 0.00488758553274682 /end COMPU_METHOD
/begin COMPU_METHOD CM_u32_angle_1_10defg "u32_angle_1/10defg" RAT_FUNC "%9.1" "defg" COEFFS 0 1 0 0 0 0.1 /end COMPU_METHOD
/begin COMPU_METHOD CM_u32_rspeed_1024rpm "u32_rspeed_1024rpm" RAT_FUNC "%8.0" "rpm" COEFFS 0 1 0 0 0 1024 /end COMPU_METHOD
/begin COMPU_METHOD CM_u8_afr_1_100 "u8_afr_1/100" RAT_FUNC "%10.2" "AFR" COEFFS 0 1 0 0 0 0.01 /end COMPU_METHOD
/begin COMPU_METHOD CM_u8_angle_1_4_10deg "u8_angle_1/4-10deg" RAT_FUNC "%10.2" "deg" COEFFS 0 1 10 0 0 0.25 /end COMPU_METHOD
/begin COMPU_METHOD CM_u8_angle_1_4deg "u8_angle_1/4deg" RAT_FUNC "%10.2" "deg" COEFFS 0 1 0 0 0 0.25 /end COMPU_METHOD
/begin COMPU_METHOD CM_u8_angle_1_8_16deg "u8_angle_1/8-16deg" RAT_FUNC "%11.3" "deg" COEFFS 0 1 16 0 0 0.125 /end COMPU_METHOD
/begin COMPU_METHOD CM_u8_angle_720_256deg "u8_angle_720/256deg" RAT_FUNC "%12.4" "deg" COEFFS 0 1 0 0 0 2.8125 /end COMPU_METHOD
/begin COMPU_METHOD CM_u8_dt_factor_1_100_5ms "u8_dt_factor_1/100/5ms" RAT_FUNC "%10.2" "/5ms" COEFFS 0 1 0 0 0 0.01 /end COMPU_METHOD
/begin COMPU_METHOD CM_u8_factor_1_100 "u8_factor_1/100" RAT_FUNC "%8.0" "%" COEFFS 0 1 0 0 0 1 /end COMPU_METHOD
/begin COMPU_METHOD CM_u8_factor_1_128 "u8_factor_1/128" RAT_FUNC "%12.4" "%" COEFFS 0 1 0 0 0 0.78125 /end COMPU_METHOD
/begin COMPU_METHOD CM_u8_factor_1_200 "u8_factor_1/200" RAT_FUNC "%9.1" "%" COEFFS 0 1 0 0 0 0.5 /end COMPU_METHOD
/begin COMPU_METHOD CM_u8_factor_1_255 "u8_factor_1/255" RAT_FUNC "%12.4" "%" COEFFS 0 1 0 0 0 0.392156862745098 /end COMPU_METHOD
/begin COMPU_METHOD CM_u8_factor_1_2560 "u8_factor_1/2560" RAT_FUNC "%12.4" "%" COEFFS 0 1 0 0 0 0.0390625 /end COMPU_METHOD
/begin COMPU_METHOD CM_u8_factor_1_32 "u8_factor_1/32" RAT_FUNC "%11.3" "%" COEFFS 0 1 0 0 0 3.125 /end COMPU_METHOD
/begin COMPU_METHOD CM_u8_factor_1_64 "u8_factor_1/64" RAT_FUNC "%12.4" "%" COEFFS 0 1 0 0 0 1.5625 /end COMPU_METHOD
/begin COMPU_METHOD CM_u8_flow_100mg_s "u8_flow_100mg/s" RAT_FUNC "%8.0" "mg/s" COEFFS 0 1 0 0 0 100 /end COMPU_METHOD
/begin COMPU_METHOD CM_u8_load_4mg_stroke "u8_load_4mg/stroke" RAT_FUNC "%8.0" "mg/stroke" COEFFS 0 1 0 0 0 4 /end COMPU_METHOD
/begin COMPU_METHOD CM_u8_percent_100_128_100 "u8_percent_100/128-100" RAT_FUNC "%12.4" "%" COEFFS 0 1 100 0 0 0.78125 /end COMPU_METHOD
/begin COMPU_METHOD CM_u8_pressure_100mbar "u8_pressure_100mbar" RAT_FUNC "%8.0" "mbar" COEFFS 0 1 0 0 0 100 /end COMPU_METHOD
/begin COMPU_METHOD CM_u8_pressure_4mbar "u8_pressure_4mbar" RAT_FUNC "%8.0" "mbar" COEFFS 0 1 0 0 0 4 /end COMPU_METHOD
/begin COMPU_METHOD CM_u8_rspeed_125_4_500rpm "u8_rspeed_125/4+500rpm" RAT_FUNC "%10.2" "rpm" COEFFS 0 1 -500 0 0 31.25 /end COMPU_METHOD
/begin COMPU_METHOD CM_u8_rspeed_accel_1_168 "u8_rspeed_accel_1/168" RAT_FUNC "%8.0" "accel_1/168" COEFFS 0 1 0 0 0 1 /end COMPU_METHOD
/begin COMPU_METHOD CM_u8_rspeed_rpm "u8_rspeed_rpm" RAT_FUNC "%8.0" "rpm" COEFFS 0 1 0 0 0 1 /end COMPU_METHOD
/begin COMPU_METHOD CM_u8_speed_1_100kph "u8_speed_1/100kph" RAT_FUNC "%10.2" "km/h" COEFFS 0 1 0 0 0 0.01 /end COMPU_METHOD
/begin COMPU_METHOD CM_u8_speed_kph "u8_speed_kph" RAT_FUNC "%8.0" "km/h" COEFFS 0 1 0 0 0 1 /end COMPU_METHOD
/begin COMPU_METHOD CM_u8_temp_1_10C "u8_temp_1/10C" RAT_FUNC "%9.1" "°C" COEFFS 0 1 0 0 0 0.1 /end COMPU_METHOD
/begin COMPU_METHOD CM_u8_temp_5_8_40c "u8_temp_5/8-40c" RAT_FUNC "%11.3" "°C" COEFFS 0 1 40 0 0 0.625 /end COMPU_METHOD
/begin COMPU_METHOD CM_u8_temp__40c "u8_temp_-40c" RAT_FUNC "%8.0" "°C" COEFFS 0 1 40 0 0 1 /end COMPU_METHOD
/begin COMPU_METHOD CM_u8_time_100ms "u8_time_100ms" RAT_FUNC "%8.0" "ms" COEFFS 0 1 0 0 0 100 /end COMPU_METHOD
/begin COMPU_METHOD CM_u8_time_10ms "u8_time_10ms" RAT_FUNC "%8.0" "ms" COEFFS 0 1 0 0 0 10 /end COMPU_METHOD
/begin COMPU_METHOD CM_u8_time_5ms "u8_time_5ms" RAT_FUNC "%8.0" "ms" COEFFS 0 1 0 0 0 5 /end COMPU_METHOD
/begin COMPU_METHOD CM_u8_time_ms "u8_time_ms" RAT_FUNC "%8.0" "ms" COEFFS 0 1 0 0 0 1 /end COMPU_METHOD
/begin COMPU_METHOD CM_u8_time_s "u8_time_s" RAT_FUNC "%8.0" "s" COEFFS 0 1 0 0 0 1 /end COMPU_METHOD
/begin COMPU_METHOD CM_u8_time_us "u8_time_us" RAT_FUNC "%8.0" "us" COEFFS 0 1 0 0 0 1 /end COMPU_METHOD
/begin COMPU_METHOD CM_u8_torque_nm "u8_torque_nm" RAT_FUNC "%8.0" "Nm" COEFFS 0 1 0 0 0 1 /end COMPU_METHOD
/begin COMPU_METHOD CM_u8_voltage_72_1023v "u8_voltage_72/1023v" RAT_FUNC "%12.4" "V" COEFFS 0 1 0 0 0 0.0703812316715543 /end COMPU_METHOD
/begin COMPU_METHOD CM_u8_volume_1_10gallon "u8_volume_1/10gallon" RAT_FUNC "%9.1" "gallon" COEFFS 0 1 0 0 0 0.1 /end COMPU_METHOD
/begin COMPU_METHOD CM_u8_volume_liter "u8_volume_liter" RAT_FUNC "%8.0" "liter" COEFFS 0 1 0 0 0 1 /end COMPU_METHOD
/begin CHARACTERISTIC CAL_base "T6-V00BU#World#Lotus#Evora#2010-2014#MT#25050b#MPC5534#CRP#0x59D4#LOTUS EVORA MY11" ASCII 0x40008E24 RL_VALUE_UBYTE 0 NO_COMPU_METHOD 0 255 NUMBER 32 /end CHARACTERISTIC
/begin CHARACTERISTIC CAL_ecu_data_base "undefined" VALUE 0x40008E44 RL_VALUE_ULONG 0 NO_COMPU_METHOD 0 4294967295 /end CHARACTERISTIC
/begin CHARACTERISTIC CAL_logger_high_speed_logger_enable "To enable the built-in highspeed data logger, set this configuration option." VALUE 0x40008E4A RL_VALUE_UBYTE 0 NO_COMPU_METHOD 0 255 /end CHARACTERISTIC
/begin CHARACTERISTIC CAL_misc_engine_running_confirm_delay "Calibration: misc engine running confirm delay. Tunable map/constant (not a live channel); log to follow core engine state." VALUE 0x40008E9B RL_VALUE_UBYTE 0 NO_COMPU_METHOD 0 255 /end CHARACTERISTIC
/begin CHARACTERISTIC CAL_ecu_learning_x_axis_stability_threshold "Calibration: ECU learning x axis stability threshold. Tunable map/constant (not a live channel); mostly housekeeping/diagnostic state." VALUE 0x40008EA1 RL_VALUE_UBYTE 0 NO_COMPU_METHOD 0 255 /end CHARACTERISTIC
/begin CHARACTERISTIC CAL_ecu_learning_y_axis_stability_threshold "uint8_t" VALUE 0x40008EA2 RL_VALUE_UBYTE 0 NO_COMPU_METHOD 0 255 /end CHARACTERISTIC
/begin CHARACTERISTIC CAL_ecu_ign_threshold "Calibration: ECU ignition threshold. Tunable map/constant (not a live channel); log spark advance to confirm the timing strategy and headroom to knock. (V; raw*72/1023)" VALUE 0x40008EAF RL_VALUE_UBYTE 0 CM_u8_voltage_72_1023v 0 17.9472140762463 /end CHARACTERISTIC
/begin CHARACTERISTIC CAL_tps2_range_lo_frac "u16_factor_1/1023" VALUE 0x40008F26 RL_VALUE_UWORD 0 CM_u16_factor_1_1023 0 6406.15835777126 /end CHARACTERISTIC
/begin CHARACTERISTIC CAL_tps2_range_hi_frac "u16_factor_1/1023" VALUE 0x40008F28 RL_VALUE_UWORD 0 CM_u16_factor_1_1023 0 6406.15835777126 /end CHARACTERISTIC
/begin CHARACTERISTIC CAL_ecu_starter_max_engage_after_run "u16_time_5ms" VALUE 0x40008F44 RL_VALUE_UWORD 0 CM_u8_time_5ms 0 327675 /end CHARACTERISTIC
/begin CHARACTERISTIC CAL_misc_engine_detection_on "Calibration: misc engine detection on. Tunable map/constant (not a live channel); log to follow core engine state. (us; raw*4)" VALUE 0x40008F4E RL_VALUE_UWORD 0 CM_u16_time_4us 0 262140 /end CHARACTERISTIC
/begin CHARACTERISTIC CAL_misc_engine_detection_off "Calibration: misc engine detection off. Tunable map/constant (not a live channel); log to follow core engine state. (us; raw*4)" VALUE 0x40008F50 RL_VALUE_UWORD 0 CM_u16_time_4us 0 262140 /end CHARACTERISTIC
/begin CHARACTERISTIC CAL_ecu_gear_long_ratio "Calibration: ECU gear long ratio. Tunable map/constant (not a live channel); mostly housekeeping/diagnostic state." VAL_BLK 0x40008F58 RL_VALUE_UWORD 0 NO_COMPU_METHOD 0 65535 NUMBER 10 /end CHARACTERISTIC
/begin CHARACTERISTIC CAL_ecu_ign_off_relay_hold_time "Calibration: ECU ignition off relay hold time. Tunable map/constant (not a live channel); log spark advance to confirm the timing strategy and headroom to knock." VALUE 0x40008F76 RL_VALUE_UWORD 0 NO_COMPU_METHOD 0 65535 /end CHARACTERISTIC
/begin CHARACTERISTIC CAL_ecu_standing_start_threshold "uint16_t" VALUE 0x40008F7A RL_VALUE_UWORD 0 NO_COMPU_METHOD 0 65535 /end CHARACTERISTIC
/begin CHARACTERISTIC CAL_ecu_accel_pedal_released_threshold "Calibration: cruise accelerator pedal override threshold exit. Tunable map/constant (not a live channel); log to debug cruise engagement and speed holding. (0-1; raw/1023)" VALUE 0x40008F8C RL_VALUE_UBYTE 0 CM_u16_factor_1_1023 0 24.9266862170088 /end CHARACTERISTIC
/begin CHARACTERISTIC CAL_ecu_accel_pedal_pressed_threshold "Calibration: cruise accelerator pedal override threshold enter. Tunable map/constant (not a live channel); log to debug cruise engagement and speed holding. (0-1; raw/1023)" VALUE 0x40008F8D RL_VALUE_UBYTE 0 CM_u16_factor_1_1023 0 24.9266862170088 /end CHARACTERISTIC
/begin CHARACTERISTIC CAL_ecu_2gr_cylinder_air_mass_mg "Calibration: ECU 2gr cylinder air mass mg. Tunable map/constant (not a live channel); mostly housekeeping/diagnostic state. (mg)" VALUE 0x40008F8E RL_VALUE_UWORD 0 CM_u16_mass_mg 0 65535 /end CHARACTERISTIC
/begin CHARACTERISTIC CAL_ecu_2gr_cylinder_air_mass_mg_obd_ii "Calibration: ECU 2gr cylinder air mass mg OBD. Tunable map/constant (not a live channel); mostly housekeeping/diagnostic state. (mg)" VALUE 0x40008F90 RL_VALUE_UWORD 0 CM_u16_mass_mg 0 65535 /end CHARACTERISTIC
/begin CHARACTERISTIC CAL_vehicle_moving_speed_min "Calibration: vehicle moving speed min. Tunable map/constant (not a live channel); adjust to change this behavior. (km/h)" VALUE 0x40008F95 RL_VALUE_UBYTE 0 CM_u8_speed_kph 0 255 /end CHARACTERISTIC
/begin CHARACTERISTIC CAL_ecu_gear_long_ratio_topgear "Calibration: ECU gear long ratio topgear. Tunable map/constant (not a live channel); mostly housekeeping/diagnostic state." VAL_BLK 0x40008FF4 RL_VALUE_UWORD 0 NO_COMPU_METHOD 0 65535 NUMBER 2 /end CHARACTERISTIC
/begin CHARACTERISTIC CAL_ecu_brake_or_clutch_inactive_timer "uint16_t" VALUE 0x40009042 RL_VALUE_UWORD 0 NO_COMPU_METHOD 0 65535 /end CHARACTERISTIC
/begin CHARACTERISTIC CAL_ecu_relay_enable_delay "Calibration: cooling afterrun fan timer unknown. Tunable map/constant (not a live channel); log to confirm fans/pumps switch at the right temperatures." VALUE 0x40009045 RL_VALUE_UBYTE 0 NO_COMPU_METHOD 0 255 /end CHARACTERISTIC
/begin CHARACTERISTIC CAL_tpms_version "Calibration: tpms version. Tunable map/constant (not a live channel); adjust to change this behavior." VALUE 0x40009046 RL_VALUE_UBYTE 0 NO_COMPU_METHOD 0 255 /end CHARACTERISTIC
/begin CHARACTERISTIC CAL_vehicle_speed_limit "Calibration: vehicle speed limit. Tunable map/constant (not a live channel); adjust to change this behavior. (km/h)" VALUE 0x40009086 RL_VALUE_UBYTE 0 CM_u8_speed_kph 0 255 /end CHARACTERISTIC
/begin CHARACTERISTIC CAL_vehicle_speed_limit_enforce "Calibration: vehicle speed limit enforce. Tunable map/constant (not a live channel); adjust to change this behavior." VALUE 0x40009088 RL_VALUE_UBYTE 0 NO_COMPU_METHOD 0 255 /end CHARACTERISTIC
/begin CHARACTERISTIC CAL_vehicle_speed_limit_ramp_step "Calibration: vehicle speed limit enforce margin. Tunable map/constant (not a live channel); adjust to change this behavior. (km/h; raw/100)" VALUE 0x40009089 RL_VALUE_UBYTE 0 CM_u8_speed_1_100kph 0 2.55 /end CHARACTERISTIC
/begin CHARACTERISTIC CAL_unused1 "uint16_t" VALUE 0x4000908C RL_VALUE_UWORD 0 NO_COMPU_METHOD 0 65535 /end CHARACTERISTIC
/begin CHARACTERISTIC CAL_ecu_ips_enable_in_shutdown_speed "u8_speed_kph" VALUE 0x40009090 RL_VALUE_UBYTE 0 CM_u8_speed_kph 0 255 /end CHARACTERISTIC
/begin CHARACTERISTIC CAL_unused2 "uint16_t" VALUE 0x400090AA RL_VALUE_UWORD 0 NO_COMPU_METHOD 0 65535 /end CHARACTERISTIC
/begin CHARACTERISTIC CAL_dca_enable_untested "Calibration: Drive-Cycle-Assist enable untested. Tunable map/constant (not a live channel); log to observe Drive-Cycle-Assist activation (normally off)." VALUE 0x400090B3 RL_VALUE_UBYTE 0 NO_COMPU_METHOD 0 255 /end CHARACTERISTIC
/begin CHARACTERISTIC CAL_unused3 "byte[3]" VAL_BLK 0x400090BA RL_VALUE_UBYTE 0 NO_COMPU_METHOD 0 255 NUMBER 3 /end CHARACTERISTIC
/begin CHARACTERISTIC CAL_dca_enable_steering_max "Calibration: Drive-Cycle-Assist enable steering max. Tunable map/constant (not a live channel); log to observe Drive-Cycle-Assist activation (normally off)." VALUE 0x400090E5 RL_VALUE_UBYTE 0 NO_COMPU_METHOD 0 255 /end CHARACTERISTIC
/begin CHARACTERISTIC CAL_dca_enable_carspeed "Calibration: Drive-Cycle-Assist enable carspeed. Tunable map/constant (not a live channel); log to observe Drive-Cycle-Assist activation (normally off). (km/h)" VAL_BLK 0x400090E6 RL_VALUE_UBYTE 0 CM_u8_speed_kph 0 255 NUMBER 2 /end CHARACTERISTIC
/begin CHARACTERISTIC CAL_dca_stationary_wait_time "Calibration: Drive-Cycle-Assist stationary wait time. Tunable map/constant (not a live channel); log to observe Drive-Cycle-Assist activation (normally off). (ms; raw*100)" VALUE 0x400090E8 RL_VALUE_UBYTE 0 CM_u8_time_100ms 0 25500 /end CHARACTERISTIC
/begin CHARACTERISTIC CAL_dca_tps_initial_offset "Calibration: Drive-Cycle-Assist throttle position initial offset. Tunable map/constant (not a live channel); log to see throttle/pedal demand and throttle response." VALUE 0x400090E9 RL_VALUE_UBYTE 0 NO_COMPU_METHOD 0 255 /end CHARACTERISTIC
/begin CHARACTERISTIC CAL_dca_enable_tps_margin "Calibration: Drive-Cycle-Assist enable throttle position margin. Tunable map/constant (not a live channel); log to see throttle/pedal demand and throttle response." VALUE 0x400090EA RL_VALUE_UBYTE 0 NO_COMPU_METHOD 0 255 /end CHARACTERISTIC
/begin CHARACTERISTIC CAL_dca_activate_timer "Calibration: Drive-Cycle-Assist activate timer. Tunable map/constant (not a live channel); log to observe Drive-Cycle-Assist activation (normally off). (ms; raw*5)" VALUE 0x400090EB RL_VALUE_UBYTE 0 CM_u8_time_5ms 0 1275 /end CHARACTERISTIC
/begin CHARACTERISTIC CAL_dca_activate_tps_threshold "Calibration: Drive-Cycle-Assist activate throttle position threshold. Tunable map/constant (not a live channel); log to see throttle/pedal demand and throttle response. (0-1; raw/1023)" VALUE 0x400090EC RL_VALUE_UWORD 0 CM_u16_factor_1_1023 0 6406.15835777126 /end CHARACTERISTIC
/begin CHARACTERISTIC CAL_dca_freerev_wait_time "Calibration: Drive-Cycle-Assist freerev wait time. Tunable map/constant (not a live channel); log to observe Drive-Cycle-Assist activation (normally off)." VALUE 0x400090EF RL_VALUE_UBYTE 0 NO_COMPU_METHOD 0 255 /end CHARACTERISTIC
/begin CHARACTERISTIC CAL_dca_tps_ramp_step_period "Calibration: Drive-Cycle-Assist throttle position ramp step period. Tunable map/constant (not a live channel); log to see throttle/pedal demand and throttle response." VALUE 0x400090F0 RL_VALUE_UBYTE 0 NO_COMPU_METHOD 0 255 /end CHARACTERISTIC
/begin CHARACTERISTIC CAL_dca_freerev_rpm_tolerance "Calibration: Drive-Cycle-Assist freerev RPM tolerance. Tunable map/constant (not a live channel); log to observe Drive-Cycle-Assist activation (normally off)." VALUE 0x400090F1 RL_VALUE_UBYTE 0 NO_COMPU_METHOD 0 255 /end CHARACTERISTIC
/begin CHARACTERISTIC CAL_dca_freerev_rpm "Calibration: Drive-Cycle-Assist freerev RPM. Tunable map/constant (not a live channel); log to observe Drive-Cycle-Assist activation (normally off)." VALUE 0x400090F8 RL_VALUE_UBYTE 0 NO_COMPU_METHOD 0 255 /end CHARACTERISTIC
/begin CHARACTERISTIC CAL_ecu_engine_speed_decel_hysteresis_rpm "uint8_t" VALUE 0x40009100 RL_VALUE_UBYTE 0 NO_COMPU_METHOD 0 255 /end CHARACTERISTIC
/begin CHARACTERISTIC CAL_unused_large1 "byte[224]" VAL_BLK 0x400091EA RL_VALUE_UBYTE 0 NO_COMPU_METHOD 0 255 NUMBER 224 /end CHARACTERISTIC
/begin AXIS_PTS CAL_ecu_engine_speed_target_sport_X_pps "X-axis breakpoints for the 'ECU engine speed target sport' table. Defines the lookup grid (not a live channel); change only when re-axing the map." 0x4000A4B6 accel_pedal_pos RL_AXIS_UWORD 0 CM_u16_factor_1_1023 10 0 6406.15835777126 /end AXIS_PTS
/begin CHARACTERISTIC CAL_ecu_engine_speed_target_sport "Calibration: ECU engine speed target sport. Tunable map/constant (not a live channel); mostly housekeeping/diagnostic state." CURVE 0x4000A4CA RL_VALUE_UWORD 0 CM_u16_rspeed_1_4rpm 0 16383.75
 /begin AXIS_DESCR COM_AXIS accel_pedal_pos CM_u16_factor_1_1023 10 0 6406.15835777126 AXIS_PTS_REF CAL_ecu_engine_speed_target_sport_X_pps /end AXIS_DESCR
/end CHARACTERISTIC
/begin AXIS_PTS CAL_ecu_engine_speed_target_tour_X_pps "X-axis breakpoints for the 'ECU engine speed target tour' table. Defines the lookup grid (not a live channel); change only when re-axing the map." 0x4000D03A accel_pedal_pos RL_AXIS_UWORD 0 CM_u16_factor_1_1023 10 0 6406.15835777126 /end AXIS_PTS
/begin CHARACTERISTIC CAL_ecu_engine_speed_target_tour "Calibration: ECU engine speed target tour. Tunable map/constant (not a live channel); mostly housekeeping/diagnostic state." CURVE 0x4000D04E RL_VALUE_UWORD 0 CM_u16_rspeed_1_4rpm 0 16383.75
 /begin AXIS_DESCR COM_AXIS accel_pedal_pos CM_u16_factor_1_1023 10 0 6406.15835777126 AXIS_PTS_REF CAL_ecu_engine_speed_target_tour_X_pps /end AXIS_DESCR
/end CHARACTERISTIC
/begin AXIS_PTS CAL_dca_tps_limit_manual_X_time "X-axis breakpoints for the 'Drive-Cycle-Assist throttle position limit manual' table. Defines the lookup grid (not a live channel); change only when re-axing the map." 0x4000D0A2 V_CAL_dca_tps_limit_manual_X_time RL_AXIS_UBYTE 0 NO_COMPU_METHOD 8 0 255 /end AXIS_PTS
/begin CHARACTERISTIC CAL_dca_tps_limit_manual "Calibration: Drive-Cycle-Assist throttle position limit manual. Tunable map/constant (not a live channel); log to see throttle/pedal demand and throttle response." CURVE 0x4000D0AA RL_VALUE_UBYTE 0 NO_COMPU_METHOD 0 255
 /begin AXIS_DESCR COM_AXIS V_CAL_dca_tps_limit_manual_X_time NO_COMPU_METHOD 8 0 255 AXIS_PTS_REF CAL_dca_tps_limit_manual_X_time /end AXIS_DESCR
/end CHARACTERISTIC
/begin AXIS_PTS CAL_dca_tps_limit_ips_X_time "X-axis breakpoints for the 'Drive-Cycle-Assist throttle position limit IPS' table. Defines the lookup grid (not a live channel); change only when re-axing the map." 0x4000D0B2 V_CAL_dca_tps_limit_ips_X_time RL_AXIS_UBYTE 0 NO_COMPU_METHOD 8 0 255 /end AXIS_PTS
/begin CHARACTERISTIC CAL_dca_tps_limit_ips "Calibration: Drive-Cycle-Assist throttle position limit IPS. Tunable map/constant (not a live channel); log to see throttle/pedal demand and throttle response." CURVE 0x4000D0BA RL_VALUE_UBYTE 0 NO_COMPU_METHOD 0 255
 /begin AXIS_DESCR COM_AXIS V_CAL_dca_tps_limit_ips_X_time NO_COMPU_METHOD 8 0 255 AXIS_PTS_REF CAL_dca_tps_limit_ips_X_time /end AXIS_DESCR
/end CHARACTERISTIC
/begin AXIS_PTS CAL_dca_tps_limit_ips2_X_time "X-axis breakpoints for the 'Drive-Cycle-Assist throttle position limit ips2' table. Defines the lookup grid (not a live channel); change only when re-axing the map." 0x4000D0D2 V_CAL_dca_tps_limit_ips2_X_time RL_AXIS_UBYTE 0 NO_COMPU_METHOD 8 0 255 /end AXIS_PTS
/begin CHARACTERISTIC CAL_dca_tps_limit_ips2 "Calibration: Drive-Cycle-Assist throttle position limit ips2. Tunable map/constant (not a live channel); log to see throttle/pedal demand and throttle response." CURVE 0x4000D0DA RL_VALUE_UBYTE 0 NO_COMPU_METHOD 0 255
 /begin AXIS_DESCR COM_AXIS V_CAL_dca_tps_limit_ips2_X_time NO_COMPU_METHOD 8 0 255 AXIS_PTS_REF CAL_dca_tps_limit_ips2_X_time /end AXIS_DESCR
/end CHARACTERISTIC
/begin CHARACTERISTIC CAL_ecu_system_voltage_threshold "uint16_t" VALUE 0x4000D1DC RL_VALUE_UWORD 0 NO_COMPU_METHOD 0 65535 /end CHARACTERISTIC
/begin CHARACTERISTIC CAL_tpms_low_pressure_18_19 "u8_pressure_100mbar" VALUE 0x4000D202 RL_VALUE_UBYTE 0 CM_u8_pressure_100mbar 0 25500 /end CHARACTERISTIC
/begin CHARACTERISTIC CAL_tpms_low_warn_offset_18_19 "u8_pressure_100mbar" VALUE 0x4000D203 RL_VALUE_UBYTE 0 CM_u8_pressure_100mbar 0 25500 /end CHARACTERISTIC
/begin CHARACTERISTIC CAL_tpms_low_pressure_19_20 "u8_pressure_100mbar" VALUE 0x4000D204 RL_VALUE_UBYTE 0 CM_u8_pressure_100mbar 0 25500 /end CHARACTERISTIC
/begin CHARACTERISTIC CAL_tpms_low_warn_offset_19_20 "u8_pressure_100mbar" VALUE 0x4000D205 RL_VALUE_UBYTE 0 CM_u8_pressure_100mbar 0 25500 /end CHARACTERISTIC
/begin CHARACTERISTIC CAL_lea_misfire_baseline_set "bool" VALUE 0x4000D236 RL_VALUE_UBYTE 0 NO_COMPU_METHOD 0 255 /end CHARACTERISTIC
/begin CHARACTERISTIC CAL_ecu_obd_engine_off_gate_delay "Calibration: ECU OBD engine off gate delay. Tunable map/constant (not a live channel); mostly housekeeping/diagnostic state." VALUE 0x4000D260 RL_VALUE_UWORD 0 NO_COMPU_METHOD 0 65535 /end CHARACTERISTIC
/begin CHARACTERISTIC CAL_unused5 "Unused2. Runtime state -- log to observe this behavior." VALUE 0x4000D272 RL_VALUE_ULONG 0 NO_COMPU_METHOD 0 4294967295 /end CHARACTERISTIC
/begin CHARACTERISTIC CAL_tpms_high_pressure_19_20 "u8_pressure_100mbar" VALUE 0x4000D316 RL_VALUE_UBYTE 0 CM_u8_pressure_100mbar 0 25500 /end CHARACTERISTIC
/begin CHARACTERISTIC CAL_tpms_nominal_pressure_19_20 "u8_pressure_100mbar" VALUE 0x4000D317 RL_VALUE_UBYTE 0 CM_u8_pressure_100mbar 0 25500 /end CHARACTERISTIC
/begin CHARACTERISTIC CAL_tpms_gen2_low_pressure_threshold_19_20 "u8_pressure_100mbar" VALUE 0x4000D318 RL_VALUE_UBYTE 0 CM_u8_pressure_100mbar 0 25500 /end CHARACTERISTIC
/begin CHARACTERISTIC CAL_tpms_gen2_low_warn_19_20 "u8_pressure_100mbar" VALUE 0x4000D319 RL_VALUE_UBYTE 0 CM_u8_pressure_100mbar 0 25500 /end CHARACTERISTIC
/begin CHARACTERISTIC CAL_tpms_high_pressure_18_19 "u8_pressure_100mbar" VALUE 0x4000D329 RL_VALUE_UBYTE 0 CM_u8_pressure_100mbar 0 25500 /end CHARACTERISTIC
/begin CHARACTERISTIC CAL_tpms_nominal_pressure_18_19 "u8_pressure_100mbar" VALUE 0x4000D32A RL_VALUE_UBYTE 0 CM_u8_pressure_100mbar 0 25500 /end CHARACTERISTIC
/begin CHARACTERISTIC CAL_tpms_gen2_low_pressure_threshold_18_19 "u8_pressure_100mbar" VALUE 0x4000D32B RL_VALUE_UBYTE 0 CM_u8_pressure_100mbar 0 25500 /end CHARACTERISTIC
/begin CHARACTERISTIC CAL_tpms_gen2_low_warn_18_19 "u8_pressure_100mbar" VALUE 0x4000D32C RL_VALUE_UBYTE 0 CM_u8_pressure_100mbar 0 25500 /end CHARACTERISTIC
/begin CHARACTERISTIC CAL_ecu_gear_close_ratio "Calibration: ECU gear close ratio. Tunable map/constant (not a live channel); mostly housekeeping/diagnostic state." VAL_BLK 0x4000D33A RL_VALUE_UWORD 0 NO_COMPU_METHOD 0 65535 NUMBER 10 /end CHARACTERISTIC
/begin CHARACTERISTIC CAL_ecu_gear_close_ratio_topgear "Calibration: ECU gear close ratio topgear. Tunable map/constant (not a live channel); mostly housekeeping/diagnostic state." VAL_BLK 0x4000D34E RL_VALUE_UWORD 0 NO_COMPU_METHOD 0 65535 NUMBER 2 /end CHARACTERISTIC
/begin CHARACTERISTIC CAL_unused_array2 "byte[938]" VAL_BLK 0x4000D41A RL_VALUE_UBYTE 0 NO_COMPU_METHOD 0 255 NUMBER 938 /end CHARACTERISTIC
/begin CHARACTERISTIC CAL_unused_array3 "byte[11]" VAL_BLK 0x4000DA3D RL_VALUE_UBYTE 0 NO_COMPU_METHOD 0 255 NUMBER 11 /end CHARACTERISTIC
/begin CHARACTERISTIC CAL_unused_array4 "byte[292]" VAL_BLK 0x4000DA52 RL_VALUE_UBYTE 0 NO_COMPU_METHOD 0 255 NUMBER 292 /end CHARACTERISTIC
/begin CHARACTERISTIC CAL_unused_array5 "byte[313]" VAL_BLK 0x4000DC37 RL_VALUE_UBYTE 0 NO_COMPU_METHOD 0 255 NUMBER 313 /end CHARACTERISTIC
/begin CHARACTERISTIC CAL_unused_array6_ "byte[32]" VAL_BLK 0x4000DEEC RL_VALUE_UBYTE 0 NO_COMPU_METHOD 0 255 NUMBER 32 /end CHARACTERISTIC
/begin CHARACTERISTIC CAL_unused_array1 "byte[128]" VAL_BLK 0x4000E0AC RL_VALUE_UBYTE 0 NO_COMPU_METHOD 0 255 NUMBER 128 /end CHARACTERISTIC
/begin CHARACTERISTIC CAL_ecu_thermostat_diag_maf_threshold_manual "u8_temp_5/8-40c[18]" VAL_BLK 0x4000E7B8 RL_VALUE_UBYTE 0 CM_u8_temp_5_8_40c -40 119.375 NUMBER 18 /end CHARACTERISTIC
/begin CHARACTERISTIC CAL_ecu_thermostat_diag_maf_threshold_ips "u8_temp_5/8-40c[18]" VAL_BLK 0x4000E7E6 RL_VALUE_UBYTE 0 CM_u8_temp_5_8_40c -40 119.375 NUMBER 18 /end CHARACTERISTIC
/begin CHARACTERISTIC CAL_prog_version "Calibration: prog version. Tunable map/constant (not a live channel); adjust to change this behavior." ASCII 0x4000E7F8 RL_VALUE_UBYTE 0 NO_COMPU_METHOD 0 255 NUMBER 32 /end CHARACTERISTIC
/begin CHARACTERISTIC CAL_unused_array7 "byte[40]" VAL_BLK 0x4000E938 RL_VALUE_UBYTE 0 NO_COMPU_METHOD 0 255 NUMBER 40 /end CHARACTERISTIC
/begin CHARACTERISTIC CAL_unused_end_of_range "byte[376]" VAL_BLK 0x4000EE80 RL_VALUE_UBYTE 0 NO_COMPU_METHOD 0 255 NUMBER 376 /end CHARACTERISTIC
/begin CHARACTERISTIC CAL_ecu_unlock_magic "Calibration: ECU unlock magic. Tunable map/constant (not a live channel); mostly housekeeping/diagnostic state." ASCII 0x4000EFF8 RL_VALUE_UBYTE 0 NO_COMPU_METHOD 0 255 NUMBER 4 /end CHARACTERISTIC
/begin MEASUREMENT engine_speed_period_0 "undefined2" UWORD NO_COMPU_METHOD 0 0 0 65535 ECU_ADDRESS 0x40000000 /end MEASUREMENT
/begin MEASUREMENT engine_speed_period_3 "undefined2" UWORD NO_COMPU_METHOD 0 0 0 65535 ECU_ADDRESS 0x40000010 /end MEASUREMENT
/begin MEASUREMENT obd_ii_ecu_shutdown_timer "u32_time_5ms" ULONG CM_u8_time_5ms 0 0 0 21474836475 ECU_ADDRESS 0x40001350 /end MEASUREMENT
/begin MEASUREMENT hc08_rx_timeout_timer "u8_time_5ms" UBYTE CM_u8_time_5ms 0 0 0 1275 ECU_ADDRESS 0x40001354 /end MEASUREMENT
/begin MEASUREMENT event_timer_10hz "undefined2" UWORD NO_COMPU_METHOD 0 0 0 65535 ECU_ADDRESS 0x40001356 /end MEASUREMENT
/begin MEASUREMENT event_timer_100hz "undefined1" UBYTE NO_COMPU_METHOD 0 0 0 255 ECU_ADDRESS 0x40001358 /end MEASUREMENT
/begin MEASUREMENT event_timer_50hz "undefined1" UBYTE NO_COMPU_METHOD 0 0 0 255 ECU_ADDRESS 0x40001359 /end MEASUREMENT
/begin MEASUREMENT event_timer_20hz "undefined1" UBYTE NO_COMPU_METHOD 0 0 0 255 ECU_ADDRESS 0x4000135A /end MEASUREMENT
/begin MEASUREMENT event_timer_5hz "undefined1" UBYTE NO_COMPU_METHOD 0 0 0 255 ECU_ADDRESS 0x4000135B /end MEASUREMENT
/begin MEASUREMENT event_timer_3p33hz "undefined1" UBYTE NO_COMPU_METHOD 0 0 0 255 ECU_ADDRESS 0x4000135C /end MEASUREMENT
/begin MEASUREMENT event_timer_2hz "undefined1" UBYTE NO_COMPU_METHOD 0 0 0 255 ECU_ADDRESS 0x4000135D /end MEASUREMENT
/begin MEASUREMENT event_timer_1s "undefined1" UBYTE NO_COMPU_METHOD 0 0 0 255 ECU_ADDRESS 0x4000135E /end MEASUREMENT
/begin MEASUREMENT event_timer_1000hz "undefined1" UBYTE NO_COMPU_METHOD 0 0 0 255 ECU_ADDRESS 0x4000135F /end MEASUREMENT
/begin MEASUREMENT event_timer_200hz "undefined1" UBYTE NO_COMPU_METHOD 0 0 0 255 ECU_ADDRESS 0x40001360 /end MEASUREMENT
/begin MEASUREMENT etpu_task_timing_capture_holdoff "undefined1" UBYTE NO_COMPU_METHOD 0 0 0 255 ECU_ADDRESS 0x40001361 /end MEASUREMENT
/begin MEASUREMENT engine_running_confirm_timer "undefined2" UWORD NO_COMPU_METHOD 0 0 0 65535 ECU_ADDRESS 0x4000136E /end MEASUREMENT
/begin MEASUREMENT knock_sensor_b1_dc_bias "Bank-1 knock-sensor DC bias / noise floor. Log to check knock-sensor health and the detection baseline. (V; raw*5/1023)" UWORD CM_u16_voltage_5_1023v 0 0 0 320.307917888563 ECU_ADDRESS 0x40001388 /end MEASUREMENT
/begin MEASUREMENT knock_sensor_b2_dc_bias "Bank-2 knock-sensor DC bias / noise floor. Log to check knock-sensor health. (V; raw*5/1023)" UWORD CM_u16_voltage_5_1023v 0 0 0 320.307917888563 ECU_ADDRESS 0x4000138A /end MEASUREMENT
/begin MEASUREMENT fuel_level_stable_counter "undefined1" UBYTE NO_COMPU_METHOD 0 0 0 255 ECU_ADDRESS 0x4000138C /end MEASUREMENT
/begin MEASUREMENT ign_comp_iat "i16_angle_1/4deg" SWORD CM_u8_angle_1_4deg 0 0 -8192 8191.75 ECU_ADDRESS 0x40001390 /end MEASUREMENT
/begin MEASUREMENT ign_comp_coolant "i16_angle_1/4deg" SWORD CM_u8_angle_1_4deg 0 0 -8192 8191.75 ECU_ADDRESS 0x40001392 /end MEASUREMENT
/begin MEASUREMENT ign_temp_engine_air_comp "i16_angle_1/4deg" SWORD CM_u8_angle_1_4deg 0 0 -8192 8191.75 ECU_ADDRESS 0x40001394 /end MEASUREMENT
/begin MEASUREMENT ign_comp_overtemp_base "i16_angle_1/4deg" SWORD CM_u8_angle_1_4deg 0 0 -8192 8191.75 ECU_ADDRESS 0x40001396 /end MEASUREMENT
/begin MEASUREMENT ign_comp_overtemp_coeff "undefined1" UBYTE NO_COMPU_METHOD 0 0 0 255 ECU_ADDRESS 0x40001398 /end MEASUREMENT
/begin MEASUREMENT ign_comp_temp_raw "undefined2" UWORD NO_COMPU_METHOD 0 0 0 65535 ECU_ADDRESS 0x4000139A /end MEASUREMENT
/begin MEASUREMENT ign_retard_recovery_step "undefined1" UBYTE NO_COMPU_METHOD 0 0 0 255 ECU_ADDRESS 0x4000139C /end MEASUREMENT
/begin MEASUREMENT inj_warmup_factor "u8_factor_1/64" UBYTE CM_u8_factor_1_64 0 0 0 398.4375 ECU_ADDRESS 0x400013A0 /end MEASUREMENT
/begin MEASUREMENT inj_afterstart_enrich_coolant "u8_factor_1/32" UBYTE CM_u8_factor_1_32 0 0 0 796.875 ECU_ADDRESS 0x400013A1 /end MEASUREMENT
/begin MEASUREMENT inj_afterstart_enrich_iat "u8_factor_1/32" UBYTE CM_u8_factor_1_32 0 0 0 796.875 ECU_ADDRESS 0x400013A2 /end MEASUREMENT
/begin MEASUREMENT inj_pulse_time_b1 "u16_time_us" UWORD CM_u8_time_us 0 0 0 65535 ECU_ADDRESS 0x400013A4 /end MEASUREMENT
/begin MEASUREMENT inj_pulse_time_b2 "u16_time_us" UWORD CM_u8_time_us 0 0 0 65535 ECU_ADDRESS 0x400013A6 /end MEASUREMENT
/begin MEASUREMENT inj_comp_iat "u8_factor_1/128" UBYTE CM_u8_factor_1_128 0 0 0 199.21875 ECU_ADDRESS 0x400013A8 /end MEASUREMENT
/begin MEASUREMENT soak_time_at_start "u16_time_100ms" UWORD CM_u8_time_100ms 0 0 0 6553500 ECU_ADDRESS 0x400013AA /end MEASUREMENT
/begin MEASUREMENT soak_time_remaining "u16_time_100ms" UWORD CM_u8_time_100ms 0 0 0 6553500 ECU_ADDRESS 0x400013AC /end MEASUREMENT
/begin MEASUREMENT soak_timer_tick_10hz_ "u8_time_5ms" UBYTE CM_u8_time_5ms 0 0 0 1275 ECU_ADDRESS 0x400013AE /end MEASUREMENT
/begin MEASUREMENT relay_enable_delay_timer "undefined1" UBYTE NO_COMPU_METHOD 0 0 0 255 ECU_ADDRESS 0x400013B0 /end MEASUREMENT
/begin MEASUREMENT cluster_500ms_divider "u8_count" UBYTE NO_COMPU_METHOD 0 0 0 255 ECU_ADDRESS 0x400013B1 /end MEASUREMENT
/begin MEASUREMENT cluster_lamp_test_duration "u8_time_100ms" UBYTE CM_u8_time_100ms 0 0 0 25500 ECU_ADDRESS 0x400013B2 /end MEASUREMENT
/begin MEASUREMENT cluster_lamp_test_timer "u8_time_100ms" UBYTE CM_u8_time_100ms 0 0 0 25500 ECU_ADDRESS 0x400013B3 /end MEASUREMENT
/begin MEASUREMENT exhaust_flap_commanded_state "undefined2" UWORD NO_COMPU_METHOD 0 0 0 65535 ECU_ADDRESS 0x400013B4 /end MEASUREMENT
/begin MEASUREMENT flexcan_a_tx_102_timer "undefined1" UBYTE NO_COMPU_METHOD 0 0 0 255 ECU_ADDRESS 0x400013B6 /end MEASUREMENT
/begin MEASUREMENT engine_speed_unknown "undefined1" UBYTE NO_COMPU_METHOD 0 0 0 255 ECU_ADDRESS 0x400013B7 /end MEASUREMENT
/begin MEASUREMENT inj_tip_apply_adj "Injector tip apply adj. Log to verify injector pulse width and fuel delivery vs target." UBYTE NO_COMPU_METHOD 0 0 0 255 ECU_ADDRESS 0x400013B8 /end MEASUREMENT
/begin MEASUREMENT obd_ii_stft_b1 "u8_percent_100/128-100" UBYTE CM_u8_percent_100_128_100 0 0 -100 99.21875 ECU_ADDRESS 0x400013C8 /end MEASUREMENT
/begin MEASUREMENT obd_ii_stft_b2 "u8_percent_100/128-100" UBYTE CM_u8_percent_100_128_100 0 0 -100 99.21875 ECU_ADDRESS 0x400013C9 /end MEASUREMENT
/begin MEASUREMENT obd_ii_ltft_bank_1 "u8_percent_100/128-100" UBYTE CM_u8_percent_100_128_100 0 0 -100 99.21875 ECU_ADDRESS 0x400013CA /end MEASUREMENT
/begin MEASUREMENT obd_ii_ltft_bank_2 "u8_percent_100/128-100" UBYTE CM_u8_percent_100_128_100 0 0 -100 99.21875 ECU_ADDRESS 0x400013CB /end MEASUREMENT
/begin MEASUREMENT obd_ii_DTC_current "string" ULONG NO_COMPU_METHOD 0 0 0 4294967295 ECU_ADDRESS 0x400013CC /end MEASUREMENT
/begin MEASUREMENT obd_ii_perm_dtc "string" ULONG NO_COMPU_METHOD 0 0 0 4294967295 ECU_ADDRESS 0x400013D4 /end MEASUREMENT
/begin MEASUREMENT obd_ii_DTC_confirmed "string" ULONG NO_COMPU_METHOD 0 0 0 4294967295 ECU_ADDRESS 0x400013DC /end MEASUREMENT
/begin MEASUREMENT obd_ii_DTC_pending "string" ULONG NO_COMPU_METHOD 0 0 0 4294967295 ECU_ADDRESS 0x400013E4 /end MEASUREMENT
/begin MEASUREMENT cl_ramp_interval "undefined1" UBYTE NO_COMPU_METHOD 0 0 0 255 ECU_ADDRESS 0x400013F0 /end MEASUREMENT
/begin MEASUREMENT idle_control_timer_10hz "undefined1" UBYTE NO_COMPU_METHOD 0 0 0 255 ECU_ADDRESS 0x400013FA /end MEASUREMENT
/begin MEASUREMENT knock_buffer_size "Knock buffer size. Log to catch knock events and see how much timing is being pulled." UBYTE NO_COMPU_METHOD 0 0 0 255 ECU_ADDRESS 0x40001400 /end MEASUREMENT
/begin MEASUREMENT knock_sensitivity "undefined1" UBYTE NO_COMPU_METHOD 0 0 0 255 ECU_ADDRESS 0x40001401 /end MEASUREMENT
/begin MEASUREMENT knock_peak_threshold "undefined1" UBYTE NO_COMPU_METHOD 0 0 0 255 ECU_ADDRESS 0x40001402 /end MEASUREMENT
/begin MEASUREMENT knock_retard_decay_prescaler "undefined1" UBYTE NO_COMPU_METHOD 0 0 0 255 ECU_ADDRESS 0x40001404 /end MEASUREMENT
/begin MEASUREMENT accel_pedal_mode "Pedal-interpretation mode (drive map). Log to see which response map is active." UBYTE NO_COMPU_METHOD 0 0 0 255 ECU_ADDRESS 0x40001428 /end MEASUREMENT
/begin MEASUREMENT accel_pedal_d_zero_voltage "u16_factor_1/1023" UWORD CM_u16_factor_1_1023 0 0 0 6406.15835777126 ECU_ADDRESS 0x4000142A /end MEASUREMENT
/begin MEASUREMENT accel_pedal_e_zero_voltage "undefined2" UWORD NO_COMPU_METHOD 0 0 0 65535 ECU_ADDRESS 0x4000142C /end MEASUREMENT
/begin MEASUREMENT cruise_override_release_timer "5 ms ticks, 100 = 0.5 s pedal released ends override" UBYTE NO_COMPU_METHOD 0 0 0 255 ECU_ADDRESS 0x4000142E /end MEASUREMENT
/begin MEASUREMENT cruise_override_resume_timer "500 = 2.5 s, then override ends if speed < target" UWORD NO_COMPU_METHOD 0 0 0 65535 ECU_ADDRESS 0x40001430 /end MEASUREMENT
/begin MEASUREMENT accel_pedal_zero_learn_timer "uint16_t" UWORD NO_COMPU_METHOD 0 0 0 65535 ECU_ADDRESS 0x40001432 /end MEASUREMENT
/begin MEASUREMENT evap_purge_ramp_up_step "undefined2" UWORD NO_COMPU_METHOD 0 0 0 65535 ECU_ADDRESS 0x40001438 /end MEASUREMENT
/begin MEASUREMENT evap_purge_ramp_down_step "undefined2" UWORD NO_COMPU_METHOD 0 0 0 65535 ECU_ADDRESS 0x4000143A /end MEASUREMENT
/begin MEASUREMENT evap_purge_conditioning_timer "undefined1" UBYTE NO_COMPU_METHOD 0 0 0 255 ECU_ADDRESS 0x4000143C /end MEASUREMENT
/begin MEASUREMENT obd_ii_P0806_clutch_voltage_min_seen "u16_voltage_5/1023v" UWORD CM_u16_voltage_5_1023v 0 0 0 320.307917888563 ECU_ADDRESS 0x4000144A /end MEASUREMENT
/begin MEASUREMENT cam_park_position_max_inlet_b1 "u16_angle_1/4deg" UWORD CM_u8_angle_1_4deg 0 0 0 16383.75 ECU_ADDRESS 0x40001458 /end MEASUREMENT
/begin MEASUREMENT cam_park_position_max_inlet_b2 "u16_angle_1/4deg" UWORD CM_u8_angle_1_4deg 0 0 0 16383.75 ECU_ADDRESS 0x4000145A /end MEASUREMENT
/begin MEASUREMENT cam_park_position_max_exhaust_b1 "undefined2" UWORD NO_COMPU_METHOD 0 0 0 65535 ECU_ADDRESS 0x4000145C /end MEASUREMENT
/begin MEASUREMENT cam_park_position_max_exhaust_b2 "undefined2" UWORD NO_COMPU_METHOD 0 0 0 65535 ECU_ADDRESS 0x4000145E /end MEASUREMENT
/begin MEASUREMENT cam_park_position_min_inlet_b1 "u16_angle_1/4deg" UWORD CM_u8_angle_1_4deg 0 0 0 16383.75 ECU_ADDRESS 0x40001460 /end MEASUREMENT
/begin MEASUREMENT cam_park_position_min_inlet_b2 "u16_angle_1/4deg" UWORD CM_u8_angle_1_4deg 0 0 0 16383.75 ECU_ADDRESS 0x40001462 /end MEASUREMENT
/begin MEASUREMENT cam_park_position_min_exhauswt_b1 "undefined2" UWORD NO_COMPU_METHOD 0 0 0 65535 ECU_ADDRESS 0x40001464 /end MEASUREMENT
/begin MEASUREMENT cam_park_position_min_exhaust_b2 "undefined2" UWORD NO_COMPU_METHOD 0 0 0 65535 ECU_ADDRESS 0x40001466 /end MEASUREMENT
/begin MEASUREMENT vvt_duty_inlet_b1 "u16_factor_1/1000" UWORD CM_u16_factor_1_1000 0 0 0 6553.5 ECU_ADDRESS 0x40001468 /end MEASUREMENT
/begin MEASUREMENT vvt_duty_inlet_b2 "u16_factor_1/1000" UWORD CM_u16_factor_1_1000 0 0 0 6553.5 ECU_ADDRESS 0x4000146A /end MEASUREMENT
/begin MEASUREMENT vvt_duty_exhaust_b1 "u16_factor_1/1000" UWORD CM_u16_factor_1_1000 0 0 0 6553.5 ECU_ADDRESS 0x4000146C /end MEASUREMENT
/begin MEASUREMENT vvt_duty_exhaust_b2 "u16_factor_1/1000" UWORD CM_u16_factor_1_1000 0 0 0 6553.5 ECU_ADDRESS 0x4000146E /end MEASUREMENT
/begin MEASUREMENT tps_warmup_limit_timer "undefined1" UBYTE NO_COMPU_METHOD 0 0 0 255 ECU_ADDRESS 0x40001470 /end MEASUREMENT
/begin MEASUREMENT throttle_actuator_activity "Throttle actuator activity. Runtime state -- log to observe this behavior." UBYTE NO_COMPU_METHOD 0 0 0 255 ECU_ADDRESS 0x40001471 /end MEASUREMENT
/begin MEASUREMENT lfb_tps_max "undefined2" UWORD NO_COMPU_METHOD 0 0 0 65535 ECU_ADDRESS 0x40001472 /end MEASUREMENT
/begin MEASUREMENT etb_low_voltage_debounce_counter "u8_count" UBYTE NO_COMPU_METHOD 0 0 0 255 ECU_ADDRESS 0x40001478 /end MEASUREMENT
/begin MEASUREMENT lfb_requires_init "Long-term fuel requires init. Log to track long-term fuel learning and spot a developing fuel fault." UBYTE NO_COMPU_METHOD 0 0 0 255 ECU_ADDRESS 0x40001479 /end MEASUREMENT
/begin MEASUREMENT knock_sampling_active "Knock sampling active. Log to catch knock events and see how much timing is being pulled." UBYTE NO_COMPU_METHOD 0 0 0 255 ECU_ADDRESS 0x40001480 /end MEASUREMENT
/begin MEASUREMENT knock_agc_reference_level_ "undefined1" UBYTE NO_COMPU_METHOD 0 0 0 255 ECU_ADDRESS 0x40001482 /end MEASUREMENT
/begin MEASUREMENT knock_window_irq_phase "undefined1" UBYTE NO_COMPU_METHOD 0 0 0 255 ECU_ADDRESS 0x40001483 /end MEASUREMENT
/begin MEASUREMENT ccp_tx_watchdog_timer "uint8_t" UBYTE NO_COMPU_METHOD 0 0 0 255 ECU_ADDRESS 0x40001488 /end MEASUREMENT
/begin MEASUREMENT airtemp_ambient "Intake-air temperature. Log it to see charge-air heating and its effect on fueling and timing pull. (deg C; raw*5/8-40)" UBYTE CM_u8_temp_5_8_40c 0 0 -40 119.375 ECU_ADDRESS 0x400014A0 /end MEASUREMENT
/begin MEASUREMENT ambient_air_temp_unscaled "undefined1" UBYTE NO_COMPU_METHOD 0 0 0 255 ECU_ADDRESS 0x400014A1 /end MEASUREMENT
/begin MEASUREMENT torque_request1 "undefined2" UWORD NO_COMPU_METHOD 0 0 0 65535 ECU_ADDRESS 0x400014A2 /end MEASUREMENT
/begin MEASUREMENT torque_request2 "undefined2" UWORD NO_COMPU_METHOD 0 0 0 65535 ECU_ADDRESS 0x400014A4 /end MEASUREMENT
/begin MEASUREMENT torque_request3 "undefined2" UWORD NO_COMPU_METHOD 0 0 0 65535 ECU_ADDRESS 0x400014A6 /end MEASUREMENT
/begin MEASUREMENT cruise_button_tap_delay "reload 3" UBYTE NO_COMPU_METHOD 0 0 0 255 ECU_ADDRESS 0x400014A8 /end MEASUREMENT
/begin MEASUREMENT cruise_invalid_switch_delay_unused "reset to 3 every pass, ==0 test never fires" UBYTE NO_COMPU_METHOD 0 0 0 255 ECU_ADDRESS 0x400014A9 /end MEASUREMENT
/begin MEASUREMENT cruise_button_repeat_delay_reload "init 110 = 0.55 s" UBYTE NO_COMPU_METHOD 0 0 0 255 ECU_ADDRESS 0x400014AA /end MEASUREMENT
/begin MEASUREMENT cruise_button_repeat_delay "uint8_t" UBYTE NO_COMPU_METHOD 0 0 0 255 ECU_ADDRESS 0x400014AB /end MEASUREMENT
/begin MEASUREMENT cruise_10hz_divider "uint8_t" UBYTE NO_COMPU_METHOD 0 0 0 255 ECU_ADDRESS 0x400014AC /end MEASUREMENT
/begin MEASUREMENT cruise_2hz_divider "uint8_t" UBYTE NO_COMPU_METHOD 0 0 0 255 ECU_ADDRESS 0x400014AD /end MEASUREMENT
/begin MEASUREMENT cruise_40hz_divider "uint8_t" UBYTE NO_COMPU_METHOD 0 0 0 255 ECU_ADDRESS 0x400014AE /end MEASUREMENT
/begin MEASUREMENT cruise_airflow_base "0xFFFF = init from maf_flow_1 (bumpless engage)" UWORD CM_u16_flow_10mg_s 0 0 0 655350 ECU_ADDRESS 0x400014B0 /end MEASUREMENT
/begin MEASUREMENT cruise_min_engage_gear "Cruise min engage gear. Log to debug cruise engagement and speed holding." UBYTE NO_COMPU_METHOD 0 0 0 255 ECU_ADDRESS 0x400014B2 /end MEASUREMENT
/begin MEASUREMENT cruise_rpm_max_cancel_scale "init 208 (engage uses 200)" UBYTE NO_COMPU_METHOD 0 0 0 255 ECU_ADDRESS 0x400014B3 /end MEASUREMENT
/begin MEASUREMENT cruise_rpm_min_cancel_scale "init 192 (engage uses 200)" UBYTE NO_COMPU_METHOD 0 0 0 255 ECU_ADDRESS 0x400014B4 /end MEASUREMENT
/begin MEASUREMENT cruise_tps_request_max "init 1000, integrator anti-windup" UWORD NO_COMPU_METHOD 0 0 0 65535 ECU_ADDRESS 0x400014B6 /end MEASUREMENT
/begin MEASUREMENT cruise_airflow_base_at_engage "u16_flow_10mg/s" UWORD CM_u16_flow_10mg_s 0 0 0 655350 ECU_ADDRESS 0x400014B8 /end MEASUREMENT
/begin MEASUREMENT torque_limit_tps_current "u16_factor_1/1023" UWORD CM_u16_factor_1_1023 0 0 0 6406.15835777126 ECU_ADDRESS 0x400014C0 /end MEASUREMENT
/begin MEASUREMENT torque_limit_external_request "Torque limit external gross. Log to follow the ECU torque estimate and any torque limiting. (Nm)" UWORD CM_u8_torque_nm 0 0 0 65535 ECU_ADDRESS 0x400014C2 /end MEASUREMENT
/begin MEASUREMENT torque_external_request_tps_based "Torque limit tps2. Log to follow the ECU torque estimate and any torque limiting. (Nm)" UWORD CM_u8_torque_nm 0 0 0 65535 ECU_ADDRESS 0x400014C4 /end MEASUREMENT
/begin MEASUREMENT torque_limit_external_tc_fast "Torque limit external traction-control fast. Log to follow the ECU torque estimate and any torque limiting. (Nm)" UWORD CM_u8_torque_nm 0 0 0 65535 ECU_ADDRESS 0x400014C6 /end MEASUREMENT
/begin MEASUREMENT torque_limit_external_esp_fast "Torque limit external ESP fast. Log to follow the ECU torque estimate and any torque limiting. (Nm)" UWORD CM_u8_torque_nm 0 0 0 65535 ECU_ADDRESS 0x400014C8 /end MEASUREMENT
/begin MEASUREMENT torque_limit_external_tc_slow "Torque limit external traction-control slow. Log to follow the ECU torque estimate and any torque limiting. (Nm)" UWORD CM_u8_torque_nm 0 0 0 65535 ECU_ADDRESS 0x400014CA /end MEASUREMENT
/begin MEASUREMENT torque_limit_tcu_0xc7_raw "u16_torque_nm" UWORD CM_u8_torque_nm 0 0 0 65535 ECU_ADDRESS 0x400014CC /end MEASUREMENT
/begin MEASUREMENT torque_requested_during_shift_raw "u16_torque_nm" UWORD CM_u8_torque_nm 0 0 0 65535 ECU_ADDRESS 0x400014D0 /end MEASUREMENT
/begin MEASUREMENT torque_requested_during_shift_scaled "u16_torque_nm" UWORD CM_u8_torque_nm 0 0 0 65535 ECU_ADDRESS 0x400014D2 /end MEASUREMENT
/begin MEASUREMENT torque_limit_external_applied "u16_torque_nm" UWORD CM_u8_torque_nm 0 0 0 65535 ECU_ADDRESS 0x400014D4 /end MEASUREMENT
/begin MEASUREMENT torque_reduction_factor_ign "Torque reduction factor ignition. Log spark advance to confirm the timing strategy and headroom to knock. (0-1; raw/255)" UBYTE CM_u8_factor_1_255 0 0 0 100 ECU_ADDRESS 0x400014DA /end MEASUREMENT
/begin MEASUREMENT torque_spark_efficiency_slope "undefined2" UWORD NO_COMPU_METHOD 0 0 0 65535 ECU_ADDRESS 0x400014DC /end MEASUREMENT
/begin MEASUREMENT torque_spark_efficiency_current "u8_factor_1/255" UBYTE CM_u8_factor_1_255 0 0 0 100 ECU_ADDRESS 0x400014DE /end MEASUREMENT
/begin MEASUREMENT torque_spark_efficiency_at_limit "Torque spark efficiency at limit. Log to follow the ECU torque estimate and any torque limiting. (0-1; raw/255)" UBYTE CM_u8_factor_1_255 0 0 0 100 ECU_ADDRESS 0x400014DF /end MEASUREMENT
/begin MEASUREMENT torque_efficiency_factor_at_limit "undefined1" UBYTE NO_COMPU_METHOD 0 0 0 255 ECU_ADDRESS 0x400014E0 /end MEASUREMENT
/begin MEASUREMENT load_to_tps "u16_factor_1/1023" UWORD CM_u16_factor_1_1023 0 0 0 6406.15835777126 ECU_ADDRESS 0x400014E2 /end MEASUREMENT
/begin MEASUREMENT load_to_tps_trim_factor "u16_factor_1/100" UWORD CM_u8_factor_1_100 0 0 0 65535 ECU_ADDRESS 0x400014E4 /end MEASUREMENT
/begin MEASUREMENT torque_cruise_request "Torque cruise request. Log to follow the ECU torque estimate and any torque limiting. (Nm)" UWORD CM_u8_torque_nm 0 0 0 65535 ECU_ADDRESS 0x400014E6 /end MEASUREMENT
/begin MEASUREMENT torque_limit_arbitrated_fast "u16_torque_nm" UWORD CM_u8_torque_nm 0 0 0 65535 ECU_ADDRESS 0x400014E8 /end MEASUREMENT
/begin MEASUREMENT torque_limit_arbitrated_slow "u16_torque_nm" UWORD CM_u8_torque_nm 0 0 0 65535 ECU_ADDRESS 0x400014EA /end MEASUREMENT
/begin MEASUREMENT torque_limit_0xb7_fast_validated "u16_torque_nm" UWORD CM_u8_torque_nm 0 0 0 65535 ECU_ADDRESS 0x400014EC /end MEASUREMENT
/begin MEASUREMENT torque_limit_0xb7_slow_validated "u16_torque_nm" UWORD CM_u8_torque_nm 0 0 0 65535 ECU_ADDRESS 0x400014EE /end MEASUREMENT
/begin MEASUREMENT torque_limit_arbitrary_end_of_pass_unuised "u16_torque_nm" UWORD CM_u8_torque_nm 0 0 0 65535 ECU_ADDRESS 0x400014F0 /end MEASUREMENT
/begin MEASUREMENT torque_limit_tcu_0xc7_validated "u16_torque_nm" UWORD CM_u8_torque_nm 0 0 0 65535 ECU_ADDRESS 0x400014F2 /end MEASUREMENT
/begin MEASUREMENT torque_limit_ips_shift_fast "u16_torque_nm" UWORD CM_u8_torque_nm 0 0 0 65535 ECU_ADDRESS 0x400014F4 /end MEASUREMENT
/begin MEASUREMENT torque_limit_ips_shift_slow "u16_torque_nm" UWORD CM_u8_torque_nm 0 0 0 65535 ECU_ADDRESS 0x400014F6 /end MEASUREMENT
/begin MEASUREMENT torque_task_rate_divider "undefined1" UBYTE NO_COMPU_METHOD 0 0 0 255 ECU_ADDRESS 0x400014F8 /end MEASUREMENT
/begin MEASUREMENT ac_10hz_timer "A/C 10hz timer. Log to see A/C clutch engagement and its load/idle impact. (ms; raw*5)" UBYTE CM_u8_time_5ms 0 0 0 1275 ECU_ADDRESS 0x40001500 /end MEASUREMENT
/begin MEASUREMENT ac_compressor_soft_engage_timer "undefined1" UBYTE NO_COMPU_METHOD 0 0 0 255 ECU_ADDRESS 0x40001503 /end MEASUREMENT
/begin MEASUREMENT revlimit_integral_windup_tps_max "u16_factor_1/1023" UWORD CM_u16_factor_1_1023 0 0 0 6406.15835777126 ECU_ADDRESS 0x40001512 /end MEASUREMENT
/begin MEASUREMENT speed_limit_target_ramped "Speed limit target ramped. Log vehicle speed for speed-based logic and limiters. (km/h; raw/100)" UWORD CM_u8_speed_1_100kph 0 0 0 655.35 ECU_ADDRESS 0x40001514 /end MEASUREMENT
/begin MEASUREMENT revlimit_car_speed_limit "Revlimit car speed limit. Log to confirm where and how the rev limiter intervenes. (km/h; raw/100)" UWORD CM_u8_speed_1_100kph 0 0 0 655.35 ECU_ADDRESS 0x40001516 /end MEASUREMENT
/begin MEASUREMENT yaw_sensor_can_status_flags "undefined1" UBYTE NO_COMPU_METHOD 0 0 0 255 ECU_ADDRESS 0x40001518 /end MEASUREMENT
/begin MEASUREMENT steering_angle_rate "undefined1" UBYTE NO_COMPU_METHOD 0 0 0 255 ECU_ADDRESS 0x40001520 /end MEASUREMENT
/begin MEASUREMENT p0316_eval_tc_request_state "P0316 eval traction-control request state. Runtime state -- log to observe this behavior." UBYTE NO_COMPU_METHOD 0 0 0 255 ECU_ADDRESS 0x40001521 /end MEASUREMENT
/begin MEASUREMENT ips_torque_blend_exit_delta "u16_torque_nm" UWORD CM_u8_torque_nm 0 0 0 65535 ECU_ADDRESS 0x4000152C /end MEASUREMENT
/begin MEASUREMENT ips_speed_match_converge_timer "u16_time_ms" UWORD CM_u8_time_ms 0 0 0 65535 ECU_ADDRESS 0x4000152E /end MEASUREMENT
/begin MEASUREMENT ips_shift_active_lost_timer "u8_time_ms" UBYTE CM_u8_time_ms 0 0 0 255 ECU_ADDRESS 0x40001530 /end MEASUREMENT
/begin MEASUREMENT ips_torque_blend_alpha "u8_factor_1/2560" UBYTE CM_u8_factor_1_2560 0 0 0 9.9609375 ECU_ADDRESS 0x40001531 /end MEASUREMENT
/begin MEASUREMENT ips_torque_blend_enable "bool" UBYTE NO_COMPU_METHOD 0 0 0 255 ECU_ADDRESS 0x40001532 /end MEASUREMENT
/begin MEASUREMENT flash_driver_init_status "pointer" ULONG NO_COMPU_METHOD 0 0 0 4294967295 ECU_ADDRESS 0x40001538 /end MEASUREMENT
/begin MEASUREMENT flash_erase_pending_flags "undefined1" UBYTE NO_COMPU_METHOD 0 0 0 255 ECU_ADDRESS 0x40001560 /end MEASUREMENT
/begin MEASUREMENT crank_cycle_position "undefined2" UWORD NO_COMPU_METHOD 0 0 0 65535 ECU_ADDRESS 0x40001564 /end MEASUREMENT
/begin MEASUREMENT ecu_unlocked "Flag: ECU is in unlocked/dev mode. Log to know when privileged access is active." UBYTE NO_COMPU_METHOD 0 0 0 255 ECU_ADDRESS 0x40001568 /end MEASUREMENT
/begin MEASUREMENT stack_peak_found "bool" UBYTE NO_COMPU_METHOD 0 0 0 255 ECU_ADDRESS 0x40001570 /end MEASUREMENT
/begin MEASUREMENT stack_peak_usage "uint32_t" ULONG NO_COMPU_METHOD 0 0 0 4294967295 ECU_ADDRESS 0x40001574 /end MEASUREMENT
/begin MEASUREMENT stack_peak_addr "Addr. Runtime state -- log to observe this behavior." ULONG NO_COMPU_METHOD 0 0 0 4294967295 ECU_ADDRESS 0x40001578 /end MEASUREMENT
/begin MEASUREMENT diag_test_trim_unknown "undefined1" UBYTE NO_COMPU_METHOD 0 0 0 255 ECU_ADDRESS 0x4000157C /end MEASUREMENT
/begin MEASUREMENT inj_bank_balance_test_trim "undefined1" UBYTE NO_COMPU_METHOD 0 0 0 255 ECU_ADDRESS 0x4000157D /end MEASUREMENT
/begin MEASUREMENT vvt_exhaust_fallback_angle_zero "u8_angle_1/4-10deg" UBYTE CM_u8_angle_1_4_10deg 0 0 -10 53.75 ECU_ADDRESS 0x4000157E /end MEASUREMENT
/begin MEASUREMENT afr_target_trim_0p02_steps "undefined1" UBYTE NO_COMPU_METHOD 0 0 0 255 ECU_ADDRESS 0x4000157F /end MEASUREMENT
/begin MEASUREMENT vvt_intake_fallback_angle_zero "undefined1" UBYTE NO_COMPU_METHOD 0 0 0 255 ECU_ADDRESS 0x40001580 /end MEASUREMENT
/begin MEASUREMENT inj_angle_test_trim "u8_angle_720/256deg" UBYTE CM_u8_angle_720_256deg 0 0 0 717.1875 ECU_ADDRESS 0x40001581 /end MEASUREMENT
/begin MEASUREMENT ign_advance_test_trim "u8_angle_1/8-16deg" UBYTE CM_u8_angle_1_8_16deg 0 0 -16 15.875 ECU_ADDRESS 0x40001582 /end MEASUREMENT
/begin MEASUREMENT inj_efficiency_test_trim "undefined1" UBYTE NO_COMPU_METHOD 0 0 0 255 ECU_ADDRESS 0x40001583 /end MEASUREMENT
/begin MEASUREMENT timer_main "undefined4" ULONG NO_COMPU_METHOD 0 0 0 4294967295 ECU_ADDRESS 0x40001584 /end MEASUREMENT
/begin MEASUREMENT tps_rate_filtered_for_ign_comp "uint16_t" UWORD NO_COMPU_METHOD 0 0 0 65535 ECU_ADDRESS 0x40001588 /end MEASUREMENT
/begin MEASUREMENT ecu_run_timer "ECU run timer. Mostly housekeeping/diagnostic state." UWORD NO_COMPU_METHOD 0 0 0 65535 ECU_ADDRESS 0x4000158A /end MEASUREMENT
/begin MEASUREMENT dfco_pedal_ramp_target2 "undefined2" UWORD NO_COMPU_METHOD 0 0 0 65535 ECU_ADDRESS 0x4000158C /end MEASUREMENT
/begin MEASUREMENT dfco_duration_timer "u16_time_5ms" UWORD CM_u8_time_5ms 0 0 0 327675 ECU_ADDRESS 0x4000158E /end MEASUREMENT
/begin MEASUREMENT ign_dfco_recovery_hold_timer "Fuel cut inhibit timer. Log to follow fuel delivery and mixture control. (ms; raw*5)" UWORD CM_u8_time_5ms 0 0 0 327675 ECU_ADDRESS 0x40001590 /end MEASUREMENT
/begin MEASUREMENT fan_1_after_run_timer "Fan 1 after run timer. Timer/counter -- log to measure how long a condition persists. (s)" UWORD CM_u8_time_5ms 0 0 0 327675 ECU_ADDRESS 0x40001592 /end MEASUREMENT
/begin MEASUREMENT fan_2_after_run_timer "Fan 2 after run timer. Runtime state -- log to observe this behavior." UWORD CM_u8_time_5ms 0 0 0 327675 ECU_ADDRESS 0x40001594 /end MEASUREMENT
/begin MEASUREMENT fan_engine_bay_aux_timer "Fan engine bay aux timer. Log to follow core engine state." UWORD CM_u8_time_5ms 0 0 0 327675 ECU_ADDRESS 0x40001596 /end MEASUREMENT
/begin MEASUREMENT tps_delta_rate "uint16_t" UWORD NO_COMPU_METHOD 0 0 0 65535 ECU_ADDRESS 0x40001598 /end MEASUREMENT
/begin MEASUREMENT tps_rate_current "Rate of throttle change. Log to study tip-in/tip-out transients. (0-1; raw/255)" UWORD CM_u8_factor_1_255 0 0 0 25700 ECU_ADDRESS 0x4000159A /end MEASUREMENT
/begin MEASUREMENT fan_1_on_timer "u8_time_10ms" UBYTE CM_u8_time_10ms 0 0 0 2550 ECU_ADDRESS 0x4000159C /end MEASUREMENT
/begin MEASUREMENT fan_2_on_timer "u8_time_10ms" UBYTE CM_u8_time_10ms 0 0 0 2550 ECU_ADDRESS 0x4000159D /end MEASUREMENT
/begin MEASUREMENT fan_engine_bay_ramp_timer "u8_time_10ms" UBYTE CM_u8_time_10ms 0 0 0 2550 ECU_ADDRESS 0x4000159E /end MEASUREMENT
/begin MEASUREMENT maf_accumulated_2 "Running total of inducted air mass. Log for fuel-used / integrated-airflow analysis. (g)" UWORD CM_u16_mass_g 0 0 0 65535 ECU_ADDRESS 0x400015A0 /end MEASUREMENT
/begin MEASUREMENT fuel_level "Fuel level in litres. Log for range/consumption tracking. (L)" UBYTE CM_u8_volume_liter 0 0 0 255 ECU_ADDRESS 0x400015A2 /end MEASUREMENT
/begin MEASUREMENT load_learning_stabilization_timer "u16_time_5ms" UWORD CM_u8_time_5ms 0 0 0 327675 ECU_ADDRESS 0x400015A4 /end MEASUREMENT
/begin MEASUREMENT obd_ii_accumulated_mass_air "undefined4" ULONG NO_COMPU_METHOD 0 0 0 4294967295 ECU_ADDRESS 0x400015A8 /end MEASUREMENT
/begin MEASUREMENT cooling_recirc_pump_run_time_ms "uint32_t" ULONG NO_COMPU_METHOD 0 0 0 4294967295 ECU_ADDRESS 0x400015B4 /end MEASUREMENT
/begin MEASUREMENT cooling_recirc_pump_stopped_dwell_timer "undefined2" UWORD NO_COMPU_METHOD 0 0 0 65535 ECU_ADDRESS 0x400015B8 /end MEASUREMENT
/begin MEASUREMENT injtip_overrun_hysteresis_timer "u16_time_5ms" UWORD CM_u8_time_5ms 0 0 0 327675 ECU_ADDRESS 0x400015BA /end MEASUREMENT
/begin MEASUREMENT fan_engine_bay_engine_off_timer "undefined2" UWORD NO_COMPU_METHOD 0 0 0 65535 ECU_ADDRESS 0x400015BC /end MEASUREMENT
/begin MEASUREMENT fan_engine_bay_stationary_timer "undefined2" UWORD NO_COMPU_METHOD 0 0 0 65535 ECU_ADDRESS 0x400015BE /end MEASUREMENT
/begin MEASUREMENT fan_engine_bay_run_duration_timer "u16_time_100ms" UWORD CM_u8_time_100ms 0 0 0 6553500 ECU_ADDRESS 0x400015C0 /end MEASUREMENT
/begin MEASUREMENT fan_engine_bay_off_duration_timer "undefined2" UWORD NO_COMPU_METHOD 0 0 0 65535 ECU_ADDRESS 0x400015C2 /end MEASUREMENT
/begin MEASUREMENT engine_speed_delta100ms "Change in RPM over 100 ms (acceleration/deceleration rate). Log to see how fast revs rise/fall." UWORD CM_u8_rspeed_rpm 0 0 0 65535 ECU_ADDRESS 0x400015C4 /end MEASUREMENT
/begin MEASUREMENT ign_on_engine_stopped_time "u32_time_5ms" ULONG CM_u8_time_5ms 0 0 0 21474836475 ECU_ADDRESS 0x400015CC /end MEASUREMENT
/begin MEASUREMENT injtip_decay_cycle_counter "uint16_t" UWORD NO_COMPU_METHOD 0 0 0 65535 ECU_ADDRESS 0x400015D0 /end MEASUREMENT
/begin MEASUREMENT load_learning_holdoff_timer "u16_time_5ms" UWORD CM_u8_time_5ms 0 0 0 327675 ECU_ADDRESS 0x400015D2 /end MEASUREMENT
/begin MEASUREMENT ips_cruise_status_flags "undefined1" UBYTE NO_COMPU_METHOD 0 0 0 255 ECU_ADDRESS 0x400015D5 /end MEASUREMENT
/begin MEASUREMENT dfco_pedal_ramp_step_interval "undefined1" UBYTE NO_COMPU_METHOD 0 0 0 255 ECU_ADDRESS 0x400015D6 /end MEASUREMENT
/begin MEASUREMENT task_timing_stats_reset_request "bool" UBYTE NO_COMPU_METHOD 0 0 0 255 ECU_ADDRESS 0x400015D7 /end MEASUREMENT
/begin MEASUREMENT etpu_elapsed_min_ticks "undefined4" ULONG NO_COMPU_METHOD 0 0 0 4294967295 ECU_ADDRESS 0x400015E8 /end MEASUREMENT
/begin MEASUREMENT etpu_elapsed_max_captured_ticks "undefined4" ULONG NO_COMPU_METHOD 0 0 0 4294967295 ECU_ADDRESS 0x400015EC /end MEASUREMENT
/begin MEASUREMENT runtime_since_start "Time since the current engine start. Log as a time base for traces. (ms; raw*5)" ULONG CM_u8_time_5ms 0 0 0 21474836475 ECU_ADDRESS 0x400015F4 /end MEASUREMENT
/begin MEASUREMENT obd_ii_vvt_inlet_angle_bank2 "u16_angle_1/4deg" UWORD CM_u8_angle_1_4deg 0 0 0 16383.75 ECU_ADDRESS 0x400015FA /end MEASUREMENT
/begin MEASUREMENT obd_ii_vvt_exhaust_position_bank2 "undefined2" UWORD NO_COMPU_METHOD 0 0 0 65535 ECU_ADDRESS 0x400015FC /end MEASUREMENT
/begin MEASUREMENT obd_ii_vvt_inlet_position_bank1 "u16_angle_1/4deg" UWORD CM_u8_angle_1_4deg 0 0 0 16383.75 ECU_ADDRESS 0x400015FE /end MEASUREMENT
/begin MEASUREMENT obd_ii_vvt_exhaust_position_bank1 "undefined2" UWORD NO_COMPU_METHOD 0 0 0 65535 ECU_ADDRESS 0x40001600 /end MEASUREMENT
/begin MEASUREMENT ign_static_timing_enable "undefined2" UWORD NO_COMPU_METHOD 0 0 0 65535 ECU_ADDRESS 0x40001608 /end MEASUREMENT
/begin MEASUREMENT maf_voltage_buffer_head "undefined2" UWORD NO_COMPU_METHOD 0 0 0 65535 ECU_ADDRESS 0x4000160A /end MEASUREMENT
/begin MEASUREMENT map_voltage_buffer_index "undefined2" UWORD NO_COMPU_METHOD 0 0 0 65535 ECU_ADDRESS 0x4000160C /end MEASUREMENT
/begin MEASUREMENT cal_verification_lockout "Cal verification lockout. Runtime state -- log to observe this behavior." UBYTE NO_COMPU_METHOD 0 0 0 255 ECU_ADDRESS 0x4000160E /end MEASUREMENT
/begin MEASUREMENT slow_period_update_divider "undefined1" UBYTE NO_COMPU_METHOD 0 0 0 255 ECU_ADDRESS 0x4000160F /end MEASUREMENT
/begin MEASUREMENT engine_sync_reset_count "uint8_t" UBYTE NO_COMPU_METHOD 0 0 0 255 ECU_ADDRESS 0x40001612 /end MEASUREMENT
/begin MEASUREMENT unused_mem1byte "undefined" ULONG NO_COMPU_METHOD 0 0 0 4294967295 ECU_ADDRESS 0x40001613 /end MEASUREMENT
/begin MEASUREMENT torque_cut_level_prev "Torque cut level prev. Log to follow the ECU torque estimate and any torque limiting." UBYTE NO_COMPU_METHOD 0 0 0 255 ECU_ADDRESS 0x4000161E /end MEASUREMENT
/begin MEASUREMENT torque_cut_remaining_cyl_count "undefined1" UBYTE NO_COMPU_METHOD 0 0 0 255 ECU_ADDRESS 0x4000161F /end MEASUREMENT
/begin MEASUREMENT torque_cut_coilpack_failure_mask "undefined1" UBYTE NO_COMPU_METHOD 0 0 0 255 ECU_ADDRESS 0x40001620 /end MEASUREMENT
/begin MEASUREMENT failed_ignition_cyl_count_prev "Failed ignition cylinder count prev. Runtime state -- log to observe this behavior." UBYTE NO_COMPU_METHOD 0 0 0 255 ECU_ADDRESS 0x40001621 /end MEASUREMENT
/begin MEASUREMENT torque_cut_cyl_anchor "uint16_t" UWORD NO_COMPU_METHOD 0 0 0 65535 ECU_ADDRESS 0x40001622 /end MEASUREMENT
/begin MEASUREMENT crank_sync_prev_cylinder_idx "undefined1" UBYTE NO_COMPU_METHOD 0 0 0 255 ECU_ADDRESS 0x40001624 /end MEASUREMENT
/begin MEASUREMENT ign_cyl_active_count_bank2 "u8_count" UBYTE NO_COMPU_METHOD 0 0 0 255 ECU_ADDRESS 0x4000162D /end MEASUREMENT
/begin MEASUREMENT ign_cyl_active_count_bank1 "u8_count" UBYTE NO_COMPU_METHOD 0 0 0 255 ECU_ADDRESS 0x4000162E /end MEASUREMENT
/begin MEASUREMENT ign_cyl_cut_flags "uint8_t" UBYTE NO_COMPU_METHOD 0 0 0 255 ECU_ADDRESS 0x4000162F /end MEASUREMENT
/begin MEASUREMENT next_firing_cyl_index "Next firing cylinder index. Runtime state -- log to observe this behavior." UBYTE NO_COMPU_METHOD 0 0 0 255 ECU_ADDRESS 0x40001630 /end MEASUREMENT
/begin MEASUREMENT idle_speed_period_delta "undefined4" ULONG NO_COMPU_METHOD 0 0 0 4294967295 ECU_ADDRESS 0x40001634 /end MEASUREMENT
/begin MEASUREMENT engine_is_running "Flag: engine is running. Log as a state gate for other channels." UBYTE NO_COMPU_METHOD 0 0 0 255 ECU_ADDRESS 0x40001638 /end MEASUREMENT
/begin MEASUREMENT engine_speed_16bit "Engine speed (RPM). Log it -- the primary reference for almost every other channel." UWORD CM_u8_rspeed_rpm 0 0 0 65535 ECU_ADDRESS 0x4000163A /end MEASUREMENT
/begin MEASUREMENT obd_ii_engine_speed "Engine speed as reported on OBD-II (0.25-RPM units). Log to match scan-tool data." UWORD CM_u16_rspeed_1_4rpm 0 0 0 16383.75 ECU_ADDRESS 0x4000163C /end MEASUREMENT
/begin MEASUREMENT air_temp_engine_stopped "Intake-air temperature latched at key-off. Log to study soak temperatures. (deg C; raw*5/8-40)" UBYTE CM_u8_temp_5_8_40c 0 0 -40 119.375 ECU_ADDRESS 0x4000163E /end MEASUREMENT
/begin MEASUREMENT coolant_temp_engine_stopped "Coolant temperature latched at the last key-off. Log to study heat-soak between starts. (deg C; raw*5/8-40)" UBYTE CM_u8_temp_5_8_40c 0 0 -40 119.375 ECU_ADDRESS 0x4000163F /end MEASUREMENT
/begin MEASUREMENT engine_speed_3 "Engine speed (coarse 8-bit). A lower-resolution RPM copy." UBYTE CM_u8_rspeed_125_4_500rpm 0 0 500 8468.75 ECU_ADDRESS 0x40001640 /end MEASUREMENT
/begin MEASUREMENT engine_speed_period_1 "undefined4" ULONG NO_COMPU_METHOD 0 0 0 4294967295 ECU_ADDRESS 0x40001644 /end MEASUREMENT
/begin MEASUREMENT engine_speed_period_2 "undefined4" ULONG NO_COMPU_METHOD 0 0 0 4294967295 ECU_ADDRESS 0x40001648 /end MEASUREMENT
/begin MEASUREMENT engine_speed_period_avg "undefined2" UWORD NO_COMPU_METHOD 0 0 0 65535 ECU_ADDRESS 0x4000164C /end MEASUREMENT
/begin MEASUREMENT engine_speed_accel "u32_rspeed_accel_1/168" ULONG CM_u8_rspeed_accel_1_168 0 0 0 4294967295 ECU_ADDRESS 0x40001650 /end MEASUREMENT
/begin MEASUREMENT injection_flags "undefined2" UWORD NO_COMPU_METHOD 0 0 0 65535 ECU_ADDRESS 0x40001654 /end MEASUREMENT
/begin MEASUREMENT dfco_active_duration_time "undefined2" UWORD NO_COMPU_METHOD 0 0 0 65535 ECU_ADDRESS 0x40001656 /end MEASUREMENT
/begin MEASUREMENT cam_exh_b2_edge_status "undefined1" UBYTE NO_COMPU_METHOD 0 0 0 255 ECU_ADDRESS 0x4000166B /end MEASUREMENT
/begin MEASUREMENT cam_exh_b2_edge_polarity "undefined1" UBYTE NO_COMPU_METHOD 0 0 0 255 ECU_ADDRESS 0x40001673 /end MEASUREMENT
/begin MEASUREMENT cam_exh_b2_delta_angle "undefined2" UWORD NO_COMPU_METHOD 0 0 0 65535 ECU_ADDRESS 0x40001678 /end MEASUREMENT
/begin MEASUREMENT cam_exh_b2_last_angle "undefined2" UWORD NO_COMPU_METHOD 0 0 0 65535 ECU_ADDRESS 0x40001688 /end MEASUREMENT
/begin MEASUREMENT engine_running_state "undefined1" UBYTE NO_COMPU_METHOD 0 0 0 255 ECU_ADDRESS 0x400016B0 /end MEASUREMENT
/begin MEASUREMENT crank_tooth_counter "undefined2" UWORD NO_COMPU_METHOD 0 0 0 65535 ECU_ADDRESS 0x400016B4 /end MEASUREMENT
/begin MEASUREMENT eTPU_crank_angle_speed_scaling "undefined4" ULONG NO_COMPU_METHOD 0 0 0 4294967295 ECU_ADDRESS 0x400016C0 /end MEASUREMENT
/begin MEASUREMENT knock_window_irq_count "undefined1" UBYTE NO_COMPU_METHOD 0 0 0 255 ECU_ADDRESS 0x400016C4 /end MEASUREMENT
/begin MEASUREMENT cam_sync_pulse_count "undefined1" UBYTE NO_COMPU_METHOD 0 0 0 255 ECU_ADDRESS 0x400016CC /end MEASUREMENT
/begin MEASUREMENT etb_pwm_period_isr_count_unused "undefined1" UBYTE NO_COMPU_METHOD 0 0 0 255 ECU_ADDRESS 0x400016E0 /end MEASUREMENT
/begin MEASUREMENT ac_compressor_speed_pulse_seen "undefined1" UBYTE NO_COMPU_METHOD 0 0 0 255 ECU_ADDRESS 0x400016E1 /end MEASUREMENT
/begin MEASUREMENT UNUSED_wheel_speed_new_data_flag "undefined1" UBYTE NO_COMPU_METHOD 0 0 0 255 ECU_ADDRESS 0x400016E2 /end MEASUREMENT
/begin MEASUREMENT ac_compressor_speed_period_us "undefined4" ULONG NO_COMPU_METHOD 0 0 0 4294967295 ECU_ADDRESS 0x400016E4 /end MEASUREMENT
/begin MEASUREMENT nonabs_wheel_speed_period_ticks "undefined4" ULONG NO_COMPU_METHOD 0 0 0 4294967295 ECU_ADDRESS 0x400016E8 /end MEASUREMENT
/begin MEASUREMENT obd_ii_relay_status "uint8_t" UBYTE NO_COMPU_METHOD 0 0 0 255 ECU_ADDRESS 0x400016EC /end MEASUREMENT
/begin MEASUREMENT fuel_level_filtered_x40000 "undefined4" ULONG NO_COMPU_METHOD 0 0 0 4294967295 ECU_ADDRESS 0x400016F4 /end MEASUREMENT
/begin MEASUREMENT sensor_adc_coolant "Sensor ADC coolant. Log the raw sensor signal to check sensor health and range. (V; raw*5/1023)" UWORD CM_u16_voltage_5_1023v 0 0 0 320.307917888563 ECU_ADDRESS 0x400016F8 /end MEASUREMENT
/begin MEASUREMENT ac_evap_temp_voltage "A/C EVAP temperature voltage. Log to see A/C clutch engagement and its load/idle impact. (V; raw*5/1023)" UWORD CM_u16_voltage_5_1023v 0 0 0 320.307917888563 ECU_ADDRESS 0x400016FA /end MEASUREMENT
/begin MEASUREMENT sensor_adc_tmaf_temp "Sensor ADC engine air. Log the raw sensor signal to check sensor health and range. (V; raw*5/1023)" UWORD CM_u16_voltage_5_1023v 0 0 0 320.307917888563 ECU_ADDRESS 0x400016FC /end MEASUREMENT
/begin MEASUREMENT coolant_temp "Engine coolant temperature, the ECU's primary temp input. Log it to verify warm-up, thermostat regulation, and that cooling keeps up under sustained load. (deg C; raw*5/8-40)" UBYTE CM_u8_temp_5_8_40c 0 0 -40 119.375 ECU_ADDRESS 0x400016FE /end MEASUREMENT
/begin MEASUREMENT obd_ii_ac_evap_temp "u16_temp_1/10C" UWORD CM_u8_temp_1_10C 0 0 0 6553.5 ECU_ADDRESS 0x40001700 /end MEASUREMENT
/begin MEASUREMENT airtemp_tmaf "Engine intake-air temperature. Log to track charge temperature and IAT-based compensations. (deg C; raw*5/8-40)" UBYTE CM_u8_temp_5_8_40c 0 0 -40 119.375 ECU_ADDRESS 0x40001702 /end MEASUREMENT
/begin MEASUREMENT obd_ii_iat "Inlet air temp from TMAF sensor" UWORD CM_u8_temp_5_8_40c 0 0 -40 40919.375 ECU_ADDRESS 0x40001704 /end MEASUREMENT
/begin MEASUREMENT coolant_temp_raw "undefined2" UWORD NO_COMPU_METHOD 0 0 0 65535 ECU_ADDRESS 0x40001706 /end MEASUREMENT
/begin MEASUREMENT ac_evap_temp_scaled "undefined2" UWORD NO_COMPU_METHOD 0 0 0 65535 ECU_ADDRESS 0x40001708 /end MEASUREMENT
/begin MEASUREMENT sensor_adc_baro "u16_voltage_5/1023v" UWORD CM_u16_voltage_5_1023v 0 0 0 320.307917888563 ECU_ADDRESS 0x4000170A /end MEASUREMENT
/begin MEASUREMENT obd_ii_atmospheric_baro "Barometric (ambient) pressure used for altitude/density correction. Log to see how altitude shifts fueling." UWORD CM_i16_pressure_mbar 0 0 0 65535 ECU_ADDRESS 0x4000170C /end MEASUREMENT
/begin MEASUREMENT tps_8bit "Throttle-plate position, 0-100% (8-bit). Log to see throttle opening and correlate tip-in with fueling/timing." UBYTE CM_u8_factor_1_255 0 0 0 100 ECU_ADDRESS 0x4000170E /end MEASUREMENT
/begin MEASUREMENT fuel_level_raw "Raw fuel-level reading. Log to check sender behavior/slosh. (gal; raw/10)" UBYTE CM_u8_volume_1_10gallon 0 0 0 25.5 ECU_ADDRESS 0x4000170F /end MEASUREMENT
/begin MEASUREMENT obd_ii_evap_vapor_pressure "undefined2" UWORD NO_COMPU_METHOD 0 0 0 65535 ECU_ADDRESS 0x40001710 /end MEASUREMENT
/begin MEASUREMENT obd_ii_o2_sensor1_voltage "Bank-1 pre-cat O2 sensor voltage. Log to watch closed-loop switching and confirm the sensor is alive and oscillating. (V; raw*5/1023)" UWORD CM_u16_voltage_5_1023v 0 0 0 320.307917888563 ECU_ADDRESS 0x40001712 /end MEASUREMENT
/begin MEASUREMENT obd_ii_o2_sensor5_voltage "Bank-2 pre-cat O2 sensor voltage. Log to watch bank-2 fuel control. (V; raw*5/1023)" UWORD CM_u16_voltage_5_1023v 0 0 0 320.307917888563 ECU_ADDRESS 0x40001714 /end MEASUREMENT
/begin MEASUREMENT obd_ii_o2_sensor2_voltage "Bank-1 post-cat O2 sensor voltage. Log to judge catalyst health (post-cat should be lazy/steady). (V; raw*5/1023)" UWORD CM_u16_voltage_5_1023v 0 0 0 320.307917888563 ECU_ADDRESS 0x40001716 /end MEASUREMENT
/begin MEASUREMENT obd_ii_o2_sensor6_voltage "Bank-2 pre-cat O2 sensor voltage. Log to watch bank-2 closed-loop fuel control. (V; raw*5/1023)" UWORD CM_u16_voltage_5_1023v 0 0 0 320.307917888563 ECU_ADDRESS 0x40001718 /end MEASUREMENT
/begin MEASUREMENT ignition_on_flags "undefined2" UWORD NO_COMPU_METHOD 0 0 0 65535 ECU_ADDRESS 0x4000171A /end MEASUREMENT
/begin MEASUREMENT sensor_adc_ecu_voltage "ECU/battery supply voltage. Log it -- low voltage skews injector dead-time and many sensors. (V; raw*18/1023)" UWORD CM_u16_voltage_18_1023v 0 0 0 1153.10850439883 ECU_ADDRESS 0x4000171C /end MEASUREMENT
/begin MEASUREMENT evap_purge_pressure_voltage "EVAP purge pressure voltage. Log the raw sensor voltage to check sensor health and wiring. (V; raw*5/1023)" UWORD CM_u16_voltage_5_1023v 0 0 0 320.307917888563 ECU_ADDRESS 0x4000171E /end MEASUREMENT
/begin MEASUREMENT clutch_pos_voltage "Clutch-pedal position sensor voltage. Log for launch/shift logic and DFCO gating. (V; raw*5/1023)" UWORD CM_u16_voltage_5_1023v 0 0 0 320.307917888563 ECU_ADDRESS 0x40001720 /end MEASUREMENT
/begin MEASUREMENT fuel_level_voltage "Fuel level voltage. Log to follow fuel delivery and mixture control. (V; raw*5/1023)" UWORD CM_u16_voltage_5_1023v 0 0 0 320.307917888563 ECU_ADDRESS 0x40001722 /end MEASUREMENT
/begin MEASUREMENT o2_sensor1_heater_current_scaled "undefined2" UWORD NO_COMPU_METHOD 0 0 0 65535 ECU_ADDRESS 0x40001724 /end MEASUREMENT
/begin MEASUREMENT o2_sensor2_heater_current_scaled "undefined2" UWORD NO_COMPU_METHOD 0 0 0 65535 ECU_ADDRESS 0x40001726 /end MEASUREMENT
/begin MEASUREMENT o2_sensor5_heater_current_scaled "undefined2" UWORD NO_COMPU_METHOD 0 0 0 65535 ECU_ADDRESS 0x40001728 /end MEASUREMENT
/begin MEASUREMENT o2_sensor6_heater_current_scaled "undefined2" UWORD NO_COMPU_METHOD 0 0 0 65535 ECU_ADDRESS 0x4000172A /end MEASUREMENT
/begin MEASUREMENT sensor_adc_airtemp_not_wired "Sensor ADC intake air. Log the raw sensor signal to check sensor health and range. (V; raw*5/1023)" UWORD CM_u16_voltage_5_1023v 0 0 0 320.307917888563 ECU_ADDRESS 0x4000172C /end MEASUREMENT
/begin MEASUREMENT airtemp_not_wired "undefined1" UBYTE NO_COMPU_METHOD 0 0 0 255 ECU_ADDRESS 0x4000172E /end MEASUREMENT
/begin MEASUREMENT fuel_pressure_unused "undefined1" UBYTE NO_COMPU_METHOD 0 0 0 255 ECU_ADDRESS 0x4000172F /end MEASUREMENT
/begin MEASUREMENT fuel_pressure_unknown_fallback_ "undefined1" UBYTE NO_COMPU_METHOD 0 0 0 255 ECU_ADDRESS 0x40001730 /end MEASUREMENT
/begin MEASUREMENT sensor_adc_unused_ch35 "u16_voltage_5/1023v" UWORD CM_u16_voltage_5_1023v 0 0 0 320.307917888563 ECU_ADDRESS 0x40001732 /end MEASUREMENT
/begin MEASUREMENT load_filtered1 "undefined4" ULONG NO_COMPU_METHOD 0 0 0 4294967295 ECU_ADDRESS 0x40001734 /end MEASUREMENT
/begin MEASUREMENT sensor_adc_map "Sensor barometric. Log the raw sensor signal to check sensor health and range. (V; raw*5/1023)" UWORD CM_u16_voltage_5_1023v 0 0 0 320.307917888563 ECU_ADDRESS 0x40001738 /end MEASUREMENT
/begin MEASUREMENT map_pressure_unused "u16_pressure_mbar" UWORD CM_i16_pressure_mbar 0 0 0 65535 ECU_ADDRESS 0x4000173A /end MEASUREMENT
/begin MEASUREMENT sport_button_enable "undefined1" UBYTE NO_COMPU_METHOD 0 0 0 255 ECU_ADDRESS 0x40001742 /end MEASUREMENT
/begin MEASUREMENT lat_accel "undefined2" UWORD NO_COMPU_METHOD 0 0 0 65535 ECU_ADDRESS 0x40001744 /end MEASUREMENT
/begin MEASUREMENT airtemp_tmaf_filter_state "undefined4" ULONG NO_COMPU_METHOD 0 0 0 4294967295 ECU_ADDRESS 0x40001748 /end MEASUREMENT
/begin MEASUREMENT coolant_temp_derived1 "undefined4" ULONG NO_COMPU_METHOD 0 0 0 4294967295 ECU_ADDRESS 0x4000174C /end MEASUREMENT
/begin MEASUREMENT ac_evap_temp_raw "undefined4" ULONG NO_COMPU_METHOD 0 0 0 4294967295 ECU_ADDRESS 0x40001750 /end MEASUREMENT
/begin MEASUREMENT air_temp_not_wired "u16_temp_5/8-40c" UWORD CM_u8_temp_5_8_40c 0 0 -40 40919.375 ECU_ADDRESS 0x40001758 /end MEASUREMENT
/begin MEASUREMENT sensor_adc_unused_ch4 "u16_voltage_5/1023v" UWORD CM_u16_voltage_5_1023v 0 0 0 320.307917888563 ECU_ADDRESS 0x4000175A /end MEASUREMENT
/begin MEASUREMENT sensor_adc_unused_ch5 "u16_voltage_5/1023v" UWORD CM_u16_voltage_5_1023v 0 0 0 320.307917888563 ECU_ADDRESS 0x4000175C /end MEASUREMENT
/begin MEASUREMENT sensor_adc_unused_ch6 "u16_voltage_5/1023v" UWORD CM_u16_voltage_5_1023v 0 0 0 320.307917888563 ECU_ADDRESS 0x4000175E /end MEASUREMENT
/begin MEASUREMENT sensor_adc_unused_ch7 "u16_voltage_5/1023v" UWORD CM_u16_voltage_5_1023v 0 0 0 320.307917888563 ECU_ADDRESS 0x40001760 /end MEASUREMENT
/begin MEASUREMENT fuel_level_update_holdoff_timer "undefined2" UWORD NO_COMPU_METHOD 0 0 0 65535 ECU_ADDRESS 0x40001762 /end MEASUREMENT
/begin MEASUREMENT lat_accel_last "Most recent lateral acceleration. Log for chassis correlation. (g; raw/255)" SLONG CM_i32_accel_1_255g 0 0 -8421504.50196078 8421504.49803922 ECU_ADDRESS 0x40001764 /end MEASUREMENT
/begin MEASUREMENT oil_pressure_warning_switch_voltage "Oil-pressure warning switch input voltage. Log to confirm oil-pressure switch state. (V; raw*5/1023)" UWORD CM_u16_voltage_5_1023v 0 0 0 320.307917888563 ECU_ADDRESS 0x4000176C /end MEASUREMENT
/begin MEASUREMENT unused_byte_variable1 "undefined2" UWORD NO_COMPU_METHOD 0 0 0 65535 ECU_ADDRESS 0x4000176E /end MEASUREMENT
/begin MEASUREMENT sensor_adc_ign_voltage "Ignition-switched supply voltage. Log to catch voltage sag affecting coils. (V; raw*5/1023)" UWORD CM_u16_voltage_5_1023v 0 0 0 320.307917888563 ECU_ADDRESS 0x40001770 /end MEASUREMENT
/begin MEASUREMENT fuel_pressure_voltage_unknown "u16_voltage_5/1023v" UWORD CM_u16_voltage_5_1023v 0 0 0 320.307917888563 ECU_ADDRESS 0x40001772 /end MEASUREMENT
/begin MEASUREMENT sensor_fuel_pressure_voltage_unused "u16_voltage_5/1023v" UWORD CM_u16_voltage_5_1023v 0 0 0 320.307917888563 ECU_ADDRESS 0x40001774 /end MEASUREMENT
/begin MEASUREMENT ign_adv_target1 "Target ignition advance. Log to follow the timing request. (deg; raw/4)" SWORD CM_u8_angle_1_4deg 0 0 -8192 8191.75 ECU_ADDRESS 0x40001778 /end MEASUREMENT
/begin MEASUREMENT ign_base "Base ignition advance from the timing map (before compensations). Log to compare base vs final." SWORD CM_u8_angle_1_4deg 0 0 -8192 8191.75 ECU_ADDRESS 0x4000177A /end MEASUREMENT
/begin MEASUREMENT ign_adv_knock_safe "Knock-safe ignition advance limit. Log to see the timing ceiling knock control allows. (deg; raw/4)" SWORD CM_u8_angle_1_4deg 0 0 -8192 8191.75 ECU_ADDRESS 0x4000177C /end MEASUREMENT
/begin MEASUREMENT ign_adv_target_slewed "i16_angle_1/4" SWORD CM_u8_angle_1_4deg 0 0 -8192 8191.75 ECU_ADDRESS 0x4000177E /end MEASUREMENT
/begin MEASUREMENT ign_adv_final "Final commanded ignition advance after all compensations. Log it -- the actual spark timing. (deg; raw/4)" SWORD CM_u8_angle_1_4deg 0 0 -8192 8191.75 ECU_ADDRESS 0x40001780 /end MEASUREMENT
/begin MEASUREMENT ign_dwell_time "undefined2" UWORD NO_COMPU_METHOD 0 0 0 65535 ECU_ADDRESS 0x40001782 /end MEASUREMENT
/begin MEASUREMENT ign_comp_total "Sum of all ignition timing compensations. Log to see net trim away from base timing. (deg; raw/4)" SWORD CM_u8_angle_1_4deg 0 0 -8192 8191.75 ECU_ADDRESS 0x40001784 /end MEASUREMENT
/begin MEASUREMENT ign_mbt_modeled "Modeled MBT (best-torque) timing. Log to see how far from MBT the ECU is running." SWORD CM_u8_angle_1_4deg 0 0 -8192 8191.75 ECU_ADDRESS 0x40001786 /end MEASUREMENT
/begin MEASUREMENT ign_adv_min "Ignition advance min. Log spark advance to confirm the timing strategy and headroom to knock. (deg; raw/4)" SWORD CM_u8_angle_1_4deg 0 0 -8192 8191.75 ECU_ADDRESS 0x40001788 /end MEASUREMENT
/begin MEASUREMENT ign_comp_idle_speed_error "Ignition compensation idle speed error. Log spark advance to confirm the timing strategy and headroom to knock. (deg; raw/4)" SWORD CM_u8_angle_1_4deg 0 0 -8192 8191.75 ECU_ADDRESS 0x4000178A /end MEASUREMENT
/begin MEASUREMENT ign_adv_idle_base "i16_angle_1/4deg" SWORD CM_u8_angle_1_4deg 0 0 -8192 8191.75 ECU_ADDRESS 0x4000178C /end MEASUREMENT
/begin MEASUREMENT ign_maf_accum_trim_startup "undefined2" UWORD NO_COMPU_METHOD 0 0 0 65535 ECU_ADDRESS 0x4000178E /end MEASUREMENT
/begin MEASUREMENT ign_comp_startup "Ignition compensation startup. Log spark advance to confirm the timing strategy and headroom to knock. (deg; raw/4)" SBYTE CM_u8_angle_1_4deg 0 0 -32 31.75 ECU_ADDRESS 0x40001790 /end MEASUREMENT
/begin MEASUREMENT ign_startup_comp_flags "undefined2" UWORD NO_COMPU_METHOD 0 0 0 65535 ECU_ADDRESS 0x40001792 /end MEASUREMENT
/begin MEASUREMENT ign_comp_tps_rate "i8_angle_1/4deg" SBYTE CM_u8_angle_1_4deg 0 0 -32 31.75 ECU_ADDRESS 0x40001794 /end MEASUREMENT
/begin MEASUREMENT ign_dfso_active "undefined2" UWORD NO_COMPU_METHOD 0 0 0 65535 ECU_ADDRESS 0x400017A2 /end MEASUREMENT
/begin MEASUREMENT ign_adv_coldstart_comp "undefined1" UBYTE NO_COMPU_METHOD 0 0 0 255 ECU_ADDRESS 0x400017A4 /end MEASUREMENT
/begin MEASUREMENT ign_advance_step_tps "i8_angle_1/4deg" SBYTE CM_u8_angle_1_4deg 0 0 -32 31.75 ECU_ADDRESS 0x400017A5 /end MEASUREMENT
/begin MEASUREMENT ign_retard_step_tps "Ignition retard step throttle position. Log spark advance to confirm the timing strategy and headroom to knock. (deg; raw/4)" SBYTE CM_u8_angle_1_4deg 0 0 -32 31.75 ECU_ADDRESS 0x400017A6 /end MEASUREMENT
/begin MEASUREMENT ign_comp_transient_total "i16_angle_1/4deg" SWORD CM_u8_angle_1_4deg 0 0 -8192 8191.75 ECU_ADDRESS 0x400017A8 /end MEASUREMENT
/begin MEASUREMENT ign_comp_idle_speed_error_moving "i16_angle_1/4" SWORD CM_u8_angle_1_4deg 0 0 -8192 8191.75 ECU_ADDRESS 0x400017AA /end MEASUREMENT
/begin MEASUREMENT ign_target_slew_prescaler "undefined1" UBYTE NO_COMPU_METHOD 0 0 0 255 ECU_ADDRESS 0x400017AC /end MEASUREMENT
/begin MEASUREMENT ign_target_update_inhibit_timer "uint16_t" UWORD NO_COMPU_METHOD 0 0 0 65535 ECU_ADDRESS 0x400017AE /end MEASUREMENT
/begin MEASUREMENT ign_idle_comp_recovery_timer "u8_time_5ms" UBYTE CM_u8_time_5ms 0 0 0 1275 ECU_ADDRESS 0x400017B0 /end MEASUREMENT
/begin MEASUREMENT ign_mode "Ignition mode. Log spark advance to confirm the timing strategy and headroom to knock." UBYTE NO_COMPU_METHOD 0 0 0 255 ECU_ADDRESS 0x400017B1 /end MEASUREMENT
/begin MEASUREMENT ign_temp_comp_load_scaling "undefined1" UBYTE NO_COMPU_METHOD 0 0 0 255 ECU_ADDRESS 0x400017B2 /end MEASUREMENT
/begin MEASUREMENT ign_mode_prev "enum_ign_mode" UBYTE NO_COMPU_METHOD 0 0 0 255 ECU_ADDRESS 0x400017B3 /end MEASUREMENT
/begin MEASUREMENT engine_operating_state_flags_ign_unknown "undefined1" UBYTE NO_COMPU_METHOD 0 0 0 255 ECU_ADDRESS 0x400017B4 /end MEASUREMENT
/begin MEASUREMENT ign_adv_target_slewed_prev "i16_angle_1/4" SWORD CM_u8_angle_1_4deg 0 0 -8192 8191.75 ECU_ADDRESS 0x400017B6 /end MEASUREMENT
/begin MEASUREMENT ign_adv_roughness_prev "i16_angle_1/4" SWORD CM_u8_angle_1_4deg 0 0 -8192 8191.75 ECU_ADDRESS 0x400017B8 /end MEASUREMENT
/begin MEASUREMENT inj_deadtime_base "u16_time_us" UWORD CM_u8_time_us 0 0 0 65535 ECU_ADDRESS 0x400017C0 /end MEASUREMENT
/begin MEASUREMENT inj_mass_to_time_scaler_b1 "u32_time_us" ULONG CM_u8_time_us 0 0 0 4294967295 ECU_ADDRESS 0x400017C4 /end MEASUREMENT
/begin MEASUREMENT inj_mass_to_time_scaler_b2 "u32_time_us" ULONG CM_u8_time_us 0 0 0 4294967295 ECU_ADDRESS 0x400017C8 /end MEASUREMENT
/begin MEASUREMENT obd_ii_injector_pulse_time_bank1_us "Bank-1 injector pulse width (us). Log it -- direct measure of fuel delivered; key for injector sizing/duty." ULONG CM_u8_time_us 0 0 0 4294967295 ECU_ADDRESS 0x400017CC /end MEASUREMENT
/begin MEASUREMENT obd_ii_injector_pulse_time_bank2_us "Bank-2 injector pulse width (us). Log for bank-2 fuel delivery and duty cycle." ULONG CM_u8_time_us 0 0 0 4294967295 ECU_ADDRESS 0x400017D0 /end MEASUREMENT
/begin MEASUREMENT inj_startup_pulse_time "Cranking/startup injector pulse width. Log to tune cold-start fueling. (us)" ULONG CM_u8_time_us 0 0 0 4294967295 ECU_ADDRESS 0x400017D4 /end MEASUREMENT
/begin MEASUREMENT inj_start_angle_target "u32_angle_1/10defg" ULONG CM_u32_angle_1_10defg 0 0 0 429496729.5 ECU_ADDRESS 0x400017D8 /end MEASUREMENT
/begin MEASUREMENT inj_start_angle_actual "undefined4" ULONG NO_COMPU_METHOD 0 0 0 4294967295 ECU_ADDRESS 0x400017DC /end MEASUREMENT
/begin MEASUREMENT afr_target "Commanded air/fuel ratio target. Log it -- the single most important channel for verifying mixture while tuning. (AFR; raw/100)" UWORD CM_u8_afr_1_100 0 0 0 655.35 ECU_ADDRESS 0x400017E0 /end MEASUREMENT
/begin MEASUREMENT inj_flow_rate "Commanded injector flow rate. Log to follow fuel delivery vs target. (mg/s)" UWORD CM_u16_flow_mg_s 0 0 0 65535 ECU_ADDRESS 0x400017E2 /end MEASUREMENT
/begin MEASUREMENT inj_fuel_mass_required "u16_mass_10ug" UWORD CM_u16_mass_10ug 0 0 0 655350 ECU_ADDRESS 0x400017E4 /end MEASUREMENT
/begin MEASUREMENT fuel_power_enrich_flags "uint8_t" UBYTE NO_COMPU_METHOD 0 0 0 255 ECU_ADDRESS 0x400017E6 /end MEASUREMENT
/begin MEASUREMENT inj_pw_bank1_post_trim_us "u32_time_us" ULONG CM_u8_time_us 0 0 0 4294967295 ECU_ADDRESS 0x400017E8 /end MEASUREMENT
/begin MEASUREMENT inj_pw_bank2_post_trim_us "u32_time_us" ULONG CM_u8_time_us 0 0 0 4294967295 ECU_ADDRESS 0x400017EC /end MEASUREMENT
/begin MEASUREMENT inj_startup_enrichment_offset "u32_time_us" ULONG CM_u8_time_us 0 0 0 4294967295 ECU_ADDRESS 0x400017F0 /end MEASUREMENT
/begin MEASUREMENT inj_pw_bank1_pre_trim_us "u32_time_us" ULONG CM_u8_time_us 0 0 0 4294967295 ECU_ADDRESS 0x400017F4 /end MEASUREMENT
/begin MEASUREMENT inj_pw_bank2_pre_trim_us "u32_time_us" ULONG CM_u8_time_us 0 0 0 4294967295 ECU_ADDRESS 0x400017F8 /end MEASUREMENT
/begin MEASUREMENT inj_fuel_mass_bank1 "u16_mass_10ug" UWORD CM_u16_mass_10ug 0 0 0 655350 ECU_ADDRESS 0x400017FC /end MEASUREMENT
/begin MEASUREMENT inj_fuel_mass_bank2 "u16_mass_10ug" UWORD CM_u16_mass_10ug 0 0 0 655350 ECU_ADDRESS 0x400017FE /end MEASUREMENT
/begin MEASUREMENT inj_angle_raw "u8_angle_720/256deg" UBYTE CM_u8_angle_720_256deg 0 0 0 717.1875 ECU_ADDRESS 0x40001800 /end MEASUREMENT
/begin MEASUREMENT afr_enrichment_from_ign_retard "Extra fuel enrichment added when timing is retarded (e.g. under knock). Log to see protective enrichment kick in." UBYTE CM_u8_afr_1_100 0 0 0 2.55 ECU_ADDRESS 0x40001801 /end MEASUREMENT
/begin MEASUREMENT inj_efficiency "u8_factor_1/200" UBYTE CM_u8_factor_1_200 0 0 0 127.5 ECU_ADDRESS 0x40001802 /end MEASUREMENT
/begin MEASUREMENT inj_duty_bank1_pct "u8_factor_1/100" UBYTE CM_u8_factor_1_100 0 0 0 255 ECU_ADDRESS 0x40001803 /end MEASUREMENT
/begin MEASUREMENT inj_duty_bank2_pct "u8_factor_1/100" UBYTE CM_u8_factor_1_100 0 0 0 255 ECU_ADDRESS 0x40001804 /end MEASUREMENT
/begin MEASUREMENT fuel_usage_instantaneous "u16_economy_1/10ml_per_km" UWORD CM_u16_economy_1_10ml_per_km 0 0 0 6553.5 ECU_ADDRESS 0x40001806 /end MEASUREMENT
/begin MEASUREMENT fuel_mileage_instantaneous "undefined2" UWORD NO_COMPU_METHOD 0 0 0 65535 ECU_ADDRESS 0x40001808 /end MEASUREMENT
/begin MEASUREMENT coilpack_failure_flags "undefined2" UWORD NO_COMPU_METHOD 0 0 0 65535 ECU_ADDRESS 0x4000180A /end MEASUREMENT
/begin MEASUREMENT inj_bank_balance_ratio "u8_factor_1/200" UBYTE CM_u8_factor_1_200 0 0 0 127.5 ECU_ADDRESS 0x4000180C /end MEASUREMENT
/begin MEASUREMENT revlimit_hard_cut_time "u8_time_100ms" UBYTE CM_u8_time_100ms 0 0 0 25500 ECU_ADDRESS 0x4000180D /end MEASUREMENT
/begin MEASUREMENT revlimit_fuelcut_count "Revlimit fuelcut count. Log to confirm where and how the rev limiter intervenes." UBYTE NO_COMPU_METHOD 0 0 0 255 ECU_ADDRESS 0x4000180E /end MEASUREMENT
/begin MEASUREMENT inj_mass_ratio_from_evap_purge_b1 "u8_factor_1/255" UBYTE CM_u8_factor_1_255 0 0 0 100 ECU_ADDRESS 0x4000180F /end MEASUREMENT
/begin MEASUREMENT inj_mass_ratio_from_evap_purge_b2 "u8_factor_1/255" UBYTE CM_u8_factor_1_255 0 0 0 100 ECU_ADDRESS 0x40001810 /end MEASUREMENT
/begin MEASUREMENT rev_limit_tick_10hz "u8_time_5ms" UBYTE CM_u8_time_5ms 0 0 0 1275 ECU_ADDRESS 0x40001811 /end MEASUREMENT
/begin MEASUREMENT afr_closedloop_hold_timer "u16_time_5ms" UWORD CM_u8_time_5ms 0 0 0 327675 ECU_ADDRESS 0x40001812 /end MEASUREMENT
/begin MEASUREMENT inj_hot_restart_enrich "u8_factor_1/255" UBYTE CM_u8_factor_1_255 0 0 0 100 ECU_ADDRESS 0x40001814 /end MEASUREMENT
/begin MEASUREMENT inj_hot_restart_enrich_soak "u8_factor_1/255" UBYTE CM_u8_factor_1_255 0 0 0 100 ECU_ADDRESS 0x40001815 /end MEASUREMENT
/begin MEASUREMENT inj_hot_restart_enrich_temps "u8_factor_1/255" UBYTE CM_u8_factor_1_255 0 0 0 100 ECU_ADDRESS 0x40001816 /end MEASUREMENT
/begin MEASUREMENT inj_hot_restart_enrich_fade "u8_factor_1/255" UBYTE CM_u8_factor_1_255 0 0 0 100 ECU_ADDRESS 0x40001817 /end MEASUREMENT
/begin MEASUREMENT inj_pw_max_available_us "u32_time_us" ULONG CM_u8_time_us 0 0 0 4294967295 ECU_ADDRESS 0x40001818 /end MEASUREMENT
/begin MEASUREMENT inj_pulse_angle_b1 "u32_angle_1/10deg" ULONG CM_u16_angle_1_10deg 0 0 0 429496729.5 ECU_ADDRESS 0x40001820 /end MEASUREMENT
/begin MEASUREMENT inj_pulse_angle_b2 "u32_angle_1/10deg" ULONG CM_u16_angle_1_10deg 0 0 0 429496729.5 ECU_ADDRESS 0x40001824 /end MEASUREMENT
/begin MEASUREMENT etpu_sdm_param24_base "undefined4" ULONG NO_COMPU_METHOD 0 0 0 4294967295 ECU_ADDRESS 0x40001830 /end MEASUREMENT
/begin MEASUREMENT etpu_sdm_base "undefined4" ULONG NO_COMPU_METHOD 0 0 0 4294967295 ECU_ADDRESS 0x40001838 /end MEASUREMENT
/begin MEASUREMENT etpu_mcr_addr "ETPU mcr addr. Internal/infrastructure state -- not a typical data-logging channel." ULONG NO_COMPU_METHOD 0 0 0 4294967295 ECU_ADDRESS 0x40001840 /end MEASUREMENT
/begin MEASUREMENT timer_main_start2 "undefined4" ULONG NO_COMPU_METHOD 0 0 0 4294967295 ECU_ADDRESS 0x4000186C /end MEASUREMENT
/begin MEASUREMENT preserve_perf_ "bool" UBYTE NO_COMPU_METHOD 0 0 0 255 ECU_ADDRESS 0x40001870 /end MEASUREMENT
/begin MEASUREMENT lea_init_stamp_lo "uint16_t" UWORD NO_COMPU_METHOD 0 0 0 65535 ECU_ADDRESS 0x40001872 /end MEASUREMENT
/begin MEASUREMENT lea_init_stamp_hi "uint16_t" UWORD NO_COMPU_METHOD 0 0 0 65535 ECU_ADDRESS 0x40001874 /end MEASUREMENT
/begin MEASUREMENT lea_init_status_flags "uint8_t" UBYTE NO_COMPU_METHOD 0 0 0 255 ECU_ADDRESS 0x40001878 /end MEASUREMENT
/begin MEASUREMENT diag_lea_reset_trigger "Diag lea reset trigger. Runtime state -- log to observe this behavior." UWORD NO_COMPU_METHOD 0 0 0 65535 ECU_ADDRESS 0x4000187C /end MEASUREMENT
/begin MEASUREMENT flash_saved_sll_slms_mask "undefined4" ULONG NO_COMPU_METHOD 0 0 0 4294967295 ECU_ADDRESS 0x400018A8 /end MEASUREMENT
/begin MEASUREMENT flash_saved_lml_hbl_hi_mask "undefined4" ULONG NO_COMPU_METHOD 0 0 0 4294967295 ECU_ADDRESS 0x400018AC /end MEASUREMENT
/begin MEASUREMENT flash_saved_lml_hbl_lo_mask "undefined4" ULONG NO_COMPU_METHOD 0 0 0 4294967295 ECU_ADDRESS 0x400018B0 /end MEASUREMENT
/begin MEASUREMENT fan_coolant_flags "uint32_t" ULONG NO_COMPU_METHOD 0 0 0 4294967295 ECU_ADDRESS 0x400018B8 /end MEASUREMENT
/begin MEASUREMENT gear_change_flags "Bit 0 is set whenever a gear change is detected" UWORD NO_COMPU_METHOD 0 0 0 65535 ECU_ADDRESS 0x400018BC /end MEASUREMENT
/begin MEASUREMENT car_gear_current "Currently selected/estimated gear. Log to map RPM/load against gear." UBYTE NO_COMPU_METHOD 0 0 0 255 ECU_ADDRESS 0x400018BE /end MEASUREMENT
/begin MEASUREMENT ign_off_main_relay_hold_timer "undefined2" UWORD NO_COMPU_METHOD 0 0 0 65535 ECU_ADDRESS 0x400018C0 /end MEASUREMENT
/begin MEASUREMENT fuel_level_percentage "Fuel level as a percentage. Log for fuel-gauge behavior. (0-1; raw/255)" UBYTE CM_u8_factor_1_255 0 0 0 100 ECU_ADDRESS 0x400018C2 /end MEASUREMENT
/begin MEASUREMENT fan_cooling_1_state "undefined1" UBYTE NO_COMPU_METHOD 0 0 0 255 ECU_ADDRESS 0x400018C3 /end MEASUREMENT
/begin MEASUREMENT fan_cooling_2_state "undefined1" UBYTE NO_COMPU_METHOD 0 0 0 255 ECU_ADDRESS 0x400018C4 /end MEASUREMENT
/begin MEASUREMENT fan_engine_bay_aux_state "undefined1" UBYTE NO_COMPU_METHOD 0 0 0 255 ECU_ADDRESS 0x400018C5 /end MEASUREMENT
/begin MEASUREMENT recirculation_pump_state "undefined1" UBYTE NO_COMPU_METHOD 0 0 0 255 ECU_ADDRESS 0x400018C6 /end MEASUREMENT
/begin MEASUREMENT ign_voltage_above_threshold "Flag: supply voltage is above the minimum for normal operation. Log to flag brown-outs." UBYTE NO_COMPU_METHOD 0 0 0 255 ECU_ADDRESS 0x400018C8 /end MEASUREMENT
/begin MEASUREMENT rev_per_km "undefined4" ULONG NO_COMPU_METHOD 0 0 0 4294967295 ECU_ADDRESS 0x400018CC /end MEASUREMENT
/begin MEASUREMENT acis_state "undefined1" UBYTE NO_COMPU_METHOD 0 0 0 255 ECU_ADDRESS 0x400018D4 /end MEASUREMENT
/begin MEASUREMENT intake_flapper_state "undefined1" UBYTE NO_COMPU_METHOD 0 0 0 255 ECU_ADDRESS 0x400018D5 /end MEASUREMENT
/begin MEASUREMENT exhaust_flap_state "undefined1" UBYTE NO_COMPU_METHOD 0 0 0 255 ECU_ADDRESS 0x400018D6 /end MEASUREMENT
/begin MEASUREMENT car_speed_u8 "Vehicle speed (km/h). Log for speed-based logic, limiters, and gear inference." UBYTE CM_u8_speed_kph 0 0 0 255 ECU_ADDRESS 0x400018D7 /end MEASUREMENT
/begin MEASUREMENT car_speed_x100 "Vehicle speed at 0.01 km/h resolution. Log for precise speed analysis. (km/h; raw/100)" UWORD CM_u8_speed_1_100kph 0 0 0 655.35 ECU_ADDRESS 0x400018D8 /end MEASUREMENT
/begin MEASUREMENT wheel_speed "Individual wheel speeds (from ABS over CAN). Log to compute slip and study traction events." ULONG NO_COMPU_METHOD 0 0 0 4294967295 ECU_ADDRESS 0x400018DA /end MEASUREMENT
/begin MEASUREMENT brake_switch "undefined1" UBYTE NO_COMPU_METHOD 0 0 0 255 ECU_ADDRESS 0x400018E2 /end MEASUREMENT
/begin MEASUREMENT clutch_pos_sensor "undefined1" UBYTE NO_COMPU_METHOD 0 0 0 255 ECU_ADDRESS 0x400018E3 /end MEASUREMENT
/begin MEASUREMENT cluster_lamp_test_state "undefined1" UBYTE NO_COMPU_METHOD 0 0 0 255 ECU_ADDRESS 0x400018FC /end MEASUREMENT
/begin MEASUREMENT injtip_overrun_inhibit_timer "undefined2" UWORD NO_COMPU_METHOD 0 0 0 65535 ECU_ADDRESS 0x400018FE /end MEASUREMENT
/begin MEASUREMENT ign_adv_from_roughness_detection "Ignition advance from roughness detection. Log spark advance to confirm the timing strategy and headroom to knock. (deg; raw/4)" SWORD CM_u8_angle_1_4deg 0 0 -8192 8191.75 ECU_ADDRESS 0x40001900 /end MEASUREMENT
/begin MEASUREMENT wheel_speed_front_accel "undefined2" UWORD NO_COMPU_METHOD 0 0 0 65535 ECU_ADDRESS 0x40001906 /end MEASUREMENT
/begin MEASUREMENT cluster_shiftlight_rpm_offset "Cluster shiftlight RPM offset. Log to check what the ECU sends the dash (gauges/warnings)." UWORD NO_COMPU_METHOD 0 0 0 65535 ECU_ADDRESS 0x40001908 /end MEASUREMENT
/begin MEASUREMENT coolant_fan_afterrun_time "Coolant fan afterrun time. Timer/counter -- log to measure how long a condition persists. (s)" UWORD CM_u8_time_s 0 0 0 65535 ECU_ADDRESS 0x4000190A /end MEASUREMENT
/begin MEASUREMENT cluster_shift_light_state "undefined1" UBYTE NO_COMPU_METHOD 0 0 0 255 ECU_ADDRESS 0x4000190C /end MEASUREMENT
/begin MEASUREMENT cluster_tpms_blink_state "undefined1" UBYTE NO_COMPU_METHOD 0 0 0 255 ECU_ADDRESS 0x4000190D /end MEASUREMENT
/begin MEASUREMENT cluster_tpms_blink_cycle_timer "undefined1" UBYTE NO_COMPU_METHOD 0 0 0 255 ECU_ADDRESS 0x4000190E /end MEASUREMENT
/begin MEASUREMENT cluster_tpms_blink_timer "Once this timer expires, the TPMS light stays on" UWORD NO_COMPU_METHOD 0 0 0 65535 ECU_ADDRESS 0x40001910 /end MEASUREMENT
/begin MEASUREMENT dash_data_CAN400 "The cluster (CAN 0x400) message contents: gauges, warnings, shift lights. Log to see what the dash is told." ULONG NO_COMPU_METHOD 0 0 0 4294967295 ECU_ADDRESS 0x40001918 /end MEASUREMENT
/begin MEASUREMENT cluster_indicator_flags "undefined1" UBYTE NO_COMPU_METHOD 0 0 0 255 ECU_ADDRESS 0x40001920 /end MEASUREMENT
/begin MEASUREMENT unused_cluster_cod_config_flags "undefined1" UBYTE NO_COMPU_METHOD 0 0 0 255 ECU_ADDRESS 0x40001921 /end MEASUREMENT
/begin MEASUREMENT cluster_flags "undefined1" UBYTE NO_COMPU_METHOD 0 0 0 255 ECU_ADDRESS 0x40001922 /end MEASUREMENT
/begin MEASUREMENT shutdown_actions_done "Shutdown actions done. Runtime state -- log to observe this behavior." UBYTE NO_COMPU_METHOD 0 0 0 255 ECU_ADDRESS 0x40001923 /end MEASUREMENT
/begin MEASUREMENT tpms_tx_7a0_divider "u8_count" UBYTE NO_COMPU_METHOD 0 0 0 255 ECU_ADDRESS 0x40001924 /end MEASUREMENT
/begin MEASUREMENT pwm_0xB3_initialized "Pwm 0xB3 initialized. Runtime state -- log to observe this behavior." UBYTE NO_COMPU_METHOD 0 0 0 255 ECU_ADDRESS 0x40001925 /end MEASUREMENT
/begin MEASUREMENT exhaust_flap_enable_flags "undefined1" UBYTE NO_COMPU_METHOD 0 0 0 255 ECU_ADDRESS 0x40001926 /end MEASUREMENT
/begin MEASUREMENT nonabs_wheelspeed "undefined4" ULONG NO_COMPU_METHOD 0 0 0 4294967295 ECU_ADDRESS 0x40001928 /end MEASUREMENT
/begin MEASUREMENT recirc_pump_shutdown_timer_set "Recirc pump shutdown timer set. Runtime state -- log to observe this behavior." UBYTE NO_COMPU_METHOD 0 0 0 255 ECU_ADDRESS 0x4000192C /end MEASUREMENT
/begin MEASUREMENT fan_coolant_fall_delta "Fan coolant temperature drop. Log to track thermal behavior and confirm the sensor reads sanely. (deg C; raw*5/8-40)" UBYTE CM_u8_temp_5_8_40c 0 0 -40 119.375 ECU_ADDRESS 0x4000192D /end MEASUREMENT
/begin MEASUREMENT fan_coolant_fall_check_timer "u8_time_100ms" UBYTE CM_u8_time_100ms 0 0 0 25500 ECU_ADDRESS 0x4000192E /end MEASUREMENT
/begin MEASUREMENT fan_inhibit_coolant_falling "Fan engine bay inhibit. Log to follow core engine state." UBYTE NO_COMPU_METHOD 0 0 0 255 ECU_ADDRESS 0x4000192F /end MEASUREMENT
/begin MEASUREMENT fan_coolant_fall_check_prev_temp "A second/redundant coolant-temperature reading. Log alongside coolant_temp to cross-check the sensor. (deg C; raw*5/8-40)" UBYTE CM_u8_temp_5_8_40c 0 0 -40 119.375 ECU_ADDRESS 0x40001930 /end MEASUREMENT
/begin MEASUREMENT engine_speed_tach_filtered "u16_rspeed_1/4rpm" UWORD CM_u16_rspeed_1_4rpm 0 0 0 16383.75 ECU_ADDRESS 0x40001944 /end MEASUREMENT
/begin MEASUREMENT exhaust_flap_desired_state "Exhaust flap desired state. Log to see exhaust bypass valve position (sound/backpressure)." UBYTE NO_COMPU_METHOD 0 0 0 255 ECU_ADDRESS 0x40001949 /end MEASUREMENT
/begin MEASUREMENT wheel_speed_front_delta_filtered "undefined2" UWORD NO_COMPU_METHOD 0 0 0 65535 ECU_ADDRESS 0x4000194C /end MEASUREMENT
/begin MEASUREMENT wheel_speed_front_delta "undefined2" UWORD NO_COMPU_METHOD 0 0 0 65535 ECU_ADDRESS 0x4000194E /end MEASUREMENT
/begin MEASUREMENT wheel_speed_front_accel_update_timer "undefined1" UBYTE NO_COMPU_METHOD 0 0 0 255 ECU_ADDRESS 0x40001950 /end MEASUREMENT
/begin MEASUREMENT wheel_speed_front_avg_current "undefined2" UWORD NO_COMPU_METHOD 0 0 0 65535 ECU_ADDRESS 0x40001952 /end MEASUREMENT
/begin MEASUREMENT wheel_speed_front_avg_prev "undefined2" UWORD NO_COMPU_METHOD 0 0 0 65535 ECU_ADDRESS 0x40001954 /end MEASUREMENT
/begin MEASUREMENT engine_speed_pps_target "u16_rspeed_1/4rpm" UWORD CM_u16_rspeed_1_4rpm 0 0 0 16383.75 ECU_ADDRESS 0x40001956 /end MEASUREMENT
/begin MEASUREMENT engine_speed_tach_fp8 "High-resolution filtered engine speed (tach). Log for smooth RPM traces." ULONG CM_u32_rspeed_1024rpm 0 0 0 4398046510080 ECU_ADDRESS 0x40001958 /end MEASUREMENT
/begin MEASUREMENT idle_underspeed_latch "Idle underspeed latch. Log to diagnose idle quality, hunting, and stalls." UBYTE NO_COMPU_METHOD 0 0 0 255 ECU_ADDRESS 0x4000195D /end MEASUREMENT
/begin MEASUREMENT engine_speed_tach_fp8_prev "Engine speed tach (fixed-point) prev. Log to follow core engine state. (RPM; raw/1024)" ULONG CM_u32_rspeed_1024rpm 0 0 0 4398046510080 ECU_ADDRESS 0x40001960 /end MEASUREMENT
/begin MEASUREMENT engine_speed_filter_rise_coeff "Engine speed filter rise coeff. Log to follow core engine state. (0-1; raw/255)" UBYTE CM_u8_factor_1_255 0 0 0 100 ECU_ADDRESS 0x40001964 /end MEASUREMENT
/begin MEASUREMENT main_relay_state "Main power-relay state. Log for power-up/down diagnostics." UBYTE NO_COMPU_METHOD 0 0 0 255 ECU_ADDRESS 0x40001965 /end MEASUREMENT
/begin MEASUREMENT ips_shift_light_flags "undefined1" UBYTE NO_COMPU_METHOD 0 0 0 255 ECU_ADDRESS 0x40001966 /end MEASUREMENT
/begin MEASUREMENT paddle_shift_sensor_raw "Paddle shift sensor raw. Log the raw sensor signal to check sensor health and range. (V; raw*5/1023)" UWORD CM_u16_voltage_5_1023v 0 0 0 320.307917888563 ECU_ADDRESS 0x40001968 /end MEASUREMENT
/begin MEASUREMENT paddle_shift_flags "undefined1" UBYTE NO_COMPU_METHOD 0 0 0 255 ECU_ADDRESS 0x4000196A /end MEASUREMENT
/begin MEASUREMENT tpms_tx_pending_flags "undefined1" UBYTE NO_COMPU_METHOD 0 0 0 255 ECU_ADDRESS 0x40001980 /end MEASUREMENT
/begin MEASUREMENT dfco_recovery_enrichment "undefined4" ULONG NO_COMPU_METHOD 0 0 0 4294967295 ECU_ADDRESS 0x40001988 /end MEASUREMENT
/begin MEASUREMENT inj_tip_adj_enrichment "undefined4" ULONG NO_COMPU_METHOD 0 0 0 4294967295 ECU_ADDRESS 0x4000198C /end MEASUREMENT
/begin MEASUREMENT inj_tip_adj_enleanment "undefined4" ULONG NO_COMPU_METHOD 0 0 0 4294967295 ECU_ADDRESS 0x40001990 /end MEASUREMENT
/begin MEASUREMENT inj_flags "undefined2" UWORD NO_COMPU_METHOD 0 0 0 65535 ECU_ADDRESS 0x40001994 /end MEASUREMENT
/begin MEASUREMENT injtip_in_rpm_decay "u8_dt_factor_1/100/5ms" UBYTE CM_u8_dt_factor_1_100_5ms 0 0 0 2.55 ECU_ADDRESS 0x40001996 /end MEASUREMENT
/begin MEASUREMENT injtip_out_rpm_decay "u8_dt_factor_1/100/5ms" UBYTE CM_u8_dt_factor_1_100_5ms 0 0 0 2.55 ECU_ADDRESS 0x40001997 /end MEASUREMENT
/begin MEASUREMENT dfco_pedal_ramp_target "uint8_t" UBYTE NO_COMPU_METHOD 0 0 0 255 ECU_ADDRESS 0x40001998 /end MEASUREMENT
/begin MEASUREMENT injtip_in_enrichment_raw "undefined4" ULONG NO_COMPU_METHOD 0 0 0 4294967295 ECU_ADDRESS 0x4000199C /end MEASUREMENT
/begin MEASUREMENT injtip_out_enleanment_raw "undefined4" ULONG NO_COMPU_METHOD 0 0 0 4294967295 ECU_ADDRESS 0x400019A0 /end MEASUREMENT
/begin MEASUREMENT logged_tps_rate_transient "undefined2" UWORD NO_COMPU_METHOD 0 0 0 65535 ECU_ADDRESS 0x400019A4 /end MEASUREMENT
/begin MEASUREMENT dfco_recovery_enrich_cooldown_timer "u16_time_5ms" UWORD CM_u8_time_5ms 0 0 0 327675 ECU_ADDRESS 0x400019A6 /end MEASUREMENT
/begin MEASUREMENT injtip_in_rpm_scale "u8_factor_1/128" UBYTE CM_u8_factor_1_128 0 0 0 199.21875 ECU_ADDRESS 0x400019A8 /end MEASUREMENT
/begin MEASUREMENT injtip_in_coolant_scale "u8_factor_1/64" UBYTE CM_u8_factor_1_64 0 0 0 398.4375 ECU_ADDRESS 0x400019A9 /end MEASUREMENT
/begin MEASUREMENT injtip_out_rpm_scale "u8_factor_1/128" UBYTE CM_u8_factor_1_128 0 0 0 199.21875 ECU_ADDRESS 0x400019AA /end MEASUREMENT
/begin MEASUREMENT injtip_out_coolant_scale "u8_factor_1/64" UBYTE CM_u8_factor_1_64 0 0 0 398.4375 ECU_ADDRESS 0x400019AB /end MEASUREMENT
/begin MEASUREMENT inj_tip_in_adj_gear_current "Injector tip in adj gear current. Log to verify injector pulse width and fuel delivery vs target." SBYTE NO_COMPU_METHOD 0 0 -128 127 ECU_ADDRESS 0x400019AC /end MEASUREMENT
/begin MEASUREMENT dfco_enable_engine_speed "RPM above which DFCO (fuel cut on decel) is allowed. Log to study overrun fuel cut." UWORD CM_u8_rspeed_rpm 0 0 0 65535 ECU_ADDRESS 0x400019AE /end MEASUREMENT
/begin MEASUREMENT dfco_disable_rpm_ingear "DFCO disable RPM ingear. Log to see when fuel is cut and restored on deceleration. (RPM)" UWORD CM_u8_rspeed_rpm 0 0 0 65535 ECU_ADDRESS 0x400019B0 /end MEASUREMENT
/begin MEASUREMENT dfco_disable_rpm_neutral "DFCO disable RPM neutral. Log to see when fuel is cut and restored on deceleration. (RPM)" UWORD CM_u8_rspeed_rpm 0 0 0 65535 ECU_ADDRESS 0x400019B2 /end MEASUREMENT
/begin MEASUREMENT cyl_fuelcut_sparking_mask "undefined1" UBYTE NO_COMPU_METHOD 0 0 0 255 ECU_ADDRESS 0x400019B4 /end MEASUREMENT
/begin MEASUREMENT ign_per_cyl_fire_enable "Ignition per cylinder fire enable. Log spark advance to confirm the timing strategy and headroom to knock." UBYTE NO_COMPU_METHOD 0 0 0 255 ECU_ADDRESS 0x400019B5 /end MEASUREMENT
/begin MEASUREMENT sensor_adc_maf1 "u16_voltage_5/1023v" UWORD CM_u16_voltage_5_1023v 0 0 0 320.307917888563 ECU_ADDRESS 0x400019C0 /end MEASUREMENT
/begin MEASUREMENT maf_flow_1 "Mass-air-flow reading (primary). Log it -- airflow is the basis of the whole fuel calculation." UWORD CM_u16_flow_10mg_s 0 0 0 655350 ECU_ADDRESS 0x400019C2 /end MEASUREMENT
/begin MEASUREMENT manifold_pressure_calculated "Estimated manifold absolute pressure (mbar); the NA ECU has no MAP sensor. = intercept*baro/1013 + load*29565/(ve_x2*iat_ratio). Feeds 'vacuum' (idle TPS feedforward, evap purge). Not used for fueling." UWORD CM_i16_pressure_mbar 0 0 0 65535 ECU_ADDRESS 0x400019C4 /end MEASUREMENT
/begin MEASUREMENT load_mass_per_stroke_raw "u32_load_mg/stroke" ULONG CM_u16_load_mg_stroke 0 0 0 4294967295 ECU_ADDRESS 0x400019C8 /end MEASUREMENT
/begin MEASUREMENT load_selected_raw "The load value actually selected for the fuel/ign calc. Log it -- this is the load the engine is running on. (mg/stroke)" ULONG CM_u16_load_mg_stroke 0 0 0 4294967295 ECU_ADDRESS 0x400019CC /end MEASUREMENT
/begin MEASUREMENT sensor_adc_maf2 "u16_voltage_5/1023v" UWORD CM_u16_voltage_5_1023v 0 0 0 320.307917888563 ECU_ADDRESS 0x400019D0 /end MEASUREMENT
/begin MEASUREMENT load_alphaN_learn_cell "uint16_t" UWORD NO_COMPU_METHOD 0 0 0 65535 ECU_ADDRESS 0x400019D2 /end MEASUREMENT
/begin MEASUREMENT _load_to_tps_trim_factor_cell "undefined2" UWORD NO_COMPU_METHOD 0 0 0 65535 ECU_ADDRESS 0x400019D4 /end MEASUREMENT
/begin MEASUREMENT map_estimate_intercept "MAP-estimate intercept for current rpm (mbar), before baro scaling. Log with manifold_pressure_calculated to separate intercept vs VE term." UWORD CM_i16_pressure_mbar 0 0 0 65535 ECU_ADDRESS 0x400019D8 /end MEASUREMENT
/begin MEASUREMENT map_estimate_ve_x2 "MAP-estimate VE for current rpm, stored as 2*VE% (= CAL_load_map_estimate_ve raw + 153)." UWORD NO_COMPU_METHOD 0 0 0 65535 ECU_ADDRESS 0x400019DA /end MEASUREMENT
/begin MEASUREMENT load_maf_vs_alphaN_difference "Disagreement between MAF and Alpha-N load. Log to detect a metering/airflow fault. (mg/stroke)" UWORD CM_u16_load_mg_stroke 0 0 0 65535 ECU_ADDRESS 0x400019DC /end MEASUREMENT
/begin MEASUREMENT tps_delta_from_idle "Throttle opening above the closed/idle baseline. Log to detect off-idle tip-in. (0-1; raw/1023)" UWORD CM_u16_factor_1_1023 0 0 0 6406.15835777126 ECU_ADDRESS 0x400019DE /end MEASUREMENT
/begin MEASUREMENT load_computed_maf "Engine load computed from MAF. Log to compare MAF-based vs Alpha-N load. (mg/stroke)" ULONG CM_u16_load_mg_stroke 0 0 0 4294967295 ECU_ADDRESS 0x400019E0 /end MEASUREMENT
/begin MEASUREMENT maf_flow_difference "Difference between the two MAF computations. Log to spot MAF disagreement or a metering fault. (mg/s; raw*10)" UWORD CM_u16_flow_10mg_s 0 0 0 655350 ECU_ADDRESS 0x400019E4 /end MEASUREMENT
/begin MEASUREMENT load_computed_alphaN "Engine load computed from throttle+RPM (Alpha-N). Log to compare against MAF load." ULONG CM_u16_load_mg_stroke 0 0 0 4294967295 ECU_ADDRESS 0x400019E8 /end MEASUREMENT
/begin MEASUREMENT tps_idle_baseline_calculated "Throttle position idle baseline learned. Log to diagnose idle quality, hunting, and stalls. (0-1; raw/1023)" UWORD CM_u16_factor_1_1023 0 0 0 6406.15835777126 ECU_ADDRESS 0x400019EC /end MEASUREMENT
/begin MEASUREMENT ecu_load_alphaN_base "u16_load_mg/stroke" UWORD CM_u16_load_mg_stroke 0 0 0 65535 ECU_ADDRESS 0x400019F0 /end MEASUREMENT
/begin MEASUREMENT load_to_tps_mapping "Load to throttle position mapping. Log to see throttle/pedal demand and throttle response. (0-1; raw/1023)" UWORD CM_u16_factor_1_1023 0 0 0 6406.15835777126 ECU_ADDRESS 0x400019F2 /end MEASUREMENT
/begin MEASUREMENT maf_vs_alphaN_flow_error "u16_flow_10mg/s" UWORD CM_u16_flow_10mg_s 0 0 0 655350 ECU_ADDRESS 0x400019F4 /end MEASUREMENT
/begin MEASUREMENT load_alphaN_trim_factor "u16_factor_1/100" UWORD CM_u8_factor_1_100 0 0 0 65535 ECU_ADDRESS 0x400019F6 /end MEASUREMENT
/begin MEASUREMENT load_to_tps_trim_factor_400019F8 "u16_factor_1/100" UWORD CM_u8_factor_1_100 0 0 0 65535 ECU_ADDRESS 0x400019F8 /end MEASUREMENT
/begin MEASUREMENT transient_load_timer "u8_time_5ms" UBYTE CM_u8_time_5ms 0 0 0 1275 ECU_ADDRESS 0x400019FA /end MEASUREMENT
/begin MEASUREMENT load_mass_per_stroke "Load mass per stroke. Log engine load -- the main axis for fueling and ignition. (mg/stroke; raw*4)" UBYTE CM_u8_load_4mg_stroke 0 0 0 1020 ECU_ADDRESS 0x400019FB /end MEASUREMENT
/begin MEASUREMENT obd_ii_p0106_min_tps "Runtime monitor state for P0106 (MAP/baro rationality). Log to see this monitor evaluate." UBYTE CM_u8_factor_1_255 0 0 0 100 ECU_ADDRESS 0x400019FC /end MEASUREMENT
/begin MEASUREMENT load_tps_scaling_factor "u8_factor_1/255" UBYTE CM_u8_factor_1_255 0 0 0 100 ECU_ADDRESS 0x400019FD /end MEASUREMENT
/begin MEASUREMENT load_selection_tps_threshold "Load selection throttle position threshold. Log to see throttle/pedal demand and throttle response. (0-1; raw/255)" UBYTE CM_u8_factor_1_255 0 0 0 100 ECU_ADDRESS 0x400019FE /end MEASUREMENT
/begin MEASUREMENT knock_inhibit_tps_max "Knock inhibit throttle position max. Log to catch knock events and see how much timing is being pulled. (0-1; raw/255)" UBYTE CM_u8_factor_1_255 0 0 0 100 ECU_ADDRESS 0x400019FF /end MEASUREMENT
/begin MEASUREMENT load_ratio_alphaN_to_maf "u8_factor_1/100" UBYTE CM_u8_factor_1_100 0 0 0 255 ECU_ADDRESS 0x40001A00 /end MEASUREMENT
/begin MEASUREMENT tps_ratio_idle_to_current "u8_factor_1/100" UBYTE CM_u8_factor_1_100 0 0 0 255 ECU_ADDRESS 0x40001A01 /end MEASUREMENT
/begin MEASUREMENT obd_ii_calc_engine_load "undefined1" UBYTE NO_COMPU_METHOD 0 0 0 255 ECU_ADDRESS 0x40001A02 /end MEASUREMENT
/begin MEASUREMENT obd_ii_load_abs "Load ABS. Log engine load -- the main axis for fueling and ignition. (0-1; raw/255)" UWORD CM_u8_factor_1_255 0 0 0 25700 ECU_ADDRESS 0x40001A04 /end MEASUREMENT
/begin MEASUREMENT map_estimate_iat_density_ratio "Air-density temperature ratio for the MAP estimate: 29800/T_K = 100*298K/T (100 at 25 C)." UBYTE CM_u8_factor_1_100 0 0 0 255 ECU_ADDRESS 0x40001A06 /end MEASUREMENT
/begin MEASUREMENT map_estimate_baro_factor "Baro ratio for the MAP estimate: baro*100/1013 (100 = standard atmosphere). Scales the intercept only." UBYTE CM_u8_factor_1_100 0 0 0 255 ECU_ADDRESS 0x40001A07 /end MEASUREMENT
/begin MEASUREMENT load_pct "Engine load as a percentage. Log it -- the common load axis for maps. (0-1; raw/100)" UBYTE CM_u8_factor_1_100 0 0 0 255 ECU_ADDRESS 0x40001A08 /end MEASUREMENT
/begin MEASUREMENT load_source_is_alphaN "Flag: load is currently sourced from Alpha-N rather than MAF. Log to know which model is active." UBYTE NO_COMPU_METHOD 0 0 0 255 ECU_ADDRESS 0x40001A09 /end MEASUREMENT
/begin MEASUREMENT engine_speed_period_adj "undefined2" UWORD NO_COMPU_METHOD 0 0 0 65535 ECU_ADDRESS 0x40001A0A /end MEASUREMENT
/begin MEASUREMENT maf_flow_2 "Mass-air-flow reading (secondary/alternate). Log to cross-check the primary MAF." UWORD CM_u16_flow_10mg_s 0 0 0 655350 ECU_ADDRESS 0x40001A0C /end MEASUREMENT
/begin MEASUREMENT obd_calc_load_wot_airmass "uint8_t" UBYTE NO_COMPU_METHOD 0 0 0 255 ECU_ADDRESS 0x40001A0E /end MEASUREMENT
/begin MEASUREMENT load_density_corrected_8bit "Load density corrected 8bit. Log engine load -- the main axis for fueling and ignition. (mg/stroke; raw*4)" UBYTE CM_u8_load_4mg_stroke 0 0 0 1020 ECU_ADDRESS 0x40001A0F /end MEASUREMENT
/begin MEASUREMENT load_maf_absolute "undefined4" ULONG NO_COMPU_METHOD 0 0 0 4294967295 ECU_ADDRESS 0x40001A10 /end MEASUREMENT
/begin MEASUREMENT vacuum "Estimated manifold vacuum = baro - manifold_pressure_calculated, clamped 0..1023 mbar. Used by idle TPS-from-air-demand and evap purge flow limits." UWORD CM_i16_pressure_mbar 0 0 0 65535 ECU_ADDRESS 0x40001A14 /end MEASUREMENT
/begin MEASUREMENT obd_ii_P0011_debounce_counter "u8_count" UBYTE NO_COMPU_METHOD 0 0 0 255 ECU_ADDRESS 0x40001A18 /end MEASUREMENT
/begin MEASUREMENT obd_ii_P0012_debounce_counter "u8_count" UBYTE NO_COMPU_METHOD 0 0 0 255 ECU_ADDRESS 0x40001A19 /end MEASUREMENT
/begin MEASUREMENT obd_ii_P0021_debounce_counter "u8_count" UBYTE NO_COMPU_METHOD 0 0 0 255 ECU_ADDRESS 0x40001A1A /end MEASUREMENT
/begin MEASUREMENT obd_ii_P0022_debounce_counter "u8_count" UBYTE NO_COMPU_METHOD 0 0 0 255 ECU_ADDRESS 0x40001A1B /end MEASUREMENT
/begin MEASUREMENT obd_ii_P0014_debounce_counter "u8_count" UBYTE NO_COMPU_METHOD 0 0 0 255 ECU_ADDRESS 0x40001A1C /end MEASUREMENT
/begin MEASUREMENT obd_ii_P0015_debounce_counter "u8_count" UBYTE NO_COMPU_METHOD 0 0 0 255 ECU_ADDRESS 0x40001A1D /end MEASUREMENT
/begin MEASUREMENT obd_ii_P0024_debounce_counter "u8_count" UBYTE NO_COMPU_METHOD 0 0 0 255 ECU_ADDRESS 0x40001A1E /end MEASUREMENT
/begin MEASUREMENT obd_ii_P0025_debounce_counter "u8_count" UBYTE NO_COMPU_METHOD 0 0 0 255 ECU_ADDRESS 0x40001A1F /end MEASUREMENT
/begin MEASUREMENT obd_ii_P0016_debounce_counter "u8_count" UBYTE NO_COMPU_METHOD 0 0 0 255 ECU_ADDRESS 0x40001A20 /end MEASUREMENT
/begin MEASUREMENT obd_ii_P0017_debounce_counter "u8_count" UBYTE NO_COMPU_METHOD 0 0 0 255 ECU_ADDRESS 0x40001A21 /end MEASUREMENT
/begin MEASUREMENT obd_ii_P0018_debounce_counter "u8_count" UBYTE NO_COMPU_METHOD 0 0 0 255 ECU_ADDRESS 0x40001A22 /end MEASUREMENT
/begin MEASUREMENT obd_ii_P0019_debounce_counter "u8_count" UBYTE NO_COMPU_METHOD 0 0 0 255 ECU_ADDRESS 0x40001A23 /end MEASUREMENT
/begin MEASUREMENT obd_ii_P0420_debounce_counter "u8_count" UBYTE NO_COMPU_METHOD 0 0 0 255 ECU_ADDRESS 0x40001A30 /end MEASUREMENT
/begin MEASUREMENT obd_ii_P0430_debounce_counter "u8_count" UBYTE NO_COMPU_METHOD 0 0 0 255 ECU_ADDRESS 0x40001A31 /end MEASUREMENT
/begin MEASUREMENT cat_monitor_min_maf_accum_thresh_ "undefined1" UBYTE NO_COMPU_METHOD 0 0 0 255 ECU_ADDRESS 0x40001A32 /end MEASUREMENT
/begin MEASUREMENT obd_ii_o2_postcat_sw_bank1 "undefined2" UWORD NO_COMPU_METHOD 0 0 0 65535 ECU_ADDRESS 0x40001A5E /end MEASUREMENT
/begin MEASUREMENT obd_ii_o2_precat_sw_bank2 "undefined2" UWORD NO_COMPU_METHOD 0 0 0 65535 ECU_ADDRESS 0x40001A64 /end MEASUREMENT
/begin MEASUREMENT obd_ii_o2_precat_sw_bank1 "undefined2" UWORD NO_COMPU_METHOD 0 0 0 65535 ECU_ADDRESS 0x40001A66 /end MEASUREMENT
/begin MEASUREMENT cat_monitor_o2_switch_thresh "undefined2" UWORD NO_COMPU_METHOD 0 0 0 65535 ECU_ADDRESS 0x40001A68 /end MEASUREMENT
/begin MEASUREMENT obd_similar_cond_met_mask "undefined1" UBYTE NO_COMPU_METHOD 0 0 0 255 ECU_ADDRESS 0x40001A88 /end MEASUREMENT
/begin MEASUREMENT obd_monitor_task_scheduler_token "undefined2" UWORD NO_COMPU_METHOD 0 0 0 65535 ECU_ADDRESS 0x40001A8A /end MEASUREMENT
/begin MEASUREMENT obd_ii_montior_passes_bitfield "undefined2" UWORD NO_COMPU_METHOD 0 0 0 65535 ECU_ADDRESS 0x40001A8C /end MEASUREMENT
/begin MEASUREMENT obd_ii_engine_coolant_temp "u8_temp_-40c" UBYTE CM_u8_temp__40c 0 0 -40 215 ECU_ADDRESS 0x40001A8F /end MEASUREMENT
/begin MEASUREMENT obd_ii_dtc_state "undefined1" UBYTE NO_COMPU_METHOD 0 0 0 255 ECU_ADDRESS 0x40001A90 /end MEASUREMENT
/begin MEASUREMENT tpms_handshake_failed "bool" UBYTE NO_COMPU_METHOD 0 0 0 255 ECU_ADDRESS 0x40001A96 /end MEASUREMENT
/begin MEASUREMENT engine_has_run "Flag: engine has run this key cycle. Useful as a logging gate." UBYTE NO_COMPU_METHOD 0 0 0 255 ECU_ADDRESS 0x40001A97 /end MEASUREMENT
/begin MEASUREMENT obd_warmup_ready "undefined1" UBYTE NO_COMPU_METHOD 0 0 0 255 ECU_ADDRESS 0x40001A98 /end MEASUREMENT
/begin MEASUREMENT obd_ii_gd_idle_timer "undefined2" UWORD NO_COMPU_METHOD 0 0 0 65535 ECU_ADDRESS 0x40001AAC /end MEASUREMENT
/begin MEASUREMENT obd_ii_gd_runtime_timer "undefined2" UWORD NO_COMPU_METHOD 0 0 0 65535 ECU_ADDRESS 0x40001AAE /end MEASUREMENT
/begin MEASUREMENT obd_ii_gd_speed_timer "undefined2" UWORD NO_COMPU_METHOD 0 0 0 65535 ECU_ADDRESS 0x40001AB0 /end MEASUREMENT
/begin MEASUREMENT obd_P0122_not_failed "bool" UBYTE NO_COMPU_METHOD 0 0 0 255 ECU_ADDRESS 0x40001AD8 /end MEASUREMENT
/begin MEASUREMENT obd_P0123_not_failed "bool" UBYTE NO_COMPU_METHOD 0 0 0 255 ECU_ADDRESS 0x40001AD9 /end MEASUREMENT
/begin MEASUREMENT obd_P0222_not_failed "bool" UBYTE NO_COMPU_METHOD 0 0 0 255 ECU_ADDRESS 0x40001ADA /end MEASUREMENT
/begin MEASUREMENT obd_P0223_not_failed "bool" UBYTE NO_COMPU_METHOD 0 0 0 255 ECU_ADDRESS 0x40001ADB /end MEASUREMENT
/begin MEASUREMENT obd_P0638_fail_countdown "undefined1" UBYTE NO_COMPU_METHOD 0 0 0 255 ECU_ADDRESS 0x40001ADC /end MEASUREMENT
/begin MEASUREMENT obd_P2119_not_failed "bool" UBYTE NO_COMPU_METHOD 0 0 0 255 ECU_ADDRESS 0x40001ADD /end MEASUREMENT
/begin MEASUREMENT obd_P2173_fail_countdown_ "undefined1" UBYTE NO_COMPU_METHOD 0 0 0 255 ECU_ADDRESS 0x40001ADE /end MEASUREMENT
/begin MEASUREMENT obd_P2135_not_failed "bool" UBYTE NO_COMPU_METHOD 0 0 0 255 ECU_ADDRESS 0x40001ADF /end MEASUREMENT
/begin MEASUREMENT obd_ii_P2104_debounce_counter "u8_count" UBYTE NO_COMPU_METHOD 0 0 0 255 ECU_ADDRESS 0x40001AE0 /end MEASUREMENT
/begin MEASUREMENT obd_ii_P1104_debounce_counter "u8_count" UBYTE NO_COMPU_METHOD 0 0 0 255 ECU_ADDRESS 0x40001AE1 /end MEASUREMENT
/begin MEASUREMENT obd_ii_P2105_debounce_counter "u8_count" UBYTE NO_COMPU_METHOD 0 0 0 255 ECU_ADDRESS 0x40001AE2 /end MEASUREMENT
/begin MEASUREMENT obd_ii_P2106_debounce_counter "u8_count" UBYTE NO_COMPU_METHOD 0 0 0 255 ECU_ADDRESS 0x40001AE3 /end MEASUREMENT
/begin MEASUREMENT obd_ii_P2107_debounce_counter "u8_count" UBYTE NO_COMPU_METHOD 0 0 0 255 ECU_ADDRESS 0x40001AE4 /end MEASUREMENT
/begin MEASUREMENT obd_ii_P2100_debounce_counter "u8_count" UBYTE NO_COMPU_METHOD 0 0 0 255 ECU_ADDRESS 0x40001AE5 /end MEASUREMENT
/begin MEASUREMENT obd_ii_P2102_debounce_counter "u8_count" UBYTE NO_COMPU_METHOD 0 0 0 255 ECU_ADDRESS 0x40001AE6 /end MEASUREMENT
/begin MEASUREMENT obd_ii_P2103_debounce_counter "u8_count" UBYTE NO_COMPU_METHOD 0 0 0 255 ECU_ADDRESS 0x40001AE7 /end MEASUREMENT
/begin MEASUREMENT obd_ii_P2108_debounce_counter "u8_count" UBYTE NO_COMPU_METHOD 0 0 0 255 ECU_ADDRESS 0x40001AE8 /end MEASUREMENT
/begin MEASUREMENT etb_module_fault_latched "bool" UBYTE NO_COMPU_METHOD 0 0 0 255 ECU_ADDRESS 0x40001AE9 /end MEASUREMENT
/begin MEASUREMENT obd_ii_P1106_debounce_counter "u8_count" UBYTE NO_COMPU_METHOD 0 0 0 255 ECU_ADDRESS 0x40001AF0 /end MEASUREMENT
/begin MEASUREMENT hc08_sf_mode_duration "uint16_t" UWORD NO_COMPU_METHOD 0 0 0 65535 ECU_ADDRESS 0x40001AF2 /end MEASUREMENT
/begin MEASUREMENT obd_ii_P2173_alphaN_trim_limit "undefined1" UBYTE NO_COMPU_METHOD 0 0 0 255 ECU_ADDRESS 0x40001AF4 /end MEASUREMENT
/begin MEASUREMENT evap_vent_valve_closed "bool" UBYTE NO_COMPU_METHOD 0 0 0 255 ECU_ADDRESS 0x40001AF8 /end MEASUREMENT
/begin MEASUREMENT obd_ii_P0441_fail_countdown "undefined1" UBYTE NO_COMPU_METHOD 0 0 0 255 ECU_ADDRESS 0x40001AF9 /end MEASUREMENT
/begin MEASUREMENT obd_ii_P0446_fail_countdown "undefined1" UBYTE NO_COMPU_METHOD 0 0 0 255 ECU_ADDRESS 0x40001AFA /end MEASUREMENT
/begin MEASUREMENT evap_canister_purge_solenoid_timer "undefined1" UBYTE NO_COMPU_METHOD 0 0 0 255 ECU_ADDRESS 0x40001AFB /end MEASUREMENT
/begin MEASUREMENT evap_purge_flow_state_timer "undefined1" UBYTE NO_COMPU_METHOD 0 0 0 255 ECU_ADDRESS 0x40001AFD /end MEASUREMENT
/begin MEASUREMENT evap_vent_control_timer "undefined1" UBYTE NO_COMPU_METHOD 0 0 0 255 ECU_ADDRESS 0x40001B00 /end MEASUREMENT
/begin MEASUREMENT evap_purge_stuck_open_test_countdown "undefined1" UBYTE NO_COMPU_METHOD 0 0 0 255 ECU_ADDRESS 0x40001B01 /end MEASUREMENT
/begin MEASUREMENT obd_ii_P0335_debounce_counter "u8_count" UBYTE NO_COMPU_METHOD 0 0 0 255 ECU_ADDRESS 0x40001B08 /end MEASUREMENT
/begin MEASUREMENT obd_ii_P0341_debounce_counter "u8_count" UBYTE NO_COMPU_METHOD 0 0 0 255 ECU_ADDRESS 0x40001B09 /end MEASUREMENT
/begin MEASUREMENT obd_ii_P0346_debounce_counter "u8_count" UBYTE NO_COMPU_METHOD 0 0 0 255 ECU_ADDRESS 0x40001B0A /end MEASUREMENT
/begin MEASUREMENT obd_ii_P0366_debounce_counter "u8_count" UBYTE NO_COMPU_METHOD 0 0 0 255 ECU_ADDRESS 0x40001B0B /end MEASUREMENT
/begin MEASUREMENT obd_ii_P0391_debounce_counter "u8_count" UBYTE NO_COMPU_METHOD 0 0 0 255 ECU_ADDRESS 0x40001B0C /end MEASUREMENT
/begin MEASUREMENT obd_ii_P0500_debounce_counter "u8_count" UBYTE NO_COMPU_METHOD 0 0 0 255 ECU_ADDRESS 0x40001B0D /end MEASUREMENT
/begin MEASUREMENT abs_wheel_speed_validity_flags "undefined1" UBYTE NO_COMPU_METHOD 0 0 0 255 ECU_ADDRESS 0x40001B0E /end MEASUREMENT
/begin MEASUREMENT obd_ii_P0500_test_timer "undefined2" UWORD NO_COMPU_METHOD 0 0 0 65535 ECU_ADDRESS 0x40001B10 /end MEASUREMENT
/begin MEASUREMENT cl_state_flags_bank1 "uint16_t" UWORD NO_COMPU_METHOD 0 0 0 65535 ECU_ADDRESS 0x40001B18 /end MEASUREMENT
/begin MEASUREMENT cl_state_flags_bank2 "uint16_t" UWORD NO_COMPU_METHOD 0 0 0 65535 ECU_ADDRESS 0x40001B1A /end MEASUREMENT
/begin MEASUREMENT stft_bank1 "i16_percent_1/20" SWORD CM_i16_percent_1_20 0 0 -1638.4 1638.35 ECU_ADDRESS 0x40001B1C /end MEASUREMENT
/begin MEASUREMENT stft_bank2 "i16_percent_1/20" SWORD CM_i16_percent_1_20 0 0 -1638.4 1638.35 ECU_ADDRESS 0x40001B1E /end MEASUREMENT
/begin MEASUREMENT cl_status_bank1 "undefined2" UWORD NO_COMPU_METHOD 0 0 0 65535 ECU_ADDRESS 0x40001B20 /end MEASUREMENT
/begin MEASUREMENT cl_status_bank2 "undefined2" UWORD NO_COMPU_METHOD 0 0 0 65535 ECU_ADDRESS 0x40001B22 /end MEASUREMENT
/begin MEASUREMENT stft_filtered_bank1 "i16_percent_1/20" SWORD CM_i16_percent_1_20 0 0 -1638.4 1638.35 ECU_ADDRESS 0x40001B24 /end MEASUREMENT
/begin MEASUREMENT stft_filtered_bank2 "i16_percent_1/20" SWORD CM_i16_percent_1_20 0 0 -1638.4 1638.35 ECU_ADDRESS 0x40001B26 /end MEASUREMENT
/begin MEASUREMENT ltft_bank1 "i16_percent_1/10" SWORD CM_u16_factor_1_1000 0 0 -3276.8 3276.7 ECU_ADDRESS 0x40001B28 /end MEASUREMENT
/begin MEASUREMENT ltft_bank2 "i16_percent_1/10" SWORD CM_u16_factor_1_1000 0 0 -3276.8 3276.7 ECU_ADDRESS 0x40001B2A /end MEASUREMENT
/begin MEASUREMENT obd_ii_fuel_learn_timer "undefined2" UWORD NO_COMPU_METHOD 0 0 0 65535 ECU_ADDRESS 0x40001B2C /end MEASUREMENT
/begin MEASUREMENT obd_ii_fuel_trim_offidle_time_bank1 "u16_time_100ms" UWORD CM_u8_time_100ms 0 0 0 6553500 ECU_ADDRESS 0x40001B2E /end MEASUREMENT
/begin MEASUREMENT obd_ii_fuel_trim_offidle_time_bank2 "u16_time_100ms" UWORD CM_u8_time_100ms 0 0 0 6553500 ECU_ADDRESS 0x40001B30 /end MEASUREMENT
/begin MEASUREMENT obd_ii_fuel_trim_idle_time_bank1 "u16_time_100ms" UWORD CM_u8_time_100ms 0 0 0 6553500 ECU_ADDRESS 0x40001B32 /end MEASUREMENT
/begin MEASUREMENT obd_ii_fuel_trim_idle_time_bank2 "u16_time_100ms" UWORD CM_u8_time_100ms 0 0 0 6553500 ECU_ADDRESS 0x40001B34 /end MEASUREMENT
/begin MEASUREMENT obd_ii_fuel_trim_zone3_time_bank1 "u16_time_100ms" UWORD CM_u8_time_100ms 0 0 0 6553500 ECU_ADDRESS 0x40001B36 /end MEASUREMENT
/begin MEASUREMENT obd_ii_fuel_trim_zone3_time_bank2 "u16_time_100ms" UWORD CM_u8_time_100ms 0 0 0 6553500 ECU_ADDRESS 0x40001B38 /end MEASUREMENT
/begin MEASUREMENT cl_proportional_gain_lean "i16_factor_1/20" SWORD CM_i16_factor_1_20 0 0 -163840 163835 ECU_ADDRESS 0x40001B3A /end MEASUREMENT
/begin MEASUREMENT cl_proportional_gain_rich "undefined2" UWORD NO_COMPU_METHOD 0 0 0 65535 ECU_ADDRESS 0x40001B3C /end MEASUREMENT
/begin MEASUREMENT cl_jump_lean "undefined2" UWORD NO_COMPU_METHOD 0 0 0 65535 ECU_ADDRESS 0x40001B3E /end MEASUREMENT
/begin MEASUREMENT cl_jump_rich "i16_factor_1/20" SWORD CM_i16_factor_1_20 0 0 -163840 163835 ECU_ADDRESS 0x40001B40 /end MEASUREMENT
/begin MEASUREMENT closedloop_activate_time "Closedloop activate time. Log to watch O2 feedback trim the mixture and confirm the loop is active. (ms; raw*5)" UWORD CM_u8_time_5ms 0 0 0 327675 ECU_ADDRESS 0x40001B42 /end MEASUREMENT
/begin MEASUREMENT stft_ramp_rate_bank1 "int16_t" SWORD NO_COMPU_METHOD 0 0 -32768 32767 ECU_ADDRESS 0x40001B44 /end MEASUREMENT
/begin MEASUREMENT stft_ramp_rate_bank2 "int16_t" SWORD NO_COMPU_METHOD 0 0 -32768 32767 ECU_ADDRESS 0x40001B46 /end MEASUREMENT
/begin MEASUREMENT closed_loop_active_bank1 "bool" UBYTE NO_COMPU_METHOD 0 0 0 255 ECU_ADDRESS 0x40001B48 /end MEASUREMENT
/begin MEASUREMENT closed_loop_active_bank2 "bool" UBYTE NO_COMPU_METHOD 0 0 0 255 ECU_ADDRESS 0x40001B49 /end MEASUREMENT
/begin MEASUREMENT stft_ramp_timer_bank1 "undefined2" UWORD NO_COMPU_METHOD 0 0 0 65535 ECU_ADDRESS 0x40001B4A /end MEASUREMENT
/begin MEASUREMENT o2_switch_count_bank1 "uint16_t" UWORD NO_COMPU_METHOD 0 0 0 65535 ECU_ADDRESS 0x40001B4C /end MEASUREMENT
/begin MEASUREMENT stft_ramp_timer_bank2 "undefined2" UWORD NO_COMPU_METHOD 0 0 0 65535 ECU_ADDRESS 0x40001B4E /end MEASUREMENT
/begin MEASUREMENT o2_switch_count_bank2 "uint16_t" UWORD NO_COMPU_METHOD 0 0 0 65535 ECU_ADDRESS 0x40001B50 /end MEASUREMENT
/begin MEASUREMENT stft_filter_accum_bank1 "int32_t" SLONG NO_COMPU_METHOD 0 0 -2147483648 2147483647 ECU_ADDRESS 0x40001B54 /end MEASUREMENT
/begin MEASUREMENT stft_filter_accum_bank2 "int32_t" SLONG NO_COMPU_METHOD 0 0 -2147483648 2147483647 ECU_ADDRESS 0x40001B58 /end MEASUREMENT
/begin MEASUREMENT fuel_learning_zone "uint8_t" UBYTE NO_COMPU_METHOD 0 0 0 255 ECU_ADDRESS 0x40001B62 /end MEASUREMENT
/begin MEASUREMENT cl_transient_holdoff_timer "hold-off after a transient or DFCO event" UBYTE CM_u8_time_100ms 0 0 0 25500 ECU_ADDRESS 0x40001B63 /end MEASUREMENT
/begin MEASUREMENT o2_switch_count_threshold "uint16_t" UWORD NO_COMPU_METHOD 0 0 0 65535 ECU_ADDRESS 0x40001B64 /end MEASUREMENT
/begin MEASUREMENT stft_bank1_prev "i16_percent_1/20" SWORD CM_i16_percent_1_20 0 0 -1638.4 1638.35 ECU_ADDRESS 0x40001B66 /end MEASUREMENT
/begin MEASUREMENT stft_bank2_prev "i16_percent_1/20" SWORD CM_i16_percent_1_20 0 0 -1638.4 1638.35 ECU_ADDRESS 0x40001B68 /end MEASUREMENT
/begin MEASUREMENT stft_bank_sync_hold_timer_bank1 "u16_time_100ms" UWORD CM_u8_time_100ms 0 0 0 6553500 ECU_ADDRESS 0x40001B6A /end MEASUREMENT
/begin MEASUREMENT stft_bank_sync_hold_timer_bank2 "u16_time_100ms" UWORD CM_u8_time_100ms 0 0 0 6553500 ECU_ADDRESS 0x40001B6C /end MEASUREMENT
/begin MEASUREMENT obd_ii_P0171_debounce_counter "u8_count" UBYTE NO_COMPU_METHOD 0 0 0 255 ECU_ADDRESS 0x40001B70 /end MEASUREMENT
/begin MEASUREMENT obd_ii_P0172_debounce_counter "u8_count" UBYTE NO_COMPU_METHOD 0 0 0 255 ECU_ADDRESS 0x40001B71 /end MEASUREMENT
/begin MEASUREMENT obd_ii_P0174_debounce_counter "u8_count" UBYTE NO_COMPU_METHOD 0 0 0 255 ECU_ADDRESS 0x40001B72 /end MEASUREMENT
/begin MEASUREMENT obd_ii_P0175_debounce_counter "u8_count" UBYTE NO_COMPU_METHOD 0 0 0 255 ECU_ADDRESS 0x40001B73 /end MEASUREMENT
/begin MEASUREMENT obd_ii_P2191_debounce_counter "u8_count" UBYTE NO_COMPU_METHOD 0 0 0 255 ECU_ADDRESS 0x40001B74 /end MEASUREMENT
/begin MEASUREMENT obd_ii_P2193_debounce_counter "u8_count" UBYTE NO_COMPU_METHOD 0 0 0 255 ECU_ADDRESS 0x40001B75 /end MEASUREMENT
/begin MEASUREMENT hc08_remote_comm_fault_count "uint16_t" UWORD NO_COMPU_METHOD 0 0 0 65535 ECU_ADDRESS 0x40001BA2 /end MEASUREMENT
/begin MEASUREMENT hc08_rx_timeout_count "uint16_t" UWORD NO_COMPU_METHOD 0 0 0 65535 ECU_ADDRESS 0x40001BA4 /end MEASUREMENT
/begin MEASUREMENT hc08_send_timer "HC08 throttle co-processor send timer. Timer/counter -- log to measure how long a condition persists. (ms; raw*5)" UWORD CM_u8_time_5ms 0 0 0 327675 ECU_ADDRESS 0x40001BAC /end MEASUREMENT
/begin MEASUREMENT throttle_control_mode "Electronic-throttle system state. Log to follow DBW mode transitions/faults." UBYTE NO_COMPU_METHOD 0 0 0 255 ECU_ADDRESS 0x40001BB0 /end MEASUREMENT
/begin MEASUREMENT throttle_control_flags "undefined1" UBYTE NO_COMPU_METHOD 0 0 0 255 ECU_ADDRESS 0x40001BB1 /end MEASUREMENT
/begin MEASUREMENT engine_operating_state_flags "uint16_t" UWORD NO_COMPU_METHOD 0 0 0 65535 ECU_ADDRESS 0x40001BB8 /end MEASUREMENT
/begin MEASUREMENT obd_ii_idle_speed_target_total "Idle speed target total. Log to diagnose idle quality, hunting, and stalls. (RPM)" UWORD CM_u8_rspeed_rpm 0 0 0 65535 ECU_ADDRESS 0x40001BBA /end MEASUREMENT
/begin MEASUREMENT obd_ii_idle_speed_error "i16_rspeed_rpm" SWORD CM_u8_rspeed_rpm 0 0 -32768 32767 ECU_ADDRESS 0x40001BBE /end MEASUREMENT
/begin MEASUREMENT obd_ii_idle_air_output "undefined1" UBYTE NO_COMPU_METHOD 0 0 0 255 ECU_ADDRESS 0x40001BC0 /end MEASUREMENT
/begin MEASUREMENT idle_air_control_proportional_term "undefined2" UWORD NO_COMPU_METHOD 0 0 0 65535 ECU_ADDRESS 0x40001BC2 /end MEASUREMENT
/begin MEASUREMENT idle_air_control_integral_term "undefined4" ULONG NO_COMPU_METHOD 0 0 0 4294967295 ECU_ADDRESS 0x40001BC4 /end MEASUREMENT
/begin MEASUREMENT obd_ii_idle_status "undefined1" UBYTE NO_COMPU_METHOD 0 0 0 255 ECU_ADDRESS 0x40001BC8 /end MEASUREMENT
/begin MEASUREMENT idle_tps_target_calculated "Idle throttle position target calculated. Log to diagnose idle quality, hunting, and stalls." UBYTE CM_u8_flow_100mg_s 0 0 0 25500 ECU_ADDRESS 0x40001BC9 /end MEASUREMENT
/begin MEASUREMENT tps_idle_target_cranking "Throttle position idle target cranking. Log to diagnose idle quality, hunting, and stalls. (0-1; raw/1023)" UBYTE CM_u16_factor_1_1023 0 0 0 24.9266862170088 ECU_ADDRESS 0x40001BCA /end MEASUREMENT
/begin MEASUREMENT idle_air_decay_phase "uint8_t" UBYTE NO_COMPU_METHOD 0 0 0 255 ECU_ADDRESS 0x40001BCB /end MEASUREMENT
/begin MEASUREMENT idle_stabilization_timer "undefined1" UBYTE NO_COMPU_METHOD 0 0 0 255 ECU_ADDRESS 0x40001BCC /end MEASUREMENT
/begin MEASUREMENT timer_above_min_carspeed "undefined1" UBYTE NO_COMPU_METHOD 0 0 0 255 ECU_ADDRESS 0x40001BCD /end MEASUREMENT
/begin MEASUREMENT idle_air_comp_dashpot "u8_flow_100mg/s" UBYTE CM_u8_flow_100mg_s 0 0 0 25500 ECU_ADDRESS 0x40001BCE /end MEASUREMENT
/begin MEASUREMENT idle_air_hi_rpm_adder_full_rpm "u16_rspeed_rpm" UWORD CM_u8_rspeed_rpm 0 0 0 65535 ECU_ADDRESS 0x40001BD0 /end MEASUREMENT
/begin MEASUREMENT idle_control_entry_rpm "u16_rspeed_rpm" UWORD CM_u8_rspeed_rpm 0 0 0 65535 ECU_ADDRESS 0x40001BD2 /end MEASUREMENT
/begin MEASUREMENT idle_comp_ecu_voltage "undefined2" UWORD NO_COMPU_METHOD 0 0 0 65535 ECU_ADDRESS 0x40001BD8 /end MEASUREMENT
/begin MEASUREMENT idle_air_integral_step "u8_factor_1/255" UBYTE CM_u8_factor_1_255 0 0 0 100 ECU_ADDRESS 0x40001BDD /end MEASUREMENT
/begin MEASUREMENT idle_comp_carspeed_decaying "Idle compensation carspeed decaying. Log to diagnose idle quality, hunting, and stalls. (RPM)" UWORD CM_u8_rspeed_rpm 0 0 0 65535 ECU_ADDRESS 0x40001BDE /end MEASUREMENT
/begin MEASUREMENT idle_comp_carspeed "u16_flow_100mg/s" UWORD CM_u8_flow_100mg_s 0 0 0 6553500 ECU_ADDRESS 0x40001BE0 /end MEASUREMENT
/begin MEASUREMENT idle_air_comp_ac "u8_flow_100mg/s" UBYTE CM_u8_flow_100mg_s 0 0 0 25500 ECU_ADDRESS 0x40001BE2 /end MEASUREMENT
/begin MEASUREMENT idle_air_comp_fan_1 "u8_flow_100mg/s" UBYTE CM_u8_flow_100mg_s 0 0 0 25500 ECU_ADDRESS 0x40001BE3 /end MEASUREMENT
/begin MEASUREMENT idle_air_comp_fan_2 "u8_flow_100mg/s" UBYTE CM_u8_flow_100mg_s 0 0 0 25500 ECU_ADDRESS 0x40001BE4 /end MEASUREMENT
/begin MEASUREMENT idle_air_comp_bay_fan "u8_flow_100mg/s" UBYTE CM_u8_flow_100mg_s 0 0 0 25500 ECU_ADDRESS 0x40001BE5 /end MEASUREMENT
/begin MEASUREMENT idle_comp_baro "u8_flow_100mg/s" UBYTE CM_u8_flow_100mg_s 0 0 0 25500 ECU_ADDRESS 0x40001BE6 /end MEASUREMENT
/begin MEASUREMENT idle_air_base "u8_flow_100mg/s" UBYTE CM_u8_flow_100mg_s 0 0 0 25500 ECU_ADDRESS 0x40001BE7 /end MEASUREMENT
/begin MEASUREMENT idle_air_warmup_factor "u8_factor_1/64" UBYTE CM_u8_factor_1_64 0 0 0 398.4375 ECU_ADDRESS 0x40001BE8 /end MEASUREMENT
/begin MEASUREMENT idle_air_hi_rpm_adder "u8_factor_1/255" UBYTE CM_u8_factor_1_255 0 0 0 100 ECU_ADDRESS 0x40001BE9 /end MEASUREMENT
/begin MEASUREMENT vacuum_4mbar "Estimated vacuum in 4 mbar steps (vacuum>>2, 0..255), Y input to CAL_idle_tps_from_air_demand." UWORD CM_u8_pressure_4mbar 0 0 0 262140 ECU_ADDRESS 0x40001BEA /end MEASUREMENT
/begin MEASUREMENT idle_comp_high_rpm_transient "Idle compensation high RPM transient. Log to diagnose idle quality, hunting, and stalls. (RPM)" UWORD CM_u8_rspeed_rpm 0 0 0 65535 ECU_ADDRESS 0x40001BEC /end MEASUREMENT
/begin MEASUREMENT idle_air_comp_ign_startup "u8_flow_100mg/s" UBYTE CM_u8_flow_100mg_s 0 0 0 25500 ECU_ADDRESS 0x40001BEE /end MEASUREMENT
/begin MEASUREMENT idle_comp_ign_variant "u8_flow_100mg/s" UBYTE CM_u8_flow_100mg_s 0 0 0 25500 ECU_ADDRESS 0x40001BEF /end MEASUREMENT
/begin MEASUREMENT idle_air_comp_misfire "u8_flow_100mg/s" UBYTE CM_u8_flow_100mg_s 0 0 0 25500 ECU_ADDRESS 0x40001BF0 /end MEASUREMENT
/begin MEASUREMENT idle_air_low_load_cam_active "Idle ignition variant enabled unknown. Log spark advance to confirm the timing strategy and headroom to knock." UBYTE NO_COMPU_METHOD 0 0 0 255 ECU_ADDRESS 0x40001BF1 /end MEASUREMENT
/begin MEASUREMENT idle_air_fast_decay_flag "Idle air fast decay flag. Log to diagnose idle quality, hunting, and stalls." UBYTE NO_COMPU_METHOD 0 0 0 255 ECU_ADDRESS 0x40001BF2 /end MEASUREMENT
/begin MEASUREMENT idle_strategy "Idle strategy. Log to diagnose idle quality, hunting, and stalls." UBYTE NO_COMPU_METHOD 0 0 0 255 ECU_ADDRESS 0x40001BF3 /end MEASUREMENT
/begin MEASUREMENT idle_rolling_target_delta "u16_rspeed_rpm" UWORD CM_u8_rspeed_rpm 0 0 0 65535 ECU_ADDRESS 0x40001BF4 /end MEASUREMENT
/begin MEASUREMENT idle_air_learn_coolant_interpolated "uint32_t" ULONG NO_COMPU_METHOD 0 0 0 4294967295 ECU_ADDRESS 0x40001BF8 /end MEASUREMENT
/begin MEASUREMENT idle_comp_decay_step_timer "u8_time_ms" UBYTE CM_u8_time_ms 0 0 0 255 ECU_ADDRESS 0x40001BFD /end MEASUREMENT
/begin MEASUREMENT idle_air_decay_step_timer "u8_time_ms" UBYTE CM_u8_time_ms 0 0 0 255 ECU_ADDRESS 0x40001BFE /end MEASUREMENT
/begin MEASUREMENT idle_comp_decay_step "u8_rspeed_rpm" UBYTE CM_u8_rspeed_rpm 0 0 0 255 ECU_ADDRESS 0x40001BFF /end MEASUREMENT
/begin MEASUREMENT idle_comp_timer_carspeed "Idle compensation timer carspeed. Log to diagnose idle quality, hunting, and stalls. (RPM)" UWORD CM_u8_rspeed_rpm 0 0 0 65535 ECU_ADDRESS 0x40001C00 /end MEASUREMENT
/begin MEASUREMENT idle_comp_iat "Idle compensation intake-air temp. Log to diagnose idle quality, hunting, and stalls. (RPM)" UBYTE CM_u8_rspeed_rpm 0 0 0 255 ECU_ADDRESS 0x40001C02 /end MEASUREMENT
/begin MEASUREMENT idle_rolling_target_delta_slewed "u16_rspeed_rpm" UWORD CM_u8_rspeed_rpm 0 0 0 65535 ECU_ADDRESS 0x40001C04 /end MEASUREMENT
/begin MEASUREMENT idle_comp_car_speed "Idle compensation car speed. Log to diagnose idle quality, hunting, and stalls. (RPM)" UWORD CM_u8_rspeed_rpm 0 0 0 65535 ECU_ADDRESS 0x40001C06 /end MEASUREMENT
/begin MEASUREMENT idle_air_decay_target "u16_factor_1/255" UWORD CM_u8_factor_1_255 0 0 0 25700 ECU_ADDRESS 0x40001C08 /end MEASUREMENT
/begin MEASUREMENT idle_dashpot_rpm_lift_max "u16_rspeed_rpm" UWORD CM_u8_rspeed_rpm 0 0 0 65535 ECU_ADDRESS 0x40001C0A /end MEASUREMENT
/begin MEASUREMENT idle_tps_requested "Idle throttle position requested. Log to diagnose idle quality, hunting, and stalls. (0-1; raw/1023)" UWORD CM_u16_factor_1_1023 0 0 0 6406.15835777126 ECU_ADDRESS 0x40001C0C /end MEASUREMENT
/begin MEASUREMENT obd_ii_P0506_debounce_counter "u8_count" UBYTE NO_COMPU_METHOD 0 0 0 255 ECU_ADDRESS 0x40001C10 /end MEASUREMENT
/begin MEASUREMENT obd_ii_P0507_debounce_counter "u8_count" UBYTE NO_COMPU_METHOD 0 0 0 255 ECU_ADDRESS 0x40001C11 /end MEASUREMENT
/begin MEASUREMENT obd_ii_P050A_debounce_counter "u8_count" UBYTE NO_COMPU_METHOD 0 0 0 255 ECU_ADDRESS 0x40001C12 /end MEASUREMENT
/begin MEASUREMENT knock_ign_retard_sum "Knock ignition retard2 sum. Log spark advance to confirm the timing strategy and headroom to knock." SWORD CM_u8_angle_1_4deg 0 0 -8192 8191.75 ECU_ADDRESS 0x40001C2E /end MEASUREMENT
/begin MEASUREMENT knock_flags "undefined1" UBYTE NO_COMPU_METHOD 0 0 0 255 ECU_ADDRESS 0x40001C30 /end MEASUREMENT
/begin MEASUREMENT knock_sampling_window_offset "undefined1" UBYTE NO_COMPU_METHOD 0 0 0 255 ECU_ADDRESS 0x40001C31 /end MEASUREMENT
/begin MEASUREMENT ign_adv_delta_to_knock_safe "Ignition advance delta to knock safe. Log spark advance to confirm the timing strategy and headroom to knock. (deg; raw/4)" SWORD CM_u8_angle_1_4deg 0 0 -8192 8191.75 ECU_ADDRESS 0x40001C40 /end MEASUREMENT
/begin MEASUREMENT knock_inhibit_timer_tps_rate "undefined1" UBYTE NO_COMPU_METHOD 0 0 0 255 ECU_ADDRESS 0x40001C42 /end MEASUREMENT
/begin MEASUREMENT octane_scaler_current_min "undefined2" UWORD NO_COMPU_METHOD 0 0 0 65535 ECU_ADDRESS 0x40001C44 /end MEASUREMENT
/begin MEASUREMENT knock_gain_mode_unknown2 "undefined1" UBYTE NO_COMPU_METHOD 0 0 0 255 ECU_ADDRESS 0x40001C4A /end MEASUREMENT
/begin MEASUREMENT knock_gain_mode_unknown1 "undefined1" UBYTE NO_COMPU_METHOD 0 0 0 255 ECU_ADDRESS 0x40001C4B /end MEASUREMENT
/begin MEASUREMENT obd_ii_P0455_debounce_counter "u8_count" UBYTE NO_COMPU_METHOD 0 0 0 255 ECU_ADDRESS 0x40001C58 /end MEASUREMENT
/begin MEASUREMENT evap_system_state_flags "undefined4" ULONG NO_COMPU_METHOD 0 0 0 4294967295 ECU_ADDRESS 0x40001C5C /end MEASUREMENT
/begin MEASUREMENT obd_ii_system_leak_status "undefined1" UBYTE NO_COMPU_METHOD 0 0 0 255 ECU_ADDRESS 0x40001C62 /end MEASUREMENT
/begin MEASUREMENT evap_leak_test_decay_corrected "undefined2" UWORD NO_COMPU_METHOD 0 0 0 65535 ECU_ADDRESS 0x40001C64 /end MEASUREMENT
/begin MEASUREMENT obd_ii_eval_leak_check_result "undefined2" UWORD NO_COMPU_METHOD 0 0 0 65535 ECU_ADDRESS 0x40001C66 /end MEASUREMENT
/begin MEASUREMENT evap_leak_test_P0456_limit "undefined1" UBYTE NO_COMPU_METHOD 0 0 0 255 ECU_ADDRESS 0x40001C68 /end MEASUREMENT
/begin MEASUREMENT evap_leak_test_P0442_limit "undefined1" UBYTE NO_COMPU_METHOD 0 0 0 255 ECU_ADDRESS 0x40001C69 /end MEASUREMENT
/begin MEASUREMENT evap_leak_test_pressure_swing "undefined2" UWORD NO_COMPU_METHOD 0 0 0 65535 ECU_ADDRESS 0x40001C6A /end MEASUREMENT
/begin MEASUREMENT evap_leak_test_decay_start_pressure "undefined2" UWORD NO_COMPU_METHOD 0 0 0 65535 ECU_ADDRESS 0x40001C70 /end MEASUREMENT
/begin MEASUREMENT evap_leak_test_pulldown_target "undefined2" UWORD NO_COMPU_METHOD 0 0 0 65535 ECU_ADDRESS 0x40001C78 /end MEASUREMENT
/begin MEASUREMENT obd_ii_P0456_debounce_counter "u8_count" UBYTE NO_COMPU_METHOD 0 0 0 255 ECU_ADDRESS 0x40001C80 /end MEASUREMENT
/begin MEASUREMENT obd_ii_P0442_debounce_counter "u8_count" UBYTE NO_COMPU_METHOD 0 0 0 255 ECU_ADDRESS 0x40001C81 /end MEASUREMENT
/begin MEASUREMENT evap_leak_test_idle_dwell_timer "u16_time_100ms" UWORD CM_u8_time_100ms 0 0 0 6553500 ECU_ADDRESS 0x40001C82 /end MEASUREMENT
/begin MEASUREMENT hc_prog_mode_mem "Hc prog mode mem. Runtime state -- log to observe this behavior." ULONG NO_COMPU_METHOD 0 0 0 4294967295 ECU_ADDRESS 0x40001C98 /end MEASUREMENT
/begin MEASUREMENT main_diagnostic_flags "undefined2" UWORD NO_COMPU_METHOD 0 0 0 65535 ECU_ADDRESS 0x40001CA0 /end MEASUREMENT
/begin MEASUREMENT obd_ii_P050B_fail_counter "uint16_t" UWORD NO_COMPU_METHOD 0 0 0 65535 ECU_ADDRESS 0x40001CA2 /end MEASUREMENT
/begin MEASUREMENT obd_ii_P2340_retard_debounce_counter "u8_count" UBYTE NO_COMPU_METHOD 0 0 0 255 ECU_ADDRESS 0x40001CAE /end MEASUREMENT
/begin MEASUREMENT obd_ii_P2341_retard_debounce_counter "u8_count" UBYTE NO_COMPU_METHOD 0 0 0 255 ECU_ADDRESS 0x40001CB0 /end MEASUREMENT
/begin MEASUREMENT obd_ii_P2340_octane_debounce_counter "u8_count" UBYTE NO_COMPU_METHOD 0 0 0 255 ECU_ADDRESS 0x40001CBA /end MEASUREMENT
/begin MEASUREMENT obd_ii_P2341_octane_debounce_counter "u8_count" UBYTE NO_COMPU_METHOD 0 0 0 255 ECU_ADDRESS 0x40001CBC /end MEASUREMENT
/begin MEASUREMENT obd_ii_P0300_debounce_counter "u8_count" UBYTE NO_COMPU_METHOD 0 0 0 255 ECU_ADDRESS 0x40001CC0 /end MEASUREMENT
/begin MEASUREMENT obd_ii_P0301_debounce_counter "u8_count" UBYTE NO_COMPU_METHOD 0 0 0 255 ECU_ADDRESS 0x40001CC1 /end MEASUREMENT
/begin MEASUREMENT obd_ii_P0302_debounce_counter "u8_count" UBYTE NO_COMPU_METHOD 0 0 0 255 ECU_ADDRESS 0x40001CC2 /end MEASUREMENT
/begin MEASUREMENT obd_ii_P0303_debounce_counter "u8_count" UBYTE NO_COMPU_METHOD 0 0 0 255 ECU_ADDRESS 0x40001CC3 /end MEASUREMENT
/begin MEASUREMENT obd_ii_P0304_debounce_counter "u8_count" UBYTE NO_COMPU_METHOD 0 0 0 255 ECU_ADDRESS 0x40001CC4 /end MEASUREMENT
/begin MEASUREMENT obd_ii_P0305_debounce_counter "u8_count" UBYTE NO_COMPU_METHOD 0 0 0 255 ECU_ADDRESS 0x40001CC5 /end MEASUREMENT
/begin MEASUREMENT obd_ii_P0306_debounce_counter "u8_count" UBYTE NO_COMPU_METHOD 0 0 0 255 ECU_ADDRESS 0x40001CC6 /end MEASUREMENT
/begin MEASUREMENT obd_ii_P1301_debounce_counter "u8_count" UBYTE NO_COMPU_METHOD 0 0 0 255 ECU_ADDRESS 0x40001CC7 /end MEASUREMENT
/begin MEASUREMENT obd_ii_P1302_debounce_counter "u8_count" UBYTE NO_COMPU_METHOD 0 0 0 255 ECU_ADDRESS 0x40001CC8 /end MEASUREMENT
/begin MEASUREMENT misfire_threshold_current_window "undefined2" UWORD NO_COMPU_METHOD 0 0 0 65535 ECU_ADDRESS 0x40001CCA /end MEASUREMENT
/begin MEASUREMENT misfire_p1302_pass_holdoff_timer "undefined2" UWORD NO_COMPU_METHOD 0 0 0 65535 ECU_ADDRESS 0x40001CCC /end MEASUREMENT
/begin MEASUREMENT misfire_detect_min_load "Misfire detect min load. Log to find misfires and which cylinder is responsible. (mg/stroke; raw*4)" UBYTE CM_u8_load_4mg_stroke 0 0 0 1020 ECU_ADDRESS 0x40001CCF /end MEASUREMENT
/begin MEASUREMENT misfire_rough_road_hold_timer "undefined2" UWORD NO_COMPU_METHOD 0 0 0 65535 ECU_ADDRESS 0x40001CD0 /end MEASUREMENT
/begin MEASUREMENT misfire_tps_rate_hold_timer "undefined2" UWORD NO_COMPU_METHOD 0 0 0 65535 ECU_ADDRESS 0x40001CD2 /end MEASUREMENT
/begin MEASUREMENT misfire_wheel_speed_deviation "Wheelspeeds unknown. Runtime state -- log to observe this behavior." ULONG NO_COMPU_METHOD 0 0 0 4294967295 ECU_ADDRESS 0x40001CE8 /end MEASUREMENT
/begin MEASUREMENT misfire_wheel_speed_filt_x256 "Wheelspeeds unknown2. Runtime state -- log to observe this behavior." ULONG NO_COMPU_METHOD 0 0 0 4294967295 ECU_ADDRESS 0x40001CF8 /end MEASUREMENT
/begin MEASUREMENT misfire_wheel_speed_filt "Wheel speed offset unknown. Runtime state -- log to observe this behavior." ULONG NO_COMPU_METHOD 0 0 0 4294967295 ECU_ADDRESS 0x40001D08 /end MEASUREMENT
/begin MEASUREMENT misfire_last_sampled_cyl "undefined1" UBYTE NO_COMPU_METHOD 0 0 0 255 ECU_ADDRESS 0x40001D1E /end MEASUREMENT
/begin MEASUREMENT failed_ignition_cyl_count "Failed ignition cylinder count. Runtime state -- log to observe this behavior." UBYTE NO_COMPU_METHOD 0 0 0 255 ECU_ADDRESS 0x40001D24 /end MEASUREMENT
/begin MEASUREMENT misfire_enable_hold_timer "undefined2" UWORD NO_COMPU_METHOD 0 0 0 65535 ECU_ADDRESS 0x40001D26 /end MEASUREMENT
/begin MEASUREMENT misfire_sensitivity "Misfire sensitivity. Log to find misfires and which cylinder is responsible." UWORD NO_COMPU_METHOD 0 0 0 65535 ECU_ADDRESS 0x40001D2C /end MEASUREMENT
/begin MEASUREMENT misfire_rpm_load_threshold_scaled "undefined2" UWORD NO_COMPU_METHOD 0 0 0 65535 ECU_ADDRESS 0x40001D2E /end MEASUREMENT
/begin MEASUREMENT obd_ii_max_misfire_results_emissions "undefined2" UWORD NO_COMPU_METHOD 0 0 0 65535 ECU_ADDRESS 0x40001D34 /end MEASUREMENT
/begin MEASUREMENT misfire_emissions_limit "undefined1" UBYTE NO_COMPU_METHOD 0 0 0 255 ECU_ADDRESS 0x40001D36 /end MEASUREMENT
/begin MEASUREMENT misfire_condition_flags "undefined4" ULONG NO_COMPU_METHOD 0 0 0 4294967295 ECU_ADDRESS 0x40001D38 /end MEASUREMENT
/begin MEASUREMENT obd_DTC_pending_count "undefined1" UBYTE NO_COMPU_METHOD 0 0 0 255 ECU_ADDRESS 0x40001D78 /end MEASUREMENT
/begin MEASUREMENT obd_ii_mode08_active_test_mask "undefined1" UBYTE NO_COMPU_METHOD 0 0 0 255 ECU_ADDRESS 0x40001D80 /end MEASUREMENT
/begin MEASUREMENT obd_ii_mode08_evap_test_timer "u16_time_5ms" UWORD CM_u8_time_5ms 0 0 0 327675 ECU_ADDRESS 0x40001D86 /end MEASUREMENT
/begin MEASUREMENT obd_DTC_confirmed_count "undefined1" UBYTE NO_COMPU_METHOD 0 0 0 255 ECU_ADDRESS 0x40001D88 /end MEASUREMENT
/begin MEASUREMENT obd_ii_mode13_enable "bool" UBYTE NO_COMPU_METHOD 0 0 0 255 ECU_ADDRESS 0x40001D89 /end MEASUREMENT
/begin MEASUREMENT calibration_verification_number "Calibration verification number. Runtime state -- log to observe this behavior." UWORD NO_COMPU_METHOD 0 0 0 65535 ECU_ADDRESS 0x40001D90 /end MEASUREMENT
/begin MEASUREMENT obd_ii_P0140_debounce_counter "u8_count" UBYTE NO_COMPU_METHOD 0 0 0 255 ECU_ADDRESS 0x40001D98 /end MEASUREMENT
/begin MEASUREMENT obd_ii_P0160_debounce_counter "u8_count" UBYTE NO_COMPU_METHOD 0 0 0 255 ECU_ADDRESS 0x40001D99 /end MEASUREMENT
/begin MEASUREMENT o2_sensor_1_leanrich "undefined" ULONG NO_COMPU_METHOD 0 0 0 4294967295 ECU_ADDRESS 0x40001DBC /end MEASUREMENT
/begin MEASUREMENT o2_sensor_5_leanrich "undefined" ULONG NO_COMPU_METHOD 0 0 0 4294967295 ECU_ADDRESS 0x40001DBD /end MEASUREMENT
/begin MEASUREMENT obd_ii_o2_precat_diag_timer_bank2 "undefined2" UWORD NO_COMPU_METHOD 0 0 0 65535 ECU_ADDRESS 0x40001DFE /end MEASUREMENT
/begin MEASUREMENT obd_ii_o2_precat_diag_timer_bank1 "undefined2" UWORD NO_COMPU_METHOD 0 0 0 65535 ECU_ADDRESS 0x40001E00 /end MEASUREMENT
/begin MEASUREMENT obd_ii_P0159_debounce_counter "u8_count" UBYTE NO_COMPU_METHOD 0 0 0 255 ECU_ADDRESS 0x40001E34 /end MEASUREMENT
/begin MEASUREMENT obd_ii_P0154_debounce_counter "u8_count" UBYTE NO_COMPU_METHOD 0 0 0 255 ECU_ADDRESS 0x40001E35 /end MEASUREMENT
/begin MEASUREMENT obd_ii_P0153_debounce_counter "u8_count" UBYTE NO_COMPU_METHOD 0 0 0 255 ECU_ADDRESS 0x40001E36 /end MEASUREMENT
/begin MEASUREMENT obd_ii_P0139_debounce_counter "u8_count" UBYTE NO_COMPU_METHOD 0 0 0 255 ECU_ADDRESS 0x40001E37 /end MEASUREMENT
/begin MEASUREMENT obd_ii_P0134_debounce_counter "u8_count" UBYTE NO_COMPU_METHOD 0 0 0 255 ECU_ADDRESS 0x40001E38 /end MEASUREMENT
/begin MEASUREMENT obd_ii_P0133_debounce_counter "u8_count" UBYTE NO_COMPU_METHOD 0 0 0 255 ECU_ADDRESS 0x40001E39 /end MEASUREMENT
/begin MEASUREMENT cylinder_seq_sync_flags "Cylinder seq sync flags. Runtime state -- log to observe this behavior." UBYTE NO_COMPU_METHOD 0 0 0 255 ECU_ADDRESS 0x40001E42 /end MEASUREMENT
/begin MEASUREMENT obd_ii_P0079_debounce_counter "u8_count" UBYTE NO_COMPU_METHOD 0 0 0 255 ECU_ADDRESS 0x40001E52 /end MEASUREMENT
/begin MEASUREMENT obd_ii_P0080_debounce_counter "u8_count" UBYTE NO_COMPU_METHOD 0 0 0 255 ECU_ADDRESS 0x40001E53 /end MEASUREMENT
/begin MEASUREMENT obd_ii_P0082_debounce_counter "u8_count" UBYTE NO_COMPU_METHOD 0 0 0 255 ECU_ADDRESS 0x40001E54 /end MEASUREMENT
/begin MEASUREMENT obd_ii_P0083_debounce_counter "u8_count" UBYTE NO_COMPU_METHOD 0 0 0 255 ECU_ADDRESS 0x40001E55 /end MEASUREMENT
/begin MEASUREMENT obd_ii_P0085_debounce_counter "u8_count" UBYTE NO_COMPU_METHOD 0 0 0 255 ECU_ADDRESS 0x40001E56 /end MEASUREMENT
/begin MEASUREMENT obd_ii_P0086_debounce_counter "u8_count" UBYTE NO_COMPU_METHOD 0 0 0 255 ECU_ADDRESS 0x40001E57 /end MEASUREMENT
/begin MEASUREMENT obd_ii_P0261_debounce_counter "u8_count" UBYTE NO_COMPU_METHOD 0 0 0 255 ECU_ADDRESS 0x40001E58 /end MEASUREMENT
/begin MEASUREMENT obd_ii_P0262_debounce_counter "u8_count" UBYTE NO_COMPU_METHOD 0 0 0 255 ECU_ADDRESS 0x40001E59 /end MEASUREMENT
/begin MEASUREMENT obd_ii_P0264_debounce_counter "u8_count" UBYTE NO_COMPU_METHOD 0 0 0 255 ECU_ADDRESS 0x40001E5A /end MEASUREMENT
/begin MEASUREMENT obd_ii_P0265_debounce_counter "u8_count" UBYTE NO_COMPU_METHOD 0 0 0 255 ECU_ADDRESS 0x40001E5B /end MEASUREMENT
/begin MEASUREMENT obd_ii_P0267_debounce_counter "u8_count" UBYTE NO_COMPU_METHOD 0 0 0 255 ECU_ADDRESS 0x40001E5C /end MEASUREMENT
/begin MEASUREMENT obd_ii_P0268_debounce_counter "u8_count" UBYTE NO_COMPU_METHOD 0 0 0 255 ECU_ADDRESS 0x40001E5D /end MEASUREMENT
/begin MEASUREMENT obd_ii_P0270_debounce_counter "u8_count" UBYTE NO_COMPU_METHOD 0 0 0 255 ECU_ADDRESS 0x40001E5E /end MEASUREMENT
/begin MEASUREMENT obd_ii_P0271_debounce_counter "u8_count" UBYTE NO_COMPU_METHOD 0 0 0 255 ECU_ADDRESS 0x40001E5F /end MEASUREMENT
/begin MEASUREMENT obd_ii_P0273_debounce_counter "u8_count" UBYTE NO_COMPU_METHOD 0 0 0 255 ECU_ADDRESS 0x40001E60 /end MEASUREMENT
/begin MEASUREMENT obd_ii_P0274_debounce_counter "u8_count" UBYTE NO_COMPU_METHOD 0 0 0 255 ECU_ADDRESS 0x40001E61 /end MEASUREMENT
/begin MEASUREMENT obd_ii_P0276_debounce_counter "u8_count" UBYTE NO_COMPU_METHOD 0 0 0 255 ECU_ADDRESS 0x40001E62 /end MEASUREMENT
/begin MEASUREMENT obd_ii_P0277_debounce_counter "u8_count" UBYTE NO_COMPU_METHOD 0 0 0 255 ECU_ADDRESS 0x40001E63 /end MEASUREMENT
/begin MEASUREMENT obd_ii_P0351_debounce_counter "u8_count" UBYTE NO_COMPU_METHOD 0 0 0 255 ECU_ADDRESS 0x40001E64 /end MEASUREMENT
/begin MEASUREMENT obd_ii_P0352_debounce_counter "u8_count" UBYTE NO_COMPU_METHOD 0 0 0 255 ECU_ADDRESS 0x40001E65 /end MEASUREMENT
/begin MEASUREMENT obd_ii_P0353_debounce_counter "u8_count" UBYTE NO_COMPU_METHOD 0 0 0 255 ECU_ADDRESS 0x40001E66 /end MEASUREMENT
/begin MEASUREMENT obd_ii_P0354_debounce_counter "u8_count" UBYTE NO_COMPU_METHOD 0 0 0 255 ECU_ADDRESS 0x40001E67 /end MEASUREMENT
/begin MEASUREMENT obd_ii_P0355_debounce_counter "u8_count" UBYTE NO_COMPU_METHOD 0 0 0 255 ECU_ADDRESS 0x40001E68 /end MEASUREMENT
/begin MEASUREMENT obd_ii_P0356_debounce_counter "u8_count" UBYTE NO_COMPU_METHOD 0 0 0 255 ECU_ADDRESS 0x40001E69 /end MEASUREMENT
/begin MEASUREMENT obd_ii_P0135_debounce_counter "u8_count" UBYTE NO_COMPU_METHOD 0 0 0 255 ECU_ADDRESS 0x40001E6A /end MEASUREMENT
/begin MEASUREMENT obd_ii_P0155_debounce_counter "u8_count" UBYTE NO_COMPU_METHOD 0 0 0 255 ECU_ADDRESS 0x40001E6B /end MEASUREMENT
/begin MEASUREMENT obd_ii_P0141_heater_current_debounce_counter "u8_count" UBYTE NO_COMPU_METHOD 0 0 0 255 ECU_ADDRESS 0x40001E6C /end MEASUREMENT
/begin MEASUREMENT obd_ii_P0161_debounce_counter "u8_count" UBYTE NO_COMPU_METHOD 0 0 0 255 ECU_ADDRESS 0x40001E6D /end MEASUREMENT
/begin MEASUREMENT obd_ii_P0647_debounce_counter "u8_count" UBYTE NO_COMPU_METHOD 0 0 0 255 ECU_ADDRESS 0x40001E7E /end MEASUREMENT
/begin MEASUREMENT obd_ii_P0646_debounce_counter "u8_count" UBYTE NO_COMPU_METHOD 0 0 0 255 ECU_ADDRESS 0x40001E82 /end MEASUREMENT
/begin MEASUREMENT obd_ii_P0444_debounce_counter "u8_count" UBYTE NO_COMPU_METHOD 0 0 0 255 ECU_ADDRESS 0x40001E86 /end MEASUREMENT
/begin MEASUREMENT obd_ii_P0445_debounce_counter "u8_count" UBYTE NO_COMPU_METHOD 0 0 0 255 ECU_ADDRESS 0x40001E8A /end MEASUREMENT
/begin MEASUREMENT obd_ii_P0628_debounce_counter "u8_count" UBYTE NO_COMPU_METHOD 0 0 0 255 ECU_ADDRESS 0x40001EB6 /end MEASUREMENT
/begin MEASUREMENT obd_ii_P0629_debounce_counter "u8_count" UBYTE NO_COMPU_METHOD 0 0 0 255 ECU_ADDRESS 0x40001EBA /end MEASUREMENT
/begin MEASUREMENT obd_ii_P0480_debounce_counter "u8_count" UBYTE NO_COMPU_METHOD 0 0 0 255 ECU_ADDRESS 0x40001EBE /end MEASUREMENT
/begin MEASUREMENT obd_ii_P0481_debounce_counter "u8_count" UBYTE NO_COMPU_METHOD 0 0 0 255 ECU_ADDRESS 0x40001EC2 /end MEASUREMENT
/begin MEASUREMENT obd_ii_P0482_debounce_counter "u8_count" UBYTE NO_COMPU_METHOD 0 0 0 255 ECU_ADDRESS 0x40001EC6 /end MEASUREMENT
/begin MEASUREMENT obd_ii_P0447_debounce_counter "u8_count" UBYTE NO_COMPU_METHOD 0 0 0 255 ECU_ADDRESS 0x40001ED2 /end MEASUREMENT
/begin MEASUREMENT obd_ii_P0448_debounce_counter "u8_count" UBYTE NO_COMPU_METHOD 0 0 0 255 ECU_ADDRESS 0x40001ED6 /end MEASUREMENT
/begin MEASUREMENT obd_ii_P2602_debounce_counter "u8_count" UBYTE NO_COMPU_METHOD 0 0 0 255 ECU_ADDRESS 0x40001EDA /end MEASUREMENT
/begin MEASUREMENT obd_ii_P2603_debounce_counter "u8_count" UBYTE NO_COMPU_METHOD 0 0 0 255 ECU_ADDRESS 0x40001EDE /end MEASUREMENT
/begin MEASUREMENT obd_ii_P1113_debounce_counter "u8_count" UBYTE NO_COMPU_METHOD 0 0 0 255 ECU_ADDRESS 0x40001EE3 /end MEASUREMENT
/begin MEASUREMENT obd_ii_P0661_debounce_counter "u8_count" UBYTE NO_COMPU_METHOD 0 0 0 255 ECU_ADDRESS 0x40001EE6 /end MEASUREMENT
/begin MEASUREMENT obd_ii_P0662_debounce_counter "u8_count" UBYTE NO_COMPU_METHOD 0 0 0 255 ECU_ADDRESS 0x40001EEA /end MEASUREMENT
/begin MEASUREMENT obd_ii_P0616_debounce_counter "u8_count" UBYTE NO_COMPU_METHOD 0 0 0 255 ECU_ADDRESS 0x40001EEE /end MEASUREMENT
/begin MEASUREMENT obd_ii_P0617_debounce_counter "u8_count" UBYTE NO_COMPU_METHOD 0 0 0 255 ECU_ADDRESS 0x40001EF2 /end MEASUREMENT
/begin MEASUREMENT obd_ii_P2612_debounce_counter "u8_count" UBYTE NO_COMPU_METHOD 0 0 0 255 ECU_ADDRESS 0x40001EF6 /end MEASUREMENT
/begin MEASUREMENT obd_ii_P2613_debounce_counter "u8_count" UBYTE NO_COMPU_METHOD 0 0 0 255 ECU_ADDRESS 0x40001EFA /end MEASUREMENT
/begin MEASUREMENT accelerator_pedal_pos_d "u16_factor_1/1023" UWORD CM_u16_factor_1_1023 0 0 0 6406.15835777126 ECU_ADDRESS 0x40001F08 /end MEASUREMENT
/begin MEASUREMENT accelerator_pedal_pos_e "u16_factor_1/1023" UWORD CM_u16_factor_1_1023 0 0 0 6406.15835777126 ECU_ADDRESS 0x40001F0A /end MEASUREMENT
/begin MEASUREMENT tps_target "Commanded throttle-plate target (DBW). Log against actual TPS to check throttle-servo tracking." UWORD CM_u16_factor_1_1023 0 0 0 6406.15835777126 ECU_ADDRESS 0x40001F0C /end MEASUREMENT
/begin MEASUREMENT accel_pedal_latched "Latched accelerator-pedal position. Log to compare driver demand to delivered throttle. (0-1; raw/1023)" UWORD CM_u16_factor_1_1023 0 0 0 6406.15835777126 ECU_ADDRESS 0x40001F0E /end MEASUREMENT
/begin MEASUREMENT tps_driver_requested "undefined2" UWORD NO_COMPU_METHOD 0 0 0 65535 ECU_ADDRESS 0x40001F12 /end MEASUREMENT
/begin MEASUREMENT dca_stationary_wait_timer "undefined2" UWORD NO_COMPU_METHOD 0 0 0 65535 ECU_ADDRESS 0x40001F14 /end MEASUREMENT
/begin MEASUREMENT dca_active_timer "undefined2" UWORD NO_COMPU_METHOD 0 0 0 65535 ECU_ADDRESS 0x40001F16 /end MEASUREMENT
/begin MEASUREMENT dca_activate_timer "Drive-Cycle-Assist activate timer. Log to observe Drive-Cycle-Assist activation (normally off). (ms; raw*5)" UBYTE CM_u8_time_5ms 0 0 0 1275 ECU_ADDRESS 0x40001F18 /end MEASUREMENT
/begin MEASUREMENT dca_tps_idle_delta "undefined2" UWORD NO_COMPU_METHOD 0 0 0 65535 ECU_ADDRESS 0x40001F1A /end MEASUREMENT
/begin MEASUREMENT dca_tps_target_limit "undefined2" UWORD NO_COMPU_METHOD 0 0 0 65535 ECU_ADDRESS 0x40001F1C /end MEASUREMENT
/begin MEASUREMENT dca_accel_pedal_raw "undefined2" UWORD NO_COMPU_METHOD 0 0 0 65535 ECU_ADDRESS 0x40001F1E /end MEASUREMENT
/begin MEASUREMENT dca_accel_pedal "undefined2" UWORD NO_COMPU_METHOD 0 0 0 65535 ECU_ADDRESS 0x40001F20 /end MEASUREMENT
/begin MEASUREMENT dca_tps_ramp_step "undefined2" UWORD NO_COMPU_METHOD 0 0 0 65535 ECU_ADDRESS 0x40001F22 /end MEASUREMENT
/begin MEASUREMENT dca_tps_ramp_target "undefined2" UWORD NO_COMPU_METHOD 0 0 0 65535 ECU_ADDRESS 0x40001F24 /end MEASUREMENT
/begin MEASUREMENT dca_tps_ramp_index "undefined2" UWORD NO_COMPU_METHOD 0 0 0 65535 ECU_ADDRESS 0x40001F26 /end MEASUREMENT
/begin MEASUREMENT dca_config_enabled "Drive-Cycle-Assist config enabled. Log to observe Drive-Cycle-Assist activation (normally off)." UBYTE NO_COMPU_METHOD 0 0 0 255 ECU_ADDRESS 0x40001F28 /end MEASUREMENT
/begin MEASUREMENT obd_ii_P2138_debounce_counter "u8_count" UBYTE NO_COMPU_METHOD 0 0 0 255 ECU_ADDRESS 0x40001F29 /end MEASUREMENT
/begin MEASUREMENT obd_ii_P2122_debounce_counter "u8_count" UBYTE NO_COMPU_METHOD 0 0 0 255 ECU_ADDRESS 0x40001F2C /end MEASUREMENT
/begin MEASUREMENT obd_ii_P2123_debounce_counter "u8_count" UBYTE NO_COMPU_METHOD 0 0 0 255 ECU_ADDRESS 0x40001F30 /end MEASUREMENT
/begin MEASUREMENT obd_ii_P2127_debounce_counter "u8_count" UBYTE NO_COMPU_METHOD 0 0 0 255 ECU_ADDRESS 0x40001F34 /end MEASUREMENT
/begin MEASUREMENT obd_ii_P2128_debounce_counter "u8_count" UBYTE NO_COMPU_METHOD 0 0 0 255 ECU_ADDRESS 0x40001F38 /end MEASUREMENT
/begin MEASUREMENT accel_pedal_debounce_counter "undefined1" UBYTE NO_COMPU_METHOD 0 0 0 255 ECU_ADDRESS 0x40001F3C /end MEASUREMENT
/begin MEASUREMENT accel_pedal_debounce_expired "undefined1" UBYTE NO_COMPU_METHOD 0 0 0 255 ECU_ADDRESS 0x40001F3D /end MEASUREMENT
/begin MEASUREMENT dca_mode "Drive-Cycle-Assist mode. Log to observe Drive-Cycle-Assist activation (normally off)." UBYTE NO_COMPU_METHOD 0 0 0 255 ECU_ADDRESS 0x40001F3E /end MEASUREMENT
/begin MEASUREMENT obd_ii_commanded_evap_purge "u16_factor_1/255" UWORD CM_u8_factor_1_255 0 0 0 25700 ECU_ADDRESS 0x40001F40 /end MEASUREMENT
/begin MEASUREMENT evap_purge_flags "uint16_t" UWORD NO_COMPU_METHOD 0 0 0 65535 ECU_ADDRESS 0x40001F42 /end MEASUREMENT
/begin MEASUREMENT evap_purge_duty "uint8_t" UBYTE NO_COMPU_METHOD 0 0 0 255 ECU_ADDRESS 0x40001F44 /end MEASUREMENT
/begin MEASUREMENT idle_bypass_airflow "u16_flow_mg/s" UWORD CM_u16_flow_mg_s 0 0 0 65535 ECU_ADDRESS 0x40001F46 /end MEASUREMENT
/begin MEASUREMENT load_comp_idle "u16_load_mg/stroke" UWORD CM_u16_load_mg_stroke 0 0 0 65535 ECU_ADDRESS 0x40001F48 /end MEASUREMENT
/begin MEASUREMENT evap_purge_fuel_mass_b1 "u16_mass_10ug" UWORD CM_u16_mass_10ug 0 0 0 655350 ECU_ADDRESS 0x40001F4C /end MEASUREMENT
/begin MEASUREMENT evap_purge_fuel_mass_b2 "u16_mass_10ug" UWORD CM_u16_mass_10ug 0 0 0 655350 ECU_ADDRESS 0x40001F4E /end MEASUREMENT
/begin MEASUREMENT obd_ii_evap_vapor_concentration "undefined2" UWORD NO_COMPU_METHOD 0 0 0 65535 ECU_ADDRESS 0x40001F50 /end MEASUREMENT
/begin MEASUREMENT evap_purge_vacuum_filtered "Low-pass filtered estimated manifold vacuum (mbar) used by evap purge (flow limit, vacuum-min gates, commanded-purge table)." SWORD CM_i16_pressure_mbar 0 0 -32768 32767 ECU_ADDRESS 0x40001F5A /end MEASUREMENT
/begin MEASUREMENT evap_purge_airflow_scaled_unused "undefined1" UBYTE NO_COMPU_METHOD 0 0 0 255 ECU_ADDRESS 0x40001F5C /end MEASUREMENT
/begin MEASUREMENT evap_purge_solenoid_duty_table "undefined2" UWORD NO_COMPU_METHOD 0 0 0 65535 ECU_ADDRESS 0x40001F60 /end MEASUREMENT
/begin MEASUREMENT evap_purge_duty_ramped "undefined2" UWORD NO_COMPU_METHOD 0 0 0 65535 ECU_ADDRESS 0x40001F7C /end MEASUREMENT
/begin MEASUREMENT evap_purge_duty_max "u8_dutycycle_100/255" UBYTE CM_u8_factor_1_255 0 0 0 100 ECU_ADDRESS 0x40001F7E /end MEASUREMENT
/begin MEASUREMENT evap_purge_duty_max_flow "u8_dutycycle_100/255" UBYTE CM_u8_factor_1_255 0 0 0 100 ECU_ADDRESS 0x40001F7F /end MEASUREMENT
/begin MEASUREMENT evap_purge_duty_max_fuel "u8_dutycycle_100/255" UBYTE CM_u8_factor_1_255 0 0 0 100 ECU_ADDRESS 0x40001F80 /end MEASUREMENT
/begin MEASUREMENT evap_purge_vacuum_filter_acc "IIR accumulator (x256) for evap_purge_vacuum_filtered; alpha = CAL_evap_purge_filter_alpha/256." ULONG NO_COMPU_METHOD 0 0 0 4294967295 ECU_ADDRESS 0x40001F94 /end MEASUREMENT
/begin MEASUREMENT evap_purge_inj_fuel_mass_min "undefined2" UWORD NO_COMPU_METHOD 0 0 0 65535 ECU_ADDRESS 0x40001F98 /end MEASUREMENT
/begin MEASUREMENT evap_stft_settle_timer "undefined1" UBYTE NO_COMPU_METHOD 0 0 0 255 ECU_ADDRESS 0x40001FA6 /end MEASUREMENT
/begin MEASUREMENT evap_purge_open_kick_timer "u8_time_100ms" UBYTE CM_u8_time_100ms 0 0 0 25500 ECU_ADDRESS 0x40001FA7 /end MEASUREMENT
/begin MEASUREMENT obd_ii_mode2f_flags_enabled "undefined4" ULONG NO_COMPU_METHOD 0 0 0 4294967295 ECU_ADDRESS 0x40001FB0 /end MEASUREMENT
/begin MEASUREMENT obd_ii_mode2f_flags_state "undefined4" ULONG NO_COMPU_METHOD 0 0 0 4294967295 ECU_ADDRESS 0x40001FB4 /end MEASUREMENT
/begin MEASUREMENT engine_off_obd_gate_timer "undefined2" UWORD NO_COMPU_METHOD 0 0 0 65535 ECU_ADDRESS 0x40001FBC /end MEASUREMENT
/begin MEASUREMENT obd_ii_mode2f_vvti_output_val "undefined1" UBYTE NO_COMPU_METHOD 0 0 0 255 ECU_ADDRESS 0x40001FBE /end MEASUREMENT
/begin MEASUREMENT obd_ii_mode2f_tach_commanded "undefined2" UWORD NO_COMPU_METHOD 0 0 0 65535 ECU_ADDRESS 0x40001FC0 /end MEASUREMENT
/begin MEASUREMENT obd_mode2f_evap_purge_duty "u8_factor_1/255" UBYTE CM_u8_factor_1_255 0 0 0 100 ECU_ADDRESS 0x40001FC2 /end MEASUREMENT
/begin MEASUREMENT obd_dyno_mode_active "bool" UBYTE NO_COMPU_METHOD 0 0 0 255 ECU_ADDRESS 0x40001FC3 /end MEASUREMENT
/begin MEASUREMENT obd_ii_mode2f_injector_pulse_timer "undefined1" UBYTE NO_COMPU_METHOD 0 0 0 255 ECU_ADDRESS 0x40001FE4 /end MEASUREMENT
/begin MEASUREMENT obd_ii_mode2f_coil_pulse_timer "undefined1" UBYTE NO_COMPU_METHOD 0 0 0 255 ECU_ADDRESS 0x40001FE5 /end MEASUREMENT
/begin MEASUREMENT obd_ii_mode2f_timeout "undefined2" UWORD NO_COMPU_METHOD 0 0 0 65535 ECU_ADDRESS 0x40001FE8 /end MEASUREMENT
/begin MEASUREMENT obd_ii_monitor_status_this_drive_cycle "undefined2" UWORD NO_COMPU_METHOD 0 0 0 65535 ECU_ADDRESS 0x40001FF2 /end MEASUREMENT
/begin MEASUREMENT obd_ii_P0111_debounce_counter "u8_count" UBYTE NO_COMPU_METHOD 0 0 0 255 ECU_ADDRESS 0x40002000 /end MEASUREMENT
/begin MEASUREMENT obd_ii_P0112_debounce_counter "u8_count" UBYTE NO_COMPU_METHOD 0 0 0 255 ECU_ADDRESS 0x40002001 /end MEASUREMENT
/begin MEASUREMENT obd_ii_P0113_debounce_counter "u8_count" UBYTE NO_COMPU_METHOD 0 0 0 255 ECU_ADDRESS 0x40002002 /end MEASUREMENT
/begin MEASUREMENT obd_ii_P0071_fail_counter "uint8_t" UBYTE NO_COMPU_METHOD 0 0 0 255 ECU_ADDRESS 0x40002003 /end MEASUREMENT
/begin MEASUREMENT obd_ii_P0116_debounce_counter "u8_count" UBYTE NO_COMPU_METHOD 0 0 0 255 ECU_ADDRESS 0x40002004 /end MEASUREMENT
/begin MEASUREMENT obd_ii_P0117_debounce_counter "u8_count" UBYTE NO_COMPU_METHOD 0 0 0 255 ECU_ADDRESS 0x40002005 /end MEASUREMENT
/begin MEASUREMENT obd_ii_P0118_debounce_counter "u8_count" UBYTE NO_COMPU_METHOD 0 0 0 255 ECU_ADDRESS 0x40002006 /end MEASUREMENT
/begin MEASUREMENT obd_ii_P0131_debounce_counter "u8_count" UBYTE NO_COMPU_METHOD 0 0 0 255 ECU_ADDRESS 0x40002007 /end MEASUREMENT
/begin MEASUREMENT obd_ii_P0806_debounce_counter "u8_count" UBYTE NO_COMPU_METHOD 0 0 0 255 ECU_ADDRESS 0x4000200C /end MEASUREMENT
/begin MEASUREMENT obd_ii_P0807_debounce_counter "u8_count" UBYTE NO_COMPU_METHOD 0 0 0 255 ECU_ADDRESS 0x4000200D /end MEASUREMENT
/begin MEASUREMENT obd_ii_P0808_debounce_counter "u8_count" UBYTE NO_COMPU_METHOD 0 0 0 255 ECU_ADDRESS 0x4000200E /end MEASUREMENT
/begin MEASUREMENT engine_state_failure_flags "undefined4" ULONG NO_COMPU_METHOD 0 0 0 4294967295 ECU_ADDRESS 0x40002014 /end MEASUREMENT
/begin MEASUREMENT obd_ii_P0101_maf_alphaN_load_ratio_pct "undefined2" UWORD NO_COMPU_METHOD 0 0 0 65535 ECU_ADDRESS 0x40002018 /end MEASUREMENT
/begin MEASUREMENT obd_ii_P0101_idle_debounce_counter "u8_count" UBYTE NO_COMPU_METHOD 0 0 0 255 ECU_ADDRESS 0x4000201A /end MEASUREMENT
/begin MEASUREMENT obd_ii_P0101_offidle_debounce_counter "u8_count" UBYTE NO_COMPU_METHOD 0 0 0 255 ECU_ADDRESS 0x4000201B /end MEASUREMENT
/begin MEASUREMENT obd_ii_P0102_debounce_counter "u8_count" UBYTE NO_COMPU_METHOD 0 0 0 255 ECU_ADDRESS 0x40002020 /end MEASUREMENT
/begin MEASUREMENT obd_ii_P0107_debounce_counter "u8_count" UBYTE NO_COMPU_METHOD 0 0 0 255 ECU_ADDRESS 0x40002028 /end MEASUREMENT
/begin MEASUREMENT obd_ii_P0108_debounce_counter "u8_count" UBYTE NO_COMPU_METHOD 0 0 0 255 ECU_ADDRESS 0x4000202C /end MEASUREMENT
/begin MEASUREMENT obd_ii_P0327_debounce_counter "u8_count" UBYTE NO_COMPU_METHOD 0 0 0 255 ECU_ADDRESS 0x4000204E /end MEASUREMENT
/begin MEASUREMENT obd_ii_P0328_debounce_counter "u8_count" UBYTE NO_COMPU_METHOD 0 0 0 255 ECU_ADDRESS 0x40002052 /end MEASUREMENT
/begin MEASUREMENT obd_ii_P0332_debounce_counter "u8_count" UBYTE NO_COMPU_METHOD 0 0 0 255 ECU_ADDRESS 0x40002056 /end MEASUREMENT
/begin MEASUREMENT obd_ii_P0333_debounce_counter "u8_count" UBYTE NO_COMPU_METHOD 0 0 0 255 ECU_ADDRESS 0x4000205A /end MEASUREMENT
/begin MEASUREMENT obd_ii_P0452_debounce_counter "u8_count" UBYTE NO_COMPU_METHOD 0 0 0 255 ECU_ADDRESS 0x40002066 /end MEASUREMENT
/begin MEASUREMENT obd_ii_P0453_debounce_counter "u8_count" UBYTE NO_COMPU_METHOD 0 0 0 255 ECU_ADDRESS 0x4000206A /end MEASUREMENT
/begin MEASUREMENT obd_ii_P0462_debounce_counter "u8_count" UBYTE NO_COMPU_METHOD 0 0 0 255 ECU_ADDRESS 0x4000206E /end MEASUREMENT
/begin MEASUREMENT obd_ii_P0463_debounce_counter "u8_count" UBYTE NO_COMPU_METHOD 0 0 0 255 ECU_ADDRESS 0x40002072 /end MEASUREMENT
/begin MEASUREMENT obd_ii_P0523_debounce_counter "u8_count" UBYTE NO_COMPU_METHOD 0 0 0 255 ECU_ADDRESS 0x40002076 /end MEASUREMENT
/begin MEASUREMENT obd_ii_P0563_debounce_counter "u8_count" UBYTE NO_COMPU_METHOD 0 0 0 255 ECU_ADDRESS 0x4000207A /end MEASUREMENT
/begin MEASUREMENT obd_ii_P0562_debounce_counter "u8_count" UBYTE NO_COMPU_METHOD 0 0 0 255 ECU_ADDRESS 0x4000207E /end MEASUREMENT
/begin MEASUREMENT obd_ii_P0685_debounce_counter "u8_count" UBYTE NO_COMPU_METHOD 0 0 0 255 ECU_ADDRESS 0x40002083 /end MEASUREMENT
/begin MEASUREMENT obd_ii_P0827_debounce_counter "u8_count" UBYTE NO_COMPU_METHOD 0 0 0 255 ECU_ADDRESS 0x40002087 /end MEASUREMENT
/begin MEASUREMENT obd_ii_P0828_debounce_counter "u8_count" UBYTE NO_COMPU_METHOD 0 0 0 255 ECU_ADDRESS 0x4000208A /end MEASUREMENT
/begin MEASUREMENT obd_ii_P1809_debounce_counter "u8_count" UBYTE NO_COMPU_METHOD 0 0 0 255 ECU_ADDRESS 0x4000208E /end MEASUREMENT
/begin MEASUREMENT obd_ii_P1562_debounce_counter "u8_count" UBYTE NO_COMPU_METHOD 0 0 0 255 ECU_ADDRESS 0x4000208F /end MEASUREMENT
/begin MEASUREMENT obd_ii_P0111_stage "undefined1" UBYTE NO_COMPU_METHOD 0 0 0 255 ECU_ADDRESS 0x40002092 /end MEASUREMENT
/begin MEASUREMENT obd_ii_P0111_high_airflow_timer "undefined2" UWORD NO_COMPU_METHOD 0 0 0 65535 ECU_ADDRESS 0x4000209A /end MEASUREMENT
/begin MEASUREMENT obd_ii_P0101_load_tolerance "u8_factor_1/100" UBYTE CM_u8_factor_1_100 0 0 0 255 ECU_ADDRESS 0x4000209C /end MEASUREMENT
/begin MEASUREMENT obd_ii_P0571_debounce_counter "u8_count" UBYTE NO_COMPU_METHOD 0 0 0 255 ECU_ADDRESS 0x4000209D /end MEASUREMENT
/begin MEASUREMENT bootloader_rx_buffer "Bootloader rx buffer. Internal/infrastructure state -- not a typical data-logging channel." UBYTE NO_COMPU_METHOD 0 0 0 255 ECU_ADDRESS 0x400020A8 /end MEASUREMENT
/begin MEASUREMENT obd_ii_P0106_debounce_counter "u8_count" UBYTE NO_COMPU_METHOD 0 0 0 255 ECU_ADDRESS 0x400020B1 /end MEASUREMENT
/begin MEASUREMENT obd_p0106_baro_estimate_no_throttle "P0106 part-load estimate without the throttle-vacuum term (MAP model + intake drop). Diagnostic only." UWORD CM_i16_pressure_mbar 0 0 0 65535 ECU_ADDRESS 0x400020CC /end MEASUREMENT
/begin MEASUREMENT obd_p0106_baro_corr_highload "P0106 high-load correction (mbar) subtracted from the baro estimate." UBYTE CM_i16_pressure_mbar 0 0 0 255 ECU_ADDRESS 0x400020CE /end MEASUREMENT
/begin MEASUREMENT obd_p0106_throttle_vacuum_model "P0106 part-load expected vacuum across the throttle (4 mbar), rpm-interpolated between the rpm_lo and rpm_hi tables." UBYTE CM_u8_pressure_4mbar 0 0 0 1020 ECU_ADDRESS 0x400020CF /end MEASUREMENT
/begin MEASUREMENT obd_p0106_throttle_vacuum_rpm_hi "P0106 expected throttle vacuum from the rpm-window-high table (4 mbar)." UBYTE CM_u8_pressure_4mbar 0 0 0 1020 ECU_ADDRESS 0x400020D0 /end MEASUREMENT
/begin MEASUREMENT obd_p0106_throttle_vacuum_rpm_lo "P0106 expected throttle vacuum from the rpm-window-low table (4 mbar)." UBYTE CM_u8_pressure_4mbar 0 0 0 1020 ECU_ADDRESS 0x400020D1 /end MEASUREMENT
/begin MEASUREMENT obd_p0106_baro_error "P0106 error = baro sensor - obd_p0106_baro_estimate (mbar). Fails if > limits[0] or < -limits[1]." SWORD CM_i16_pressure_mbar 0 0 -32768 32767 ECU_ADDRESS 0x400020D2 /end MEASUREMENT
/begin MEASUREMENT obd_p0106_baro_estimate "P0106 modelled baro (mbar) = MAP model (unscaled intercept + VE term) + intake drop(MAF) + throttle vacuum model (part load) or - high-load corr. 0 when not evaluating." UWORD CM_i16_pressure_mbar 0 0 0 65535 ECU_ADDRESS 0x400020D6 /end MEASUREMENT
/begin MEASUREMENT obd_ii_P0128_air_mass_threshold "undefined1" UBYTE NO_COMPU_METHOD 0 0 0 255 ECU_ADDRESS 0x400020D8 /end MEASUREMENT
/begin MEASUREMENT obd_P0128_weighted_air_mass "undefined4" ULONG NO_COMPU_METHOD 0 0 0 4294967295 ECU_ADDRESS 0x400020DC /end MEASUREMENT
/begin MEASUREMENT obd_P0128_heat_weight "u8_factor_1/255" UBYTE CM_u8_factor_1_255 0 0 0 100 ECU_ADDRESS 0x400020E0 /end MEASUREMENT
/begin MEASUREMENT obd_ii_P0128_fail_countdown "undefined1" UBYTE NO_COMPU_METHOD 0 0 0 255 ECU_ADDRESS 0x400020E1 /end MEASUREMENT
/begin MEASUREMENT obd_ii_P0128_lowspeed_seconds "uint32_t" ULONG NO_COMPU_METHOD 0 0 0 4294967295 ECU_ADDRESS 0x400020E4 /end MEASUREMENT
/begin MEASUREMENT obd_ii_P0128_iat_too_cold_latch "bool" UBYTE NO_COMPU_METHOD 0 0 0 255 ECU_ADDRESS 0x400020E8 /end MEASUREMENT
/begin MEASUREMENT obd_ii_P0461_debounce_counter "u8_count" UBYTE NO_COMPU_METHOD 0 0 0 255 ECU_ADDRESS 0x400020F7 /end MEASUREMENT
/begin MEASUREMENT obd_ii_P0451_debounce_counter "u8_count" UBYTE NO_COMPU_METHOD 0 0 0 255 ECU_ADDRESS 0x400020F8 /end MEASUREMENT
/begin MEASUREMENT vvt_task_rate_divider "undefined1" UBYTE NO_COMPU_METHOD 0 0 0 255 ECU_ADDRESS 0x40002118 /end MEASUREMENT
/begin MEASUREMENT vvt_intake_adv_net "u16_angle_1/4deg" UWORD CM_u8_angle_1_4deg 0 0 0 16383.75 ECU_ADDRESS 0x4000211A /end MEASUREMENT
/begin MEASUREMENT vvt_exhaust_advance "u16_angle_1/4deg" UWORD CM_u8_angle_1_4deg 0 0 0 16383.75 ECU_ADDRESS 0x4000211C /end MEASUREMENT
/begin MEASUREMENT vvt_pi_p_term_inlet_b1 "undefined2" UWORD NO_COMPU_METHOD 0 0 0 65535 ECU_ADDRESS 0x4000211E /end MEASUREMENT
/begin MEASUREMENT vvt_pi_integral_inlet_b1 "int32_t" SLONG NO_COMPU_METHOD 0 0 -2147483648 2147483647 ECU_ADDRESS 0x40002120 /end MEASUREMENT
/begin MEASUREMENT vvt_pi_output_inlet_b1 "undefined4" ULONG NO_COMPU_METHOD 0 0 0 4294967295 ECU_ADDRESS 0x40002124 /end MEASUREMENT
/begin MEASUREMENT vvt_pi_p_term_inlet_b2 "undefined2" UWORD NO_COMPU_METHOD 0 0 0 65535 ECU_ADDRESS 0x40002128 /end MEASUREMENT
/begin MEASUREMENT vvt_pi_integral_inlet_b2 "int32_t" SLONG NO_COMPU_METHOD 0 0 -2147483648 2147483647 ECU_ADDRESS 0x4000212C /end MEASUREMENT
/begin MEASUREMENT vvt_pi_output_inlet_b2 "undefined4" ULONG NO_COMPU_METHOD 0 0 0 4294967295 ECU_ADDRESS 0x40002130 /end MEASUREMENT
/begin MEASUREMENT vvt_pi_p_term_exhaust_b1 "undefined2" UWORD NO_COMPU_METHOD 0 0 0 65535 ECU_ADDRESS 0x40002134 /end MEASUREMENT
/begin MEASUREMENT vvt_pi_integral_exhaust_b1 "int32_t" SLONG NO_COMPU_METHOD 0 0 -2147483648 2147483647 ECU_ADDRESS 0x40002138 /end MEASUREMENT
/begin MEASUREMENT vvt_pi_output_exhaust_b1 "undefined4" ULONG NO_COMPU_METHOD 0 0 0 4294967295 ECU_ADDRESS 0x4000213C /end MEASUREMENT
/begin MEASUREMENT vvt_pi_p_term_exhaust_b2 "undefined2" UWORD NO_COMPU_METHOD 0 0 0 65535 ECU_ADDRESS 0x40002140 /end MEASUREMENT
/begin MEASUREMENT vvt_pi_integral_exhaust_b2 "int32_t" SLONG NO_COMPU_METHOD 0 0 -2147483648 2147483647 ECU_ADDRESS 0x40002144 /end MEASUREMENT
/begin MEASUREMENT vvt_pi_output_exhaust_b2 "undefined4" ULONG NO_COMPU_METHOD 0 0 0 4294967295 ECU_ADDRESS 0x40002148 /end MEASUREMENT
/begin MEASUREMENT vvt_intake_transition_complete "VVT intake transition complete. Log commanded vs actual cam timing to verify VVT response." UBYTE NO_COMPU_METHOD 0 0 0 255 ECU_ADDRESS 0x4000214C /end MEASUREMENT
/begin MEASUREMENT vvt_exhaust_transition_complete "VVT exhaust transition complete. Log commanded vs actual cam timing to verify VVT response." UBYTE NO_COMPU_METHOD 0 0 0 255 ECU_ADDRESS 0x4000214D /end MEASUREMENT
/begin MEASUREMENT cam_park_position_sum_inlet_b1 "undefined4" ULONG NO_COMPU_METHOD 0 0 0 4294967295 ECU_ADDRESS 0x40002150 /end MEASUREMENT
/begin MEASUREMENT cam_park_position_sum_inlet_b2 "u32_angle_1/4deg" ULONG CM_u8_angle_1_4deg 0 0 0 1073741823.75 ECU_ADDRESS 0x40002154 /end MEASUREMENT
/begin MEASUREMENT cam_park_position_sum_exhaust_b1 "undefined4" ULONG NO_COMPU_METHOD 0 0 0 4294967295 ECU_ADDRESS 0x40002158 /end MEASUREMENT
/begin MEASUREMENT cam_park_position_sum_exhaust_b2 "undefined4" ULONG NO_COMPU_METHOD 0 0 0 4294967295 ECU_ADDRESS 0x4000215C /end MEASUREMENT
/begin MEASUREMENT cam_park_sample_count_inlet_b1 "undefined4" ULONG NO_COMPU_METHOD 0 0 0 4294967295 ECU_ADDRESS 0x40002160 /end MEASUREMENT
/begin MEASUREMENT cam_park_sample_count_inlet_b2 "undefined4" ULONG NO_COMPU_METHOD 0 0 0 4294967295 ECU_ADDRESS 0x40002164 /end MEASUREMENT
/begin MEASUREMENT cam_park_sample_count_exhaust_b1 "undefined4" ULONG NO_COMPU_METHOD 0 0 0 4294967295 ECU_ADDRESS 0x40002168 /end MEASUREMENT
/begin MEASUREMENT cam_park_sample_count_exhaust_b2 "undefined4" ULONG NO_COMPU_METHOD 0 0 0 4294967295 ECU_ADDRESS 0x4000216C /end MEASUREMENT
/begin MEASUREMENT vvt_park_integral_reset_flags "uint8_t" UBYTE NO_COMPU_METHOD 0 0 0 255 ECU_ADDRESS 0x40002170 /end MEASUREMENT
/begin MEASUREMENT vvt_intake_target_zero_timer "VVT inlet bank1 zero timer. Log commanded vs actual cam timing to verify VVT response. (ms; raw*100)" UBYTE CM_u8_time_100ms 0 0 0 25500 ECU_ADDRESS 0x40002171 /end MEASUREMENT
/begin MEASUREMENT vvt_exhaust_target_zero_timer "VVT inlet bank2 zero timer. Log commanded vs actual cam timing to verify VVT response. (ms; raw*100)" UBYTE CM_u8_time_100ms 0 0 0 25500 ECU_ADDRESS 0x40002172 /end MEASUREMENT
/begin MEASUREMENT vvt_low_load_active "undefined1" UBYTE NO_COMPU_METHOD 0 0 0 255 ECU_ADDRESS 0x40002173 /end MEASUREMENT
/begin MEASUREMENT vvt_low_load_cam_offset "undefined1" UBYTE NO_COMPU_METHOD 0 0 0 255 ECU_ADDRESS 0x40002174 /end MEASUREMENT
/begin MEASUREMENT vvt_exhaust_mode_flags "undefined1" UBYTE NO_COMPU_METHOD 0 0 0 255 ECU_ADDRESS 0x40002175 /end MEASUREMENT
/begin MEASUREMENT vvt_intake_low_load_mode_flags "undefined1" UBYTE NO_COMPU_METHOD 0 0 0 255 ECU_ADDRESS 0x40002176 /end MEASUREMENT
/begin MEASUREMENT cam_edge_watchdog_exhaust_b2 "u8_count" UBYTE NO_COMPU_METHOD 0 0 0 255 ECU_ADDRESS 0x40002177 /end MEASUREMENT
/begin MEASUREMENT cam_edge_watchdog_exhaust_b1 "undefined1" UBYTE NO_COMPU_METHOD 0 0 0 255 ECU_ADDRESS 0x40002178 /end MEASUREMENT
/begin MEASUREMENT cam_edge_watchdog_inlet_b2 "undefined1" UBYTE NO_COMPU_METHOD 0 0 0 255 ECU_ADDRESS 0x40002179 /end MEASUREMENT
/begin MEASUREMENT cam_edge_watchdog "undefined1" UBYTE NO_COMPU_METHOD 0 0 0 255 ECU_ADDRESS 0x4000217A /end MEASUREMENT
/begin MEASUREMENT cam_park_position_mean_exhaust_b2 "undefined4" ULONG NO_COMPU_METHOD 0 0 0 4294967295 ECU_ADDRESS 0x4000217C /end MEASUREMENT
/begin MEASUREMENT cam_park_position_mean_exhaust_b1 "undefined4" ULONG NO_COMPU_METHOD 0 0 0 4294967295 ECU_ADDRESS 0x40002180 /end MEASUREMENT
/begin MEASUREMENT cam_park_position_mean_inlet_b2 "undefined4" ULONG NO_COMPU_METHOD 0 0 0 4294967295 ECU_ADDRESS 0x40002184 /end MEASUREMENT
/begin MEASUREMENT cam_park_position_mean_inlet_b1 "undefined4" ULONG NO_COMPU_METHOD 0 0 0 4294967295 ECU_ADDRESS 0x40002188 /end MEASUREMENT
/begin MEASUREMENT cam_park_offset_fault_exhaust_b2 "bool" UBYTE NO_COMPU_METHOD 0 0 0 255 ECU_ADDRESS 0x4000218C /end MEASUREMENT
/begin MEASUREMENT cam_park_offset_fault_exhaust_b1 "bool" UBYTE NO_COMPU_METHOD 0 0 0 255 ECU_ADDRESS 0x4000218D /end MEASUREMENT
/begin MEASUREMENT cam_park_offset_fault_inlet_b2 "bool" UBYTE NO_COMPU_METHOD 0 0 0 255 ECU_ADDRESS 0x4000218E /end MEASUREMENT
/begin MEASUREMENT cam_park_offset_fault_inlet_b1 "bool" UBYTE NO_COMPU_METHOD 0 0 0 255 ECU_ADDRESS 0x4000218F /end MEASUREMENT
/begin MEASUREMENT cam_park_check_done_exhaust_b2 "bool" UBYTE NO_COMPU_METHOD 0 0 0 255 ECU_ADDRESS 0x40002190 /end MEASUREMENT
/begin MEASUREMENT cam_park_check_done_exhaust_b1 "bool" UBYTE NO_COMPU_METHOD 0 0 0 255 ECU_ADDRESS 0x40002191 /end MEASUREMENT
/begin MEASUREMENT cam_park_offset_fault_inlet_b2_40002192 "bool" UBYTE NO_COMPU_METHOD 0 0 0 255 ECU_ADDRESS 0x40002192 /end MEASUREMENT
/begin MEASUREMENT cam_park_check_done_inlet_b1 "bool" UBYTE NO_COMPU_METHOD 0 0 0 255 ECU_ADDRESS 0x40002193 /end MEASUREMENT
/begin MEASUREMENT vvt_start_time "u16_time_5ms" UWORD CM_u8_time_5ms 0 0 0 327675 ECU_ADDRESS 0x40002194 /end MEASUREMENT
/begin MEASUREMENT vvt_pi_error_exhaust_b2 "undefined2" UWORD NO_COMPU_METHOD 0 0 0 65535 ECU_ADDRESS 0x40002196 /end MEASUREMENT
/begin MEASUREMENT vvt_pi_error_exhaust_b1 "u16_angle_1/4deg" UWORD CM_u8_angle_1_4deg 0 0 0 16383.75 ECU_ADDRESS 0x40002198 /end MEASUREMENT
/begin MEASUREMENT vvt_pi_error_inlet_b2 "u16_angle_1/4deg" UWORD CM_u8_angle_1_4deg 0 0 0 16383.75 ECU_ADDRESS 0x4000219A /end MEASUREMENT
/begin MEASUREMENT vvt_pi_error_inlet_b1 "undefined2" UWORD NO_COMPU_METHOD 0 0 0 65535 ECU_ADDRESS 0x4000219C /end MEASUREMENT
/begin MEASUREMENT obd_ii_vvt_exhaust_target "u16_angle_1/4deg" UWORD CM_u8_angle_1_4deg 0 0 0 16383.75 ECU_ADDRESS 0x4000219E /end MEASUREMENT
/begin MEASUREMENT obd_ii_vvt_inlet_target "u16_angle_1/4deg" UWORD CM_u8_angle_1_4deg 0 0 0 16383.75 ECU_ADDRESS 0x400021A0 /end MEASUREMENT
/begin MEASUREMENT obd_ii_throttle_body_range_perf "undefined1" UBYTE NO_COMPU_METHOD 0 0 0 255 ECU_ADDRESS 0x400021A8 /end MEASUREMENT
/begin MEASUREMENT sensor_tps_track_a_voltage "u16_voltage_5/1023v" UWORD CM_u16_voltage_5_1023v 0 0 0 320.307917888563 ECU_ADDRESS 0x400021AA /end MEASUREMENT
/begin MEASUREMENT sensor_tps_track_b_voltage "ABS throttle position b. Log the raw sensor voltage to check sensor health and wiring. (V; raw*5/1023)" UWORD CM_u16_voltage_5_1023v 0 0 0 320.307917888563 ECU_ADDRESS 0x400021AC /end MEASUREMENT
/begin MEASUREMENT obd_ii_commanded_throttle_actuator "Commanded throttle actuator. Log this ratio to see the resulting control output. (0-1; raw/1023)" UWORD CM_u16_factor_1_1023 0 0 0 6406.15835777126 ECU_ADDRESS 0x400021B0 /end MEASUREMENT
/begin MEASUREMENT tps_warmup_limited_target "Throttle position warmup limited target. Log to see throttle/pedal demand and throttle response. (0-1; raw/1023)" UWORD CM_u16_factor_1_1023 0 0 0 6406.15835777126 ECU_ADDRESS 0x400021B2 /end MEASUREMENT
/begin MEASUREMENT etb_position_error "u16_factor_1/1023" UWORD CM_u16_factor_1_1023 0 0 0 6406.15835777126 ECU_ADDRESS 0x400021B4 /end MEASUREMENT
/begin MEASUREMENT debug_tps_target_post_limits_s32 "uint32_t" ULONG NO_COMPU_METHOD 0 0 0 4294967295 ECU_ADDRESS 0x400021D0 /end MEASUREMENT
/begin MEASUREMENT debug_tps_target_post_limits_u16 "u16_factor_1/1023" UWORD CM_u16_factor_1_1023 0 0 0 6406.15835777126 ECU_ADDRESS 0x400021D4 /end MEASUREMENT
/begin MEASUREMENT tps_smoothing_step_flags "enum_tps_smooth_step_flag" UBYTE NO_COMPU_METHOD 0 0 0 255 ECU_ADDRESS 0x400021E8 /end MEASUREMENT
/begin MEASUREMENT throttle_error_flags "undefined1" UBYTE NO_COMPU_METHOD 0 0 0 255 ECU_ADDRESS 0x400021EA /end MEASUREMENT
/begin MEASUREMENT etb_hc08_independent_shutdown "bool" UBYTE NO_COMPU_METHOD 0 0 0 255 ECU_ADDRESS 0x400021EB /end MEASUREMENT
/begin MEASUREMENT throttle_calibrate_fail "Flag: throttle calibration failed. Log to catch DBW faults." UBYTE NO_COMPU_METHOD 0 0 0 255 ECU_ADDRESS 0x400021EC /end MEASUREMENT
/begin MEASUREMENT lfb_pulse_toggle_timer "Long-term fuel pulse toggle timer. Log to track long-term fuel learning and spot a developing fuel fault. (ms; raw*100)" UWORD CM_u8_time_100ms 0 0 0 6553500 ECU_ADDRESS 0x400021EE /end MEASUREMENT
/begin MEASUREMENT lfb_state_flags "undefined1" UBYTE NO_COMPU_METHOD 0 0 0 255 ECU_ADDRESS 0x400021F0 /end MEASUREMENT
/begin MEASUREMENT etb_initialization_state "Electronic-throttle-body init/calibration state. Log to debug throttle limp on startup." UBYTE NO_COMPU_METHOD 0 0 0 255 ECU_ADDRESS 0x400021F2 /end MEASUREMENT
/begin MEASUREMENT tps_max_during_warmup "Throttle position max during warmup. Log to see throttle/pedal demand and throttle response. (0-1; raw/1023)" UWORD CM_u16_factor_1_1023 0 0 0 6406.15835777126 ECU_ADDRESS 0x400021F6 /end MEASUREMENT
/begin MEASUREMENT tps_decrement "undefined2" UWORD NO_COMPU_METHOD 0 0 0 65535 ECU_ADDRESS 0x4000220C /end MEASUREMENT
/begin MEASUREMENT tpssmooth_increment "Tpssmooth increment. Log to see throttle-signal smoothing/filtering behavior. (0-1; raw/1023)" UBYTE CM_u16_factor_1_1023 0 0 0 24.9266862170088 ECU_ADDRESS 0x4000220E /end MEASUREMENT
/begin MEASUREMENT tpssmooth_low_speed_active "Tpssmooth low speed active. Log to see throttle-signal smoothing/filtering behavior." UBYTE NO_COMPU_METHOD 0 0 0 255 ECU_ADDRESS 0x4000220F /end MEASUREMENT
/begin MEASUREMENT etb_init_delay_timer "u16_time_ms" UWORD CM_u8_time_ms 0 0 0 65535 ECU_ADDRESS 0x4000221C /end MEASUREMENT
/begin MEASUREMENT etb_cal_closed_pos_status "uint8_t" UBYTE NO_COMPU_METHOD 0 0 0 255 ECU_ADDRESS 0x4000221E /end MEASUREMENT
/begin MEASUREMENT lbf_hold_timer "undefined2" UWORD NO_COMPU_METHOD 0 0 0 65535 ECU_ADDRESS 0x4000222A /end MEASUREMENT
/begin MEASUREMENT lbf_entry_countdown_timer "undefined2" UWORD NO_COMPU_METHOD 0 0 0 65535 ECU_ADDRESS 0x4000222C /end MEASUREMENT
/begin MEASUREMENT lfb_brake_off_hold_ticks "undefined2" UWORD NO_COMPU_METHOD 0 0 0 65535 ECU_ADDRESS 0x4000222E /end MEASUREMENT
/begin MEASUREMENT tps_track_b_closed_value "undefined2" UWORD NO_COMPU_METHOD 0 0 0 65535 ECU_ADDRESS 0x40002234 /end MEASUREMENT
/begin MEASUREMENT tps_track_a_closed_value "undefined2" UWORD NO_COMPU_METHOD 0 0 0 65535 ECU_ADDRESS 0x40002236 /end MEASUREMENT
/begin MEASUREMENT ips_state_flags "undefined1" UBYTE NO_COMPU_METHOD 0 0 0 255 ECU_ADDRESS 0x40002238 /end MEASUREMENT
/begin MEASUREMENT ips_engine_speed_at_shift "IPS engine speed at shift. Log to follow IPS automated-manual shift behavior. (RPM)" UWORD CM_u8_rspeed_rpm 0 0 0 65535 ECU_ADDRESS 0x4000223A /end MEASUREMENT
/begin MEASUREMENT tps_state_degraded "Throttle position state degraded. Log to see throttle/pedal demand and throttle response." UBYTE NO_COMPU_METHOD 0 0 0 255 ECU_ADDRESS 0x40002240 /end MEASUREMENT
/begin MEASUREMENT tps_16bit "Throttle-plate position, high resolution. Log for precise throttle tracking and DBW diagnostics. (0-1; raw/1023)" UWORD CM_u16_factor_1_1023 0 0 0 6406.15835777126 ECU_ADDRESS 0x40002242 /end MEASUREMENT
/begin MEASUREMENT accel_pedal_diag_state_degraded "(level 1: single pedal sensor faulted/correlation mismatch, still using redundant sensor" UBYTE NO_COMPU_METHOD 0 0 0 255 ECU_ADDRESS 0x40002244 /end MEASUREMENT
/begin MEASUREMENT accel_pedal_pos "Accelerator-pedal position (driver demand). Log it -- the input the DBW throttle is trying to satisfy." UWORD CM_u16_factor_1_1023 0 0 0 6406.15835777126 ECU_ADDRESS 0x40002248 /end MEASUREMENT
/begin MEASUREMENT tps_fault_active "Flag: a throttle-position fault is set. Log to correlate faults with throttle limits." UBYTE NO_COMPU_METHOD 0 0 0 255 ECU_ADDRESS 0x4000224A /end MEASUREMENT
/begin MEASUREMENT accel_pedal_diag_state_fault_active "level 2: confirmed dual-sensor fault, pedal position forced to 0" UBYTE NO_COMPU_METHOD 0 0 0 255 ECU_ADDRESS 0x4000224B /end MEASUREMENT
/begin MEASUREMENT tps_fault_flags "undefined1" UBYTE NO_COMPU_METHOD 0 0 0 255 ECU_ADDRESS 0x4000224D /end MEASUREMENT
/begin MEASUREMENT knock_buffer_last_index "undefined1" UBYTE NO_COMPU_METHOD 0 0 0 255 ECU_ADDRESS 0x40002250 /end MEASUREMENT
/begin MEASUREMENT knock_sensor_new_data_available "Knock sensor new data available. Log to catch knock events and see how much timing is being pulled." UBYTE NO_COMPU_METHOD 0 0 0 255 ECU_ADDRESS 0x40002252 /end MEASUREMENT
/begin MEASUREMENT knock_curr_cylinder "undefined1" UBYTE NO_COMPU_METHOD 0 0 0 255 ECU_ADDRESS 0x40002253 /end MEASUREMENT
/begin MEASUREMENT knock_gain_mode "undefined1" UBYTE NO_COMPU_METHOD 0 0 0 255 ECU_ADDRESS 0x40002254 /end MEASUREMENT
/begin MEASUREMENT knock_agc_override "Knock AGC override. Log to catch knock events and see how much timing is being pulled." UBYTE NO_COMPU_METHOD 0 0 0 255 ECU_ADDRESS 0x40002255 /end MEASUREMENT
/begin MEASUREMENT knock_buffer_index "undefined1" UBYTE NO_COMPU_METHOD 0 0 0 255 ECU_ADDRESS 0x40002256 /end MEASUREMENT
/begin MEASUREMENT knock_freq_bin_count "undefined1" UBYTE NO_COMPU_METHOD 0 0 0 255 ECU_ADDRESS 0x40002258 /end MEASUREMENT
/begin MEASUREMENT ccp_tx_stall_count "u8_count" UBYTE NO_COMPU_METHOD 0 0 0 255 ECU_ADDRESS 0x40002260 /end MEASUREMENT
/begin MEASUREMENT iat_overtemp_monitor_lockout_timer "undefined1" UBYTE NO_COMPU_METHOD 0 0 0 255 ECU_ADDRESS 0x40002277 /end MEASUREMENT
/begin MEASUREMENT obd_ii_tire_pressure_valid_and_error "undefined2" UWORD NO_COMPU_METHOD 0 0 0 65535 ECU_ADDRESS 0x40002278 /end MEASUREMENT
/begin MEASUREMENT obd_ii_U0127_debounce_counter "u8_count" UBYTE NO_COMPU_METHOD 0 0 0 255 ECU_ADDRESS 0x40002282 /end MEASUREMENT
/begin MEASUREMENT obd_ii_defer_send "Defer send. Runtime state -- log to observe this behavior." UBYTE NO_COMPU_METHOD 0 0 0 255 ECU_ADDRESS 0x40002288 /end MEASUREMENT
/begin MEASUREMENT obd_ii_tx_messages_pending "undefined1" UBYTE NO_COMPU_METHOD 0 0 0 255 ECU_ADDRESS 0x40002289 /end MEASUREMENT
/begin MEASUREMENT isotp_flow_status "undefined1" UBYTE NO_COMPU_METHOD 0 0 0 255 ECU_ADDRESS 0x4000228A /end MEASUREMENT
/begin MEASUREMENT isotp_fc_received "undefined1" UBYTE NO_COMPU_METHOD 0 0 0 255 ECU_ADDRESS 0x4000228B /end MEASUREMENT
/begin MEASUREMENT isotp_block_size "undefined1" UBYTE NO_COMPU_METHOD 0 0 0 255 ECU_ADDRESS 0x4000228C /end MEASUREMENT
/begin MEASUREMENT isotp_stmin "undefined1" UBYTE NO_COMPU_METHOD 0 0 0 255 ECU_ADDRESS 0x4000228D /end MEASUREMENT
/begin MEASUREMENT obd_resp_length "undefined2" UWORD NO_COMPU_METHOD 0 0 0 65535 ECU_ADDRESS 0x4000228E /end MEASUREMENT
/begin MEASUREMENT isotp_block_counter "undefined1" UBYTE NO_COMPU_METHOD 0 0 0 255 ECU_ADDRESS 0x40002290 /end MEASUREMENT
/begin MEASUREMENT isotp_stmin_counter "undefined1" UBYTE NO_COMPU_METHOD 0 0 0 255 ECU_ADDRESS 0x40002291 /end MEASUREMENT
/begin MEASUREMENT gear_index_auto "Inferred gear index. Log for gear-based analysis." UBYTE NO_COMPU_METHOD 0 0 0 255 ECU_ADDRESS 0x40002298 /end MEASUREMENT
/begin MEASUREMENT ips_shift_active "IPS shift active. Log to follow IPS automated-manual shift behavior." UBYTE NO_COMPU_METHOD 0 0 0 255 ECU_ADDRESS 0x40002299 /end MEASUREMENT
/begin MEASUREMENT ips_flags_faults "undefined1" UBYTE NO_COMPU_METHOD 0 0 0 255 ECU_ADDRESS 0x4000229A /end MEASUREMENT
/begin MEASUREMENT obd_ii_oil_temp_ips "undefined1" UBYTE NO_COMPU_METHOD 0 0 0 255 ECU_ADDRESS 0x4000229B /end MEASUREMENT
/begin MEASUREMENT dm_data_buffer "undefined4" ULONG NO_COMPU_METHOD 0 0 0 4294967295 ECU_ADDRESS 0x4000229C /end MEASUREMENT
/begin MEASUREMENT can_rx_msg_timestamp "undefined2" UWORD NO_COMPU_METHOD 0 0 0 65535 ECU_ADDRESS 0x400022A8 /end MEASUREMENT
/begin MEASUREMENT can_b7_rolling_counter "Can b7 rolling counter. Runtime state -- log to observe this behavior." UBYTE NO_COMPU_METHOD 0 0 0 255 ECU_ADDRESS 0x400022B1 /end MEASUREMENT
/begin MEASUREMENT ips_tcu_shift_request_flags "uint8_t" UBYTE NO_COMPU_METHOD 0 0 0 255 ECU_ADDRESS 0x400022C8 /end MEASUREMENT
/begin MEASUREMENT imu_gyro "undefined2" UWORD NO_COMPU_METHOD 0 0 0 65535 ECU_ADDRESS 0x400022CA /end MEASUREMENT
/begin MEASUREMENT imu_accel_lat "Lateral acceleration (IMU). Log for cornering/grip analysis." SWORD CM_i32_accel_1_255g 0 0 -128.501960784314 128.498039215686 ECU_ADDRESS 0x400022CC /end MEASUREMENT
/begin MEASUREMENT steering_angle_sensor_status "undefined1" UBYTE NO_COMPU_METHOD 0 0 0 255 ECU_ADDRESS 0x400022CF /end MEASUREMENT
/begin MEASUREMENT steering_angle_rate_400022D0 "undefined1" UBYTE NO_COMPU_METHOD 0 0 0 255 ECU_ADDRESS 0x400022D0 /end MEASUREMENT
/begin MEASUREMENT steering_angle "Steering-wheel angle (from SAS over CAN). Log for chassis/traction correlation." UWORD CM_u16_angle_1_10deg 0 0 0 6553.5 ECU_ADDRESS 0x400022D2 /end MEASUREMENT
/begin MEASUREMENT obd_o2_value_buf "undefined1" UBYTE NO_COMPU_METHOD 0 0 0 255 ECU_ADDRESS 0x40002334 /end MEASUREMENT
/begin MEASUREMENT obd_MIL_and_DTC "undefined1" UBYTE NO_COMPU_METHOD 0 0 0 255 ECU_ADDRESS 0x40002348 /end MEASUREMENT
/begin MEASUREMENT obd_DTC_count "undefined1" UBYTE NO_COMPU_METHOD 0 0 0 255 ECU_ADDRESS 0x40002349 /end MEASUREMENT
/begin MEASUREMENT hc08_rx_checksum_accum "undefined1" UBYTE NO_COMPU_METHOD 0 0 0 255 ECU_ADDRESS 0x40002350 /end MEASUREMENT
/begin MEASUREMENT hc08_rx_parse_state "undefined1" UBYTE NO_COMPU_METHOD 0 0 0 255 ECU_ADDRESS 0x40002351 /end MEASUREMENT
/begin MEASUREMENT hc08_tx_sequence_counter "undefined1" UBYTE NO_COMPU_METHOD 0 0 0 255 ECU_ADDRESS 0x40002352 /end MEASUREMENT
/begin MEASUREMENT esci_a_rx_queue_count "undefined1" UBYTE NO_COMPU_METHOD 0 0 0 255 ECU_ADDRESS 0x40002355 /end MEASUREMENT
/begin MEASUREMENT esci_a_rx_queue_head "undefined1" UBYTE NO_COMPU_METHOD 0 0 0 255 ECU_ADDRESS 0x40002356 /end MEASUREMENT
/begin MEASUREMENT esci_a_rx_queue_tail "undefined1" UBYTE NO_COMPU_METHOD 0 0 0 255 ECU_ADDRESS 0x40002357 /end MEASUREMENT
/begin MEASUREMENT hc08_tx_rx_delta "undefined2" UWORD NO_COMPU_METHOD 0 0 0 65535 ECU_ADDRESS 0x40002358 /end MEASUREMENT
/begin MEASUREMENT hc08_valid_rx_count "undefined4" ULONG NO_COMPU_METHOD 0 0 0 4294967295 ECU_ADDRESS 0x4000235C /end MEASUREMENT
/begin MEASUREMENT hc08_status_tx_count "undefined4" ULONG NO_COMPU_METHOD 0 0 0 4294967295 ECU_ADDRESS 0x40002360 /end MEASUREMENT
/begin MEASUREMENT cruise_multifunction_switch_voltage "┌───────────────┬───────────┬────────────────────────────┐" UWORD CM_u16_voltage_5_1023v 0 0 0 320.307917888563 ECU_ADDRESS 0x40002368 /end MEASUREMENT
/begin MEASUREMENT cruise_status "1 armed,2 engaged,4 accel hold,8 coast hold,10 accel tap,20 coast tap,40 cancel latched,80 captured,100/200 resync after hold,400 pedal override,800/1000 slew up/down,2000 settled,4000 bad switch V,8000 inhibited,10000 resuming,20000 recent cancel,40" ULONG NO_COMPU_METHOD 0 0 0 4294967295 ECU_ADDRESS 0x4000236C /end MEASUREMENT
/begin MEASUREMENT cruise_speed_target "Cruise speed target. Log to debug cruise engagement and speed holding. (km/h; raw/100)" UWORD CM_u8_speed_1_100kph 0 0 0 655.35 ECU_ADDRESS 0x40002370 /end MEASUREMENT
/begin MEASUREMENT cruise_proportional_term "10 mg/s airflow" SWORD NO_COMPU_METHOD 0 0 -32768 32767 ECU_ADDRESS 0x40002372 /end MEASUREMENT
/begin MEASUREMENT cruise_integral_term "10 mg/s airflow" SWORD NO_COMPU_METHOD 0 0 -32768 32767 ECU_ADDRESS 0x40002374 /end MEASUREMENT
/begin MEASUREMENT cruise_deriv_term "10 mg/s airflow" SWORD NO_COMPU_METHOD 0 0 -32768 32767 ECU_ADDRESS 0x40002376 /end MEASUREMENT
/begin MEASUREMENT cruise_airflow_cmd "slewed airflow request" UWORD CM_u16_flow_10mg_s 0 0 0 655350 ECU_ADDRESS 0x40002378 /end MEASUREMENT
/begin MEASUREMENT cruise_load_request "~1 mg/stroke, max 0x3ff; >>2 into CAL_load_to_tps_mapping" UWORD NO_COMPU_METHOD 0 0 0 65535 ECU_ADDRESS 0x4000237A /end MEASUREMENT
/begin MEASUREMENT cruise_tps_request "TPS above idle sent to accel_pedal_200hz" UWORD CM_u16_factor_1_1023 0 0 0 6406.15835777126 ECU_ADDRESS 0x4000237C /end MEASUREMENT
/begin MEASUREMENT tps_commanded_cruise "undefined2" UWORD NO_COMPU_METHOD 0 0 0 65535 ECU_ADDRESS 0x4000237E /end MEASUREMENT
/begin MEASUREMENT cruise_speed_error "Cruise speed error. Log to debug cruise engagement and speed holding. (km/h; raw/100)" UWORD CM_u8_speed_1_100kph 0 0 0 655.35 ECU_ADDRESS 0x40002380 /end MEASUREMENT
/begin GROUP G_Vehicle_dca "dca"
 /begin REF_CHARACTERISTIC CAL_dca_activate_timer CAL_dca_activate_tps_threshold CAL_dca_enable_carspeed CAL_dca_enable_steering_max CAL_dca_enable_tps_margin CAL_dca_enable_untested CAL_dca_freerev_rpm CAL_dca_freerev_rpm_tolerance CAL_dca_freerev_wait_time CAL_dca_stationary_wait_time CAL_dca_tps_initial_offset CAL_dca_tps_limit_ips CAL_dca_tps_limit_ips2 CAL_dca_tps_limit_ips2_X_time CAL_dca_tps_limit_ips_X_time CAL_dca_tps_limit_manual CAL_dca_tps_limit_manual_X_time CAL_dca_tps_ramp_step_period /end REF_CHARACTERISTIC
/end GROUP
/begin GROUP G_Vehicle_tpms "tpms"
 /begin REF_CHARACTERISTIC CAL_tpms_gen2_low_pressure_threshold_18_19 CAL_tpms_gen2_low_pressure_threshold_19_20 CAL_tpms_gen2_low_warn_18_19 CAL_tpms_gen2_low_warn_19_20 CAL_tpms_high_pressure_18_19 CAL_tpms_high_pressure_19_20 CAL_tpms_low_pressure_18_19 CAL_tpms_low_pressure_19_20 CAL_tpms_low_warn_offset_18_19 CAL_tpms_low_warn_offset_19_20 CAL_tpms_nominal_pressure_18_19 CAL_tpms_nominal_pressure_19_20 CAL_tpms_version /end REF_CHARACTERISTIC
/end GROUP
/begin GROUP G_Vehicle_vehicle "vehicle"
 /begin REF_CHARACTERISTIC CAL_vehicle_moving_speed_min CAL_vehicle_speed_limit CAL_vehicle_speed_limit_enforce CAL_vehicle_speed_limit_ramp_step /end REF_CHARACTERISTIC
/end GROUP
/begin GROUP G_Other "Other" ROOT
 /begin SUB_GROUP G_Other_base G_Other_ecu G_Other_lea G_Other_logger G_Other_misc G_Other_prog G_Other_tps2 G_Other_unused G_Other_unused1 G_Other_unused2 G_Other_unused3 G_Other_unused5 /end SUB_GROUP
/end GROUP
/begin GROUP G_Other_base "base" /begin REF_CHARACTERISTIC CAL_base /end REF_CHARACTERISTIC /end GROUP
/begin GROUP G_Other_ecu "ecu"
 /begin REF_CHARACTERISTIC CAL_ecu_2gr_cylinder_air_mass_mg CAL_ecu_2gr_cylinder_air_mass_mg_obd_ii CAL_ecu_accel_pedal_pressed_threshold CAL_ecu_accel_pedal_released_threshold CAL_ecu_brake_or_clutch_inactive_timer CAL_ecu_data_base CAL_ecu_engine_speed_decel_hysteresis_rpm CAL_ecu_engine_speed_target_sport CAL_ecu_engine_speed_target_sport_X_pps CAL_ecu_engine_speed_target_tour CAL_ecu_engine_speed_target_tour_X_pps CAL_ecu_gear_close_ratio CAL_ecu_gear_close_ratio_topgear CAL_ecu_gear_long_ratio CAL_ecu_gear_long_ratio_topgear CAL_ecu_ign_off_relay_hold_time CAL_ecu_ign_threshold CAL_ecu_ips_enable_in_shutdown_speed CAL_ecu_learning_x_axis_stability_threshold CAL_ecu_learning_y_axis_stability_threshold CAL_ecu_obd_engine_off_gate_delay CAL_ecu_relay_enable_delay CAL_ecu_standing_start_threshold CAL_ecu_starter_max_engage_after_run CAL_ecu_system_voltage_threshold CAL_ecu_thermostat_diag_maf_threshold_ips CAL_ecu_thermostat_diag_maf_threshold_manual CAL_ecu_unlock_magic /end REF_CHARACTERISTIC
/end GROUP
/begin GROUP G_Other_lea "lea" /begin REF_CHARACTERISTIC CAL_lea_misfire_baseline_set /end REF_CHARACTERISTIC /end GROUP
/begin GROUP G_Other_logger "logger" /begin REF_CHARACTERISTIC CAL_logger_high_speed_logger_enable /end REF_CHARACTERISTIC /end GROUP
/begin GROUP G_Other_misc "misc"
 /begin REF_CHARACTERISTIC CAL_misc_engine_detection_off CAL_misc_engine_detection_on CAL_misc_engine_running_confirm_delay /end REF_CHARACTERISTIC
/end GROUP
/begin GROUP G_Other_prog "prog" /begin REF_CHARACTERISTIC CAL_prog_version /end REF_CHARACTERISTIC /end GROUP
/begin GROUP G_Other_tps2 "tps2" /begin REF_CHARACTERISTIC CAL_tps2_range_hi_frac CAL_tps2_range_lo_frac /end REF_CHARACTERISTIC /end GROUP
/begin GROUP G_Other_unused "unused"
 /begin REF_CHARACTERISTIC CAL_unused_array1 CAL_unused_array2 CAL_unused_array3 CAL_unused_array4 CAL_unused_array5 CAL_unused_array6_ CAL_unused_array7 CAL_unused_end_of_range CAL_unused_large1 /end REF_CHARACTERISTIC
/end GROUP
/begin GROUP G_Other_unused1 "unused1" /begin REF_CHARACTERISTIC CAL_unused1 /end REF_CHARACTERISTIC /end GROUP
/begin GROUP G_Other_unused2 "unused2" /begin REF_CHARACTERISTIC CAL_unused2 /end REF_CHARACTERISTIC /end GROUP
/begin GROUP G_Other_unused3 "unused3" /begin REF_CHARACTERISTIC CAL_unused3 /end REF_CHARACTERISTIC /end GROUP
/begin GROUP G_Other_unused5 "unused5" /begin REF_CHARACTERISTIC CAL_unused5 /end REF_CHARACTERISTIC /end GROUP
/end MODULE
/end PROJECT
