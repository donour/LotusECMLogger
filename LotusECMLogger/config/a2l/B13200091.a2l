ASAP2_VERSION 1 61
/begin PROJECT B13200091 "Lotus T6 B13200091"
/begin HEADER "" VERSION "generated v1" /end HEADER
/begin MODULE B13200091 ""
/begin MOD_COMMON "" BYTE_ORDER MSB_FIRST ALIGNMENT_BYTE 1 ALIGNMENT_WORD 2 ALIGNMENT_LONG 4 /end MOD_COMMON
/begin RECORD_LAYOUT RL_VALUE_UBYTE FNC_VALUES 1 UBYTE ROW_DIR DIRECT /end RECORD_LAYOUT
/begin RECORD_LAYOUT RL_AXIS_UBYTE AXIS_PTS_X 1 UBYTE INDEX_INCR DIRECT /end RECORD_LAYOUT
/begin RECORD_LAYOUT RL_VALUE_SBYTE FNC_VALUES 1 SBYTE ROW_DIR DIRECT /end RECORD_LAYOUT
/begin RECORD_LAYOUT RL_AXIS_SBYTE AXIS_PTS_X 1 SBYTE INDEX_INCR DIRECT /end RECORD_LAYOUT
/begin RECORD_LAYOUT RL_VALUE_UWORD FNC_VALUES 1 UWORD ROW_DIR DIRECT /end RECORD_LAYOUT
/begin RECORD_LAYOUT RL_AXIS_UWORD AXIS_PTS_X 1 UWORD INDEX_INCR DIRECT /end RECORD_LAYOUT
/begin RECORD_LAYOUT RL_VALUE_SWORD FNC_VALUES 1 SWORD ROW_DIR DIRECT /end RECORD_LAYOUT
/begin RECORD_LAYOUT RL_VALUE_ULONG FNC_VALUES 1 ULONG ROW_DIR DIRECT /end RECORD_LAYOUT
/begin COMPU_METHOD CM_i16_percent_1_10 "i16_percent_1/10" RAT_FUNC "%9.1" "%" COEFFS 0 1 0 0 0 0.1 /end COMPU_METHOD
/begin COMPU_METHOD CM_i16_pressure_mbar "i16_pressure_mbar" RAT_FUNC "%8.0" "mbar" COEFFS 0 1 0 0 0 1 /end COMPU_METHOD
/begin COMPU_METHOD CM_u16_angle_1_10deg "u16_angle_1/10deg" RAT_FUNC "%9.1" "deg" COEFFS 0 1 0 0 0 0.1 /end COMPU_METHOD
/begin COMPU_METHOD CM_u16_current_mA "u16_current_mA" RAT_FUNC "%8.0" "mA" COEFFS 0 1 0 0 0 1 /end COMPU_METHOD
/begin COMPU_METHOD CM_u16_factor_1_1023 "u16_factor_1/1023" RAT_FUNC "%12.4" "%" COEFFS 0 1 0 0 0 0.0977517106549365 /end COMPU_METHOD
/begin COMPU_METHOD CM_u16_factor_1_65536 "u16_factor_1/65536" RAT_FUNC "%12.4" "%" COEFFS 0 1 0 0 0 0.00152587890625 /end COMPU_METHOD
/begin COMPU_METHOD CM_u16_flow_100_256mg_s "u16_flow_100/256mg/s" RAT_FUNC "%12.4" "mg/s" COEFFS 0 1 0 0 0 0.390625 /end COMPU_METHOD
/begin COMPU_METHOD CM_u16_flow_10mg_s "u16_flow_10mg/s" RAT_FUNC "%8.0" "mg/s" COEFFS 0 1 0 0 0 10 /end COMPU_METHOD
/begin COMPU_METHOD CM_u16_load_mg_stroke "u16_load_mg/stroke" RAT_FUNC "%8.0" "mg/stroke" COEFFS 0 1 0 0 0 1 /end COMPU_METHOD
/begin COMPU_METHOD CM_u16_mass_g "u16_mass_g" RAT_FUNC "%8.0" "g" COEFFS 0 1 0 0 0 1 /end COMPU_METHOD
/begin COMPU_METHOD CM_u16_mass_mg "u16_mass_mg" RAT_FUNC "%8.0" "mg" COEFFS 0 1 0 0 0 1 /end COMPU_METHOD
/begin COMPU_METHOD CM_u16_rspeed_1_4rpm "u16_rspeed_1/4rpm" RAT_FUNC "%10.2" "rpm" COEFFS 0 1 0 0 0 0.25 /end COMPU_METHOD
/begin COMPU_METHOD CM_u16_voltage_18_1023v "u16_voltage_18/1023v" RAT_FUNC "%12.4" "V" COEFFS 0 1 0 0 0 0.0175953079178886 /end COMPU_METHOD
/begin COMPU_METHOD CM_u16_voltage_5_1023v "u16_voltage_5/1023v" RAT_FUNC "%12.4" "V" COEFFS 0 1 0 0 0 0.00488758553274682 /end COMPU_METHOD
/begin COMPU_METHOD CM_u8_afr_1_100 "u8_afr_1/100" RAT_FUNC "%10.2" "AFR" COEFFS 0 1 0 0 0 0.01 /end COMPU_METHOD
/begin COMPU_METHOD CM_u8_afr_1_20_5 "u8_afr_1/20+5" RAT_FUNC "%10.2" "AFR" COEFFS 0 1 -5 0 0 0.05 /end COMPU_METHOD
/begin COMPU_METHOD CM_u8_angle_1_4_10deg "u8_angle_1/4-10deg" RAT_FUNC "%10.2" "deg" COEFFS 0 1 10 0 0 0.25 /end COMPU_METHOD
/begin COMPU_METHOD CM_u8_angle_1_4_20deg "u8_angle_1/4-20deg" RAT_FUNC "%10.2" "deg" COEFFS 0 1 20 0 0 0.25 /end COMPU_METHOD
/begin COMPU_METHOD CM_u8_angle_1_4_32deg "u8_angle_1/4-32deg" RAT_FUNC "%10.2" "deg" COEFFS 0 1 32 0 0 0.25 /end COMPU_METHOD
/begin COMPU_METHOD CM_u8_angle_1_4_64deg "u8_angle_1/4-64deg" RAT_FUNC "%10.2" "deg" COEFFS 0 1 64 0 0 0.25 /end COMPU_METHOD
/begin COMPU_METHOD CM_u8_angle_1_4deg "u8_angle_1/4deg" RAT_FUNC "%10.2" "deg" COEFFS 0 1 0 0 0 0.25 /end COMPU_METHOD
/begin COMPU_METHOD CM_u8_factor_1_100 "u8_factor_1/100" RAT_FUNC "%8.0" "%" COEFFS 0 1 0 0 0 1 /end COMPU_METHOD
/begin COMPU_METHOD CM_u8_factor_1_128 "u8_factor_1/128" RAT_FUNC "%12.4" "%" COEFFS 0 1 0 0 0 0.78125 /end COMPU_METHOD
/begin COMPU_METHOD CM_u8_factor_1_200 "u8_factor_1/200" RAT_FUNC "%9.1" "%" COEFFS 0 1 0 0 0 0.5 /end COMPU_METHOD
/begin COMPU_METHOD CM_u8_factor_1_255 "u8_factor_1/255" RAT_FUNC "%12.4" "%" COEFFS 0 1 0 0 0 0.392156862745098 /end COMPU_METHOD
/begin COMPU_METHOD CM_u8_flow_100mg_s "u8_flow_100mg/s" RAT_FUNC "%8.0" "mg/s" COEFFS 0 1 0 0 0 100 /end COMPU_METHOD
/begin COMPU_METHOD CM_u8_flow_2g_s "u8_flow_2g/s" RAT_FUNC "%8.0" "g/s" COEFFS 0 1 0 0 0 2 /end COMPU_METHOD
/begin COMPU_METHOD CM_u8_gain__x_104_26 "u8_gain_(x-104)/26" RAT_FUNC "%12.4" "" COEFFS 0 1 4 0 0 0.0384615384615385 /end COMPU_METHOD
/begin COMPU_METHOD CM_u8_load_4mg_stroke "u8_load_4mg/stroke" RAT_FUNC "%8.0" "mg/stroke" COEFFS 0 1 0 0 0 4 /end COMPU_METHOD
/begin COMPU_METHOD CM_u8_pressure_100mbar "u8_pressure_100mbar" RAT_FUNC "%8.0" "mbar" COEFFS 0 1 0 0 0 100 /end COMPU_METHOD
/begin COMPU_METHOD CM_u8_pressure_2mbar "u8_pressure_2mbar" RAT_FUNC "%8.0" "mbar" COEFFS 0 1 0 0 0 2 /end COMPU_METHOD
/begin COMPU_METHOD CM_u8_pressure_4mbar "u8_pressure_4mbar" RAT_FUNC "%8.0" "mbar" COEFFS 0 1 0 0 0 4 /end COMPU_METHOD
/begin COMPU_METHOD CM_u8_rspeed_10_6000rpm "u8_rspeed_10+6000rpm" RAT_FUNC "%8.0" "rpm" COEFFS 0 1 -6000 0 0 10 /end COMPU_METHOD
/begin COMPU_METHOD CM_u8_rspeed_125_4_500rpm "u8_rspeed_125/4+500rpm" RAT_FUNC "%10.2" "rpm" COEFFS 0 1 -500 0 0 31.25 /end COMPU_METHOD
/begin COMPU_METHOD CM_u8_rspeed_2rpm "u8_rspeed_2rpm" RAT_FUNC "%8.0" "rpm" COEFFS 0 1 0 0 0 2 /end COMPU_METHOD
/begin COMPU_METHOD CM_u8_rspeed_4_500rpm "u8_rspeed_4+500rpm" RAT_FUNC "%8.0" "rpm" COEFFS 0 1 -500 0 0 4 /end COMPU_METHOD
/begin COMPU_METHOD CM_u8_rspeed_4rpm "u8_rspeed_4rpm" RAT_FUNC "%8.0" "rpm" COEFFS 0 1 0 0 0 4 /end COMPU_METHOD
/begin COMPU_METHOD CM_u8_rspeed_8rpm "u8_rspeed_8rpm" RAT_FUNC "%8.0" "rpm" COEFFS 0 1 0 0 0 8 /end COMPU_METHOD
/begin COMPU_METHOD CM_u8_rspeed_rpm "u8_rspeed_rpm" RAT_FUNC "%8.0" "rpm" COEFFS 0 1 0 0 0 1 /end COMPU_METHOD
/begin COMPU_METHOD CM_u8_speed_1_100kph "u8_speed_1/100kph" RAT_FUNC "%10.2" "km/h" COEFFS 0 1 0 0 0 0.01 /end COMPU_METHOD
/begin COMPU_METHOD CM_u8_speed_kph "u8_speed_kph" RAT_FUNC "%8.0" "km/h" COEFFS 0 1 0 0 0 1 /end COMPU_METHOD
/begin COMPU_METHOD CM_u8_temp_5_8_40c "u8_temp_5/8-40c" RAT_FUNC "%11.3" "°C" COEFFS 0 1 40 0 0 0.625 /end COMPU_METHOD
/begin COMPU_METHOD CM_u8_time_100ms "u8_time_100ms" RAT_FUNC "%8.0" "ms" COEFFS 0 1 0 0 0 100 /end COMPU_METHOD
/begin COMPU_METHOD CM_u8_time_10us "u8_time_10us" RAT_FUNC "%8.0" "us" COEFFS 0 1 0 0 0 10 /end COMPU_METHOD
/begin COMPU_METHOD CM_u8_time_20us "u8_time_20us" RAT_FUNC "%8.0" "us" COEFFS 0 1 0 0 0 20 /end COMPU_METHOD
/begin COMPU_METHOD CM_u8_time_256us "u8_time_256us" RAT_FUNC "%8.0" "us" COEFFS 0 1 0 0 0 256 /end COMPU_METHOD
/begin COMPU_METHOD CM_u8_time_5ms "u8_time_5ms" RAT_FUNC "%8.0" "ms" COEFFS 0 1 0 0 0 5 /end COMPU_METHOD
/begin COMPU_METHOD CM_u8_time_5s "u8_time_5s" RAT_FUNC "%8.0" "s" COEFFS 0 1 0 0 0 5 /end COMPU_METHOD
/begin COMPU_METHOD CM_u8_time_64us "u8_time_64us" RAT_FUNC "%8.0" "us" COEFFS 0 1 0 0 0 64 /end COMPU_METHOD
/begin COMPU_METHOD CM_u8_time_s "u8_time_s" RAT_FUNC "%8.0" "s" COEFFS 0 1 0 0 0 1 /end COMPU_METHOD
/begin COMPU_METHOD CM_u8_torque_2nm "u8_torque_2nm" RAT_FUNC "%8.0" "Nm" COEFFS 0 1 0 0 0 2 /end COMPU_METHOD
/begin COMPU_METHOD CM_u8_torque_nm "u8_torque_nm" RAT_FUNC "%8.0" "Nm" COEFFS 0 1 0 0 0 1 /end COMPU_METHOD
/begin COMPU_METHOD CM_u8_voltage_72_1023v "u8_voltage_72/1023v" RAT_FUNC "%12.4" "V" COEFFS 0 1 0 0 0 0.0703812316715543 /end COMPU_METHOD
/begin COMPU_METHOD CM_u8_volume_1_10gallon "u8_volume_1/10gallon" RAT_FUNC "%9.1" "gallon" COEFFS 0 1 0 0 0 0.1 /end COMPU_METHOD
/begin COMPU_METHOD CM_u8_volume_liter "u8_volume_liter" RAT_FUNC "%8.0" "liter" COEFFS 0 1 0 0 0 1 /end COMPU_METHOD
/begin AXIS_PTS CAL_cooling_fan_afterrun_X_air_temp "X-axis breakpoints for the 'cooling fan afterrun' table. Defines the lookup grid (not a live channel); change only when re-axing the map. (deg C; raw*5/8-40)" 0x4000A65A NO_INPUT_QUANTITY RL_AXIS_UBYTE 0 CM_u8_temp_5_8_40c 8 -40 119.375 /end AXIS_PTS
/begin AXIS_PTS CAL_cooling_fan_afterrun_Y_coolant_temp "Y-axis breakpoints for the 'cooling fan afterrun' table. Defines the lookup grid (not a live channel); change only when re-axing the map. (deg C; raw*5/8-40)" 0x4000A662 NO_INPUT_QUANTITY RL_AXIS_UBYTE 0 CM_u8_temp_5_8_40c 8 -40 119.375 /end AXIS_PTS
/begin CHARACTERISTIC CAL_cooling_fan_afterrun "Calibration: cooling fan afterrun. Tunable map/constant (not a live channel); log to confirm fans/pumps switch at the right temperatures. (ms; raw*250)" MAP 0x4000A66A RL_VALUE_UBYTE 0 CM_u8_time_5s 0 1275
 /begin AXIS_DESCR COM_AXIS NO_INPUT_QUANTITY CM_u8_temp_5_8_40c 8 -40 119.375 AXIS_PTS_REF CAL_cooling_fan_afterrun_X_air_temp /end AXIS_DESCR
 /begin AXIS_DESCR COM_AXIS NO_INPUT_QUANTITY CM_u8_temp_5_8_40c 8 -40 119.375 AXIS_PTS_REF CAL_cooling_fan_afterrun_Y_coolant_temp /end AXIS_DESCR
/end CHARACTERISTIC
/begin AXIS_PTS CAL_idle_comp_ac_load_X_ac_load "X-axis breakpoints for the 'idle compensation A/C load' table. Defines the lookup grid (not a live channel); change only when re-axing the map." 0x4000A6AA NO_INPUT_QUANTITY RL_AXIS_UBYTE 0 NO_COMPU_METHOD 8 0 255 /end AXIS_PTS
/begin CHARACTERISTIC CAL_idle_comp_ac_load "Calibration: idle compensation A/C load. Tunable map/constant (not a live channel); log to diagnose idle quality, hunting, and stalls." CURVE 0x4000A6B2 RL_VALUE_UBYTE 0 CM_u8_flow_100mg_s 0 25500
 /begin AXIS_DESCR COM_AXIS NO_INPUT_QUANTITY NO_COMPU_METHOD 8 0 255 AXIS_PTS_REF CAL_idle_comp_ac_load_X_ac_load /end AXIS_DESCR
/end CHARACTERISTIC
/begin AXIS_PTS CAL_idle_air_comp_fan_1_X_time "uint8_t[8]" 0x4000A6BA NO_INPUT_QUANTITY RL_AXIS_UBYTE 0 NO_COMPU_METHOD 8 0 255 /end AXIS_PTS
/begin CHARACTERISTIC CAL_idle_air_comp_fan_1 "u8_flow_100mg/s[8]" CURVE 0x4000A6C2 RL_VALUE_UBYTE 0 CM_u8_flow_100mg_s 0 25500
 /begin AXIS_DESCR COM_AXIS NO_INPUT_QUANTITY NO_COMPU_METHOD 8 0 255 AXIS_PTS_REF CAL_idle_air_comp_fan_1_X_time /end AXIS_DESCR
/end CHARACTERISTIC
/begin AXIS_PTS CAL_idle_air_comp_fan_2_X_time "uint8_t[8]" 0x4000A6CA NO_INPUT_QUANTITY RL_AXIS_UBYTE 0 NO_COMPU_METHOD 8 0 255 /end AXIS_PTS
/begin CHARACTERISTIC CAL_idle_air_comp_fan_2 "u8_flow_100mg/s[8]" CURVE 0x4000A6D2 RL_VALUE_UBYTE 0 CM_u8_flow_100mg_s 0 25500
 /begin AXIS_DESCR COM_AXIS NO_INPUT_QUANTITY NO_COMPU_METHOD 8 0 255 AXIS_PTS_REF CAL_idle_air_comp_fan_2_X_time /end AXIS_DESCR
/end CHARACTERISTIC
/begin AXIS_PTS CAL_inj_startup_enrichment_offset_X_coolant_temp_engine_stopped "X-axis breakpoints for the 'injector startup enrichment offset' table. Defines the lookup grid (not a live channel); change only when re-axing the map. (deg C; raw*5/8-40)" 0x4000A6DA NO_INPUT_QUANTITY RL_AXIS_UBYTE 0 CM_u8_temp_5_8_40c 16 -40 119.375 /end AXIS_PTS
/begin CHARACTERISTIC CAL_inj_startup_enrichment_offset "Calibration: injector startup enrichment offset. Tunable map/constant (not a live channel); log to verify injector pulse width and fuel delivery vs target. (us; raw*256)" CURVE 0x4000A6EA RL_VALUE_UBYTE 0 CM_u8_time_256us 0 65280
 /begin AXIS_DESCR COM_AXIS NO_INPUT_QUANTITY CM_u8_temp_5_8_40c 16 -40 119.375 AXIS_PTS_REF CAL_inj_startup_enrichment_offset_X_coolant_temp_engine_stopped /end AXIS_DESCR
/end CHARACTERISTIC
/begin AXIS_PTS CAL_idle_comp_carspeed_manual_X_carspeed "X-axis breakpoints for the 'idle compensation carspeed manual' table. Defines the lookup grid (not a live channel); change only when re-axing the map. (km/h)" 0x4000A6FA NO_INPUT_QUANTITY RL_AXIS_UBYTE 0 CM_u8_speed_kph 8 0 255 /end AXIS_PTS
/begin CHARACTERISTIC CAL_idle_comp_carspeed_manual "Calibration: idle compensation carspeed manual. Tunable map/constant (not a live channel); log to diagnose idle quality, hunting, and stalls. (RPM; raw*4)" CURVE 0x4000A702 RL_VALUE_UBYTE 0 CM_u8_rspeed_4rpm 0 1020
 /begin AXIS_DESCR COM_AXIS NO_INPUT_QUANTITY CM_u8_speed_kph 8 0 255 AXIS_PTS_REF CAL_idle_comp_carspeed_manual_X_carspeed /end AXIS_DESCR
/end CHARACTERISTIC
/begin AXIS_PTS CAL_idle_comp_car_speed_manual_X_carspeed "X-axis breakpoints for the 'idle compensation car speed manual' table. Defines the lookup grid (not a live channel); change only when re-axing the map. (km/h)" 0x4000A70A NO_INPUT_QUANTITY RL_AXIS_UBYTE 0 CM_u8_speed_kph 8 0 255 /end AXIS_PTS
/begin CHARACTERISTIC CAL_idle_comp_car_speed_manual "Calibration: idle compensation car speed manual. Tunable map/constant (not a live channel); log to diagnose idle quality, hunting, and stalls. (RPM)" CURVE 0x4000A712 RL_VALUE_UBYTE 0 CM_u8_flow_100mg_s 0 25500
 /begin AXIS_DESCR COM_AXIS NO_INPUT_QUANTITY CM_u8_speed_kph 8 0 255 AXIS_PTS_REF CAL_idle_comp_car_speed_manual_X_carspeed /end AXIS_DESCR
/end CHARACTERISTIC
/begin AXIS_PTS CAL_idle_comp_timer_carspeed_manual_X_airtemp "X-axis breakpoints for the 'idle compensation timer carspeed manual' table. Defines the lookup grid (not a live channel); change only when re-axing the map. (deg C; raw*5/8-40)" 0x4000A71A NO_INPUT_QUANTITY RL_AXIS_UBYTE 0 CM_u8_temp_5_8_40c 8 -40 119.375 /end AXIS_PTS
/begin AXIS_PTS CAL_idle_comp_timer_carspeed_manual_Y_time_above_speed "Y-axis breakpoints for the 'idle compensation timer carspeed manual' table. Defines the lookup grid (not a live channel); change only when re-axing the map." 0x4000A722 NO_INPUT_QUANTITY RL_AXIS_UBYTE 0 NO_COMPU_METHOD 8 0 255 /end AXIS_PTS
/begin CHARACTERISTIC CAL_idle_comp_timer_carspeed_manual "Calibration: idle compensation timer carspeed manual. Tunable map/constant (not a live channel); log to diagnose idle quality, hunting, and stalls. (RPM; raw*8)" MAP 0x4000A72A RL_VALUE_UBYTE 0 CM_u8_rspeed_8rpm 0 2040
 /begin AXIS_DESCR COM_AXIS NO_INPUT_QUANTITY CM_u8_temp_5_8_40c 8 -40 119.375 AXIS_PTS_REF CAL_idle_comp_timer_carspeed_manual_X_airtemp /end AXIS_DESCR
 /begin AXIS_DESCR COM_AXIS NO_INPUT_QUANTITY NO_COMPU_METHOD 8 0 255 AXIS_PTS_REF CAL_idle_comp_timer_carspeed_manual_Y_time_above_speed /end AXIS_DESCR
/end CHARACTERISTIC
/begin AXIS_PTS CAL_dfco_recovery_fuel_frac_vs_pedal_X_pedal_pos "X-axis breakpoints for the 'DFCO recovery fuel frac vs pedal' table. Defines the lookup grid (not a live channel); change only when re-axing the map. (0-1; raw/255)" 0x4000A76A NO_INPUT_QUANTITY RL_AXIS_UBYTE 0 CM_u8_factor_1_255 4 0 100 /end AXIS_PTS
/begin CHARACTERISTIC CAL_dfco_recovery_fuel_frac_vs_pedal "Calibration: DFCO recovery fuel frac vs pedal. Tunable map/constant (not a live channel); log to see when fuel is cut and restored on deceleration." CURVE 0x4000A76E RL_VALUE_UBYTE 0 NO_COMPU_METHOD 0 255
 /begin AXIS_DESCR COM_AXIS NO_INPUT_QUANTITY CM_u8_factor_1_255 4 0 100 AXIS_PTS_REF CAL_dfco_recovery_fuel_frac_vs_pedal_X_pedal_pos /end AXIS_DESCR
/end CHARACTERISTIC
/begin AXIS_PTS CAL_ign_comp_maf_accum_X_maf_accum "X-axis breakpoints for the 'ignition compensation MAF accum' table. Defines the lookup grid (not a live channel); change only when re-axing the map. (g)" 0x4000A772 NO_INPUT_QUANTITY RL_AXIS_UBYTE 0 CM_u16_mass_g 8 0 255 /end AXIS_PTS
/begin AXIS_PTS CAL_ign_comp_maf_accum_Y_tps "Y-axis breakpoints for the 'ignition compensation MAF accum' table. Defines the lookup grid (not a live channel); change only when re-axing the map. (0-1; raw/255)" 0x4000A77A NO_INPUT_QUANTITY RL_AXIS_UBYTE 0 CM_u8_factor_1_255 8 0 100 /end AXIS_PTS
/begin CHARACTERISTIC CAL_ign_comp_maf_accum "Calibration: ignition compensation MAF accum. Tunable map/constant (not a live channel); log spark advance to confirm the timing strategy and headroom to knock. (0-1; raw/255)" MAP 0x4000A782 RL_VALUE_UBYTE 0 CM_u8_factor_1_255 0 100
 /begin AXIS_DESCR COM_AXIS NO_INPUT_QUANTITY CM_u16_mass_g 8 0 255 AXIS_PTS_REF CAL_ign_comp_maf_accum_X_maf_accum /end AXIS_DESCR
 /begin AXIS_DESCR COM_AXIS NO_INPUT_QUANTITY CM_u8_factor_1_255 8 0 100 AXIS_PTS_REF CAL_ign_comp_maf_accum_Y_tps /end AXIS_DESCR
/end CHARACTERISTIC
/begin AXIS_PTS CAL_ign_dwell_time_X_rpm "X-axis breakpoints for the 'ignition dwell time' table. Defines the lookup grid (not a live channel); change only when re-axing the map. (RPM; raw*125/4+500)" 0x4000A7C2 NO_INPUT_QUANTITY RL_AXIS_UBYTE 0 CM_u8_rspeed_125_4_500rpm 8 500 8468.75 /end AXIS_PTS
/begin AXIS_PTS CAL_ign_dwell_time_Y_ecu_voltage "Y-axis breakpoints for the 'ignition dwell time' table. Defines the lookup grid (not a live channel); change only when re-axing the map. (V; raw*72/1023)" 0x4000A7CA NO_INPUT_QUANTITY RL_AXIS_UBYTE 0 CM_u8_voltage_72_1023v 8 0 17.9472140762463 /end AXIS_PTS
/begin CHARACTERISTIC CAL_ign_dwell_time "Calibration: ignition dwell time. Tunable map/constant (not a live channel); log spark advance to confirm the timing strategy and headroom to knock. (us; raw*64)" MAP 0x4000A7D2 RL_VALUE_UBYTE 0 CM_u8_time_64us 0 16320
 /begin AXIS_DESCR COM_AXIS NO_INPUT_QUANTITY CM_u8_rspeed_125_4_500rpm 8 500 8468.75 AXIS_PTS_REF CAL_ign_dwell_time_X_rpm /end AXIS_DESCR
 /begin AXIS_DESCR COM_AXIS NO_INPUT_QUANTITY CM_u8_voltage_72_1023v 8 0 17.9472140762463 AXIS_PTS_REF CAL_ign_dwell_time_Y_ecu_voltage /end AXIS_DESCR
/end CHARACTERISTIC
/begin AXIS_PTS CAL_ign_knock_safe_X_rpm "X-axis breakpoints for the 'ignition knock safe' table. Defines the lookup grid (not a live channel); change only when re-axing the map. (RPM; raw*125/4+500)" 0x4000A812 NO_INPUT_QUANTITY RL_AXIS_UBYTE 0 CM_u8_rspeed_125_4_500rpm 32 500 8468.75 /end AXIS_PTS
/begin AXIS_PTS CAL_ign_knock_safe_Y_load "Y-axis breakpoints for the 'ignition knock safe' table. Defines the lookup grid (not a live channel); change only when re-axing the map. (mg/stroke; raw*4)" 0x4000A832 NO_INPUT_QUANTITY RL_AXIS_UBYTE 0 CM_u8_load_4mg_stroke 32 0 1020 /end AXIS_PTS
/begin CHARACTERISTIC CAL_ign_knock_safe "Calibration: ignition knock safe. Tunable map/constant (not a live channel); log spark advance to confirm the timing strategy and headroom to knock. (deg; raw/4-10)" MAP 0x4000A852 RL_VALUE_UBYTE 0 CM_u8_angle_1_4_10deg -10 53.75
 /begin AXIS_DESCR COM_AXIS NO_INPUT_QUANTITY CM_u8_rspeed_125_4_500rpm 32 500 8468.75 AXIS_PTS_REF CAL_ign_knock_safe_X_rpm /end AXIS_DESCR
 /begin AXIS_DESCR COM_AXIS NO_INPUT_QUANTITY CM_u8_load_4mg_stroke 32 0 1020 AXIS_PTS_REF CAL_ign_knock_safe_Y_load /end AXIS_DESCR
/end CHARACTERISTIC
/begin AXIS_PTS CAL_ign_base_manual_X_rpm "X-axis breakpoints for the 'ignition base manual' table. Defines the lookup grid (not a live channel); change only when re-axing the map. (RPM; raw*125/4+500)" 0x4000AC52 NO_INPUT_QUANTITY RL_AXIS_UBYTE 0 CM_u8_rspeed_125_4_500rpm 32 500 8468.75 /end AXIS_PTS
/begin AXIS_PTS CAL_ign_base_manual_Y_load "Y-axis breakpoints for the 'ignition base manual' table. Defines the lookup grid (not a live channel); change only when re-axing the map. (mg/stroke; raw*4)" 0x4000AC72 NO_INPUT_QUANTITY RL_AXIS_UBYTE 0 CM_u8_load_4mg_stroke 32 0 1020 /end AXIS_PTS
/begin CHARACTERISTIC CAL_ign_base_manual "Calibration: ignition base manual. Tunable map/constant (not a live channel); log spark advance to confirm the timing strategy and headroom to knock. (deg; raw/4-10)" MAP 0x4000AC92 RL_VALUE_UBYTE 0 CM_u8_angle_1_4_10deg -10 53.75
 /begin AXIS_DESCR COM_AXIS NO_INPUT_QUANTITY CM_u8_rspeed_125_4_500rpm 32 500 8468.75 AXIS_PTS_REF CAL_ign_base_manual_X_rpm /end AXIS_DESCR
 /begin AXIS_DESCR COM_AXIS NO_INPUT_QUANTITY CM_u8_load_4mg_stroke 32 0 1020 AXIS_PTS_REF CAL_ign_base_manual_Y_load /end AXIS_DESCR
/end CHARACTERISTIC
/begin AXIS_PTS CAL_sensor_maf_scaling_X_voltage "X-axis breakpoints for the 'sensor MAF scaling' table. Defines the lookup grid (not a live channel); change only when re-axing the map. (V; raw*5/1023)" 0x4000B092 NO_INPUT_QUANTITY RL_AXIS_UWORD 0 CM_u16_voltage_5_1023v 32 0 320.307917888563 /end AXIS_PTS
/begin CHARACTERISTIC CAL_sensor_maf_scaling "Calibration: sensor MAF scaling. Tunable map/constant (not a live channel); log the raw sensor signal to check sensor health and range. (mg/s; raw*10)" CURVE 0x4000B0D2 RL_VALUE_UWORD 0 CM_u16_flow_10mg_s 0 655350
 /begin AXIS_DESCR COM_AXIS NO_INPUT_QUANTITY CM_u16_voltage_5_1023v 32 0 320.307917888563 AXIS_PTS_REF CAL_sensor_maf_scaling_X_voltage /end AXIS_DESCR
/end CHARACTERISTIC
/begin AXIS_PTS CAL_idle_air_hi_rpm_adder_X_rpm "u8_rspeed_125/4+500rpm[16]" 0x4000B112 NO_INPUT_QUANTITY RL_AXIS_UBYTE 0 CM_u8_rspeed_125_4_500rpm 16 500 8468.75 /end AXIS_PTS
/begin CHARACTERISTIC CAL_idle_air_hi_rpm_adder "u8_flow_100mg/s[16]" CURVE 0x4000B122 RL_VALUE_UBYTE 0 CM_u8_flow_100mg_s 0 25500
 /begin AXIS_DESCR COM_AXIS NO_INPUT_QUANTITY CM_u8_rspeed_125_4_500rpm 16 500 8468.75 AXIS_PTS_REF CAL_idle_air_hi_rpm_adder_X_rpm /end AXIS_DESCR
/end CHARACTERISTIC
/begin AXIS_PTS CAL_tpssmooth_decrement_by_delta_X_tps_delta "X-axis breakpoints for the 'tpssmooth decrement by delta' table. Defines the lookup grid (not a live channel); change only when re-axing the map. (0-1; raw/255)" 0x4000B132 NO_INPUT_QUANTITY RL_AXIS_UBYTE 0 CM_u8_factor_1_255 8 0 100 /end AXIS_PTS
/begin CHARACTERISTIC CAL_tpssmooth_decrement_by_delta "Calibration: tpssmooth decrement by delta. Tunable map/constant (not a live channel); log to see throttle-signal smoothing/filtering behavior. (0-1; raw/255)" CURVE 0x4000B13A RL_VALUE_UBYTE 0 CM_u8_factor_1_255 0 100
 /begin AXIS_DESCR COM_AXIS NO_INPUT_QUANTITY CM_u8_factor_1_255 8 0 100 AXIS_PTS_REF CAL_tpssmooth_decrement_by_delta_X_tps_delta /end AXIS_DESCR
/end CHARACTERISTIC
/begin AXIS_PTS CAL_revlimit_speed_base_manual_gearbox_tour_X_coolant "X-axis breakpoints for the 'revlimit speed base manual gearbox tour' table. Defines the lookup grid (not a live channel); change only when re-axing the map. (deg C; raw*5/8-40)" 0x4000B142 NO_INPUT_QUANTITY RL_AXIS_UBYTE 0 CM_u8_temp_5_8_40c 8 -40 119.375 /end AXIS_PTS
/begin AXIS_PTS CAL_revlimit_speed_base_manual_gearbox_tour_Y_timer "Y-axis breakpoints for the 'revlimit speed base manual gearbox tour' table. Defines the lookup grid (not a live channel); change only when re-axing the map. (ms; raw*100)" 0x4000B14A NO_INPUT_QUANTITY RL_AXIS_UBYTE 0 CM_u8_time_100ms 8 0 25500 /end AXIS_PTS
/begin CHARACTERISTIC CAL_revlimit_speed_base_manual_gearbox_tour "Calibration: revlimit speed base manual gearbox tour. Tunable map/constant (not a live channel); log to confirm where and how the rev limiter intervenes. (RPM; raw*10+6000)" MAP 0x4000B152 RL_VALUE_UBYTE 0 CM_u8_rspeed_10_6000rpm 6000 8550
 /begin AXIS_DESCR COM_AXIS NO_INPUT_QUANTITY CM_u8_temp_5_8_40c 8 -40 119.375 AXIS_PTS_REF CAL_revlimit_speed_base_manual_gearbox_tour_X_coolant /end AXIS_DESCR
 /begin AXIS_DESCR COM_AXIS NO_INPUT_QUANTITY CM_u8_time_100ms 8 0 25500 AXIS_PTS_REF CAL_revlimit_speed_base_manual_gearbox_tour_Y_timer /end AXIS_DESCR
/end CHARACTERISTIC
/begin AXIS_PTS CAL_ign_comp_overtemp_X_rpm "X-axis breakpoints for the 'ignition compensation overtemp' table. Defines the lookup grid (not a live channel); change only when re-axing the map. (RPM; raw*125/4+500)" 0x4000B192 NO_INPUT_QUANTITY RL_AXIS_UBYTE 0 CM_u8_rspeed_125_4_500rpm 16 500 8468.75 /end AXIS_PTS
/begin CHARACTERISTIC CAL_ign_comp_overtemp "Calibration: ignition compensation overtemp. Tunable map/constant (not a live channel); log spark advance to confirm the timing strategy and headroom to knock. (deg; raw/4-32)" CURVE 0x4000B1A2 RL_VALUE_UBYTE 0 CM_u8_angle_1_4_32deg -32 31.75
 /begin AXIS_DESCR COM_AXIS NO_INPUT_QUANTITY CM_u8_rspeed_125_4_500rpm 16 500 8468.75 AXIS_PTS_REF CAL_ign_comp_overtemp_X_rpm /end AXIS_DESCR
/end CHARACTERISTIC
/begin AXIS_PTS CAL_ign_comp_overtemp_coeff_X_coolant_temp "X-axis breakpoints for the 'ignition compensation overtemp coeff' table. Defines the lookup grid (not a live channel); change only when re-axing the map. (deg C; raw*5/8-40)" 0x4000B1B2 NO_INPUT_QUANTITY RL_AXIS_UBYTE 0 CM_u8_temp_5_8_40c 8 -40 119.375 /end AXIS_PTS
/begin CHARACTERISTIC CAL_ign_comp_overtemp_coeff "Calibration: ignition compensation overtemp coeff. Tunable map/constant (not a live channel); log spark advance to confirm the timing strategy and headroom to knock. (0-1; raw/128)" CURVE 0x4000B1BA RL_VALUE_UBYTE 0 CM_u8_factor_1_128 0 199.21875
 /begin AXIS_DESCR COM_AXIS NO_INPUT_QUANTITY CM_u8_temp_5_8_40c 8 -40 119.375 AXIS_PTS_REF CAL_ign_comp_overtemp_coeff_X_coolant_temp /end AXIS_DESCR
/end CHARACTERISTIC
/begin AXIS_PTS CAL_ign_comp_speed_variation_X_rpm_delta "X-axis breakpoints for the 'ignition compensation speed variation' table. Defines the lookup grid (not a live channel); change only when re-axing the map." 0x4000B1C2 NO_INPUT_QUANTITY RL_AXIS_UBYTE 0 NO_COMPU_METHOD 16 0 255 /end AXIS_PTS
/begin CHARACTERISTIC CAL_ign_comp_speed_variation "ignition compensation indexed by engine speed variation (RPM delta)" CURVE 0x4000B1D2 RL_VALUE_UBYTE 0 NO_COMPU_METHOD 0 255
 /begin AXIS_DESCR COM_AXIS NO_INPUT_QUANTITY NO_COMPU_METHOD 16 0 255 AXIS_PTS_REF CAL_ign_comp_speed_variation_X_rpm_delta /end AXIS_DESCR
/end CHARACTERISTIC
/begin AXIS_PTS CAL_vvt_start_timer_X_coolant_temp "X-axis breakpoints for the 'VVT start timer' table. Defines the lookup grid (not a live channel); change only when re-axing the map. (deg C; raw*5/8-40)" 0x4000B1E2 NO_INPUT_QUANTITY RL_AXIS_UBYTE 0 CM_u8_temp_5_8_40c 8 -40 119.375 /end AXIS_PTS
/begin CHARACTERISTIC CAL_vvt_start_timer "Calibration: VVT start timer. Tunable map/constant (not a live channel); log commanded vs actual cam timing to verify VVT response. (ms; raw*100)" CURVE 0x4000B1EA RL_VALUE_UBYTE 0 CM_u8_time_100ms 0 25500
 /begin AXIS_DESCR COM_AXIS NO_INPUT_QUANTITY CM_u8_temp_5_8_40c 8 -40 119.375 AXIS_PTS_REF CAL_vvt_start_timer_X_coolant_temp /end AXIS_DESCR
/end CHARACTERISTIC
/begin AXIS_PTS CAL_closedloop_o2_switch_threshold_X_rpm "X-axis breakpoints for the 'closedloop O2 switch threshold' table. Defines the lookup grid (not a live channel); change only when re-axing the map. (RPM; raw*125/4+500)" 0x4000B1F2 NO_INPUT_QUANTITY RL_AXIS_UBYTE 0 CM_u8_rspeed_125_4_500rpm 8 500 8468.75 /end AXIS_PTS
/begin CHARACTERISTIC CAL_closedloop_o2_switch_threshold "Calibration: closedloop O2 switch threshold. Tunable map/constant (not a live channel); log to watch O2 feedback trim the mixture and confirm the loop is active." CURVE 0x4000B1FA RL_VALUE_UBYTE 0 NO_COMPU_METHOD 0 255
 /begin AXIS_DESCR COM_AXIS NO_INPUT_QUANTITY CM_u8_rspeed_125_4_500rpm 8 500 8468.75 AXIS_PTS_REF CAL_closedloop_o2_switch_threshold_X_rpm /end AXIS_DESCR
/end CHARACTERISTIC
/begin AXIS_PTS CAL_ign_comp_tps_rate_X_tps_rate "X-axis breakpoints for the 'ignition compensation throttle position rate' table. Defines the lookup grid (not a live channel); change only when re-axing the map." 0x4000B202 NO_INPUT_QUANTITY RL_AXIS_UBYTE 0 NO_COMPU_METHOD 8 0 255 /end AXIS_PTS
/begin CHARACTERISTIC CAL_ign_comp_tps_rate "Calibration: ignition compensation throttle position rate. Tunable map/constant (not a live channel); log spark advance to confirm the timing strategy and headroom to knock. (deg; raw/4)" CURVE 0x4000B20A RL_VALUE_SBYTE 0 CM_u8_angle_1_4deg -32 31.75
 /begin AXIS_DESCR COM_AXIS NO_INPUT_QUANTITY NO_COMPU_METHOD 8 0 255 AXIS_PTS_REF CAL_ign_comp_tps_rate_X_tps_rate /end AXIS_DESCR
/end CHARACTERISTIC
/begin AXIS_PTS CAL_knock_sampling_window_X_rpm "X-axis breakpoints for the 'knock sampling window' table. Defines the lookup grid (not a live channel); change only when re-axing the map. (RPM; raw*125/4+500)" 0x4000B212 NO_INPUT_QUANTITY RL_AXIS_UBYTE 0 CM_u8_rspeed_125_4_500rpm 16 500 8468.75 /end AXIS_PTS
/begin AXIS_PTS CAL_knock_sampling_window_Y_load "Y-axis breakpoints for the 'knock sampling window' table. Defines the lookup grid (not a live channel); change only when re-axing the map. (mg/stroke; raw*4)" 0x4000B222 NO_INPUT_QUANTITY RL_AXIS_UBYTE 0 CM_u8_load_4mg_stroke 16 0 1020 /end AXIS_PTS
/begin CHARACTERISTIC CAL_knock_sampling_window "Calibration: knock sampling window. Tunable map/constant (not a live channel); log to catch knock events and see how much timing is being pulled." MAP 0x4000B232 RL_VALUE_UBYTE 0 NO_COMPU_METHOD 0 255
 /begin AXIS_DESCR COM_AXIS NO_INPUT_QUANTITY CM_u8_rspeed_125_4_500rpm 16 500 8468.75 AXIS_PTS_REF CAL_knock_sampling_window_X_rpm /end AXIS_DESCR
 /begin AXIS_DESCR COM_AXIS NO_INPUT_QUANTITY CM_u8_load_4mg_stroke 16 0 1020 AXIS_PTS_REF CAL_knock_sampling_window_Y_load /end AXIS_DESCR
/end CHARACTERISTIC
/begin AXIS_PTS CAL_knock_buffer_size_X_rpm "X-axis breakpoints for the 'knock buffer size' table. Defines the lookup grid (not a live channel); change only when re-axing the map. (RPM; raw*125/4+500)" 0x4000B332 NO_INPUT_QUANTITY RL_AXIS_UBYTE 0 CM_u8_rspeed_125_4_500rpm 16 500 8468.75 /end AXIS_PTS
/begin AXIS_PTS CAL_knock_buffer_size_Y_load "Y-axis breakpoints for the 'knock buffer size' table. Defines the lookup grid (not a live channel); change only when re-axing the map. (mg/stroke; raw*4)" 0x4000B342 NO_INPUT_QUANTITY RL_AXIS_UBYTE 0 CM_u8_load_4mg_stroke 16 0 1020 /end AXIS_PTS
/begin CHARACTERISTIC CAL_knock_buffer_size "Calibration: knock buffer size. Tunable map/constant (not a live channel); log to catch knock events and see how much timing is being pulled." MAP 0x4000B352 RL_VALUE_UBYTE 0 NO_COMPU_METHOD 0 255
 /begin AXIS_DESCR COM_AXIS NO_INPUT_QUANTITY CM_u8_rspeed_125_4_500rpm 16 500 8468.75 AXIS_PTS_REF CAL_knock_buffer_size_X_rpm /end AXIS_DESCR
 /begin AXIS_DESCR COM_AXIS NO_INPUT_QUANTITY CM_u8_load_4mg_stroke 16 0 1020 AXIS_PTS_REF CAL_knock_buffer_size_Y_load /end AXIS_DESCR
/end CHARACTERISTIC
/begin AXIS_PTS CAL_revlimit_speed_base_manual_gearbox_sport_X_coolant "X-axis breakpoints for the 'revlimit speed base manual gearbox sport' table. Defines the lookup grid (not a live channel); change only when re-axing the map. (deg C; raw*5/8-40)" 0x4000B452 NO_INPUT_QUANTITY RL_AXIS_UBYTE 0 CM_u8_temp_5_8_40c 8 -40 119.375 /end AXIS_PTS
/begin AXIS_PTS CAL_revlimit_speed_base_manual_gearbox_sport_Y_timer "Y-axis breakpoints for the 'revlimit speed base manual gearbox sport' table. Defines the lookup grid (not a live channel); change only when re-axing the map. (ms; raw*100)" 0x4000B45A NO_INPUT_QUANTITY RL_AXIS_UBYTE 0 CM_u8_time_100ms 8 0 25500 /end AXIS_PTS
/begin CHARACTERISTIC CAL_revlimit_speed_base_manual_gearbox_sport "Calibration: revlimit speed base manual gearbox sport. Tunable map/constant (not a live channel); log to confirm where and how the rev limiter intervenes. (RPM; raw*10+6000)" MAP 0x4000B462 RL_VALUE_UBYTE 0 CM_u8_rspeed_10_6000rpm 6000 8550
 /begin AXIS_DESCR COM_AXIS NO_INPUT_QUANTITY CM_u8_temp_5_8_40c 8 -40 119.375 AXIS_PTS_REF CAL_revlimit_speed_base_manual_gearbox_sport_X_coolant /end AXIS_DESCR
 /begin AXIS_DESCR COM_AXIS NO_INPUT_QUANTITY CM_u8_time_100ms 8 0 25500 AXIS_PTS_REF CAL_revlimit_speed_base_manual_gearbox_sport_Y_timer /end AXIS_DESCR
/end CHARACTERISTIC
/begin AXIS_PTS CAL_inj_deadtime_base_X_voltage "X-axis breakpoints for the 'injector time base' table. Defines the lookup grid (not a live channel); change only when re-axing the map. (V; raw*72/1023)" 0x4000B4A2 NO_INPUT_QUANTITY RL_AXIS_UBYTE 0 CM_u8_voltage_72_1023v 8 0 17.9472140762463 /end AXIS_PTS
/begin AXIS_PTS CAL_inj_deadtime_base_Y_airtemp_maf "Y-axis breakpoints for the 'injector time base' table. Defines the lookup grid (not a live channel); change only when re-axing the map. (deg C; raw*5/8-40)" 0x4000B4AA NO_INPUT_QUANTITY RL_AXIS_UBYTE 0 CM_u8_temp_5_8_40c 8 -40 119.375 /end AXIS_PTS
/begin CHARACTERISTIC CAL_inj_deadtime_base "Calibration: injector time base. Tunable map/constant (not a live channel); log to verify injector pulse width and fuel delivery vs target. (us; raw*20)" MAP 0x4000B4B2 RL_VALUE_UBYTE 0 CM_u8_time_20us 0 5100
 /begin AXIS_DESCR COM_AXIS NO_INPUT_QUANTITY CM_u8_voltage_72_1023v 8 0 17.9472140762463 AXIS_PTS_REF CAL_inj_deadtime_base_X_voltage /end AXIS_DESCR
 /begin AXIS_DESCR COM_AXIS NO_INPUT_QUANTITY CM_u8_temp_5_8_40c 8 -40 119.375 AXIS_PTS_REF CAL_inj_deadtime_base_Y_airtemp_maf /end AXIS_DESCR
/end CHARACTERISTIC
/begin AXIS_PTS CAL_sensor_ac_evap_temp_scaling_X_voltage "X-axis breakpoints for the 'sensor A/C EVAP temperature scaling' table. Defines the lookup grid (not a live channel); change only when re-axing the map." 0x4000B4F2 NO_INPUT_QUANTITY RL_AXIS_UWORD 0 NO_COMPU_METHOD 16 0 65535 /end AXIS_PTS
/begin CHARACTERISTIC CAL_sensor_ac_evap_temp_scaling "Calibration: sensor A/C EVAP temperature scaling. Tunable map/constant (not a live channel); log the raw sensor signal to check sensor health and range." CURVE 0x4000B512 RL_VALUE_UWORD 0 NO_COMPU_METHOD 0 65535
 /begin AXIS_DESCR COM_AXIS NO_INPUT_QUANTITY NO_COMPU_METHOD 16 0 65535 AXIS_PTS_REF CAL_sensor_ac_evap_temp_scaling_X_voltage /end AXIS_DESCR
/end CHARACTERISTIC
/begin AXIS_PTS CAL_idle_air_comp_bay_fan_X_time "uint8_t[8]" 0x4000B532 NO_INPUT_QUANTITY RL_AXIS_UBYTE 0 NO_COMPU_METHOD 8 0 255 /end AXIS_PTS
/begin CHARACTERISTIC CAL_idle_air_comp_bay_fan "u8_flow_100mg/s[8]" CURVE 0x4000B53A RL_VALUE_UBYTE 0 CM_u8_flow_100mg_s 0 25500
 /begin AXIS_DESCR COM_AXIS NO_INPUT_QUANTITY NO_COMPU_METHOD 8 0 255 AXIS_PTS_REF CAL_idle_air_comp_bay_fan_X_time /end AXIS_DESCR
/end CHARACTERISTIC
/begin AXIS_PTS CAL_sensor_fuel_level_X_voltage "X-axis breakpoints for the 'sensor fuel level' table. Defines the lookup grid (not a live channel); change only when re-axing the map. (V; raw*5/1023)" 0x4000B542 NO_INPUT_QUANTITY RL_AXIS_UWORD 0 CM_u16_voltage_5_1023v 8 0 320.307917888563 /end AXIS_PTS
/begin CHARACTERISTIC CAL_sensor_fuel_level "Calibration: sensor fuel level. Tunable map/constant (not a live channel); log to follow fuel delivery and mixture control. (gal; raw/10)" CURVE 0x4000B552 RL_VALUE_UWORD 0 CM_u8_volume_1_10gallon 0 6553.5
 /begin AXIS_DESCR COM_AXIS NO_INPUT_QUANTITY CM_u16_voltage_5_1023v 8 0 320.307917888563 AXIS_PTS_REF CAL_sensor_fuel_level_X_voltage /end AXIS_DESCR
/end CHARACTERISTIC
/begin AXIS_PTS CAL_revlimit_escalation_integrator_step_X_gear "X-axis breakpoints for the 'revlimit escalation integrator step' table. Defines the lookup grid (not a live channel); change only when re-axing the map." 0x4000B562 NO_INPUT_QUANTITY RL_AXIS_UBYTE 0 NO_COMPU_METHOD 7 0 255 /end AXIS_PTS
/begin CHARACTERISTIC CAL_revlimit_escalation_integrator_step "Calibration: revlimit escalation integrator step. Tunable map/constant (not a live channel); log to confirm where and how the rev limiter intervenes." CURVE 0x4000B569 RL_VALUE_UBYTE 0 NO_COMPU_METHOD 0 255
 /begin AXIS_DESCR COM_AXIS NO_INPUT_QUANTITY NO_COMPU_METHOD 7 0 255 AXIS_PTS_REF CAL_revlimit_escalation_integrator_step_X_gear /end AXIS_DESCR
/end CHARACTERISTIC
/begin AXIS_PTS CAL_ign_comp_startup_manual_X_maf_accum "X-axis breakpoints for the 'ignition compensation startup manual' table. Defines the lookup grid (not a live channel); change only when re-axing the map. (mg)" 0x4000B572 NO_INPUT_QUANTITY RL_AXIS_UWORD 0 CM_u16_mass_mg 8 0 65535 /end AXIS_PTS
/begin CHARACTERISTIC CAL_ign_comp_startup_manual "Calibration: ignition compensation startup manual. Tunable map/constant (not a live channel); log spark advance to confirm the timing strategy and headroom to knock. (deg; raw/4)" CURVE 0x4000B582 RL_VALUE_SWORD 0 CM_u8_angle_1_4deg -8192 8191.75
 /begin AXIS_DESCR COM_AXIS NO_INPUT_QUANTITY CM_u16_mass_mg 8 0 65535 AXIS_PTS_REF CAL_ign_comp_startup_manual_X_maf_accum /end AXIS_DESCR
/end CHARACTERISTIC
/begin AXIS_PTS CAL_idle_target_ips_ingear_tour_X_coolant_temp "X-axis breakpoints for the 'idle target IPS ingear tour' table. Defines the lookup grid (not a live channel); change only when re-axing the map. (deg C; raw*5/8-40)" 0x4000B5A2 NO_INPUT_QUANTITY RL_AXIS_UBYTE 0 CM_u8_temp_5_8_40c 16 -40 119.375 /end AXIS_PTS
/begin CHARACTERISTIC CAL_idle_target_ips_ingear_tour "Calibration: idle target IPS ingear tour. Tunable map/constant (not a live channel); log to diagnose idle quality, hunting, and stalls. (RPM; raw*4+500)" CURVE 0x4000B5B2 RL_VALUE_UBYTE 0 CM_u8_rspeed_4_500rpm 500 1520
 /begin AXIS_DESCR COM_AXIS NO_INPUT_QUANTITY CM_u8_temp_5_8_40c 16 -40 119.375 AXIS_PTS_REF CAL_idle_target_ips_ingear_tour_X_coolant_temp /end AXIS_DESCR
/end CHARACTERISTIC
/begin AXIS_PTS CAL_load_alphaN_base_X_engine_speed "X-axis breakpoints for the 'load alphaN base' table. Defines the lookup grid (not a live channel); change only when re-axing the map. (RPM; raw*125/4+500)" 0x4000B5C2 NO_INPUT_QUANTITY RL_AXIS_UBYTE 0 CM_u8_rspeed_125_4_500rpm 16 500 8468.75 /end AXIS_PTS
/begin AXIS_PTS CAL_load_alphaN_base_Y_tps "Y-axis breakpoints for the 'load alphaN base' table. Defines the lookup grid (not a live channel); change only when re-axing the map. (0-1; raw/255)" 0x4000B5D2 NO_INPUT_QUANTITY RL_AXIS_UBYTE 0 CM_u8_factor_1_255 16 0 100 /end AXIS_PTS
/begin CHARACTERISTIC CAL_load_alphaN_base "Calibration: load alphaN base. Tunable map/constant (not a live channel); log engine load -- the main axis for fueling and ignition. (mg/stroke; raw*4)" MAP 0x4000B5E2 RL_VALUE_UBYTE 0 CM_u8_load_4mg_stroke 0 1020
 /begin AXIS_DESCR COM_AXIS NO_INPUT_QUANTITY CM_u8_rspeed_125_4_500rpm 16 500 8468.75 AXIS_PTS_REF CAL_load_alphaN_base_X_engine_speed /end AXIS_DESCR
 /begin AXIS_DESCR COM_AXIS NO_INPUT_QUANTITY CM_u8_factor_1_255 16 0 100 AXIS_PTS_REF CAL_load_alphaN_base_Y_tps /end AXIS_DESCR
/end CHARACTERISTIC
/begin AXIS_PTS CAL_inj_afr_base_X_engine_speed "X-axis breakpoints for the 'injector AFR base' table. Defines the lookup grid (not a live channel); change only when re-axing the map. (RPM; raw*125/4+500)" 0x4000B6E2 NO_INPUT_QUANTITY RL_AXIS_UBYTE 0 CM_u8_rspeed_125_4_500rpm 16 500 8468.75 /end AXIS_PTS
/begin AXIS_PTS CAL_inj_afr_base_Y_engine_load "Y-axis breakpoints for the 'injector AFR base' table. Defines the lookup grid (not a live channel); change only when re-axing the map. (mg/stroke; raw*4)" 0x4000B6F2 NO_INPUT_QUANTITY RL_AXIS_UBYTE 0 CM_u8_load_4mg_stroke 16 0 1020 /end AXIS_PTS
/begin CHARACTERISTIC CAL_inj_afr_base "Calibration: injector AFR base. Tunable map/constant (not a live channel); log to verify injector pulse width and fuel delivery vs target. (AFR; raw/20+5)" MAP 0x4000B702 RL_VALUE_UBYTE 0 CM_u8_afr_1_20_5 5 17.75
 /begin AXIS_DESCR COM_AXIS NO_INPUT_QUANTITY CM_u8_rspeed_125_4_500rpm 16 500 8468.75 AXIS_PTS_REF CAL_inj_afr_base_X_engine_speed /end AXIS_DESCR
 /begin AXIS_DESCR COM_AXIS NO_INPUT_QUANTITY CM_u8_load_4mg_stroke 16 0 1020 AXIS_PTS_REF CAL_inj_afr_base_Y_engine_load /end AXIS_DESCR
/end CHARACTERISTIC
/begin AXIS_PTS CAL_tpstarget_low_gear_tour_ips_X_pps "X-axis breakpoints for the 'tpstarget low gear tour IPS' table. Defines the lookup grid (not a live channel); change only when re-axing the map. (0-1; raw/1023)" 0x4000B802 NO_INPUT_QUANTITY RL_AXIS_UWORD 0 CM_u16_factor_1_1023 16 0 6406.15835777126 /end AXIS_PTS
/begin CHARACTERISTIC CAL_tpstarget_low_gear_tour_ips "Calibration: tpstarget low gear tour IPS. Tunable map/constant (not a live channel); log to compare requested throttle target to pedal demand. (0-1; raw/1023)" CURVE 0x4000B822 RL_VALUE_UWORD 0 CM_u16_factor_1_1023 0 6406.15835777126
 /begin AXIS_DESCR COM_AXIS NO_INPUT_QUANTITY CM_u16_factor_1_1023 16 0 6406.15835777126 AXIS_PTS_REF CAL_tpstarget_low_gear_tour_ips_X_pps /end AXIS_DESCR
/end CHARACTERISTIC
/begin AXIS_PTS CAL_tpstarget_sport_ips_X_pps "X-axis breakpoints for the 'tpstarget sport IPS' table. Defines the lookup grid (not a live channel); change only when re-axing the map. (0-1; raw/1023)" 0x4000B842 NO_INPUT_QUANTITY RL_AXIS_UWORD 0 CM_u16_factor_1_1023 16 0 6406.15835777126 /end AXIS_PTS
/begin CHARACTERISTIC CAL_tpstarget_sport_ips "Calibration: tpstarget sport IPS. Tunable map/constant (not a live channel); log to compare requested throttle target to pedal demand. (0-1; raw/1023)" CURVE 0x4000B862 RL_VALUE_UWORD 0 CM_u16_factor_1_1023 0 6406.15835777126
 /begin AXIS_DESCR COM_AXIS NO_INPUT_QUANTITY CM_u16_factor_1_1023 16 0 6406.15835777126 AXIS_PTS_REF CAL_tpstarget_sport_ips_X_pps /end AXIS_DESCR
/end CHARACTERISTIC
/begin AXIS_PTS CAL_knock_sensitivity_X_engine_speed "X-axis breakpoints for the 'knock sensitivity' table. Defines the lookup grid (not a live channel); change only when re-axing the map. (RPM; raw*125/4+500)" 0x4000B882 NO_INPUT_QUANTITY RL_AXIS_UBYTE 0 CM_u8_rspeed_125_4_500rpm 8 500 8468.75 /end AXIS_PTS
/begin AXIS_PTS CAL_knock_sensitivity_Y_engine_load "Y-axis breakpoints for the 'knock sensitivity' table. Defines the lookup grid (not a live channel); change only when re-axing the map. (mg/stroke; raw*4)" 0x4000B88A NO_INPUT_QUANTITY RL_AXIS_UBYTE 0 CM_u8_load_4mg_stroke 8 0 1020 /end AXIS_PTS
/begin CHARACTERISTIC CAL_knock_sensitivity "Calibration: knock sensitivity. Tunable map/constant (not a live channel); log to catch knock events and see how much timing is being pulled." MAP 0x4000B892 RL_VALUE_UBYTE 0 NO_COMPU_METHOD 0 255
 /begin AXIS_DESCR COM_AXIS NO_INPUT_QUANTITY CM_u8_rspeed_125_4_500rpm 8 500 8468.75 AXIS_PTS_REF CAL_knock_sensitivity_X_engine_speed /end AXIS_DESCR
 /begin AXIS_DESCR COM_AXIS NO_INPUT_QUANTITY CM_u8_load_4mg_stroke 8 0 1020 AXIS_PTS_REF CAL_knock_sensitivity_Y_engine_load /end AXIS_DESCR
/end CHARACTERISTIC
/begin AXIS_PTS CAL_knock_peak_threshold_X_engine_speed "X-axis breakpoints for the 'knock peak threshold' table. Defines the lookup grid (not a live channel); change only when re-axing the map. (RPM; raw*125/4+500)" 0x4000B8D2 NO_INPUT_QUANTITY RL_AXIS_UBYTE 0 CM_u8_rspeed_125_4_500rpm 8 500 8468.75 /end AXIS_PTS
/begin AXIS_PTS CAL_knock_peak_threshold_Y_load "Y-axis breakpoints for the 'knock peak threshold' table. Defines the lookup grid (not a live channel); change only when re-axing the map. (mg/stroke; raw*4)" 0x4000B8DA NO_INPUT_QUANTITY RL_AXIS_UBYTE 0 CM_u8_load_4mg_stroke 8 0 1020 /end AXIS_PTS
/begin CHARACTERISTIC CAL_knock_peak_threshold "Calibration: knock peak threshold. Tunable map/constant (not a live channel); log to catch knock events and see how much timing is being pulled." MAP 0x4000B8E2 RL_VALUE_UBYTE 0 NO_COMPU_METHOD 0 255
 /begin AXIS_DESCR COM_AXIS NO_INPUT_QUANTITY CM_u8_rspeed_125_4_500rpm 8 500 8468.75 AXIS_PTS_REF CAL_knock_peak_threshold_X_engine_speed /end AXIS_DESCR
 /begin AXIS_DESCR COM_AXIS NO_INPUT_QUANTITY CM_u8_load_4mg_stroke 8 0 1020 AXIS_PTS_REF CAL_knock_peak_threshold_Y_load /end AXIS_DESCR
/end CHARACTERISTIC
/begin AXIS_PTS CAL_knock_retard1_step_X_peak_over_threshold "X-axis breakpoints for the 'knock retard1 step' table. Defines the lookup grid (not a live channel); change only when re-axing the map." 0x4000B922 NO_INPUT_QUANTITY RL_AXIS_UBYTE 0 NO_COMPU_METHOD 8 0 255 /end AXIS_PTS
/begin CHARACTERISTIC CAL_knock_retard1_step "Calibration: knock retard1 step. Tunable map/constant (not a live channel); log to catch knock events and see how much timing is being pulled. (deg; raw/4)" CURVE 0x4000B92A RL_VALUE_UBYTE 0 CM_u8_angle_1_4deg 0 63.75
 /begin AXIS_DESCR COM_AXIS NO_INPUT_QUANTITY NO_COMPU_METHOD 8 0 255 AXIS_PTS_REF CAL_knock_retard1_step_X_peak_over_threshold /end AXIS_DESCR
/end CHARACTERISTIC
/begin AXIS_PTS CAL_knock_detection_load_threshold_X_rpm "X-axis breakpoints for the 'knock detection load threshold' table. Defines the lookup grid (not a live channel); change only when re-axing the map. (RPM; raw*125/4+500)" 0x4000B932 NO_INPUT_QUANTITY RL_AXIS_UBYTE 0 CM_u8_rspeed_125_4_500rpm 8 500 8468.75 /end AXIS_PTS
/begin CHARACTERISTIC CAL_knock_detection_load_threshold "Calibration: knock detection load threshold. Tunable map/constant (not a live channel); log to catch knock events and see how much timing is being pulled. (mg/stroke; raw*4)" CURVE 0x4000B93A RL_VALUE_UBYTE 0 CM_u8_load_4mg_stroke 0 1020
 /begin AXIS_DESCR COM_AXIS NO_INPUT_QUANTITY CM_u8_rspeed_125_4_500rpm 8 500 8468.75 AXIS_PTS_REF CAL_knock_detection_load_threshold_X_rpm /end AXIS_DESCR
/end CHARACTERISTIC
/begin AXIS_PTS CAL_knock_learning_load_threshold_X_rpm "X-axis breakpoints for the 'knock learning load threshold' table. Defines the lookup grid (not a live channel); change only when re-axing the map. (RPM; raw*125/4+500)" 0x4000B942 NO_INPUT_QUANTITY RL_AXIS_UBYTE 0 CM_u8_rspeed_125_4_500rpm 8 500 8468.75 /end AXIS_PTS
/begin CHARACTERISTIC CAL_knock_learning_load_threshold "Calibration: knock learning load threshold. Tunable map/constant (not a live channel); log to catch knock events and see how much timing is being pulled. (mg/stroke; raw*4)" CURVE 0x4000B94A RL_VALUE_UBYTE 0 CM_u8_load_4mg_stroke 0 1020
 /begin AXIS_DESCR COM_AXIS NO_INPUT_QUANTITY CM_u8_rspeed_125_4_500rpm 8 500 8468.75 AXIS_PTS_REF CAL_knock_learning_load_threshold_X_rpm /end AXIS_DESCR
/end CHARACTERISTIC
/begin AXIS_PTS CAL_obd_ii_commanded_evap_purge_X_duty "u8_dutycycle_100/255[16]" 0x4000B952 NO_INPUT_QUANTITY RL_AXIS_UBYTE 0 CM_u8_factor_1_255 16 0 100 /end AXIS_PTS
/begin AXIS_PTS CAL_obd_ii_commanded_evap_purge_Y_vacuum "u8_pressure_4mbar[16]" 0x4000B962 NO_INPUT_QUANTITY RL_AXIS_UBYTE 0 CM_u8_pressure_4mbar 16 0 1020 /end AXIS_PTS
/begin CHARACTERISTIC CAL_obd_ii_commanded_evap_purge "u8_dutycycle_100/255[256]" MAP 0x4000B972 RL_VALUE_UBYTE 0 CM_u8_factor_1_255 0 100
 /begin AXIS_DESCR COM_AXIS NO_INPUT_QUANTITY CM_u8_factor_1_255 16 0 100 AXIS_PTS_REF CAL_obd_ii_commanded_evap_purge_X_duty /end AXIS_DESCR
 /begin AXIS_DESCR COM_AXIS NO_INPUT_QUANTITY CM_u8_pressure_4mbar 16 0 1020 AXIS_PTS_REF CAL_obd_ii_commanded_evap_purge_Y_vacuum /end AXIS_DESCR
/end CHARACTERISTIC
/begin CHARACTERISTIC CAL_evap_purge_flow_X_vacuum "X-axis (filtered vacuum, 4 mbar/count) for CAL_evap_purge_flow_max_duty." VAL_BLK 0x4000BA72 RL_VALUE_UBYTE 0 CM_u8_pressure_4mbar 0 1020 NUMBER 8 /end CHARACTERISTIC
/begin CHARACTERISTIC CAL_evap_purge_flow_max_duty "Max evap purge duty allowed vs filtered manifold vacuum (flow limit). 0 when vacuum = 0." VAL_BLK 0x4000BA7A RL_VALUE_UBYTE 0 CM_u8_factor_1_255 0 100 NUMBER 8 /end CHARACTERISTIC
/begin AXIS_PTS CAL_tpstarget_tour_manual_X_pps "X-axis breakpoints for the 'tpstarget tour manual' table. Defines the lookup grid (not a live channel); change only when re-axing the map. (0-1; raw/1023)" 0x4000BA82 NO_INPUT_QUANTITY RL_AXIS_UWORD 0 CM_u16_factor_1_1023 16 0 6406.15835777126 /end AXIS_PTS
/begin CHARACTERISTIC CAL_tpstarget_tour_manual "Calibration: tpstarget tour manual. Tunable map/constant (not a live channel); log to compare requested throttle target to pedal demand. (0-1; raw/1023)" CURVE 0x4000BAA2 RL_VALUE_UWORD 0 CM_u16_factor_1_1023 0 6406.15835777126
 /begin AXIS_DESCR COM_AXIS NO_INPUT_QUANTITY CM_u16_factor_1_1023 16 0 6406.15835777126 AXIS_PTS_REF CAL_tpstarget_tour_manual_X_pps /end AXIS_DESCR
/end CHARACTERISTIC
/begin AXIS_PTS CAL_closedloop_tps_correction_tour_manual_X_unknown "uint16_t[16]" 0x4000BAC2 NO_INPUT_QUANTITY RL_AXIS_UWORD 0 NO_COMPU_METHOD 16 0 65535 /end AXIS_PTS
/begin CHARACTERISTIC CAL_closedloop_tps_correction_tour_manual "uint16_t[16]" CURVE 0x4000BAE2 RL_VALUE_UWORD 0 NO_COMPU_METHOD 0 65535
 /begin AXIS_DESCR COM_AXIS NO_INPUT_QUANTITY NO_COMPU_METHOD 16 0 65535 AXIS_PTS_REF CAL_closedloop_tps_correction_tour_manual_X_unknown /end AXIS_DESCR
/end CHARACTERISTIC
/begin AXIS_PTS CAL_tpstarget_sport_manual_X_pps "X-axis breakpoints for the 'tpstarget sport manual' table. Defines the lookup grid (not a live channel); change only when re-axing the map. (0-1; raw/1023)" 0x4000BB02 NO_INPUT_QUANTITY RL_AXIS_UWORD 0 CM_u16_factor_1_1023 16 0 6406.15835777126 /end AXIS_PTS
/begin CHARACTERISTIC CAL_tpstarget_sport_manual "Calibration: tpstarget sport manual. Tunable map/constant (not a live channel); log to compare requested throttle target to pedal demand. (0-1; raw/1023)" CURVE 0x4000BB22 RL_VALUE_UWORD 0 CM_u16_factor_1_1023 0 6406.15835777126
 /begin AXIS_DESCR COM_AXIS NO_INPUT_QUANTITY CM_u16_factor_1_1023 16 0 6406.15835777126 AXIS_PTS_REF CAL_tpstarget_sport_manual_X_pps /end AXIS_DESCR
/end CHARACTERISTIC
/begin AXIS_PTS CAL_ign_retard_step_tps_X_engine_speed "X-axis breakpoints for the 'ignition retard step throttle position' table. Defines the lookup grid (not a live channel); change only when re-axing the map. (RPM; raw*125/4+500)" 0x4000BB42 NO_INPUT_QUANTITY RL_AXIS_UBYTE 0 CM_u8_rspeed_125_4_500rpm 8 500 8468.75 /end AXIS_PTS
/begin AXIS_PTS CAL_ign_retard_step_tps_Y_pedal_pos "Y-axis breakpoints for the 'ignition retard step throttle position' table. Defines the lookup grid (not a live channel); change only when re-axing the map. (0-1; raw/255)" 0x4000BB4A NO_INPUT_QUANTITY RL_AXIS_UBYTE 0 CM_u8_factor_1_255 16 0 100 /end AXIS_PTS
/begin CHARACTERISTIC CAL_ign_retard_step_tps "Calibration: ignition retard step throttle position. Tunable map/constant (not a live channel); log spark advance to confirm the timing strategy and headroom to knock. (deg; raw/4)" MAP 0x4000BB5A RL_VALUE_SBYTE 0 CM_u8_angle_1_4deg -32 31.75
 /begin AXIS_DESCR COM_AXIS NO_INPUT_QUANTITY CM_u8_rspeed_125_4_500rpm 8 500 8468.75 AXIS_PTS_REF CAL_ign_retard_step_tps_X_engine_speed /end AXIS_DESCR
 /begin AXIS_DESCR COM_AXIS NO_INPUT_QUANTITY CM_u8_factor_1_255 16 0 100 AXIS_PTS_REF CAL_ign_retard_step_tps_Y_pedal_pos /end AXIS_DESCR
/end CHARACTERISTIC
/begin AXIS_PTS CAL_torque_load_to_torque_X_engine_speed "X-axis breakpoints for the 'torque load to torque' table. Defines the lookup grid (not a live channel); change only when re-axing the map. (RPM; raw*125/4+500)" 0x4000BBDA NO_INPUT_QUANTITY RL_AXIS_UBYTE 0 CM_u8_rspeed_125_4_500rpm 16 500 8468.75 /end AXIS_PTS
/begin AXIS_PTS CAL_torque_load_to_torque_Y_load "Y-axis breakpoints for the 'torque load to torque' table. Defines the lookup grid (not a live channel); change only when re-axing the map. (mg/stroke; raw*4)" 0x4000BBEA NO_INPUT_QUANTITY RL_AXIS_UBYTE 0 CM_u8_load_4mg_stroke 16 0 1020 /end AXIS_PTS
/begin CHARACTERISTIC CAL_torque_load_to_torque "Calibration: torque load to torque. Tunable map/constant (not a live channel); log to follow the ECU torque estimate and any torque limiting. (Nm; raw*2)" MAP 0x4000BBFA RL_VALUE_UBYTE 0 CM_u8_torque_2nm 0 510
 /begin AXIS_DESCR COM_AXIS NO_INPUT_QUANTITY CM_u8_rspeed_125_4_500rpm 16 500 8468.75 AXIS_PTS_REF CAL_torque_load_to_torque_X_engine_speed /end AXIS_DESCR
 /begin AXIS_DESCR COM_AXIS NO_INPUT_QUANTITY CM_u8_load_4mg_stroke 16 0 1020 AXIS_PTS_REF CAL_torque_load_to_torque_Y_load /end AXIS_DESCR
/end CHARACTERISTIC
/begin AXIS_PTS CAL_torque_engine_friction_speed_component_X_rpm "X-axis breakpoints for the 'torque engine friction speed component' table. Defines the lookup grid (not a live channel); change only when re-axing the map. (RPM; raw*125/4+500)" 0x4000BCFA NO_INPUT_QUANTITY RL_AXIS_UBYTE 0 CM_u8_rspeed_125_4_500rpm 16 500 8468.75 /end AXIS_PTS
/begin AXIS_PTS CAL_torque_engine_friction_speed_component_Y_load "Y-axis breakpoints for the 'torque engine friction speed component' table. Defines the lookup grid (not a live channel); change only when re-axing the map. (mg/stroke; raw*4)" 0x4000BD0A NO_INPUT_QUANTITY RL_AXIS_UBYTE 0 CM_u8_load_4mg_stroke 16 0 1020 /end AXIS_PTS
/begin CHARACTERISTIC CAL_torque_engine_friction_speed_component "Calibration: torque engine friction speed component. Tunable map/constant (not a live channel); log to follow the ECU torque estimate and any torque limiting. (Nm)" MAP 0x4000BD1A RL_VALUE_UBYTE 0 CM_u8_torque_nm 0 255
 /begin AXIS_DESCR COM_AXIS NO_INPUT_QUANTITY CM_u8_rspeed_125_4_500rpm 16 500 8468.75 AXIS_PTS_REF CAL_torque_engine_friction_speed_component_X_rpm /end AXIS_DESCR
 /begin AXIS_DESCR COM_AXIS NO_INPUT_QUANTITY CM_u8_load_4mg_stroke 16 0 1020 AXIS_PTS_REF CAL_torque_engine_friction_speed_component_Y_load /end AXIS_DESCR
/end CHARACTERISTIC
/begin AXIS_PTS CAL_torque_torque_to_load_X_engine_speed "X-axis breakpoints for the 'torque torque to load' table. Defines the lookup grid (not a live channel); change only when re-axing the map. (RPM; raw*125/4+500)" 0x4000BE1A NO_INPUT_QUANTITY RL_AXIS_UBYTE 0 CM_u8_rspeed_125_4_500rpm 16 500 8468.75 /end AXIS_PTS
/begin AXIS_PTS CAL_torque_torque_to_load_Y_torque "Y-axis breakpoints for the 'torque torque to load' table. Defines the lookup grid (not a live channel); change only when re-axing the map. (Nm; raw*2)" 0x4000BE2A NO_INPUT_QUANTITY RL_AXIS_UBYTE 0 CM_u8_torque_2nm 16 0 510 /end AXIS_PTS
/begin CHARACTERISTIC CAL_torque_torque_to_load "Calibration: torque torque to load. Tunable map/constant (not a live channel); log to follow the ECU torque estimate and any torque limiting. (mg/stroke; raw*4)" MAP 0x4000BE3A RL_VALUE_UBYTE 0 CM_u8_load_4mg_stroke 0 1020
 /begin AXIS_DESCR COM_AXIS NO_INPUT_QUANTITY CM_u8_rspeed_125_4_500rpm 16 500 8468.75 AXIS_PTS_REF CAL_torque_torque_to_load_X_engine_speed /end AXIS_DESCR
 /begin AXIS_DESCR COM_AXIS NO_INPUT_QUANTITY CM_u8_torque_2nm 16 0 510 AXIS_PTS_REF CAL_torque_torque_to_load_Y_torque /end AXIS_DESCR
/end CHARACTERISTIC
/begin AXIS_PTS CAL_load_to_tps_mapping_X_rpm "X-axis breakpoints for the 'load to throttle position mapping' table. Defines the lookup grid (not a live channel); change only when re-axing the map. (RPM; raw*125/4+500)" 0x4000BF3A NO_INPUT_QUANTITY RL_AXIS_UBYTE 0 CM_u8_rspeed_125_4_500rpm 16 500 8468.75 /end AXIS_PTS
/begin AXIS_PTS CAL_load_to_tps_mapping_Y_load "Y-axis breakpoints for the 'load to throttle position mapping' table. Defines the lookup grid (not a live channel); change only when re-axing the map. (mg/stroke; raw*4)" 0x4000BF4A NO_INPUT_QUANTITY RL_AXIS_UBYTE 0 CM_u8_load_4mg_stroke 16 0 1020 /end AXIS_PTS
/begin CHARACTERISTIC CAL_load_to_tps_mapping "Calibration: load to throttle position mapping. Tunable map/constant (not a live channel); log to see throttle/pedal demand and throttle response. (0-1; raw/255)" MAP 0x4000BF5A RL_VALUE_UBYTE 0 CM_u8_factor_1_255 0 100
 /begin AXIS_DESCR COM_AXIS NO_INPUT_QUANTITY CM_u8_rspeed_125_4_500rpm 16 500 8468.75 AXIS_PTS_REF CAL_load_to_tps_mapping_X_rpm /end AXIS_DESCR
 /begin AXIS_DESCR COM_AXIS NO_INPUT_QUANTITY CM_u8_load_4mg_stroke 16 0 1020 AXIS_PTS_REF CAL_load_to_tps_mapping_Y_load /end AXIS_DESCR
/end CHARACTERISTIC
/begin AXIS_PTS CAL_torque_ign_retard_base_X_engine_speed "X-axis breakpoints for the 'torque ignition retard base' table. Defines the lookup grid (not a live channel); change only when re-axing the map. (RPM; raw*125/4+500)" 0x4000C05A NO_INPUT_QUANTITY RL_AXIS_UBYTE 0 CM_u8_rspeed_125_4_500rpm 16 500 8468.75 /end AXIS_PTS
/begin AXIS_PTS CAL_torque_ign_retard_base_Y_torque_reduction_factor "Y-axis breakpoints for the 'torque ignition retard base' table. Defines the lookup grid (not a live channel); change only when re-axing the map. (0-1; raw/255)" 0x4000C06A NO_INPUT_QUANTITY RL_AXIS_UBYTE 0 CM_u8_factor_1_255 16 0 100 /end AXIS_PTS
/begin CHARACTERISTIC CAL_torque_ign_retard_base "Calibration: torque ignition retard base. Tunable map/constant (not a live channel); log spark advance to confirm the timing strategy and headroom to knock. (deg; raw/4-64)" MAP 0x4000C07A RL_VALUE_UBYTE 0 CM_u8_angle_1_4_64deg -64 -0.25
 /begin AXIS_DESCR COM_AXIS NO_INPUT_QUANTITY CM_u8_rspeed_125_4_500rpm 16 500 8468.75 AXIS_PTS_REF CAL_torque_ign_retard_base_X_engine_speed /end AXIS_DESCR
 /begin AXIS_DESCR COM_AXIS NO_INPUT_QUANTITY CM_u8_factor_1_255 16 0 100 AXIS_PTS_REF CAL_torque_ign_retard_base_Y_torque_reduction_factor /end AXIS_DESCR
/end CHARACTERISTIC
/begin AXIS_PTS CAL_ign_advance_min_X_engine_speed "X-axis breakpoints for the 'ignition advance min' table. Defines the lookup grid (not a live channel); change only when re-axing the map. (RPM; raw*125/4+500)" 0x4000C17A NO_INPUT_QUANTITY RL_AXIS_UBYTE 0 CM_u8_rspeed_125_4_500rpm 16 500 8468.75 /end AXIS_PTS
/begin AXIS_PTS CAL_ign_advance_min_Y_engine_load "Y-axis breakpoints for the 'ignition advance min' table. Defines the lookup grid (not a live channel); change only when re-axing the map. (mg/stroke; raw*4)" 0x4000C18A NO_INPUT_QUANTITY RL_AXIS_UBYTE 0 CM_u8_load_4mg_stroke 16 0 1020 /end AXIS_PTS
/begin CHARACTERISTIC CAL_ign_advance_min "Calibration: ignition advance min. Tunable map/constant (not a live channel); log spark advance to confirm the timing strategy and headroom to knock. (deg; raw/4-20)" MAP 0x4000C19A RL_VALUE_UBYTE 0 CM_u8_angle_1_4_20deg -20 43.75
 /begin AXIS_DESCR COM_AXIS NO_INPUT_QUANTITY CM_u8_rspeed_125_4_500rpm 16 500 8468.75 AXIS_PTS_REF CAL_ign_advance_min_X_engine_speed /end AXIS_DESCR
 /begin AXIS_DESCR COM_AXIS NO_INPUT_QUANTITY CM_u8_load_4mg_stroke 16 0 1020 AXIS_PTS_REF CAL_ign_advance_min_Y_engine_load /end AXIS_DESCR
/end CHARACTERISTIC
/begin AXIS_PTS CAL_idle_target_ips_neutral_tour_X_coolant_temp "X-axis breakpoints for the 'idle target IPS neutral tour' table. Defines the lookup grid (not a live channel); change only when re-axing the map. (deg C; raw*5/8-40)" 0x4000C29A NO_INPUT_QUANTITY RL_AXIS_UBYTE 0 CM_u8_temp_5_8_40c 16 -40 119.375 /end AXIS_PTS
/begin CHARACTERISTIC CAL_idle_target_ips_neutral_tour "Calibration: idle target IPS neutral tour. Tunable map/constant (not a live channel); log to diagnose idle quality, hunting, and stalls. (RPM; raw*4+500)" CURVE 0x4000C2AA RL_VALUE_UBYTE 0 CM_u8_rspeed_4_500rpm 500 1520
 /begin AXIS_DESCR COM_AXIS NO_INPUT_QUANTITY CM_u8_temp_5_8_40c 16 -40 119.375 AXIS_PTS_REF CAL_idle_target_ips_neutral_tour_X_coolant_temp /end AXIS_DESCR
/end CHARACTERISTIC
/begin AXIS_PTS CAL_torque_limit_base_factor_X_rpm "X-axis breakpoints for the 'torque limit base factor' table. Defines the lookup grid (not a live channel); change only when re-axing the map. (RPM; raw*125/4+500)" 0x4000C2BA NO_INPUT_QUANTITY RL_AXIS_UBYTE 0 CM_u8_rspeed_125_4_500rpm 16 500 8468.75 /end AXIS_PTS
/begin AXIS_PTS CAL_torque_limit_base_factor_Y_load "Y-axis breakpoints for the 'torque limit base factor' table. Defines the lookup grid (not a live channel); change only when re-axing the map. (mg/stroke; raw*4)" 0x4000C2CA NO_INPUT_QUANTITY RL_AXIS_UBYTE 0 CM_u8_load_4mg_stroke 16 0 1020 /end AXIS_PTS
/begin CHARACTERISTIC CAL_torque_limit_base_factor "Calibration: torque limit base factor. Tunable map/constant (not a live channel); log to follow the ECU torque estimate and any torque limiting. (0-1; raw/255)" MAP 0x4000C2DA RL_VALUE_UBYTE 0 CM_u8_factor_1_255 0 100
 /begin AXIS_DESCR COM_AXIS NO_INPUT_QUANTITY CM_u8_rspeed_125_4_500rpm 16 500 8468.75 AXIS_PTS_REF CAL_torque_limit_base_factor_X_rpm /end AXIS_DESCR
 /begin AXIS_DESCR COM_AXIS NO_INPUT_QUANTITY CM_u8_load_4mg_stroke 16 0 1020 AXIS_PTS_REF CAL_torque_limit_base_factor_Y_load /end AXIS_DESCR
/end CHARACTERISTIC
/begin AXIS_PTS CAL_torque_engine_friction_temp_component_X_coolant_temp "X-axis breakpoints for the 'torque engine friction temperature component' table. Defines the lookup grid (not a live channel); change only when re-axing the map. (deg C; raw*5/8-40)" 0x4000C3DA NO_INPUT_QUANTITY RL_AXIS_UBYTE 0 CM_u8_temp_5_8_40c 8 -40 119.375 /end AXIS_PTS
/begin AXIS_PTS CAL_torque_engine_friction_temp_component_Y_load "Y-axis breakpoints for the 'torque engine friction temperature component' table. Defines the lookup grid (not a live channel); change only when re-axing the map. (mg/stroke; raw*4)" 0x4000C3E2 NO_INPUT_QUANTITY RL_AXIS_UBYTE 0 CM_u8_load_4mg_stroke 8 0 1020 /end AXIS_PTS
/begin CHARACTERISTIC CAL_torque_engine_friction_temp_component "Calibration: torque engine friction temperature component. Tunable map/constant (not a live channel); log to follow the ECU torque estimate and any torque limiting. (Nm)" MAP 0x4000C3EA RL_VALUE_UBYTE 0 CM_u8_torque_nm 0 255
 /begin AXIS_DESCR COM_AXIS NO_INPUT_QUANTITY CM_u8_temp_5_8_40c 8 -40 119.375 AXIS_PTS_REF CAL_torque_engine_friction_temp_component_X_coolant_temp /end AXIS_DESCR
 /begin AXIS_DESCR COM_AXIS NO_INPUT_QUANTITY CM_u8_load_4mg_stroke 8 0 1020 AXIS_PTS_REF CAL_torque_engine_friction_temp_component_Y_load /end AXIS_DESCR
/end CHARACTERISTIC
/begin AXIS_PTS CAL_torque_spark_efficiency_X_rpm "X-axis breakpoints for the 'torque spark efficiency' table. Defines the lookup grid (not a live channel); change only when re-axing the map. (RPM; raw*125/4+500)" 0x4000C42A NO_INPUT_QUANTITY RL_AXIS_UBYTE 0 CM_u8_rspeed_125_4_500rpm 16 500 8468.75 /end AXIS_PTS
/begin AXIS_PTS CAL_torque_spark_efficiency_Y_ign_retard_from_mbt "Y-axis breakpoints for the 'torque spark efficiency' table. Defines the lookup grid (not a live channel); change only when re-axing the map. (deg; raw/4)" 0x4000C43A NO_INPUT_QUANTITY RL_AXIS_UBYTE 0 CM_u8_angle_1_4deg 16 0 63.75 /end AXIS_PTS
/begin CHARACTERISTIC CAL_torque_spark_efficiency "Calibration: torque spark efficiency. Tunable map/constant (not a live channel); log to follow the ECU torque estimate and any torque limiting. (0-1; raw/255)" MAP 0x4000C44A RL_VALUE_UBYTE 0 CM_u8_factor_1_255 0 100
 /begin AXIS_DESCR COM_AXIS NO_INPUT_QUANTITY CM_u8_rspeed_125_4_500rpm 16 500 8468.75 AXIS_PTS_REF CAL_torque_spark_efficiency_X_rpm /end AXIS_DESCR
 /begin AXIS_DESCR COM_AXIS NO_INPUT_QUANTITY CM_u8_angle_1_4deg 16 0 63.75 AXIS_PTS_REF CAL_torque_spark_efficiency_Y_ign_retard_from_mbt /end AXIS_DESCR
/end CHARACTERISTIC
/begin AXIS_PTS CAL_torque_spark_efficiency_slope_X_rpm "X-axis breakpoints for the 'torque spark efficiency slope' table. Defines the lookup grid (not a live channel); change only when re-axing the map. (RPM; raw*125/4+500)" 0x4000C54A NO_INPUT_QUANTITY RL_AXIS_UBYTE 0 CM_u8_rspeed_125_4_500rpm 16 500 8468.75 /end AXIS_PTS
/begin AXIS_PTS CAL_torque_spark_efficiency_slope_Y_load "Y-axis breakpoints for the 'torque spark efficiency slope' table. Defines the lookup grid (not a live channel); change only when re-axing the map. (mg/stroke; raw*4)" 0x4000C55A NO_INPUT_QUANTITY RL_AXIS_UBYTE 0 CM_u8_load_4mg_stroke 16 0 1020 /end AXIS_PTS
/begin CHARACTERISTIC CAL_torque_spark_efficiency_slope "Calibration: torque spark efficiency slope. Tunable map/constant (not a live channel); log to follow the ECU torque estimate and any torque limiting. ((raw-104)/26)" MAP 0x4000C56A RL_VALUE_UBYTE 0 CM_u8_gain__x_104_26 -4 5.80769230769231
 /begin AXIS_DESCR COM_AXIS NO_INPUT_QUANTITY CM_u8_rspeed_125_4_500rpm 16 500 8468.75 AXIS_PTS_REF CAL_torque_spark_efficiency_slope_X_rpm /end AXIS_DESCR
 /begin AXIS_DESCR COM_AXIS NO_INPUT_QUANTITY CM_u8_load_4mg_stroke 16 0 1020 AXIS_PTS_REF CAL_torque_spark_efficiency_slope_Y_load /end AXIS_DESCR
/end CHARACTERISTIC
/begin AXIS_PTS CAL_ign_mbt_modeled_X_rpm "X-axis breakpoints for the 'ignition MBT modeled' table. Defines the lookup grid (not a live channel); change only when re-axing the map. (RPM; raw*125/4+500)" 0x4000C66A NO_INPUT_QUANTITY RL_AXIS_UBYTE 0 CM_u8_rspeed_125_4_500rpm 16 500 8468.75 /end AXIS_PTS
/begin AXIS_PTS CAL_ign_mbt_modeled_Y_load "Y-axis breakpoints for the 'ignition MBT modeled' table. Defines the lookup grid (not a live channel); change only when re-axing the map. (mg/stroke; raw*4)" 0x4000C67A NO_INPUT_QUANTITY RL_AXIS_UBYTE 0 CM_u8_load_4mg_stroke 16 0 1020 /end AXIS_PTS
/begin CHARACTERISTIC CAL_ign_mbt_modeled "Calibration: ignition MBT modeled. Tunable map/constant (not a live channel); log spark advance to confirm the timing strategy and headroom to knock. (deg; raw/4-10)" MAP 0x4000C68A RL_VALUE_UBYTE 0 CM_u8_angle_1_4_10deg -10 53.75
 /begin AXIS_DESCR COM_AXIS NO_INPUT_QUANTITY CM_u8_rspeed_125_4_500rpm 16 500 8468.75 AXIS_PTS_REF CAL_ign_mbt_modeled_X_rpm /end AXIS_DESCR
 /begin AXIS_DESCR COM_AXIS NO_INPUT_QUANTITY CM_u8_load_4mg_stroke 16 0 1020 AXIS_PTS_REF CAL_ign_mbt_modeled_Y_load /end AXIS_DESCR
/end CHARACTERISTIC
/begin AXIS_PTS CAL_idle_air_base_ips_ingear_tour_X_rpm "u16_rspeed_rpm[16]" 0x4000C78A NO_INPUT_QUANTITY RL_AXIS_UWORD 0 CM_u8_rspeed_rpm 16 0 65535 /end AXIS_PTS
/begin CHARACTERISTIC CAL_idle_air_base_ips_ingear_tour "u16_flow_100/256mg/s[16]" CURVE 0x4000C7AA RL_VALUE_UWORD 0 CM_u16_flow_100_256mg_s 0 25599.609375
 /begin AXIS_DESCR COM_AXIS NO_INPUT_QUANTITY CM_u8_rspeed_rpm 16 0 65535 AXIS_PTS_REF CAL_idle_air_base_ips_ingear_tour_X_rpm /end AXIS_DESCR
/end CHARACTERISTIC
/begin AXIS_PTS CAL_ign_comp_coolant_ips_noflags_X_coolant_temp "X-axis breakpoints for the 'ignition compensation coolant IPS noflags' table. Defines the lookup grid (not a live channel); change only when re-axing the map. (deg C; raw*5/8-40)" 0x4000C7CA NO_INPUT_QUANTITY RL_AXIS_UBYTE 0 CM_u8_temp_5_8_40c 16 -40 119.375 /end AXIS_PTS
/begin CHARACTERISTIC CAL_ign_comp_coolant_ips_noflags "Calibration: ignition compensation coolant IPS noflags. Tunable map/constant (not a live channel); log spark advance to confirm the timing strategy and headroom to knock. (deg; raw/4)" CURVE 0x4000C7DA RL_VALUE_UBYTE 0 CM_u8_angle_1_4deg 0 63.75
 /begin AXIS_DESCR COM_AXIS NO_INPUT_QUANTITY CM_u8_temp_5_8_40c 16 -40 119.375 AXIS_PTS_REF CAL_ign_comp_coolant_ips_noflags_X_coolant_temp /end AXIS_DESCR
/end CHARACTERISTIC
/begin AXIS_PTS CAL_revlimit_speed_base_auto_gearbox_tour_X_coolant "X-axis breakpoints for the 'revlimit speed base auto gearbox tour' table. Defines the lookup grid (not a live channel); change only when re-axing the map. (deg C; raw*5/8-40)" 0x4000C7EA NO_INPUT_QUANTITY RL_AXIS_UBYTE 0 CM_u8_temp_5_8_40c 8 -40 119.375 /end AXIS_PTS
/begin AXIS_PTS CAL_revlimit_speed_base_auto_gearbox_tour_Y_timer "Y-axis breakpoints for the 'revlimit speed base auto gearbox tour' table. Defines the lookup grid (not a live channel); change only when re-axing the map. (ms; raw*100)" 0x4000C7F2 NO_INPUT_QUANTITY RL_AXIS_UBYTE 0 CM_u8_time_100ms 8 0 25500 /end AXIS_PTS
/begin CHARACTERISTIC CAL_revlimit_speed_base_auto_gearbox_tour "Calibration: revlimit speed base auto gearbox tour. Tunable map/constant (not a live channel); log to confirm where and how the rev limiter intervenes. (RPM; raw*10+6000)" MAP 0x4000C7FA RL_VALUE_UBYTE 0 CM_u8_rspeed_10_6000rpm 6000 8550
 /begin AXIS_DESCR COM_AXIS NO_INPUT_QUANTITY CM_u8_temp_5_8_40c 8 -40 119.375 AXIS_PTS_REF CAL_revlimit_speed_base_auto_gearbox_tour_X_coolant /end AXIS_DESCR
 /begin AXIS_DESCR COM_AXIS NO_INPUT_QUANTITY CM_u8_time_100ms 8 0 25500 AXIS_PTS_REF CAL_revlimit_speed_base_auto_gearbox_tour_Y_timer /end AXIS_DESCR
/end CHARACTERISTIC
/begin AXIS_PTS CAL_revlimit_speed_base_auto_gearbox_sport_X_coolant "X-axis breakpoints for the 'revlimit speed base auto gearbox sport' table. Defines the lookup grid (not a live channel); change only when re-axing the map. (deg C; raw*5/8-40)" 0x4000C83A NO_INPUT_QUANTITY RL_AXIS_UBYTE 0 CM_u8_temp_5_8_40c 8 -40 119.375 /end AXIS_PTS
/begin AXIS_PTS CAL_revlimit_speed_base_auto_gearbox_sport_Y_timer "Y-axis breakpoints for the 'revlimit speed base auto gearbox sport' table. Defines the lookup grid (not a live channel); change only when re-axing the map. (ms; raw*100)" 0x4000C842 NO_INPUT_QUANTITY RL_AXIS_UBYTE 0 CM_u8_time_100ms 8 0 25500 /end AXIS_PTS
/begin CHARACTERISTIC CAL_revlimit_speed_base_auto_gearbox_sport "Calibration: revlimit speed base auto gearbox sport. Tunable map/constant (not a live channel); log to confirm where and how the rev limiter intervenes. (RPM; raw*10+6000)" MAP 0x4000C84A RL_VALUE_UBYTE 0 CM_u8_rspeed_10_6000rpm 6000 8550
 /begin AXIS_DESCR COM_AXIS NO_INPUT_QUANTITY CM_u8_temp_5_8_40c 8 -40 119.375 AXIS_PTS_REF CAL_revlimit_speed_base_auto_gearbox_sport_X_coolant /end AXIS_DESCR
 /begin AXIS_DESCR COM_AXIS NO_INPUT_QUANTITY CM_u8_time_100ms 8 0 25500 AXIS_PTS_REF CAL_revlimit_speed_base_auto_gearbox_sport_Y_timer /end AXIS_DESCR
/end CHARACTERISTIC
/begin AXIS_PTS CAL_idle_comp_carspeed_ips_X_carspeed "X-axis breakpoints for the 'idle compensation carspeed IPS' table. Defines the lookup grid (not a live channel); change only when re-axing the map. (km/h)" 0x4000C88A NO_INPUT_QUANTITY RL_AXIS_UBYTE 0 CM_u8_speed_kph 8 0 255 /end AXIS_PTS
/begin CHARACTERISTIC CAL_idle_comp_carspeed_ips "Calibration: idle compensation carspeed IPS. Tunable map/constant (not a live channel); log to diagnose idle quality, hunting, and stalls. (RPM; raw*4)" CURVE 0x4000C892 RL_VALUE_UBYTE 0 CM_u8_rspeed_4rpm 0 1020
 /begin AXIS_DESCR COM_AXIS NO_INPUT_QUANTITY CM_u8_speed_kph 8 0 255 AXIS_PTS_REF CAL_idle_comp_carspeed_ips_X_carspeed /end AXIS_DESCR
/end CHARACTERISTIC
/begin AXIS_PTS CAL_idle_comp_car_speed_ips_X_carspeed "X-axis breakpoints for the 'idle compensation car speed IPS' table. Defines the lookup grid (not a live channel); change only when re-axing the map. (km/h)" 0x4000C89A NO_INPUT_QUANTITY RL_AXIS_UBYTE 0 CM_u8_speed_kph 8 0 255 /end AXIS_PTS
/begin CHARACTERISTIC CAL_idle_comp_car_speed_ips "Calibration: idle compensation car speed IPS. Tunable map/constant (not a live channel); log to diagnose idle quality, hunting, and stalls. (RPM)" CURVE 0x4000C8A2 RL_VALUE_UBYTE 0 CM_u8_flow_100mg_s 0 25500
 /begin AXIS_DESCR COM_AXIS NO_INPUT_QUANTITY CM_u8_speed_kph 8 0 255 AXIS_PTS_REF CAL_idle_comp_car_speed_ips_X_carspeed /end AXIS_DESCR
/end CHARACTERISTIC
/begin AXIS_PTS CAL_inj_bank_balance_X_rpm "X-axis breakpoints for the 'injector bank balance' table. Defines the lookup grid (not a live channel); change only when re-axing the map. (RPM; raw*125/4+500)" 0x4000C8AA NO_INPUT_QUANTITY RL_AXIS_UBYTE 0 CM_u8_rspeed_125_4_500rpm 32 500 8468.75 /end AXIS_PTS
/begin AXIS_PTS CAL_inj_bank_balance_Y_load "Y-axis breakpoints for the 'injector bank balance' table. Defines the lookup grid (not a live channel); change only when re-axing the map. (mg/stroke; raw*4)" 0x4000C8CA NO_INPUT_QUANTITY RL_AXIS_UBYTE 0 CM_u8_load_4mg_stroke 32 0 1020 /end AXIS_PTS
/begin CHARACTERISTIC CAL_inj_bank_balance "Calibration: injector bank balance. Tunable map/constant (not a live channel); log to verify injector pulse width and fuel delivery vs target. (0-1; raw/200)" MAP 0x4000C8EA RL_VALUE_UBYTE 0 CM_u8_factor_1_200 0 127.5
 /begin AXIS_DESCR COM_AXIS NO_INPUT_QUANTITY CM_u8_rspeed_125_4_500rpm 32 500 8468.75 AXIS_PTS_REF CAL_inj_bank_balance_X_rpm /end AXIS_DESCR
 /begin AXIS_DESCR COM_AXIS NO_INPUT_QUANTITY CM_u8_load_4mg_stroke 32 0 1020 AXIS_PTS_REF CAL_inj_bank_balance_Y_load /end AXIS_DESCR
/end CHARACTERISTIC
/begin AXIS_PTS CAL_load_map_estimate_intercept_X_load "X-axis (load, mg/stroke; raw*4) for the MAP-estimate intercept table. Stock axis is collapsed (all 68 except last), i.e. unused." 0x4000CCEA NO_INPUT_QUANTITY RL_AXIS_UBYTE 0 CM_u8_load_4mg_stroke 16 0 1020 /end AXIS_PTS
/begin AXIS_PTS CAL_load_map_estimate_intercept_Y_rpm "Y-axis (rpm; raw*125/4+500) for the MAP-estimate intercept table (table rows)." 0x4000CCFA NO_INPUT_QUANTITY RL_AXIS_UBYTE 0 CM_u8_rspeed_125_4_500rpm 16 500 8468.75 /end AXIS_PTS
/begin CHARACTERISTIC CAL_load_map_estimate_intercept "Estimated-MAP model intercept (mbar; raw*2). Rows = rpm (Y), cols = load (X); stock rows are constant across load, so effectively intercept vs rpm. Scaled by baro/1013 and added to the load/VE term: MAP_est = intercept*baro/1013 + load*R*T/(VE*Vd). N" MAP 0x4000CD0A RL_VALUE_UBYTE 0 CM_u8_pressure_2mbar 0 510
 /begin AXIS_DESCR COM_AXIS NO_INPUT_QUANTITY CM_u8_load_4mg_stroke 16 0 1020 AXIS_PTS_REF CAL_load_map_estimate_intercept_X_load /end AXIS_DESCR
 /begin AXIS_DESCR COM_AXIS NO_INPUT_QUANTITY CM_u8_rspeed_125_4_500rpm 16 500 8468.75 AXIS_PTS_REF CAL_load_map_estimate_intercept_Y_rpm /end AXIS_DESCR
/end CHARACTERISTIC
/begin AXIS_PTS CAL_idle_target_ips_ingear_sport_X_coolant_temp "X-axis breakpoints for the 'idle target IPS ingear sport' table. Defines the lookup grid (not a live channel); change only when re-axing the map. (deg C; raw*5/8-40)" 0x4000CE0A NO_INPUT_QUANTITY RL_AXIS_UBYTE 0 CM_u8_temp_5_8_40c 16 -40 119.375 /end AXIS_PTS
/begin CHARACTERISTIC CAL_idle_target_ips_ingear_sport "Calibration: idle target IPS ingear sport. Tunable map/constant (not a live channel); log to diagnose idle quality, hunting, and stalls. (RPM; raw*4+500)" CURVE 0x4000CE1A RL_VALUE_UBYTE 0 CM_u8_rspeed_4_500rpm 500 1520
 /begin AXIS_DESCR COM_AXIS NO_INPUT_QUANTITY CM_u8_temp_5_8_40c 16 -40 119.375 AXIS_PTS_REF CAL_idle_target_ips_ingear_sport_X_coolant_temp /end AXIS_DESCR
/end CHARACTERISTIC
/begin AXIS_PTS CAL_idle_target_ips_neutral_sport_X_coolant_temp "X-axis breakpoints for the 'idle target IPS neutral sport' table. Defines the lookup grid (not a live channel); change only when re-axing the map. (deg C; raw*5/8-40)" 0x4000CE2A NO_INPUT_QUANTITY RL_AXIS_UBYTE 0 CM_u8_temp_5_8_40c 16 -40 119.375 /end AXIS_PTS
/begin CHARACTERISTIC CAL_idle_target_ips_neutral_sport "Calibration: idle target IPS neutral sport. Tunable map/constant (not a live channel); log to diagnose idle quality, hunting, and stalls. (RPM; raw*4+500)" CURVE 0x4000CE3A RL_VALUE_UBYTE 0 CM_u8_rspeed_4_500rpm 500 1520
 /begin AXIS_DESCR COM_AXIS NO_INPUT_QUANTITY CM_u8_temp_5_8_40c 16 -40 119.375 AXIS_PTS_REF CAL_idle_target_ips_neutral_sport_X_coolant_temp /end AXIS_DESCR
/end CHARACTERISTIC
/begin AXIS_PTS CAL_cluster_shiftlight_rpm_offset_ips_X_gear "Calibration: cluster shiftlight RPM offset IPS. Tunable map/constant (not a live channel); log to check what the ECU sends the dash (gauges/warnings)." 0x4000CE4A NO_INPUT_QUANTITY RL_AXIS_UBYTE 0 NO_COMPU_METHOD 8 0 255 /end AXIS_PTS
/begin CHARACTERISTIC CAL_cluster_shiftlight_rpm_offset_ips "u8_rspeed_8rpm[8]" CURVE 0x4000CE52 RL_VALUE_UBYTE 0 CM_u8_rspeed_8rpm 0 2040
 /begin AXIS_DESCR COM_AXIS NO_INPUT_QUANTITY NO_COMPU_METHOD 8 0 255 AXIS_PTS_REF CAL_cluster_shiftlight_rpm_offset_ips_X_gear /end AXIS_DESCR
/end CHARACTERISTIC
/begin AXIS_PTS CAL_vvt_exhaust_advance_coolant_offset_X_coolant_temp "X-axis breakpoints for the 'VVT exhaust advance coolant offset' table. Defines the lookup grid (not a live channel); change only when re-axing the map. (deg C; raw*5/8-40)" 0x4000CE5A NO_INPUT_QUANTITY RL_AXIS_UBYTE 0 CM_u8_temp_5_8_40c 16 -40 119.375 /end AXIS_PTS
/begin CHARACTERISTIC CAL_vvt_exhaust_advance_coolant_offset "Calibration: VVT exhaust advance coolant offset. Tunable map/constant (not a live channel); log commanded vs actual cam timing to verify VVT response. (deg; raw/4)" CURVE 0x4000CE6A RL_VALUE_UBYTE 0 CM_u8_angle_1_4deg 0 63.75
 /begin AXIS_DESCR COM_AXIS NO_INPUT_QUANTITY CM_u8_temp_5_8_40c 16 -40 119.375 AXIS_PTS_REF CAL_vvt_exhaust_advance_coolant_offset_X_coolant_temp /end AXIS_DESCR
/end CHARACTERISTIC
/begin AXIS_PTS CAL_ign_comp_coolant_manual_cam_lowload_X_coolant_temp "X-axis breakpoints for the 'ignition compensation coolant manual VVT alt' table. Defines the lookup grid (not a live channel); change only when re-axing the map. (deg C; raw*5/8-40)" 0x4000CE82 NO_INPUT_QUANTITY RL_AXIS_UBYTE 0 CM_u8_temp_5_8_40c 16 -40 119.375 /end AXIS_PTS
/begin CHARACTERISTIC CAL_ign_comp_coolant_manual_cam_lowload "Calibration: ignition compensation coolant manual VVT alt. Tunable map/constant (not a live channel); log spark advance to confirm the timing strategy and headroom to knock. (deg; raw/4)" CURVE 0x4000CE92 RL_VALUE_UBYTE 0 CM_u8_angle_1_4deg 0 63.75
 /begin AXIS_DESCR COM_AXIS NO_INPUT_QUANTITY CM_u8_temp_5_8_40c 16 -40 119.375 AXIS_PTS_REF CAL_ign_comp_coolant_manual_cam_lowload_X_coolant_temp /end AXIS_DESCR
/end CHARACTERISTIC
/begin AXIS_PTS CAL_ign_comp_coolant_ips_flags_X_coolant_temp "X-axis breakpoints for the 'ignition compensation coolant IPS flags' table. Defines the lookup grid (not a live channel); change only when re-axing the map. (deg C; raw*5/8-40)" 0x4000CEA2 NO_INPUT_QUANTITY RL_AXIS_UBYTE 0 CM_u8_temp_5_8_40c 16 -40 119.375 /end AXIS_PTS
/begin CHARACTERISTIC CAL_ign_comp_coolant_ips_flags "Calibration: ignition compensation coolant IPS flags. Tunable map/constant (not a live channel); log spark advance to confirm the timing strategy and headroom to knock. (deg; raw/4)" CURVE 0x4000CEB2 RL_VALUE_UBYTE 0 CM_u8_angle_1_4deg 0 63.75
 /begin AXIS_DESCR COM_AXIS NO_INPUT_QUANTITY CM_u8_temp_5_8_40c 16 -40 119.375 AXIS_PTS_REF CAL_ign_comp_coolant_ips_flags_X_coolant_temp /end AXIS_DESCR
/end CHARACTERISTIC
/begin AXIS_PTS CAL_vvt_intake_advance_base_low_load_X_rpm "X-axis breakpoints for the 'VVT intake advance base low load' table. Defines the lookup grid (not a live channel); change only when re-axing the map. (RPM; raw*125/4+500)" 0x4000CEC2 NO_INPUT_QUANTITY RL_AXIS_UBYTE 0 CM_u8_rspeed_125_4_500rpm 6 500 8468.75 /end AXIS_PTS
/begin AXIS_PTS CAL_vvt_intake_advance_base_low_load_Y_load "Y-axis breakpoints for the 'VVT intake advance base low load' table. Defines the lookup grid (not a live channel); change only when re-axing the map. (mg/stroke; raw*4)" 0x4000CEC8 NO_INPUT_QUANTITY RL_AXIS_UBYTE 0 CM_u8_load_4mg_stroke 6 0 1020 /end AXIS_PTS
/begin CHARACTERISTIC CAL_vvt_intake_advance_base_low_load "Calibration: VVT intake advance base low load. Tunable map/constant (not a live channel); log commanded vs actual cam timing to verify VVT response. (deg; raw/4)" MAP 0x4000CECE RL_VALUE_UBYTE 0 CM_u8_angle_1_4deg 0 63.75
 /begin AXIS_DESCR COM_AXIS NO_INPUT_QUANTITY CM_u8_rspeed_125_4_500rpm 6 500 8468.75 AXIS_PTS_REF CAL_vvt_intake_advance_base_low_load_X_rpm /end AXIS_DESCR
 /begin AXIS_DESCR COM_AXIS NO_INPUT_QUANTITY CM_u8_load_4mg_stroke 6 0 1020 AXIS_PTS_REF CAL_vvt_intake_advance_base_low_load_Y_load /end AXIS_DESCR
/end CHARACTERISTIC
/begin AXIS_PTS CAL_idle_air_base_ips_neutral_tour_X_rpm "u16_rspeed_rpm[16]" 0x4000CEFA NO_INPUT_QUANTITY RL_AXIS_UWORD 0 CM_u8_rspeed_rpm 16 0 65535 /end AXIS_PTS
/begin CHARACTERISTIC CAL_idle_air_base_ips_neutral_tour "u16_flow_100/256mg/s[16]" CURVE 0x4000CF1A RL_VALUE_UWORD 0 CM_u16_flow_100_256mg_s 0 25599.609375
 /begin AXIS_DESCR COM_AXIS NO_INPUT_QUANTITY CM_u8_rspeed_rpm 16 0 65535 AXIS_PTS_REF CAL_idle_air_base_ips_neutral_tour_X_rpm /end AXIS_DESCR
/end CHARACTERISTIC
/begin AXIS_PTS CAL_vvt_exhaust_advance_base_low_load_X_rpm "X-axis breakpoints for the 'VVT exhaust advance base low load' table. Defines the lookup grid (not a live channel); change only when re-axing the map. (RPM; raw*125/4+500)" 0x4000CF3A NO_INPUT_QUANTITY RL_AXIS_UBYTE 0 CM_u8_rspeed_125_4_500rpm 6 500 8468.75 /end AXIS_PTS
/begin AXIS_PTS CAL_vvt_exhaust_advance_base_low_load_Y_load "Y-axis breakpoints for the 'VVT exhaust advance base low load' table. Defines the lookup grid (not a live channel); change only when re-axing the map. (mg/stroke; raw*4)" 0x4000CF40 NO_INPUT_QUANTITY RL_AXIS_UBYTE 0 CM_u8_load_4mg_stroke 6 0 1020 /end AXIS_PTS
/begin CHARACTERISTIC CAL_vvt_exhaust_advance_base_low_load "Calibration: VVT exhaust advance base low load. Tunable map/constant (not a live channel); log commanded vs actual cam timing to verify VVT response. (deg; raw/4)" MAP 0x4000CF46 RL_VALUE_UBYTE 0 CM_u8_angle_1_4deg 0 63.75
 /begin AXIS_DESCR COM_AXIS NO_INPUT_QUANTITY CM_u8_rspeed_125_4_500rpm 6 500 8468.75 AXIS_PTS_REF CAL_vvt_exhaust_advance_base_low_load_X_rpm /end AXIS_DESCR
 /begin AXIS_DESCR COM_AXIS NO_INPUT_QUANTITY CM_u8_load_4mg_stroke 6 0 1020 AXIS_PTS_REF CAL_vvt_exhaust_advance_base_low_load_Y_load /end AXIS_DESCR
/end CHARACTERISTIC
/begin AXIS_PTS CAL_idle_air_base_ips_neutral_sport_X_rpm "u16_rspeed_rpm[16]" 0x4000CF72 NO_INPUT_QUANTITY RL_AXIS_UWORD 0 CM_u8_rspeed_rpm 16 0 65535 /end AXIS_PTS
/begin CHARACTERISTIC CAL_idle_air_base_ips_neutral_sport "u16_flow_100/256mg/s[16]" CURVE 0x4000CF92 RL_VALUE_UWORD 0 CM_u16_flow_100_256mg_s 0 25599.609375
 /begin AXIS_DESCR COM_AXIS NO_INPUT_QUANTITY CM_u8_rspeed_rpm 16 0 65535 AXIS_PTS_REF CAL_idle_air_base_ips_neutral_sport_X_rpm /end AXIS_DESCR
/end CHARACTERISTIC
/begin AXIS_PTS CAL_ign_comp_startup_ips_X_coolant_temp_engine_stopped "X-axis breakpoints for the 'ignition compensation startup IPS' table. Defines the lookup grid (not a live channel); change only when re-axing the map. (deg C; raw*5/8-40)" 0x4000CFB2 NO_INPUT_QUANTITY RL_AXIS_UWORD 0 CM_u8_temp_5_8_40c 4 -40 40919.375 /end AXIS_PTS
/begin AXIS_PTS CAL_ign_comp_startup_ips_Y_maf_accumulated "Y-axis breakpoints for the 'ignition compensation startup IPS' table. Defines the lookup grid (not a live channel); change only when re-axing the map. (mg)" 0x4000CFBA NO_INPUT_QUANTITY RL_AXIS_UWORD 0 CM_u16_mass_mg 10 0 65535 /end AXIS_PTS
/begin CHARACTERISTIC CAL_ign_comp_startup_ips "Calibration: ignition compensation startup IPS. Tunable map/constant (not a live channel); log spark advance to confirm the timing strategy and headroom to knock. (deg; raw/4)" MAP 0x4000CFCE RL_VALUE_SWORD 0 CM_u8_angle_1_4deg -8192 8191.75
 /begin AXIS_DESCR COM_AXIS NO_INPUT_QUANTITY CM_u8_temp_5_8_40c 4 -40 40919.375 AXIS_PTS_REF CAL_ign_comp_startup_ips_X_coolant_temp_engine_stopped /end AXIS_DESCR
 /begin AXIS_DESCR COM_AXIS NO_INPUT_QUANTITY CM_u16_mass_mg 10 0 65535 AXIS_PTS_REF CAL_ign_comp_startup_ips_Y_maf_accumulated /end AXIS_DESCR
/end CHARACTERISTIC
/begin AXIS_PTS CAL_revlimit_trim_per_gear_X_gear "X-axis breakpoints for the 'revlimit trim per gear' table. Defines the lookup grid (not a live channel); change only when re-axing the map." 0x4000D01E NO_INPUT_QUANTITY RL_AXIS_UBYTE 0 NO_COMPU_METHOD 7 0 255 /end AXIS_PTS
/begin CHARACTERISTIC CAL_revlimit_trim_per_gear "Calibration: revlimit trim per gear. Tunable map/constant (not a live channel); log to confirm where and how the rev limiter intervenes. (RPM; raw*2)" CURVE 0x4000D025 RL_VALUE_UBYTE 0 CM_u8_rspeed_2rpm 0 510
 /begin AXIS_DESCR COM_AXIS NO_INPUT_QUANTITY NO_COMPU_METHOD 7 0 255 AXIS_PTS_REF CAL_revlimit_trim_per_gear_X_gear /end AXIS_DESCR
/end CHARACTERISTIC
/begin AXIS_PTS CAL_revlimit_maf_max_by_gear_X_gear "X-axis breakpoints for the 'revlimit max MAF by gear' table. Defines the lookup grid (not a live channel); change only when re-axing the map." 0x4000D02C NO_INPUT_QUANTITY RL_AXIS_UBYTE 0 NO_COMPU_METHOD 7 0 255 /end AXIS_PTS
/begin CHARACTERISTIC CAL_revlimit_maf_max_by_gear "Calibration: revlimit max MAF by gear. Tunable map/constant (not a live channel); log to confirm where and how the rev limiter intervenes. (g/s; raw*2)" CURVE 0x4000D033 RL_VALUE_UBYTE 0 CM_u8_flow_2g_s 0 510
 /begin AXIS_DESCR COM_AXIS NO_INPUT_QUANTITY NO_COMPU_METHOD 7 0 255 AXIS_PTS_REF CAL_revlimit_maf_max_by_gear_X_gear /end AXIS_DESCR
/end CHARACTERISTIC
/begin AXIS_PTS CAL_ecu_engine_speed_target_tour_X_pps "X-axis breakpoints for the 'ECU engine speed target tour' table. Defines the lookup grid (not a live channel); change only when re-axing the map." 0x4000D03A NO_INPUT_QUANTITY RL_AXIS_UWORD 0 CM_u16_factor_1_1023 10 0 6406.15835777126 /end AXIS_PTS
/begin CHARACTERISTIC CAL_ecu_engine_speed_target_tour "Calibration: ECU engine speed target tour. Tunable map/constant (not a live channel); mostly housekeeping/diagnostic state." CURVE 0x4000D04E RL_VALUE_UWORD 0 CM_u16_rspeed_1_4rpm 0 16383.75
 /begin AXIS_DESCR COM_AXIS NO_INPUT_QUANTITY CM_u16_factor_1_1023 10 0 6406.15835777126 AXIS_PTS_REF CAL_ecu_engine_speed_target_tour_X_pps /end AXIS_DESCR
/end CHARACTERISTIC
/begin AXIS_PTS CAL_idle_air_base_ips_ingear_sport_X_rpm "u16_rspeed_rpm[16]" 0x4000D062 NO_INPUT_QUANTITY RL_AXIS_UWORD 0 CM_u8_rspeed_rpm 16 0 65535 /end AXIS_PTS
/begin CHARACTERISTIC CAL_idle_air_base_ips_ingear_sport "u16_flow_100/256mg/s[16]" CURVE 0x4000D082 RL_VALUE_UWORD 0 CM_u16_flow_100_256mg_s 0 25599.609375
 /begin AXIS_DESCR COM_AXIS NO_INPUT_QUANTITY CM_u8_rspeed_rpm 16 0 65535 AXIS_PTS_REF CAL_idle_air_base_ips_ingear_sport_X_rpm /end AXIS_DESCR
/end CHARACTERISTIC
/begin AXIS_PTS CAL_dca_tps_limit_manual_X_time "X-axis breakpoints for the 'Drive-Cycle-Assist throttle position limit manual' table. Defines the lookup grid (not a live channel); change only when re-axing the map." 0x4000D0A2 NO_INPUT_QUANTITY RL_AXIS_UBYTE 0 NO_COMPU_METHOD 8 0 255 /end AXIS_PTS
/begin CHARACTERISTIC CAL_dca_tps_limit_manual "Calibration: Drive-Cycle-Assist throttle position limit manual. Tunable map/constant (not a live channel); log to see throttle/pedal demand and throttle response." CURVE 0x4000D0AA RL_VALUE_UBYTE 0 NO_COMPU_METHOD 0 255
 /begin AXIS_DESCR COM_AXIS NO_INPUT_QUANTITY NO_COMPU_METHOD 8 0 255 AXIS_PTS_REF CAL_dca_tps_limit_manual_X_time /end AXIS_DESCR
/end CHARACTERISTIC
/begin AXIS_PTS CAL_dca_tps_limit_ips_X_time "X-axis breakpoints for the 'Drive-Cycle-Assist throttle position limit IPS' table. Defines the lookup grid (not a live channel); change only when re-axing the map." 0x4000D0B2 NO_INPUT_QUANTITY RL_AXIS_UBYTE 0 NO_COMPU_METHOD 8 0 255 /end AXIS_PTS
/begin CHARACTERISTIC CAL_dca_tps_limit_ips "Calibration: Drive-Cycle-Assist throttle position limit IPS. Tunable map/constant (not a live channel); log to see throttle/pedal demand and throttle response." CURVE 0x4000D0BA RL_VALUE_UBYTE 0 NO_COMPU_METHOD 0 255
 /begin AXIS_DESCR COM_AXIS NO_INPUT_QUANTITY NO_COMPU_METHOD 8 0 255 AXIS_PTS_REF CAL_dca_tps_limit_ips_X_time /end AXIS_DESCR
/end CHARACTERISTIC
/begin AXIS_PTS CAL_idle_air_comp_misfire_X_cyl_count "uint8_t[8]" 0x4000D0C2 NO_INPUT_QUANTITY RL_AXIS_UBYTE 0 NO_COMPU_METHOD 8 0 255 /end AXIS_PTS
/begin CHARACTERISTIC CAL_idle_air_comp_misfire "u8_flow_100mg/s[8]" CURVE 0x4000D0CA RL_VALUE_UBYTE 0 CM_u8_flow_100mg_s 0 25500
 /begin AXIS_DESCR COM_AXIS NO_INPUT_QUANTITY NO_COMPU_METHOD 8 0 255 AXIS_PTS_REF CAL_idle_air_comp_misfire_X_cyl_count /end AXIS_DESCR
/end CHARACTERISTIC
/begin AXIS_PTS CAL_dca_tps_limit_ips2_X_time "X-axis breakpoints for the 'Drive-Cycle-Assist throttle position limit ips2' table. Defines the lookup grid (not a live channel); change only when re-axing the map." 0x4000D0D2 NO_INPUT_QUANTITY RL_AXIS_UBYTE 0 NO_COMPU_METHOD 8 0 255 /end AXIS_PTS
/begin CHARACTERISTIC CAL_dca_tps_limit_ips2 "Calibration: Drive-Cycle-Assist throttle position limit ips2. Tunable map/constant (not a live channel); log to see throttle/pedal demand and throttle response." CURVE 0x4000D0DA RL_VALUE_UBYTE 0 NO_COMPU_METHOD 0 255
 /begin AXIS_DESCR COM_AXIS NO_INPUT_QUANTITY NO_COMPU_METHOD 8 0 255 AXIS_PTS_REF CAL_dca_tps_limit_ips2_X_time /end AXIS_DESCR
/end CHARACTERISTIC
/begin AXIS_PTS CAL_tpstarget_tour_shifting_X_pps "X-axis breakpoints for the 'tpstarget tour shifting' table. Defines the lookup grid (not a live channel); change only when re-axing the map. (0-1; raw/1023)" 0x4000D0E2 NO_INPUT_QUANTITY RL_AXIS_UWORD 0 CM_u16_factor_1_1023 16 0 6406.15835777126 /end AXIS_PTS
/begin CHARACTERISTIC CAL_tpstarget_tour_shifting "Calibration: tpstarget tour shifting. Tunable map/constant (not a live channel); log to compare requested throttle target to pedal demand. (0-1; raw/1023)" CURVE 0x4000D102 RL_VALUE_UWORD 0 CM_u16_factor_1_1023 0 6406.15835777126
 /begin AXIS_DESCR COM_AXIS NO_INPUT_QUANTITY CM_u16_factor_1_1023 16 0 6406.15835777126 AXIS_PTS_REF CAL_tpstarget_tour_shifting_X_pps /end AXIS_DESCR
/end CHARACTERISTIC
/begin AXIS_PTS CAL_tpstarget_sport_shifting_X_pps "X-axis breakpoints for the 'tpstarget sport shifting' table. Defines the lookup grid (not a live channel); change only when re-axing the map. (0-1; raw/1023)" 0x4000D122 NO_INPUT_QUANTITY RL_AXIS_UWORD 0 CM_u16_factor_1_1023 16 0 6406.15835777126 /end AXIS_PTS
/begin CHARACTERISTIC CAL_tpstarget_sport_shifting "Calibration: tpstarget sport shifting. Tunable map/constant (not a live channel); log to compare requested throttle target to pedal demand. (0-1; raw/1023)" CURVE 0x4000D142 RL_VALUE_UWORD 0 CM_u16_factor_1_1023 0 6406.15835777126
 /begin AXIS_DESCR COM_AXIS NO_INPUT_QUANTITY CM_u16_factor_1_1023 16 0 6406.15835777126 AXIS_PTS_REF CAL_tpstarget_sport_shifting_X_pps /end AXIS_DESCR
/end CHARACTERISTIC
/begin AXIS_PTS CAL_revlimit_p_flow_gain_X_gear "X-axis breakpoints for the 'revlimit p flow gain' table. Defines the lookup grid (not a live channel); change only when re-axing the map." 0x4000D162 NO_INPUT_QUANTITY RL_AXIS_UBYTE 0 NO_COMPU_METHOD 7 0 255 /end AXIS_PTS
/begin CHARACTERISTIC CAL_revlimit_p_flow_gain "Calibration: revlimit p flow gain. Tunable map/constant (not a live channel); log to confirm where and how the rev limiter intervenes. (0-1; raw/255)" CURVE 0x4000D169 RL_VALUE_UBYTE 0 CM_u8_factor_1_255 0 100
 /begin AXIS_DESCR COM_AXIS NO_INPUT_QUANTITY NO_COMPU_METHOD 7 0 255 AXIS_PTS_REF CAL_revlimit_p_flow_gain_X_gear /end AXIS_DESCR
/end CHARACTERISTIC
/begin AXIS_PTS CAL_revlimit_i_flow_gain_X_gear "X-axis breakpoints for the 'revlimit i flow gain' table. Defines the lookup grid (not a live channel); change only when re-axing the map." 0x4000D170 NO_INPUT_QUANTITY RL_AXIS_UBYTE 0 NO_COMPU_METHOD 7 0 255 /end AXIS_PTS
/begin CHARACTERISTIC CAL_revlimit_i_flow_gain "Calibration: revlimit i flow gain. Tunable map/constant (not a live channel); log to confirm where and how the rev limiter intervenes. (0-1; raw/255)" CURVE 0x4000D177 RL_VALUE_UBYTE 0 CM_u8_factor_1_255 0 100
 /begin AXIS_DESCR COM_AXIS NO_INPUT_QUANTITY NO_COMPU_METHOD 7 0 255 AXIS_PTS_REF CAL_revlimit_i_flow_gain_X_gear /end AXIS_DESCR
/end CHARACTERISTIC
/begin AXIS_PTS CAL_revlimit_d_flow_gain_X_gear "X-axis breakpoints for the 'revlimit d flow gain' table. Defines the lookup grid (not a live channel); change only when re-axing the map." 0x4000D17E NO_INPUT_QUANTITY RL_AXIS_UBYTE 0 NO_COMPU_METHOD 7 0 255 /end AXIS_PTS
/begin CHARACTERISTIC CAL_revlimit_d_flow_gain "Calibration: revlimit d flow gain. Tunable map/constant (not a live channel); log to confirm where and how the rev limiter intervenes. (0-1; raw/255)" CURVE 0x4000D185 RL_VALUE_UBYTE 0 CM_u8_factor_1_255 0 100
 /begin AXIS_DESCR COM_AXIS NO_INPUT_QUANTITY NO_COMPU_METHOD 7 0 255 AXIS_PTS_REF CAL_revlimit_d_flow_gain_X_gear /end AXIS_DESCR
/end CHARACTERISTIC
/begin CHARACTERISTIC CAL_obd_ii_warmup_temp_unknown "u8_temp_5/8-40c" VALUE 0x4000D194 RL_VALUE_UBYTE 0 CM_u8_temp_5_8_40c -40 119.375 /end CHARACTERISTIC
/begin CHARACTERISTIC CAL_obd_ii_coolant_warmup_threshold_unknown "uint8_t" VALUE 0x4000D195 RL_VALUE_UBYTE 0 NO_COMPU_METHOD 0 255 /end CHARACTERISTIC
/begin CHARACTERISTIC CAL_obd_ii_coolant_warmup_thresholds "uint8_t" VALUE 0x4000D196 RL_VALUE_UBYTE 0 NO_COMPU_METHOD 0 255 /end CHARACTERISTIC
/begin CHARACTERISTIC CAL_obd_ii_similar_cond_load_window "uchar" VALUE 0x4000D197 RL_VALUE_UBYTE 0 NO_COMPU_METHOD 0 255 /end CHARACTERISTIC
/begin CHARACTERISTIC CAL_obd_ii_similar_cond_load_tol "undefined1" VALUE 0x4000D198 RL_VALUE_UBYTE 0 NO_COMPU_METHOD 0 255 /end CHARACTERISTIC
/begin CHARACTERISTIC CAL_obd_ii_cat_monitor_maf_min "uchar" VALUE 0x4000D199 RL_VALUE_UBYTE 0 NO_COMPU_METHOD 0 255 /end CHARACTERISTIC
/begin CHARACTERISTIC CAL_obd_ii_similar_cond_rpm_tol "undefined2" VALUE 0x4000D19A RL_VALUE_UWORD 0 NO_COMPU_METHOD 0 65535 /end CHARACTERISTIC
/begin CHARACTERISTIC CAL_obd_ii_similar_cond_debounce_reload "u16_time_5ms" VALUE 0x4000D19C RL_VALUE_UWORD 0 CM_u8_time_5ms 0 327675 /end CHARACTERISTIC
/begin CHARACTERISTIC CAL_obd_ii_o2_lean_period_excess_max "ushort" VALUE 0x4000D19E RL_VALUE_UWORD 0 NO_COMPU_METHOD 0 65535 /end CHARACTERISTIC
/begin CHARACTERISTIC CAL_obd_ii_o2_rich_period_excess_max "ushort" VALUE 0x4000D1A0 RL_VALUE_UWORD 0 NO_COMPU_METHOD 0 65535 /end CHARACTERISTIC
/begin CHARACTERISTIC CAL_misfire_inhibit_tps_rate_declutched "u8_factor_1/1023" VALUE 0x4000D1A2 RL_VALUE_UBYTE 0 CM_u16_factor_1_1023 0 24.9266862170088 /end CHARACTERISTIC
/begin CHARACTERISTIC CAL_misfire_inhibit_tps_rate_pos "u8_factor_1/1023" VALUE 0x4000D1A3 RL_VALUE_UBYTE 0 CM_u16_factor_1_1023 0 24.9266862170088 /end CHARACTERISTIC
/begin CHARACTERISTIC CAL_misfire_inhibit_tps_rate_neg "u8_factor_1/1023" VALUE 0x4000D1A4 RL_VALUE_UBYTE 0 CM_u16_factor_1_1023 0 24.9266862170088 /end CHARACTERISTIC
/begin CHARACTERISTIC CAL_cluster_overtemp_warning_light "Calibration: cluster overtemp warning light. Tunable map/constant (not a live channel); log to check what the ECU sends the dash (gauges/warnings). (deg C; raw*5/8-40)" VALUE 0x4000D1A8 RL_VALUE_UBYTE 0 CM_u8_temp_5_8_40c -40 119.375 /end CHARACTERISTIC
/begin CHARACTERISTIC CAL_obd_ii_unknown7 "uint8_t" VALUE 0x4000D1A9 RL_VALUE_UBYTE 0 NO_COMPU_METHOD 0 255 /end CHARACTERISTIC
/begin CHARACTERISTIC CAL_obd_ii_adc_maf_unknown1 "u16_voltage_5/1023v" VALUE 0x4000D1AA RL_VALUE_UWORD 0 CM_u16_voltage_5_1023v 0 320.307917888563 /end CHARACTERISTIC
/begin CHARACTERISTIC CAL_obd_ii_monitor_debounce_cycles "uint16_t" VALUE 0x4000D1AC RL_VALUE_UWORD 0 NO_COMPU_METHOD 0 65535 /end CHARACTERISTIC
/begin CHARACTERISTIC CAL_obd_ii_brake_pedal_conflict_count "uchar" VALUE 0x4000D1AE RL_VALUE_UBYTE 0 NO_COMPU_METHOD 0 255 /end CHARACTERISTIC
/begin CHARACTERISTIC CAL_obd_ii_P0116_coolant_deviation_max "uchar" VALUE 0x4000D1AF RL_VALUE_UBYTE 0 NO_COMPU_METHOD 0 255 /end CHARACTERISTIC
/begin CHARACTERISTIC CAL_obd_ii_P0571_brake_check_min_speed "u8_speed_kph" VALUE 0x4000D1B0 RL_VALUE_UBYTE 0 CM_u8_speed_kph 0 255 /end CHARACTERISTIC
/begin CHARACTERISTIC CAL_evap_pressure_filter_coeff "uchar" VALUE 0x4000D1B1 RL_VALUE_UBYTE 0 NO_COMPU_METHOD 0 255 /end CHARACTERISTIC
/begin CHARACTERISTIC CAL_evap_vacuum_threshold "uint8_t" VALUE 0x4000D1B3 RL_VALUE_UBYTE 0 NO_COMPU_METHOD 0 255 /end CHARACTERISTIC
/begin CHARACTERISTIC CAL_evap_purge_stuck_open_test_passes "uchar" VALUE 0x4000D1B4 RL_VALUE_UBYTE 0 NO_COMPU_METHOD 0 255 /end CHARACTERISTIC
/begin CHARACTERISTIC CAL_misfire_per_cyl_learn_enable "bool" VALUE 0x4000D1B5 RL_VALUE_UBYTE 0 NO_COMPU_METHOD 0 255 /end CHARACTERISTIC
/begin CHARACTERISTIC CAL_obd_ii_o2_sensor1_voltage_threshold "ushort" VALUE 0x4000D1B6 RL_VALUE_UWORD 0 NO_COMPU_METHOD 0 65535 /end CHARACTERISTIC
/begin CHARACTERISTIC CAL_obd_ii_o2_sensor1_voltage_limit "ushort" VALUE 0x4000D1B8 RL_VALUE_UWORD 0 NO_COMPU_METHOD 0 65535 /end CHARACTERISTIC
/begin CHARACTERISTIC CAL_obd_ii_o2_sensor2_voltage_threshold "ushort" VALUE 0x4000D1BA RL_VALUE_UWORD 0 NO_COMPU_METHOD 0 65535 /end CHARACTERISTIC
/begin CHARACTERISTIC CAL_obd_ii_o2_sensor2_voltage_limit "ushort" VALUE 0x4000D1BC RL_VALUE_UWORD 0 NO_COMPU_METHOD 0 65535 /end CHARACTERISTIC
/begin CHARACTERISTIC CAL_sensor_iat_voltage_threshold "u16_voltage_5/1023v" VALUE 0x4000D1BE RL_VALUE_UWORD 0 CM_u16_voltage_5_1023v 0 320.307917888563 /end CHARACTERISTIC
/begin CHARACTERISTIC CAL_sensor_adc_engine_air_threshold "ushort" VALUE 0x4000D1C0 RL_VALUE_UWORD 0 NO_COMPU_METHOD 0 65535 /end CHARACTERISTIC
/begin CHARACTERISTIC CAL_obd_ii_cat_monitor_baro_min "u16_pressure_mbar" VALUE 0x4000D1C2 RL_VALUE_UWORD 0 CM_i16_pressure_mbar 0 65535 /end CHARACTERISTIC
/begin CHARACTERISTIC CAL_obd_ii_cat_monitor_ect_min "u8_temp_5/8-40c" VALUE 0x4000D1C4 RL_VALUE_UBYTE 0 CM_u8_temp_5_8_40c -40 119.375 /end CHARACTERISTIC
/begin CHARACTERISTIC CAL_obd_ii_P0420_maf_min "u16_flow_10mg/s" VALUE 0x4000D1C6 RL_VALUE_UWORD 0 CM_u16_flow_10mg_s 0 655350 /end CHARACTERISTIC
/begin CHARACTERISTIC CAL_obd_ii_P0420_maf_max "u16_flow_10mg/s" VALUE 0x4000D1C8 RL_VALUE_UWORD 0 CM_u16_flow_10mg_s 0 655350 /end CHARACTERISTIC
/begin CHARACTERISTIC CAL_obd_ii_postcat_o2_voltage_bias "Calibration: OBD postcat O2 voltage bias. Tunable map/constant (not a live channel); adjust to change this behavior." VALUE 0x4000D1CA RL_VALUE_UBYTE 0 NO_COMPU_METHOD 0 255 /end CHARACTERISTIC
/begin CHARACTERISTIC CAL_obd_ii_cat_mon_post_dfco_holdoff_prescaler "uint8_t" VALUE 0x4000D1CB RL_VALUE_UBYTE 0 NO_COMPU_METHOD 0 255 /end CHARACTERISTIC
/begin CHARACTERISTIC CAL_obd_ii_o2_flatline_band "uint8_t" VALUE 0x4000D1CC RL_VALUE_UBYTE 0 NO_COMPU_METHOD 0 255 /end CHARACTERISTIC
/begin CHARACTERISTIC CAL_obd_ii_o2_activity_rate_inband "uchar" VALUE 0x4000D1CD RL_VALUE_UBYTE 0 NO_COMPU_METHOD 0 255 /end CHARACTERISTIC
/begin CHARACTERISTIC CAL_obd_ii_P0420_car_speed_max "u8_speed_kph" VALUE 0x4000D1CE RL_VALUE_UBYTE 0 CM_u8_speed_kph 0 255 /end CHARACTERISTIC
/begin CHARACTERISTIC CAL_obd_ii_P0420_car_speed_min "u8_speed_kph" VALUE 0x4000D1CF RL_VALUE_UBYTE 0 CM_u8_speed_kph 0 255 /end CHARACTERISTIC
/begin CHARACTERISTIC CAL_sensor_adc_baro_limit "u16_voltage_5/1023v" VALUE 0x4000D1D0 RL_VALUE_UWORD 0 CM_u16_voltage_5_1023v 0 320.307917888563 /end CHARACTERISTIC
/begin CHARACTERISTIC CAL_sensor_adc_baro_threshold "u16_voltage_5/1023v" VALUE 0x4000D1D2 RL_VALUE_UWORD 0 CM_u16_voltage_5_1023v 0 320.307917888563 /end CHARACTERISTIC
/begin CHARACTERISTIC CAL_sensor_coolant_voltage_threshold "u16_voltage_5/1023v" VALUE 0x4000D1D4 RL_VALUE_UWORD 0 CM_u16_voltage_5_1023v 0 320.307917888563 /end CHARACTERISTIC
/begin CHARACTERISTIC CAL_obd_ii_P0117_coolant_voltage_low "u16_voltage_5/1023v" VALUE 0x4000D1D6 RL_VALUE_UWORD 0 CM_u16_voltage_5_1023v 0 320.307917888563 /end CHARACTERISTIC
/begin CHARACTERISTIC CAL_revlimit_limp_mode_rpm_reduction "Calibration: revlimit limp mode offset. Tunable map/constant (not a live channel); log to confirm where and how the rev limiter intervenes. (RPM)" VALUE 0x4000D1D8 RL_VALUE_UWORD 0 CM_u8_rspeed_rpm 0 65535 /end CHARACTERISTIC
/begin CHARACTERISTIC CAL_obd_ii_o2_slow_response_arm_dwell "u16_time_5ms" VALUE 0x4000D1DA RL_VALUE_UWORD 0 CM_u8_time_5ms 0 327675 /end CHARACTERISTIC
/begin CHARACTERISTIC CAL_ecu_system_voltage_threshold "uint16_t" VALUE 0x4000D1DC RL_VALUE_UWORD 0 NO_COMPU_METHOD 0 65535 /end CHARACTERISTIC
/begin CHARACTERISTIC CAL_sensor_adc_ecu_voltage_threshold "ushort" VALUE 0x4000D1DE RL_VALUE_UWORD 0 NO_COMPU_METHOD 0 65535 /end CHARACTERISTIC
/begin CHARACTERISTIC CAL_obd_ii_P0562_sample_count "uchar" VALUE 0x4000D1E0 RL_VALUE_UBYTE 0 NO_COMPU_METHOD 0 255 /end CHARACTERISTIC
/begin CHARACTERISTIC CAL_obd_ii_P0563_sample_count "uchar" VALUE 0x4000D1E1 RL_VALUE_UBYTE 0 NO_COMPU_METHOD 0 255 /end CHARACTERISTIC
/begin CHARACTERISTIC CAL_sensor_baro_sensor_failure_fallback "uint8_t" VALUE 0x4000D1E2 RL_VALUE_UBYTE 0 NO_COMPU_METHOD 0 255 /end CHARACTERISTIC
/begin CHARACTERISTIC CAL_obd_ii_P0128_iat_min "u8_temp_5/8-40c" VALUE 0x4000D1E3 RL_VALUE_UBYTE 0 CM_u8_temp_5_8_40c -40 119.375 /end CHARACTERISTIC
/begin CHARACTERISTIC CAL_sensor_atmo_pressure_default "Calibration: sensor atmo pressure default. Tunable map/constant (not a live channel); log the raw sensor signal to check sensor health and range. (mbar)" VALUE 0x4000D1E4 RL_VALUE_UWORD 0 CM_i16_pressure_mbar 0 65535 /end CHARACTERISTIC
/begin CHARACTERISTIC CAL_obd_ii_cat_precat_o2_lean_thresh "u16_voltage_5/1023v" VALUE 0x4000D1E6 RL_VALUE_UWORD 0 CM_u16_voltage_5_1023v 0 320.307917888563 /end CHARACTERISTIC
/begin CHARACTERISTIC CAL_obd_ii_cat_precat_o2_rich_thresh "u16_voltage_5/1023v" VALUE 0x4000D1E8 RL_VALUE_UWORD 0 CM_u16_voltage_5_1023v 0 320.307917888563 /end CHARACTERISTIC
/begin CHARACTERISTIC CAL_obd_ii_cat_postcat_o2_lean_offset "ushort" VALUE 0x4000D1EA RL_VALUE_UWORD 0 NO_COMPU_METHOD 0 65535 /end CHARACTERISTIC
/begin CHARACTERISTIC CAL_obd_ii_cat_postcat_o2_rich_offset "u16_voltage_5/1023v" VALUE 0x4000D1EC RL_VALUE_UWORD 0 CM_u16_voltage_5_1023v 0 320.307917888563 /end CHARACTERISTIC
/begin CHARACTERISTIC CAL_obd_ii_cat_efficiency_ratio_max "ushort" VALUE 0x4000D1EE RL_VALUE_UWORD 0 NO_COMPU_METHOD 0 65535 /end CHARACTERISTIC
/begin CHARACTERISTIC CAL_obd_ii_vvt_exhaust_error_bank1_limit "ushort" VALUE 0x4000D1F0 RL_VALUE_UWORD 0 NO_COMPU_METHOD 0 65535 /end CHARACTERISTIC
/begin CHARACTERISTIC CAL_obd_P0171_ltft_limit "i16_percent_1/10" VALUE 0x4000D1F2 RL_VALUE_SWORD 0 CM_i16_percent_1_10 -3276.8 3276.7 /end CHARACTERISTIC
/begin CHARACTERISTIC CAL_obd_P0172_ltft_limit "i16_percent_1/10" VALUE 0x4000D1F4 RL_VALUE_SWORD 0 CM_i16_percent_1_10 -3276.8 3276.7 /end CHARACTERISTIC
/begin CHARACTERISTIC CAL_obd_ii_o2_response_car_speed_min "u8_speed_kph" VALUE 0x4000D1F6 RL_VALUE_UBYTE 0 CM_u8_speed_kph 0 255 /end CHARACTERISTIC
/begin CHARACTERISTIC CAL_obd_ii_o2_response_car_speed_max "u8_speed_kph" VALUE 0x4000D1F7 RL_VALUE_UBYTE 0 CM_u8_speed_kph 0 255 /end CHARACTERISTIC
/begin CHARACTERISTIC CAL_obd_ii_o2_transition_count "uchar" VALUE 0x4000D1F8 RL_VALUE_UBYTE 0 NO_COMPU_METHOD 0 255 /end CHARACTERISTIC
/begin CHARACTERISTIC CAL_obd_ii_mode06_o2_switch_time_min "ushort" VALUE 0x4000D1FA RL_VALUE_UWORD 0 NO_COMPU_METHOD 0 65535 /end CHARACTERISTIC
/begin CHARACTERISTIC CAL_obd_ii_mode06_o2_switch_time_max "ushort" VALUE 0x4000D1FC RL_VALUE_UWORD 0 NO_COMPU_METHOD 0 65535 /end CHARACTERISTIC
/begin CHARACTERISTIC CAL_obd_ii_P0111_mass_air_min "uchar" VALUE 0x4000D1FE RL_VALUE_UBYTE 0 NO_COMPU_METHOD 0 255 /end CHARACTERISTIC
/begin CHARACTERISTIC CAL_misfire_enable_coolant_min "u8_temp_5/8-40c" VALUE 0x4000D200 RL_VALUE_UBYTE 0 CM_u8_temp_5_8_40c -40 119.375 /end CHARACTERISTIC
/begin CHARACTERISTIC CAL_misfire_enable_coolant_max "u8_temp_5/8-40c" VALUE 0x4000D201 RL_VALUE_UBYTE 0 CM_u8_temp_5_8_40c -40 119.375 /end CHARACTERISTIC
/begin CHARACTERISTIC CAL_tpms_low_pressure_18_19 "u8_pressure_100mbar" VALUE 0x4000D202 RL_VALUE_UBYTE 0 CM_u8_pressure_100mbar 0 25500 /end CHARACTERISTIC
/begin CHARACTERISTIC CAL_tpms_low_warn_offset_18_19 "u8_pressure_100mbar" VALUE 0x4000D203 RL_VALUE_UBYTE 0 CM_u8_pressure_100mbar 0 25500 /end CHARACTERISTIC
/begin CHARACTERISTIC CAL_tpms_low_pressure_19_20 "u8_pressure_100mbar" VALUE 0x4000D204 RL_VALUE_UBYTE 0 CM_u8_pressure_100mbar 0 25500 /end CHARACTERISTIC
/begin CHARACTERISTIC CAL_tpms_low_warn_offset_19_20 "u8_pressure_100mbar" VALUE 0x4000D205 RL_VALUE_UBYTE 0 CM_u8_pressure_100mbar 0 25500 /end CHARACTERISTIC
/begin CHARACTERISTIC CAL_misfire_enable_rpm_min "u8_rspeed_125/4+500rpm" VALUE 0x4000D206 RL_VALUE_UBYTE 0 CM_u8_rspeed_125_4_500rpm 500 8468.75 /end CHARACTERISTIC
/begin CHARACTERISTIC CAL_misfire_enable_rpm_max "u8_rspeed_125/4+500rpm" VALUE 0x4000D207 RL_VALUE_UBYTE 0 CM_u8_rspeed_125_4_500rpm 500 8468.75 /end CHARACTERISTIC
/begin CHARACTERISTIC CAL_obd_ii_P0500_test_time "ushort" VALUE 0x4000D208 RL_VALUE_UWORD 0 NO_COMPU_METHOD 0 65535 /end CHARACTERISTIC
/begin CHARACTERISTIC CAL_misfire_failed_bank_scaling "Calibration: misfire failed bank scaling. Tunable map/constant (not a live channel); log to find misfires and which cylinder is responsible. (0-1; raw/255)" VALUE 0x4000D20A RL_VALUE_UBYTE 0 CM_u8_factor_1_255 0 100 /end CHARACTERISTIC
/begin CHARACTERISTIC CAL_obd_ii_P0685_voltage_delta "uint8_t" VALUE 0x4000D20B RL_VALUE_UBYTE 0 NO_COMPU_METHOD 0 255 /end CHARACTERISTIC
/begin CHARACTERISTIC CAL_obd_ii_P0500_car_speed_min "uchar" VALUE 0x4000D20C RL_VALUE_UBYTE 0 NO_COMPU_METHOD 0 255 /end CHARACTERISTIC
/begin CHARACTERISTIC CAL_obd_ii_crank_cam_error_count_max "u8_count" VALUE 0x4000D20D RL_VALUE_UBYTE 0 NO_COMPU_METHOD 0 255 /end CHARACTERISTIC
/begin CHARACTERISTIC CAL_obd_ii_o2_activity_rate_outband "uchar" VALUE 0x4000D20E RL_VALUE_UBYTE 0 NO_COMPU_METHOD 0 255 /end CHARACTERISTIC
/begin CHARACTERISTIC CAL_engine_speed_3_threshold_0 "uchar" VALUE 0x4000D20F RL_VALUE_UBYTE 0 NO_COMPU_METHOD 0 255 /end CHARACTERISTIC
/begin CHARACTERISTIC CAL_idle_monitor_voltage_operating_range "u16_voltage_18/1023v[2]" VAL_BLK 0x4000D210 RL_VALUE_UWORD 0 CM_u16_voltage_18_1023v 0 1153.10850439883 NUMBER 2 /end CHARACTERISTIC
/begin CHARACTERISTIC CAL_idle_learn_ac_on_param "uchar" VALUE 0x4000D214 RL_VALUE_UBYTE 0 NO_COMPU_METHOD 0 255 /end CHARACTERISTIC
/begin CHARACTERISTIC CAL_obd_ii_idle_learn_limit "uchar" VALUE 0x4000D215 RL_VALUE_UBYTE 0 NO_COMPU_METHOD 0 255 /end CHARACTERISTIC
/begin CHARACTERISTIC CAL_obd_ii_idle_error_fail_count "u8_count" VALUE 0x4000D216 RL_VALUE_UBYTE 0 NO_COMPU_METHOD 0 255 /end CHARACTERISTIC
/begin CHARACTERISTIC CAL_vvt_zero_target_timeout "Calibration: VVT zero target timeout. Tunable map/constant (not a live channel); log commanded vs actual cam timing to verify VVT response. (ms; raw*100)" VALUE 0x4000D217 RL_VALUE_UBYTE 0 CM_u8_time_100ms 0 25500 /end CHARACTERISTIC
/begin CHARACTERISTIC CAL_coolant_temp_limit "uchar" VALUE 0x4000D218 RL_VALUE_UBYTE 0 NO_COMPU_METHOD 0 255 /end CHARACTERISTIC
/begin CHARACTERISTIC CAL_obd_ii_vvt_error_fail_count "u8_count" VALUE 0x4000D219 RL_VALUE_UBYTE 0 NO_COMPU_METHOD 0 255 /end CHARACTERISTIC
/begin CHARACTERISTIC CAL_obd_ii_vvt_monitor_min_runtime "u16_time_5ms" VALUE 0x4000D21A RL_VALUE_UWORD 0 CM_u8_time_5ms 0 327675 /end CHARACTERISTIC
/begin CHARACTERISTIC CAL_misfire_inhibit_tps_rate_hold "uint16_t" VALUE 0x4000D21C RL_VALUE_UWORD 0 NO_COMPU_METHOD 0 65535 /end CHARACTERISTIC
/begin CHARACTERISTIC CAL_misfire_enable_conditions_hold "u16_time_5ms" VALUE 0x4000D21E RL_VALUE_UWORD 0 CM_u8_time_5ms 0 327675 /end CHARACTERISTIC
/begin CHARACTERISTIC CAL_obd_ii_P1302_pass_holdoff "ushort" VALUE 0x4000D220 RL_VALUE_UWORD 0 NO_COMPU_METHOD 0 65535 /end CHARACTERISTIC
/begin CHARACTERISTIC CAL_obd_ii_P0071_air_temp_limit "u8_temp_5/8-40c[2]" VAL_BLK 0x4000D222 RL_VALUE_UBYTE 0 CM_u8_temp_5_8_40c -40 119.375 NUMBER 2 /end CHARACTERISTIC
/begin CHARACTERISTIC CAL_air_temp_intake_threshold "u8_temp_5/8-40c" VALUE 0x4000D223 RL_VALUE_UBYTE 0 CM_u8_temp_5_8_40c -40 119.375 /end CHARACTERISTIC
/begin CHARACTERISTIC CAL_misfire_rough_road_deviation_threshold "u16_speed_1/100kph" VALUE 0x4000D224 RL_VALUE_UWORD 0 CM_u8_speed_1_100kph 0 655.35 /end CHARACTERISTIC
/begin CHARACTERISTIC CAL_obd_P0171_learn_time_threshold "u8_time_10us" VALUE 0x4000D226 RL_VALUE_UBYTE 0 CM_u8_time_10us 0 2550 /end CHARACTERISTIC
/begin CHARACTERISTIC CAL_obd_P0172_learn_time_threshold "u8_time_10us" VALUE 0x4000D227 RL_VALUE_UBYTE 0 CM_u8_time_10us 0 2550 /end CHARACTERISTIC
/begin CHARACTERISTIC CAL_obd_ii_accel_pedal_correlation_max_diff "u16_factor_1/1023" VALUE 0x4000D228 RL_VALUE_UWORD 0 CM_u16_factor_1_1023 0 6406.15835777126 /end CHARACTERISTIC
/begin CHARACTERISTIC CAL_coolant_temp_threshold "uchar" VALUE 0x4000D22C RL_VALUE_UBYTE 0 NO_COMPU_METHOD 0 255 /end CHARACTERISTIC
/begin CHARACTERISTIC CAL_obd_ii_o2_sensors_present "Calibration: OBD O2 sensors present. Tunable map/constant (not a live channel); adjust to change this behavior." VALUE 0x4000D22D RL_VALUE_UBYTE 0 NO_COMPU_METHOD 0 255 /end CHARACTERISTIC
/begin CHARACTERISTIC CAL_obd_ii_standards_supported "Calibration: OBD standards supported. Tunable map/constant (not a live channel); adjust to change this behavior." VALUE 0x4000D22E RL_VALUE_UBYTE 0 NO_COMPU_METHOD 0 255 /end CHARACTERISTIC
/begin CHARACTERISTIC CAL_obd_ii_o2_slow_response_sample_count "uchar" VALUE 0x4000D22F RL_VALUE_UBYTE 0 NO_COMPU_METHOD 0 255 /end CHARACTERISTIC
/begin CHARACTERISTIC CAL_obd_ii_o2_r2l_time_max_asym "uchar" VALUE 0x4000D230 RL_VALUE_UBYTE 0 NO_COMPU_METHOD 0 255 /end CHARACTERISTIC
/begin CHARACTERISTIC CAL_obd_ii_o2_l2r_time_max_asym "uchar" VALUE 0x4000D231 RL_VALUE_UBYTE 0 NO_COMPU_METHOD 0 255 /end CHARACTERISTIC
/begin CHARACTERISTIC CAL_obd_ii_o2_slow_response_limit_lean_to_rich "u16_time_5ms" VALUE 0x4000D232 RL_VALUE_UWORD 0 CM_u8_time_5ms 0 327675 /end CHARACTERISTIC
/begin CHARACTERISTIC CAL_obd_ii_o2_slow_response_limit_rich_to_lean "u16_time_5ms" VALUE 0x4000D234 RL_VALUE_UWORD 0 CM_u8_time_5ms 0 327675 /end CHARACTERISTIC
/begin CHARACTERISTIC CAL_lea_misfire_baseline_set "uchar" VALUE 0x4000D236 RL_VALUE_UBYTE 0 NO_COMPU_METHOD 0 255 /end CHARACTERISTIC
/begin CHARACTERISTIC CAL_obd_ii_P0133_min_coolant_temp "u8_temp_5/8-40c" VALUE 0x4000D239 RL_VALUE_UBYTE 0 CM_u8_temp_5_8_40c -40 119.375 /end CHARACTERISTIC
/begin CHARACTERISTIC CAL_sensor_o2_heater_undercurrent_threshold "uint16_t" VALUE 0x4000D23A RL_VALUE_UWORD 0 NO_COMPU_METHOD 0 65535 /end CHARACTERISTIC
/begin CHARACTERISTIC CAL_sensor_o2_heater_overcurrent_threshold_mA "u16_current_mA" VALUE 0x4000D23C RL_VALUE_UWORD 0 CM_u16_current_mA 0 65535 /end CHARACTERISTIC
/begin CHARACTERISTIC CAL_obd_ii_switch_voltage_debounce "uchar" VALUE 0x4000D23E RL_VALUE_UBYTE 0 NO_COMPU_METHOD 0 255 /end CHARACTERISTIC
/begin CHARACTERISTIC CAL_obd_ii_engine_speed_3_threshold_1 "uchar" VALUE 0x4000D23F RL_VALUE_UBYTE 0 NO_COMPU_METHOD 0 255 /end CHARACTERISTIC
/begin CHARACTERISTIC CAL_obd_ii_vvt_ok_pass_count "uchar" VALUE 0x4000D240 RL_VALUE_UBYTE 0 NO_COMPU_METHOD 0 255 /end CHARACTERISTIC
/begin CHARACTERISTIC CAL_engine_speed_3_limit "uchar" VALUE 0x4000D241 RL_VALUE_UBYTE 0 NO_COMPU_METHOD 0 255 /end CHARACTERISTIC
/begin CHARACTERISTIC CAL_load_mass_per_stroke_raw_limit_1 "ushort" VALUE 0x4000D242 RL_VALUE_UWORD 0 NO_COMPU_METHOD 0 65535 /end CHARACTERISTIC
/begin CHARACTERISTIC CAL_load_mass_per_stroke_raw_limit_2 "ushort" VALUE 0x4000D244 RL_VALUE_UWORD 0 NO_COMPU_METHOD 0 65535 /end CHARACTERISTIC
/begin CHARACTERISTIC CAL_engine_speed_3_threshold_2 "uchar" VALUE 0x4000D246 RL_VALUE_UBYTE 0 NO_COMPU_METHOD 0 255 /end CHARACTERISTIC
/begin CHARACTERISTIC CAL_engine_speed_3_threshold_3 "uchar" VALUE 0x4000D247 RL_VALUE_UBYTE 0 NO_COMPU_METHOD 0 255 /end CHARACTERISTIC
/begin CHARACTERISTIC CAL_obd_ii_o2_switch_time_threshold "uint8_t" VALUE 0x4000D248 RL_VALUE_UBYTE 0 NO_COMPU_METHOD 0 255 /end CHARACTERISTIC
/begin CHARACTERISTIC CAL_obd_ii_o2_switch_time_min "uchar" VALUE 0x4000D249 RL_VALUE_UBYTE 0 NO_COMPU_METHOD 0 255 /end CHARACTERISTIC
/begin CHARACTERISTIC CAL_sensor_accel_pedal_pos_d_threshold "Calibration: sensor accelerator pedal position d threshold. Tunable map/constant (not a live channel); log the raw sensor signal to check sensor health and range." VAL_BLK 0x4000D24A RL_VALUE_UWORD 0 NO_COMPU_METHOD 0 65535 NUMBER 2 /end CHARACTERISTIC
/begin CHARACTERISTIC CAL_sensor_accel_pedal_pos_e_threshold "Calibration: sensor accelerator pedal position e threshold. Tunable map/constant (not a live channel); log the raw sensor signal to check sensor health and range." VAL_BLK 0x4000D24E RL_VALUE_UWORD 0 NO_COMPU_METHOD 0 65535 NUMBER 2 /end CHARACTERISTIC
/begin CHARACTERISTIC CAL_sensor_pps_correlation_max_delta "uint16_t" VALUE 0x4000D252 RL_VALUE_UWORD 0 NO_COMPU_METHOD 0 65535 /end CHARACTERISTIC
/begin CHARACTERISTIC CAL_sensor_pps_correlation_enable_max "uint16_t" VALUE 0x4000D254 RL_VALUE_UWORD 0 NO_COMPU_METHOD 0 65535 /end CHARACTERISTIC
/begin CHARACTERISTIC CAL_obd_ii_P0638_tps_error_max "u16_factor_1/1023" VALUE 0x4000D256 RL_VALUE_UWORD 0 CM_u16_factor_1_1023 0 6406.15835777126 /end CHARACTERISTIC
/begin CHARACTERISTIC CAL_obd_ii_P2173_load_difference_max "u16_load_mg/stroke" VALUE 0x4000D258 RL_VALUE_UWORD 0 CM_u16_load_mg_stroke 0 65535 /end CHARACTERISTIC
/begin CHARACTERISTIC CAL_obd_ii_o2_precat_diag_timer "uint16_t" VALUE 0x4000D25A RL_VALUE_UWORD 0 NO_COMPU_METHOD 0 65535 /end CHARACTERISTIC
/begin CHARACTERISTIC CAL_obd_ii_mode2f_timeout "Calibration: OBD mode2f timeout. Tunable map/constant (not a live channel); adjust to change this behavior. (ms; raw*100)" VALUE 0x4000D25C RL_VALUE_UWORD 0 CM_u8_time_100ms 0 6553500 /end CHARACTERISTIC
/begin CHARACTERISTIC CAL_misfire_rough_road_hold "u16_time_5ms" VALUE 0x4000D25E RL_VALUE_UWORD 0 CM_u8_time_5ms 0 327675 /end CHARACTERISTIC
/begin CHARACTERISTIC CAL_ecu_obd_engine_off_gate_delay "Calibration: ECU OBD engine off gate delay. Tunable map/constant (not a live channel); mostly housekeeping/diagnostic state." VALUE 0x4000D260 RL_VALUE_UWORD 0 NO_COMPU_METHOD 0 65535 /end CHARACTERISTIC
/begin CHARACTERISTIC CAL_obd_ii_mode2f_injector_test_interval "u8_time_5ms" VALUE 0x4000D262 RL_VALUE_UBYTE 0 CM_u8_time_5ms 0 1275 /end CHARACTERISTIC
/begin CHARACTERISTIC CAL_coolant_temp_threshold_1 "uchar" VALUE 0x4000D263 RL_VALUE_UBYTE 0 NO_COMPU_METHOD 0 255 /end CHARACTERISTIC
/begin CHARACTERISTIC CAL_obd_ii_mode2f_injector_test_pulse_10us "uint16_t" VALUE 0x4000D264 RL_VALUE_UWORD 0 NO_COMPU_METHOD 0 65535 /end CHARACTERISTIC
/begin CHARACTERISTIC CAL_obd_ii_mode2f_injector_test_duration "ushort" VALUE 0x4000D266 RL_VALUE_UWORD 0 NO_COMPU_METHOD 0 65535 /end CHARACTERISTIC
/begin CHARACTERISTIC CAL_obd_ii_mode08_evap_test_duration "ushort" VALUE 0x4000D268 RL_VALUE_UWORD 0 NO_COMPU_METHOD 0 65535 /end CHARACTERISTIC
/begin CHARACTERISTIC CAL_obd_ii_wheel_speed_correlation_rpm_max "u8_rspeed_125/4+500rpm" VALUE 0x4000D26A RL_VALUE_UBYTE 0 CM_u8_rspeed_125_4_500rpm 500 8468.75 /end CHARACTERISTIC
/begin CHARACTERISTIC CAL_tps_commanded_during_fault "Calibration: throttle position commanded during fault. Tunable map/constant (not a live channel); log to see throttle/pedal demand and throttle response. (0-1; raw/255)" VALUE 0x4000D26B RL_VALUE_UBYTE 0 CM_u8_factor_1_255 0 100 /end CHARACTERISTIC
/begin CHARACTERISTIC CAL_sensor_iat_fallback "Calibration: sensor intake-air temp fallback. Tunable map/constant (not a live channel); log the raw sensor signal to check sensor health and range. (deg C; raw*5/8-40)" VALUE 0x4000D26C RL_VALUE_UBYTE 0 CM_u8_temp_5_8_40c -40 119.375 /end CHARACTERISTIC
/begin CHARACTERISTIC CAL_sensor_coolant_temp_fallback_value "Calibration: sensor coolant temperature fallback value. Tunable map/constant (not a live channel); log the raw sensor signal to check sensor health and range. (deg C; raw*5/8-40)" VALUE 0x4000D26D RL_VALUE_UBYTE 0 CM_u8_temp_5_8_40c -40 119.375 /end CHARACTERISTIC
/begin CHARACTERISTIC CAL_cluster_fuel_level_warning_threshold "Calibration: cluster fuel level warning threshold. Tunable map/constant (not a live channel); log to follow fuel delivery and mixture control. (L)" VAL_BLK 0x4000D270 RL_VALUE_UBYTE 0 CM_u8_volume_liter 0 255 NUMBER 2 /end CHARACTERISTIC
/begin CHARACTERISTIC CAL_unused5 "Unused2. Runtime state -- log to observe this behavior." VALUE 0x4000D272 RL_VALUE_ULONG 0 NO_COMPU_METHOD 0 4294967295 /end CHARACTERISTIC
/begin CHARACTERISTIC CAL_obd_ii_P0106_partload_rpm_window "P0106 part-load test rpm window [lo, hi]; also the interpolation endpoints for the throttle-vacuum tables." VAL_BLK 0x4000D276 RL_VALUE_UBYTE 0 CM_u8_rspeed_125_4_500rpm 500 8468.75 NUMBER 2 /end CHARACTERISTIC
/begin CHARACTERISTIC CAL_obd_ii_P0106_partload_tps_window "P0106 part-load test TPS window [lo, hi]." VAL_BLK 0x4000D278 RL_VALUE_UBYTE 0 CM_u8_factor_1_255 0 100 NUMBER 2 /end CHARACTERISTIC
/begin CHARACTERISTIC CAL_obd_ii_P0106_partload_tps_rate_max "P0106 part-load test: max |tps_delta_rate| (steady throttle)." VALUE 0x4000D27A RL_VALUE_UBYTE 0 NO_COMPU_METHOD 0 255 /end CHARACTERISTIC
/begin CHARACTERISTIC CAL_evap_state_timer_threshold "uint8_t" VALUE 0x4000D27C RL_VALUE_UBYTE 0 NO_COMPU_METHOD 0 255 /end CHARACTERISTIC
/begin CHARACTERISTIC CAL_obd_ii_mode2f_coil_test_interval "uint8_t" VALUE 0x4000D27D RL_VALUE_UBYTE 0 NO_COMPU_METHOD 0 255 /end CHARACTERISTIC
/begin CHARACTERISTIC CAL_obd_ii_mode2f_coil_test_pulse_count "uint16_t" VALUE 0x4000D27E RL_VALUE_UWORD 0 NO_COMPU_METHOD 0 65535 /end CHARACTERISTIC
/begin CHARACTERISTIC CAL_obd_ii_P0106_baro_error_limits "P0106 limits on baro sensor - baro estimate (mbar): [0] max positive, [1] max negative." VAL_BLK 0x4000D28C RL_VALUE_UWORD 0 CM_i16_pressure_mbar 0 65535 NUMBER 2 /end CHARACTERISTIC
/begin CHARACTERISTIC CAL_sensor_intake_air_temp_voltage_threshold "uint16_t" VALUE 0x4000D290 RL_VALUE_UWORD 0 NO_COMPU_METHOD 0 65535 /end CHARACTERISTIC
/begin CHARACTERISTIC CAL_obd_ii_fuel_trim_zone3_time_min "ushort" VALUE 0x4000D292 RL_VALUE_UWORD 0 NO_COMPU_METHOD 0 65535 /end CHARACTERISTIC
/begin CHARACTERISTIC CAL_obd_ii_o2_precat_activity_window "ushort" VALUE 0x4000D294 RL_VALUE_UWORD 0 NO_COMPU_METHOD 0 65535 /end CHARACTERISTIC
/begin CHARACTERISTIC CAL_obd_ii_o2_postcat_activity_min "ushort" VALUE 0x4000D296 RL_VALUE_UWORD 0 NO_COMPU_METHOD 0 65535 /end CHARACTERISTIC
/begin CHARACTERISTIC CAL_obd_ii_o2_slow_response_runtime_limit_unknown "u16_time_5ms" VALUE 0x4000D298 RL_VALUE_UWORD 0 CM_u8_time_5ms 0 327675 /end CHARACTERISTIC
/begin CHARACTERISTIC CAL_o2_threshold "Calibration: O2 threshold precat. Tunable map/constant (not a live channel); adjust to change this behavior." VALUE 0x4000D29C RL_VALUE_ULONG 0 NO_COMPU_METHOD 0 4294967295 READ_ONLY /end CHARACTERISTIC
/begin CHARACTERISTIC CAL_o2_threshold_precat "Calibration: O2 threshold precat. Tunable map/constant (not a live channel); adjust to change this behavior." VALUE 0x4000D29C RL_VALUE_UBYTE 0 NO_COMPU_METHOD 0 255 READ_ONLY /end CHARACTERISTIC
/begin CHARACTERISTIC CAL_obd_ii_cat_monitor_min_engine_runtime "uint16_t" VALUE 0x4000D2A0 RL_VALUE_UWORD 0 NO_COMPU_METHOD 0 65535 /end CHARACTERISTIC
/begin CHARACTERISTIC CAL_o2_threshold_postcat "Calibration: O2 threshold postcat. Tunable map/constant (not a live channel); adjust to change this behavior." VALUE 0x4000D2A2 RL_VALUE_ULONG 0 NO_COMPU_METHOD 0 4294967295 READ_ONLY /end CHARACTERISTIC
/begin CHARACTERISTIC CAL_sensor_o2_lean_voltage_threshold "uint16_t" VALUE 0x4000D2A6 RL_VALUE_UWORD 0 NO_COMPU_METHOD 0 65535 /end CHARACTERISTIC
/begin CHARACTERISTIC CAL_misfire_emissions_limit "Calibration: misfire emissions limit. Tunable map/constant (not a live channel); log to find misfires and which cylinder is responsible." VALUE 0x4000D2A8 RL_VALUE_UBYTE 0 NO_COMPU_METHOD 0 255 /end CHARACTERISTIC
/begin CHARACTERISTIC CAL_obd_ii_P0106_highload_rpm_window "P0106 high-load test rpm window [lo, hi]; also needs tps > CAL_sensor_P0106_min_tps_threshold(rpm)." VAL_BLK 0x4000D2A9 RL_VALUE_UBYTE 0 CM_u8_rspeed_125_4_500rpm 500 8468.75 NUMBER 2 /end CHARACTERISTIC
/begin CHARACTERISTIC CAL_obd_ii_P0128_runtime_to_lowspeed_ratio_min "uint8_t" VALUE 0x4000D2AC RL_VALUE_UBYTE 0 NO_COMPU_METHOD 0 255 /end CHARACTERISTIC
/begin CHARACTERISTIC CAL_obd_ii_P0128_lowspeed_threshold "u8_speed_kph" VALUE 0x4000D2AD RL_VALUE_UBYTE 0 CM_u8_speed_kph 0 255 /end CHARACTERISTIC
/begin CHARACTERISTIC CAL_obd_ii_P0111_iat_agreement_tol "uchar" VALUE 0x4000D2AE RL_VALUE_UBYTE 0 NO_COMPU_METHOD 0 255 /end CHARACTERISTIC
/begin CHARACTERISTIC CAL_obd_ii_P0116_coolant_deviation_max_4000D2AF "uchar" VALUE 0x4000D2AF RL_VALUE_UBYTE 0 NO_COMPU_METHOD 0 255 /end CHARACTERISTIC
/begin CHARACTERISTIC CAL_obd_ii_runtime_since_start_threshold_unknown "u16_time_5ms" VALUE 0x4000D2B0 RL_VALUE_UWORD 0 CM_u8_time_5ms 0 327675 /end CHARACTERISTIC
/begin CHARACTERISTIC CAL_obd_ii_temp_unknown "u8_temp_5/8-40c" VALUE 0x4000D2B2 RL_VALUE_UBYTE 0 CM_u8_temp_5_8_40c -40 119.375 /end CHARACTERISTIC
/begin CHARACTERISTIC CAL_obd_ii_temp_unknown2 "u8_temp_5/8-40c" VALUE 0x4000D2B3 RL_VALUE_UBYTE 0 CM_u8_temp_5_8_40c -40 119.375 /end CHARACTERISTIC
/begin CHARACTERISTIC CAL_evap_purge_pressure_voltage_threshold "ushort" VALUE 0x4000D2B4 RL_VALUE_UWORD 0 NO_COMPU_METHOD 0 65535 /end CHARACTERISTIC
/begin CHARACTERISTIC CAL_evap_purge_pressure_voltage_threshold_0 "ushort" VALUE 0x4000D2B6 RL_VALUE_UWORD 0 NO_COMPU_METHOD 0 65535 /end CHARACTERISTIC
/begin CHARACTERISTIC CAL_obd_ii_P0116_min_runtime "uint16_t" VALUE 0x4000D2B8 RL_VALUE_UWORD 0 NO_COMPU_METHOD 0 65535 /end CHARACTERISTIC
/begin CHARACTERISTIC CAL_sensor_fuel_level_sensor_voltage_threshold "Calibration: sensor fuel level sensor voltage threshold. Tunable map/constant (not a live channel); log to follow fuel delivery and mixture control. (V; raw*5/1023)" VAL_BLK 0x4000D2BA RL_VALUE_UWORD 0 CM_u16_voltage_5_1023v 0 320.307917888563 NUMBER 2 /end CHARACTERISTIC
/begin CHARACTERISTIC CAL_coolant_temp_limit_0 "uchar" VALUE 0x4000D2BF RL_VALUE_UBYTE 0 NO_COMPU_METHOD 0 255 /end CHARACTERISTIC
/begin CHARACTERISTIC CAL_temp_engine_air_threshold_0 "uchar" VALUE 0x4000D2C0 RL_VALUE_UBYTE 0 NO_COMPU_METHOD 0 255 /end CHARACTERISTIC
/begin CHARACTERISTIC CAL_evap_unknown2 "u8_temp_5/8-40c" VALUE 0x4000D2C1 RL_VALUE_UBYTE 0 CM_u8_temp_5_8_40c -40 119.375 /end CHARACTERISTIC
/begin CHARACTERISTIC CAL_evap_leak_vacuum_decay_sample "uint8_t" VALUE 0x4000D2C3 RL_VALUE_UBYTE 0 NO_COMPU_METHOD 0 255 /end CHARACTERISTIC
/begin CHARACTERISTIC CAL_cat_check_unknown4 "ushort" VALUE 0x4000D2C4 RL_VALUE_UWORD 0 NO_COMPU_METHOD 0 65535 /end CHARACTERISTIC
/begin CHARACTERISTIC CAL_obd_ii_commanded_evap_purge_threshold "ushort" VALUE 0x4000D2C6 RL_VALUE_UWORD 0 NO_COMPU_METHOD 0 65535 /end CHARACTERISTIC
/begin CHARACTERISTIC CAL_evap_tank_vacuum_flow_threshold "ushort" VALUE 0x4000D2C8 RL_VALUE_UWORD 0 NO_COMPU_METHOD 0 65535 /end CHARACTERISTIC
/begin CHARACTERISTIC CAL_evap_system_state_flags_param "ushort" VALUE 0x4000D2CA RL_VALUE_UWORD 0 NO_COMPU_METHOD 0 65535 /end CHARACTERISTIC
/begin CHARACTERISTIC CAL_evap_purge_flow_state_timer_init "uchar" VALUE 0x4000D2CC RL_VALUE_UBYTE 0 NO_COMPU_METHOD 0 255 /end CHARACTERISTIC
/begin CHARACTERISTIC CAL_evap_canister_purge_solenoid_timer_init "uchar" VALUE 0x4000D2CD RL_VALUE_UBYTE 0 NO_COMPU_METHOD 0 255 /end CHARACTERISTIC
/begin CHARACTERISTIC CAL_evap_purge_min_load "u8_load_4mg/stroke" VALUE 0x4000D2CE RL_VALUE_UBYTE 0 CM_u8_load_4mg_stroke 0 1020 /end CHARACTERISTIC
/begin CHARACTERISTIC CAL_evap_purge_min_load_active "uchar" VALUE 0x4000D2CF RL_VALUE_UBYTE 0 NO_COMPU_METHOD 0 255 /end CHARACTERISTIC
/begin CHARACTERISTIC CAL_evap_purge_vacuum_min "i16_pressure_mbar" VALUE 0x4000D2D0 RL_VALUE_SWORD 0 CM_i16_pressure_mbar -32768 32767 /end CHARACTERISTIC
/begin CHARACTERISTIC CAL_obd_ii_evap_vapor_pressure_limit "ushort" VALUE 0x4000D2D4 RL_VALUE_UWORD 0 NO_COMPU_METHOD 0 65535 /end CHARACTERISTIC
/begin CHARACTERISTIC CAL_evap_leak_test_fuel_level_min "u8_volume_1/10gallon" VALUE 0x4000D2D6 RL_VALUE_UBYTE 0 CM_u8_volume_1_10gallon 0 25.5 /end CHARACTERISTIC
/begin CHARACTERISTIC CAL_evap_leak_test_fuel_level_max "u8_volume_1/10gallon" VALUE 0x4000D2D7 RL_VALUE_UBYTE 0 CM_u8_volume_1_10gallon 0 25.5 /end CHARACTERISTIC
/begin CHARACTERISTIC CAL_evap_purge_flow_vacuum_min "uint16_t" VALUE 0x4000D2D8 RL_VALUE_UWORD 0 NO_COMPU_METHOD 0 65535 /end CHARACTERISTIC
/begin CHARACTERISTIC CAL_evap_leak_test_pre_start_delay "u8_count" VALUE 0x4000D2DA RL_VALUE_UBYTE 0 NO_COMPU_METHOD 0 255 /end CHARACTERISTIC
/begin CHARACTERISTIC CAL_evap_leak_test_purge_settle_delay "u8_count" VALUE 0x4000D2DB RL_VALUE_UBYTE 0 NO_COMPU_METHOD 0 255 /end CHARACTERISTIC
/begin CHARACTERISTIC CAL_evap_leak_test_settle_samples "uchar" VALUE 0x4000D2DC RL_VALUE_UBYTE 0 NO_COMPU_METHOD 0 255 /end CHARACTERISTIC
/begin CHARACTERISTIC CAL_evap_leak_test_stage4_dwell "uchar" VALUE 0x4000D2DD RL_VALUE_UBYTE 0 NO_COMPU_METHOD 0 255 /end CHARACTERISTIC
/begin CHARACTERISTIC CAL_evap_leak_test_sample_count "ushort" VALUE 0x4000D2DE RL_VALUE_UWORD 0 NO_COMPU_METHOD 0 65535 /end CHARACTERISTIC
/begin CHARACTERISTIC CAL_obd_ii_commanded_evap_purge_limit "ushort" VALUE 0x4000D2E0 RL_VALUE_UWORD 0 NO_COMPU_METHOD 0 65535 /end CHARACTERISTIC
/begin CHARACTERISTIC CAL_obd_ii_commanded_evap_purge_limit_0 "ushort" VALUE 0x4000D2E2 RL_VALUE_UWORD 0 NO_COMPU_METHOD 0 65535 /end CHARACTERISTIC
/begin CHARACTERISTIC CAL_evap_leak_test_baro_min "u16_pressure_mbar" VALUE 0x4000D2EA RL_VALUE_UWORD 0 CM_i16_pressure_mbar 0 65535 /end CHARACTERISTIC
/begin CHARACTERISTIC CAL_evap_leak_test_force_enable "bool" VALUE 0x4000D2EC RL_VALUE_UBYTE 0 NO_COMPU_METHOD 0 255 /end CHARACTERISTIC
/begin CHARACTERISTIC CAL_maf_flow_1_limit "uchar" VALUE 0x4000D2F0 RL_VALUE_UBYTE 0 NO_COMPU_METHOD 0 255 /end CHARACTERISTIC
/begin CHARACTERISTIC CAL_obd_ii_P0128_start_coolant_max "uchar" VALUE 0x4000D2F1 RL_VALUE_UBYTE 0 NO_COMPU_METHOD 0 255 /end CHARACTERISTIC
/begin CHARACTERISTIC CAL_obd_ii_P0128_coolant_target "Calibration: cooling thermostat open. Tunable map/constant (not a live channel); log to confirm fans/pumps switch at the right temperatures. (deg C; raw*5/8-40)" VALUE 0x4000D2F2 RL_VALUE_UBYTE 0 CM_u8_temp_5_8_40c -40 119.375 /end CHARACTERISTIC
/begin CHARACTERISTIC CAL_obd_ii_P0128_start_coolant_min "uchar" VALUE 0x4000D2F3 RL_VALUE_UBYTE 0 NO_COMPU_METHOD 0 255 /end CHARACTERISTIC
/begin CHARACTERISTIC CAL_sensor_knock_voltage_threshold "uint16_t" VALUE 0x4000D2F4 RL_VALUE_UWORD 0 NO_COMPU_METHOD 0 65535 /end CHARACTERISTIC
/begin CHARACTERISTIC CAL_knock_sensor_b1_dc_bias_threshold "ushort" VALUE 0x4000D2F6 RL_VALUE_UWORD 0 NO_COMPU_METHOD 0 65535 /end CHARACTERISTIC
/begin CHARACTERISTIC CAL_obd_ii_cat_unknown11 "u8_temp_5/8-40c" VALUE 0x4000D2F8 RL_VALUE_UBYTE 0 CM_u8_temp_5_8_40c -40 119.375 /end CHARACTERISTIC
/begin CHARACTERISTIC CAL_obd_ii_cat_unknown10 "u8_temp_5/8-40c" VALUE 0x4000D2F9 RL_VALUE_UBYTE 0 CM_u8_temp_5_8_40c -40 119.375 /end CHARACTERISTIC
/begin CHARACTERISTIC CAL_obd_ii_cat_unknown2 "u16_time_5ms" VALUE 0x4000D2FA RL_VALUE_UWORD 0 CM_u8_time_5ms 0 327675 /end CHARACTERISTIC
/begin CHARACTERISTIC CAL_obd_ii_cat_unknown3 "u16_pressure_mbar" VALUE 0x4000D2FC RL_VALUE_UWORD 0 CM_i16_pressure_mbar 0 65535 /end CHARACTERISTIC
/begin CHARACTERISTIC CAL_obd_ii_unknown5 "u8_temp_5/8-40c" VALUE 0x4000D2FE RL_VALUE_UBYTE 0 CM_u8_temp_5_8_40c -40 119.375 /end CHARACTERISTIC
/begin CHARACTERISTIC CAL_coolant_temp_limit_1 "uchar" VALUE 0x4000D2FF RL_VALUE_UBYTE 0 NO_COMPU_METHOD 0 255 /end CHARACTERISTIC
/begin CHARACTERISTIC CAL_coolant_temp_threshold_2 "uchar" VALUE 0x4000D300 RL_VALUE_UBYTE 0 NO_COMPU_METHOD 0 255 /end CHARACTERISTIC
/begin CHARACTERISTIC CAL_obd_ii_cat_unknown6 "u8_speed_kph" VALUE 0x4000D301 RL_VALUE_UBYTE 0 CM_u8_speed_kph 0 255 /end CHARACTERISTIC
/begin CHARACTERISTIC CAL_obd_ii_cat_unknown9 "u8_speed_kph" VALUE 0x4000D302 RL_VALUE_UBYTE 0 CM_u8_speed_kph 0 255 /end CHARACTERISTIC
/begin CHARACTERISTIC CAL_obd_ii_cat_monitor_coolant_min_above_iat "uchar" VALUE 0x4000D303 RL_VALUE_UBYTE 0 NO_COMPU_METHOD 0 255 /end CHARACTERISTIC
/begin CHARACTERISTIC CAL_obd_cat_monitor_init_counter_2 "ushort" VALUE 0x4000D304 RL_VALUE_UWORD 0 NO_COMPU_METHOD 0 65535 /end CHARACTERISTIC
/begin CHARACTERISTIC CAL_obd_ii_cat_monitor_window_time "ushort" VALUE 0x4000D308 RL_VALUE_UWORD 0 NO_COMPU_METHOD 0 65535 /end CHARACTERISTIC
/begin CHARACTERISTIC CAL_obd_ii_cat_monitor_stable_time "ushort" VALUE 0x4000D30A RL_VALUE_UWORD 0 NO_COMPU_METHOD 0 65535 /end CHARACTERISTIC
/begin CHARACTERISTIC CAL_obd_evap_stability_window_samples "uchar" VALUE 0x4000D30C RL_VALUE_UBYTE 0 NO_COMPU_METHOD 0 255 /end CHARACTERISTIC
/begin CHARACTERISTIC CAL_obd_evap_entry_settle_delay "uchar" VALUE 0x4000D30D RL_VALUE_UBYTE 0 NO_COMPU_METHOD 0 255 /end CHARACTERISTIC
/begin CHARACTERISTIC CAL_obd_evap_refuel_level_rise_threshold "uchar" VALUE 0x4000D30E RL_VALUE_UBYTE 0 NO_COMPU_METHOD 0 255 /end CHARACTERISTIC
/begin CHARACTERISTIC CAL_obd_evap_fuel_level_noise_count_limit "uchar" VALUE 0x4000D30F RL_VALUE_UBYTE 0 NO_COMPU_METHOD 0 255 /end CHARACTERISTIC
/begin CHARACTERISTIC CAL_obd_evap_pressure_noise_count_limit "uchar" VALUE 0x4000D310 RL_VALUE_UBYTE 0 NO_COMPU_METHOD 0 255 /end CHARACTERISTIC
/begin CHARACTERISTIC CAL_obd_evap_fuel_level_noise_threshold "u8_volume_1/10gallon" VALUE 0x4000D311 RL_VALUE_UBYTE 0 CM_u8_volume_1_10gallon 0 25.5 /end CHARACTERISTIC
/begin CHARACTERISTIC CAL_obd_evap_pressure_noise_threshold "uint16_t" VALUE 0x4000D312 RL_VALUE_UWORD 0 NO_COMPU_METHOD 0 65535 /end CHARACTERISTIC
/begin CHARACTERISTIC CAL_fuel_sender_diag_level_lo "u8_volume_1/10gallon" VALUE 0x4000D314 RL_VALUE_UBYTE 0 CM_u8_volume_1_10gallon 0 25.5 /end CHARACTERISTIC
/begin CHARACTERISTIC CAL_evap_fuel_level_threshold_mid "uint8_t" VALUE 0x4000D315 RL_VALUE_UBYTE 0 NO_COMPU_METHOD 0 255 /end CHARACTERISTIC
/begin CHARACTERISTIC CAL_tpms_high_pressure_19_20 "u8_pressure_100mbar" VALUE 0x4000D316 RL_VALUE_UBYTE 0 CM_u8_pressure_100mbar 0 25500 /end CHARACTERISTIC
/begin CHARACTERISTIC CAL_tpms_nominal_pressure_19_20 "u8_pressure_100mbar" VALUE 0x4000D317 RL_VALUE_UBYTE 0 CM_u8_pressure_100mbar 0 25500 /end CHARACTERISTIC
/begin CHARACTERISTIC CAL_tpms_gen2_low_pressure_threshold_19_20 "undefined1" VALUE 0x4000D318 RL_VALUE_UBYTE 0 NO_COMPU_METHOD 0 255 /end CHARACTERISTIC
/begin CHARACTERISTIC CAL_tpms_gen2_low_warn_19_20 "uchar" VALUE 0x4000D319 RL_VALUE_UBYTE 0 NO_COMPU_METHOD 0 255 /end CHARACTERISTIC
/begin CHARACTERISTIC CAL_sensor_temp_diagnostic_startup_delay "Calibration: sensor temperature diagnostic startup delay. Tunable map/constant (not a live channel); log the raw sensor signal to check sensor health and range. (ms; raw*5)" VALUE 0x4000D31A RL_VALUE_UWORD 0 CM_u8_time_5ms 0 327675 /end CHARACTERISTIC
/begin CHARACTERISTIC CAL_obd_ac_load_diag_tolerance_pct "uchar" VALUE 0x4000D31C RL_VALUE_UBYTE 0 NO_COMPU_METHOD 0 255 /end CHARACTERISTIC
/begin CHARACTERISTIC CAL_fuel_level_wobble_threshold "u8_volume_1/10gallon" VALUE 0x4000D31D RL_VALUE_UBYTE 0 CM_u8_volume_1_10gallon 0 25.5 /end CHARACTERISTIC
/begin CHARACTERISTIC CAL_obd_ii_P0451_pressure_swing_min "ushort" VALUE 0x4000D31E RL_VALUE_UWORD 0 NO_COMPU_METHOD 0 65535 /end CHARACTERISTIC
/begin CHARACTERISTIC CAL_sensor_tps_voltage_theshold1 "Calibration: sensor throttle position voltage theshold1. Tunable map/constant (not a live channel); log to see throttle/pedal demand and throttle response. (V; raw*5/1023)" VAL_BLK 0x4000D320 RL_VALUE_UWORD 0 CM_u16_voltage_5_1023v 0 320.307917888563 NUMBER 2 /end CHARACTERISTIC
/begin CHARACTERISTIC CAL_sensor_tps_voltage_theshold2 "Calibration: sensor throttle position voltage theshold2. Tunable map/constant (not a live channel); log to see throttle/pedal demand and throttle response. (V; raw*5/1023)" VAL_BLK 0x4000D324 RL_VALUE_UWORD 0 CM_u16_voltage_5_1023v 0 320.307917888563 NUMBER 2 /end CHARACTERISTIC
/begin CHARACTERISTIC CAL_vvt_cam_park_offset_max "u8_angle_1/4deg" VALUE 0x4000D328 RL_VALUE_UBYTE 0 CM_u8_angle_1_4deg 0 63.75 /end CHARACTERISTIC
/begin CHARACTERISTIC CAL_tpms_high_pressure_18_19 "u8_pressure_100mbar" VALUE 0x4000D329 RL_VALUE_UBYTE 0 CM_u8_pressure_100mbar 0 25500 /end CHARACTERISTIC
/begin CHARACTERISTIC CAL_tpms_nominal_pressure_18_19 "u8_pressure_100mbar" VALUE 0x4000D32A RL_VALUE_UBYTE 0 CM_u8_pressure_100mbar 0 25500 /end CHARACTERISTIC
/begin CHARACTERISTIC CAL_tpms_gen2_low_pressure_threshold_18_19 "undefined1" VALUE 0x4000D32B RL_VALUE_UBYTE 0 NO_COMPU_METHOD 0 255 /end CHARACTERISTIC
/begin CHARACTERISTIC CAL_tpms_gen2_low_warn_18_19 "uchar" VALUE 0x4000D32C RL_VALUE_UBYTE 0 NO_COMPU_METHOD 0 255 /end CHARACTERISTIC
/begin CHARACTERISTIC CAL_obd_ac_load_diag_rpm_min_div50 "uchar" VALUE 0x4000D32D RL_VALUE_UBYTE 0 NO_COMPU_METHOD 0 255 /end CHARACTERISTIC
/begin CHARACTERISTIC CAL_obd_ii_P1422_fail_threshold "u8_count" VALUE 0x4000D32E RL_VALUE_UBYTE 0 NO_COMPU_METHOD 0 255 /end CHARACTERISTIC
/begin CHARACTERISTIC CAL_obd_ii_P0806_gear_changes_min "uchar" VALUE 0x4000D32F RL_VALUE_UBYTE 0 NO_COMPU_METHOD 0 255 /end CHARACTERISTIC
/begin CHARACTERISTIC CAL_obd_ii_P0806_clutch_span_min "ushort" VALUE 0x4000D330 RL_VALUE_UWORD 0 NO_COMPU_METHOD 0 65535 /end CHARACTERISTIC
/begin CHARACTERISTIC CAL_clutch_pos_voltage_threshold "ushort" VALUE 0x4000D332 RL_VALUE_UWORD 0 NO_COMPU_METHOD 0 65535 /end CHARACTERISTIC
/begin CHARACTERISTIC CAL_bootloader_rx_buffer_threshold "ushort" VALUE 0x4000D334 RL_VALUE_UWORD 0 NO_COMPU_METHOD 0 65535 /end CHARACTERISTIC
/begin CHARACTERISTIC CAL_ac_evap_temp_voltage_low_threshold "u16_voltage_5/1023v" VALUE 0x4000D336 RL_VALUE_UWORD 0 CM_u16_voltage_5_1023v 0 320.307917888563 /end CHARACTERISTIC
/begin CHARACTERISTIC CAL_ac_evap_temp_voltage_high_threshold "u16_voltage_5/1023v" VALUE 0x4000D338 RL_VALUE_UWORD 0 CM_u16_voltage_5_1023v 0 320.307917888563 /end CHARACTERISTIC
/begin CHARACTERISTIC CAL_ecu_gear_close_ratio "Calibration: ECU gear close ratio. Tunable map/constant (not a live channel); mostly housekeeping/diagnostic state." VAL_BLK 0x4000D33A RL_VALUE_UWORD 0 NO_COMPU_METHOD 0 65535 NUMBER 10 /end CHARACTERISTIC
/begin CHARACTERISTIC CAL_ecu_gear_close_ratio_topgear "Calibration: ECU gear close ratio topgear. Tunable map/constant (not a live channel); mostly housekeeping/diagnostic state." VAL_BLK 0x4000D34E RL_VALUE_UWORD 0 NO_COMPU_METHOD 0 65535 NUMBER 2 /end CHARACTERISTIC
/begin CHARACTERISTIC CAL_airbox_flapper_engine_speed_sport "Calibration: airbox flapper engine speed sport. Tunable map/constant (not a live channel); log to follow core engine state. (RPM)" VAL_BLK 0x4000D352 RL_VALUE_UWORD 0 CM_u8_rspeed_rpm 0 65535 NUMBER 2 /end CHARACTERISTIC
/begin CHARACTERISTIC CAL_airbox_flapper_engine_speed_tour2 "Calibration: airbox flapper engine speed tour2. Tunable map/constant (not a live channel); log to follow core engine state. (RPM)" VAL_BLK 0x4000D356 RL_VALUE_UWORD 0 CM_u8_rspeed_rpm 0 65535 NUMBER 2 /end CHARACTERISTIC
/begin CHARACTERISTIC CAL_airbox_flapper_engine_speed_sport2 "Calibration: airbox flapper engine speed sport2. Tunable map/constant (not a live channel); log to follow core engine state. (RPM)" VAL_BLK 0x4000D35A RL_VALUE_UWORD 0 CM_u8_rspeed_rpm 0 65535 NUMBER 2 /end CHARACTERISTIC
/begin CHARACTERISTIC CAL_fuel_usage_density "Fuel density for the trip computer (raw × 0.075 g/L; stock 9867 = 740 g/L). The ECU never uses it for fuelling. It only converts injector flow × commanded pulse into reported fuel consumption: the dash economy figure (CAN 0x400) and the fuel-used cou" VALUE 0x4000D35E RL_VALUE_UWORD 0 NO_COMPU_METHOD 0 65535 /end CHARACTERISTIC
/begin CHARACTERISTIC CAL_evap_fuel_used_window_level_high "u8_count" VALUE 0x4000D360 RL_VALUE_UBYTE 0 NO_COMPU_METHOD 0 255 /end CHARACTERISTIC
/begin CHARACTERISTIC CAL_evap_fuel_used_window_level_low "u8_count" VALUE 0x4000D361 RL_VALUE_UBYTE 0 NO_COMPU_METHOD 0 255 /end CHARACTERISTIC
/begin CHARACTERISTIC CAL_evap_fuel_used_window_level_mid "u8_count" VALUE 0x4000D362 RL_VALUE_UBYTE 0 NO_COMPU_METHOD 0 255 /end CHARACTERISTIC
/begin CHARACTERISTIC CAL_closedloop_max_tipout_enleanment "uint8_t" VALUE 0x4000D364 RL_VALUE_UBYTE 0 NO_COMPU_METHOD 0 255 /end CHARACTERISTIC
/begin CHARACTERISTIC CAL_closedloop_max_tipout_enleanment_4000D365 "uint8_t" VALUE 0x4000D365 RL_VALUE_UBYTE 0 NO_COMPU_METHOD 0 255 /end CHARACTERISTIC
/begin CHARACTERISTIC CAL_closedloop_max_tipout_enleanment_count "uchar" VALUE 0x4000D366 RL_VALUE_UBYTE 0 NO_COMPU_METHOD 0 255 /end CHARACTERISTIC
/begin CHARACTERISTIC CAL_closedloop_tipout_holdoff_ticks "uchar" VALUE 0x4000D367 RL_VALUE_UBYTE 0 NO_COMPU_METHOD 0 255 /end CHARACTERISTIC
/begin CHARACTERISTIC CAL_closedloop_tipout_rpm_threshold "u16_rspeed_rpm" VALUE 0x4000D368 RL_VALUE_UWORD 0 CM_u8_rspeed_rpm 0 65535 /end CHARACTERISTIC
/begin CHARACTERISTIC CAL_obd_ii_P0111_maf_low_band "uchar" VALUE 0x4000D36C RL_VALUE_UBYTE 0 NO_COMPU_METHOD 0 255 /end CHARACTERISTIC
/begin CHARACTERISTIC CAL_maf_flow_1_limit_0 "uchar" VALUE 0x4000D36D RL_VALUE_UBYTE 0 NO_COMPU_METHOD 0 255 /end CHARACTERISTIC
/begin CHARACTERISTIC CAL_obd_ii_P0111_maf_debounce_time "uchar" VALUE 0x4000D36E RL_VALUE_UBYTE 0 NO_COMPU_METHOD 0 255 /end CHARACTERISTIC
/begin CHARACTERISTIC CAL_obd_ii_P0111_iat_span_min "uchar" VALUE 0x4000D36F RL_VALUE_UBYTE 0 NO_COMPU_METHOD 0 255 /end CHARACTERISTIC
/begin CHARACTERISTIC CAL_obd_ii_P0111_airflow_stage_time "uchar" VALUE 0x4000D370 RL_VALUE_UBYTE 0 NO_COMPU_METHOD 0 255 /end CHARACTERISTIC
/begin CHARACTERISTIC CAL_obd_ii_P0111_high_airflow_time "uchar" VALUE 0x4000D371 RL_VALUE_UBYTE 0 NO_COMPU_METHOD 0 255 /end CHARACTERISTIC
/begin CHARACTERISTIC CAL_obd_ii_high_load_monitor_afr_max "u16_afr_1/100" VALUE 0x4000D372 RL_VALUE_UWORD 0 CM_u8_afr_1_100 0 655.35 /end CHARACTERISTIC
/begin CHARACTERISTIC CAL_obd_ii_P2191_lean_confirm_time "uchar" VALUE 0x4000D374 RL_VALUE_UBYTE 0 NO_COMPU_METHOD 0 255 /end CHARACTERISTIC
/begin CHARACTERISTIC CAL_obd_ii_P2192_rich_confirm_time "uchar" VALUE 0x4000D375 RL_VALUE_UBYTE 0 NO_COMPU_METHOD 0 255 /end CHARACTERISTIC
/begin CHARACTERISTIC CAL_obd_ii_high_load_monitor_load_min "u8_load_4mg/stroke" VALUE 0x4000D376 RL_VALUE_UBYTE 0 CM_u8_load_4mg_stroke 0 1020 /end CHARACTERISTIC
/begin CHARACTERISTIC CAL_obd_ii_drive_cycle_car_speed_min "uchar" VALUE 0x4000D377 RL_VALUE_UBYTE 0 NO_COMPU_METHOD 0 255 /end CHARACTERISTIC
/begin CHARACTERISTIC CAL_obd_ii_drive_cycle_idle_time "ushort" VALUE 0x4000D378 RL_VALUE_UWORD 0 NO_COMPU_METHOD 0 65535 /end CHARACTERISTIC
/begin CHARACTERISTIC CAL_obd_ii_drive_cycle_runtime "ushort" VALUE 0x4000D37A RL_VALUE_UWORD 0 NO_COMPU_METHOD 0 65535 /end CHARACTERISTIC
/begin CHARACTERISTIC CAL_obd_ii_o2_monitor_window_time "ushort" VALUE 0x4000D37C RL_VALUE_UWORD 0 NO_COMPU_METHOD 0 65535 /end CHARACTERISTIC
/begin CHARACTERISTIC CAL_obd_ii_monitor_rpm_delta_max "ushort" VALUE 0x4000D37E RL_VALUE_UWORD 0 NO_COMPU_METHOD 0 65535 /end CHARACTERISTIC
/begin CHARACTERISTIC CAL_idle_coolant_fallback_temp "Calibration: idle coolant fallback temperature. Tunable map/constant (not a live channel); log to diagnose idle quality, hunting, and stalls. (deg C; raw*5/8-40)" VALUE 0x4000D380 RL_VALUE_UBYTE 0 CM_u8_temp_5_8_40c -40 119.375 /end CHARACTERISTIC
/begin CHARACTERISTIC CAL_idle_sensor_fault_coolant_temp "uint8_t" VALUE 0x4000D381 RL_VALUE_UBYTE 0 NO_COMPU_METHOD 0 255 /end CHARACTERISTIC
/begin CHARACTERISTIC CAL_idle_sensor_fault_coolant_temp_4000D382 "uint8_t" VALUE 0x4000D382 RL_VALUE_UBYTE 0 NO_COMPU_METHOD 0 255 /end CHARACTERISTIC
/begin CHARACTERISTIC CAL_obd_ii_evap_purge_settle_debounce "uchar" VALUE 0x4000D383 RL_VALUE_UBYTE 0 NO_COMPU_METHOD 0 255 /end CHARACTERISTIC
/begin CHARACTERISTIC CAL_evap_pressure_deviation_max "uchar" VALUE 0x4000D384 RL_VALUE_UBYTE 0 NO_COMPU_METHOD 0 255 /end CHARACTERISTIC
/begin CHARACTERISTIC CAL_obd_ii_P0451_debounce_count "u8_count" VALUE 0x4000D385 RL_VALUE_UBYTE 0 NO_COMPU_METHOD 0 255 /end CHARACTERISTIC
/begin CHARACTERISTIC CAL_obd_ii_o2_period_consistency_tol "uchar" VALUE 0x4000D388 RL_VALUE_UBYTE 0 NO_COMPU_METHOD 0 255 /end CHARACTERISTIC
/begin CHARACTERISTIC CAL_obd_ii_o2_imbalance_sample_count "uchar" VALUE 0x4000D389 RL_VALUE_UBYTE 0 NO_COMPU_METHOD 0 255 /end CHARACTERISTIC
/begin CHARACTERISTIC CAL_obd_ii_o2_slow_response_maf_limit_unknown2 "u16_flow_10mg/s" VALUE 0x4000D38A RL_VALUE_UWORD 0 CM_u16_flow_10mg_s 0 655350 /end CHARACTERISTIC
/begin CHARACTERISTIC CAL_obd_o2_precat_diag_init_counter "ushort" VALUE 0x4000D38C RL_VALUE_UWORD 0 NO_COMPU_METHOD 0 65535 /end CHARACTERISTIC
/begin CHARACTERISTIC CAL_obd_ii_o2_period_excess_max "uchar" VALUE 0x4000D38E RL_VALUE_UBYTE 0 NO_COMPU_METHOD 0 255 /end CHARACTERISTIC
/begin CHARACTERISTIC CAL_obd_ii_o2_imbalance_accum_cap "uchar" VALUE 0x4000D38F RL_VALUE_UBYTE 0 NO_COMPU_METHOD 0 255 /end CHARACTERISTIC
/begin CHARACTERISTIC CAL_obd_ii_cat_check_transient_blackout "ushort" VALUE 0x4000D390 RL_VALUE_UWORD 0 NO_COMPU_METHOD 0 65535 /end CHARACTERISTIC
/begin CHARACTERISTIC CAL_obd_ii_cat_check_tps_rate_max "uchar" VALUE 0x4000D392 RL_VALUE_UBYTE 0 NO_COMPU_METHOD 0 255 /end CHARACTERISTIC
/begin CHARACTERISTIC CAL_obd_ii_tps_unknown1 "u8_factor_1/255" VALUE 0x4000D393 RL_VALUE_UBYTE 0 CM_u8_factor_1_255 0 100 /end CHARACTERISTIC
/begin CHARACTERISTIC CAL_misfire_rough_road_speed_min "u16_speed_1/100kph" VALUE 0x4000D394 RL_VALUE_UWORD 0 CM_u8_speed_1_100kph 0 655.35 /end CHARACTERISTIC
/begin CHARACTERISTIC CAL_obd_ii_rpm_unknown1 "u16_rspeed_rpm" VALUE 0x4000D396 RL_VALUE_UWORD 0 CM_u8_rspeed_rpm 0 65535 /end CHARACTERISTIC
/begin CHARACTERISTIC CAL_obd_ii_o2_slow_response_maf_limit_unknown "u16_flow_10mg/s" VALUE 0x4000D398 RL_VALUE_UWORD 0 CM_u16_flow_10mg_s 0 655350 /end CHARACTERISTIC
/begin CHARACTERISTIC CAL_obd_o2_precat_diag_reset_counter "ushort" VALUE 0x4000D39A RL_VALUE_UWORD 0 NO_COMPU_METHOD 0 65535 /end CHARACTERISTIC
/begin CHARACTERISTIC CAL_sensor_accel_pedal_midpoint_voltage_range "uint16_t" VALUE 0x4000D39C RL_VALUE_UWORD 0 NO_COMPU_METHOD 0 65535 /end CHARACTERISTIC
/begin CHARACTERISTIC CAL_sensor_accel_pedal_midpoint_voltage_max "ushort" VALUE 0x4000D39E RL_VALUE_UWORD 0 NO_COMPU_METHOD 0 65535 /end CHARACTERISTIC
/begin CHARACTERISTIC CAL_obd_ii_P0579_switch_changes_max "uchar" VALUE 0x4000D3A0 RL_VALUE_UBYTE 0 NO_COMPU_METHOD 0 255 /end CHARACTERISTIC
/begin CHARACTERISTIC CAL_obd_ii_P0579_window_time "switch-change count window, val*20 ticks at 200 Hz = 100 ms/count; stock 10 = 1 s. Was CAL_obd_ii_P0579_stuck_timeout" VALUE 0x4000D3A1 RL_VALUE_UBYTE 0 NO_COMPU_METHOD 0 255 /end CHARACTERISTIC
/begin CHARACTERISTIC CAL_clutch_sensor_confidence_max "uint16_t" VALUE 0x4000D3A2 RL_VALUE_UWORD 0 NO_COMPU_METHOD 0 65535 /end CHARACTERISTIC
/begin CHARACTERISTIC CAL_clutch_variance_threshold "uint8_t" VALUE 0x4000D3A4 RL_VALUE_UBYTE 0 NO_COMPU_METHOD 0 255 /end CHARACTERISTIC
/begin CHARACTERISTIC CAL_clutch_confidence_decrement "uint8_t" VALUE 0x4000D3A5 RL_VALUE_UBYTE 0 NO_COMPU_METHOD 0 255 /end CHARACTERISTIC
/begin CHARACTERISTIC CAL_clutch_confidence_increment "uint8_t" VALUE 0x4000D3A6 RL_VALUE_UBYTE 0 NO_COMPU_METHOD 0 255 /end CHARACTERISTIC
/begin CHARACTERISTIC CAL_clutch_confidence_increment_4000D3A7 "uint8_t" VALUE 0x4000D3A7 RL_VALUE_UBYTE 0 NO_COMPU_METHOD 0 255 /end CHARACTERISTIC
/begin CHARACTERISTIC CAL_load_mass_per_stroke_raw_limit_3 "ushort" VALUE 0x4000D3A8 RL_VALUE_UWORD 0 NO_COMPU_METHOD 0 65535 /end CHARACTERISTIC
/begin CHARACTERISTIC CAL_obd_high_load_monitor_load_max "ushort" VALUE 0x4000D3AA RL_VALUE_UWORD 0 NO_COMPU_METHOD 0 65535 /end CHARACTERISTIC
/begin CHARACTERISTIC CAL_engine_speed_3_limit_0 "uchar" VALUE 0x4000D3AC RL_VALUE_UBYTE 0 NO_COMPU_METHOD 0 255 /end CHARACTERISTIC
/begin CHARACTERISTIC CAL_engine_speed_3_threshold_4 "uchar" VALUE 0x4000D3AD RL_VALUE_UBYTE 0 NO_COMPU_METHOD 0 255 /end CHARACTERISTIC
/begin CHARACTERISTIC CAL_maf_flow_1_limit_2 "ushort" VALUE 0x4000D3AE RL_VALUE_UWORD 0 NO_COMPU_METHOD 0 65535 /end CHARACTERISTIC
/begin CHARACTERISTIC CAL_maf_flow_1_threshold_4 "ushort" VALUE 0x4000D3B0 RL_VALUE_UWORD 0 NO_COMPU_METHOD 0 65535 /end CHARACTERISTIC
/begin CHARACTERISTIC CAL_obd_fuel_learn_eng_speed_delta_max "ushort" VALUE 0x4000D3B2 RL_VALUE_UWORD 0 NO_COMPU_METHOD 0 65535 /end CHARACTERISTIC
/begin CHARACTERISTIC CAL_coolant_temp_limit_2 "uchar" VALUE 0x4000D3B4 RL_VALUE_UBYTE 0 NO_COMPU_METHOD 0 255 /end CHARACTERISTIC
/begin CHARACTERISTIC CAL_obd_ii_fuel_learn_max_load_delta "uchar" VALUE 0x4000D3B5 RL_VALUE_UBYTE 0 NO_COMPU_METHOD 0 255 /end CHARACTERISTIC
/begin CHARACTERISTIC CAL_obd_fuel_learn_inhibit_holdoff_ticks "ushort" VALUE 0x4000D3B6 RL_VALUE_UWORD 0 NO_COMPU_METHOD 0 65535 /end CHARACTERISTIC
/begin CHARACTERISTIC CAL_obd_ii_o2_imbalance_sample_count_4000D3B8 "uint16_t" VALUE 0x4000D3B8 RL_VALUE_UWORD 0 NO_COMPU_METHOD 0 65535 /end CHARACTERISTIC
/begin CHARACTERISTIC CAL_obd_ii_o2_imbalance_threshold "ushort" VALUE 0x4000D3BA RL_VALUE_UWORD 0 NO_COMPU_METHOD 0 65535 /end CHARACTERISTIC
/begin CHARACTERISTIC CAL_obd_ii_o2_imbalance_sample_period "uchar" VALUE 0x4000D3BC RL_VALUE_UBYTE 0 NO_COMPU_METHOD 0 255 /end CHARACTERISTIC
/begin CHARACTERISTIC CAL_obd_ii_P0101_idle_coolant_min "u8_temp_5/8-40c" VALUE 0x4000D3BD RL_VALUE_UBYTE 0 CM_u8_temp_5_8_40c -40 119.375 /end CHARACTERISTIC
/begin CHARACTERISTIC CAL_obd_ii_P0101_idle_dwell_min "uchar" VALUE 0x4000D3BE RL_VALUE_UBYTE 0 NO_COMPU_METHOD 0 255 /end CHARACTERISTIC
/begin CHARACTERISTIC CAL_obd_ii_P0101_idle_iat_max "u8_temp_5/8-40c" VALUE 0x4000D3BF RL_VALUE_UBYTE 0 CM_u8_temp_5_8_40c -40 119.375 /end CHARACTERISTIC
/begin CHARACTERISTIC CAL_obd_ii_P0101_runtime_min "u8_time_s" VALUE 0x4000D3C0 RL_VALUE_UBYTE 0 CM_u8_time_s 0 255 /end CHARACTERISTIC
/begin CHARACTERISTIC CAL_obd_ii_P0101_load_tolerance_pct_idle "uchar" VALUE 0x4000D3C1 RL_VALUE_UBYTE 0 NO_COMPU_METHOD 0 255 /end CHARACTERISTIC
/begin CHARACTERISTIC CAL_obd_ii_P0101_baro_min "u16_pressure_mbar" VALUE 0x4000D3C2 RL_VALUE_UWORD 0 CM_i16_pressure_mbar 0 65535 /end CHARACTERISTIC
/begin CHARACTERISTIC CAL_obd_ii_P0101_plausibility_enable "uchar" VALUE 0x4000D3C4 RL_VALUE_UBYTE 0 NO_COMPU_METHOD 0 255 /end CHARACTERISTIC
/begin CHARACTERISTIC CAL_obd_ii_knock_no_activity_count "uint8_t" VALUE 0x4000D3C5 RL_VALUE_UBYTE 0 NO_COMPU_METHOD 0 255 /end CHARACTERISTIC
/begin CHARACTERISTIC CAL_obd_ii_knock_monitor_sample_count "ushort" VALUE 0x4000D3C6 RL_VALUE_UWORD 0 NO_COMPU_METHOD 0 65535 /end CHARACTERISTIC
/begin CHARACTERISTIC CAL_knock_octane_scaler_short_term_limit "u16_factor_1/65536" VALUE 0x4000D3C8 RL_VALUE_UWORD 0 CM_u16_factor_1_65536 0 99.9984741210938 /end CHARACTERISTIC
/begin CHARACTERISTIC CAL_knock_threshold_obd_ii_check_enable_engine_speed "uint16_t" VALUE 0x4000D3CA RL_VALUE_UWORD 0 NO_COMPU_METHOD 0 65535 /end CHARACTERISTIC
/begin CHARACTERISTIC CAL_knock_threshold_obd_ii_check_enable_load "uint8_t" VALUE 0x4000D3CC RL_VALUE_UBYTE 0 NO_COMPU_METHOD 0 255 /end CHARACTERISTIC
/begin CHARACTERISTIC CAL_knock_threshold_obd_ii_check_enable_load_4000D3CD "uint8_t" VALUE 0x4000D3CD RL_VALUE_UBYTE 0 NO_COMPU_METHOD 0 255 /end CHARACTERISTIC
/begin CHARACTERISTIC CAL_can_yaw_timeout "u8_time_5ms" VALUE 0x4000D3CE RL_VALUE_UBYTE 0 CM_u8_time_5ms 0 1275 /end CHARACTERISTIC
/begin CHARACTERISTIC CAL_can_lat_accel_standstill_timeout "u8_time_100ms" VALUE 0x4000D3CF RL_VALUE_UBYTE 0 CM_u8_time_100ms 0 25500 /end CHARACTERISTIC
/begin CHARACTERISTIC CAL_can_yaw_data_timeout "u8_time_5ms" VALUE 0x4000D3D0 RL_VALUE_UBYTE 0 CM_u8_time_5ms 0 1275 /end CHARACTERISTIC
/begin CHARACTERISTIC CAL_sensor_lat_accel_raw_threshold "uint8_t" VALUE 0x4000D3D1 RL_VALUE_UBYTE 0 NO_COMPU_METHOD 0 255 /end CHARACTERISTIC
/begin CHARACTERISTIC CAL_sensor_lat_accel_smoothing_factor "Calibration: sensor lat accelerator smoothing factor. Tunable map/constant (not a live channel); log the raw sensor signal to check sensor health and range. (0-1; raw/255)" VALUE 0x4000D3D2 RL_VALUE_UBYTE 0 CM_u8_factor_1_255 0 100 /end CHARACTERISTIC
/begin CHARACTERISTIC CAL_can_yaw_monitor_startup_delay "u8_time_s" VALUE 0x4000D3D3 RL_VALUE_UBYTE 0 CM_u8_time_s 0 255 /end CHARACTERISTIC
/begin CHARACTERISTIC CAL_gsi_rpm_per_kph_ips "Calibration: slip gear speed ratios IPS. Tunable map/constant (not a live channel); log to see wheel slip and traction-control intervention." VAL_BLK 0x4000D3D4 RL_VALUE_UWORD 0 NO_COMPU_METHOD 0 65535 NUMBER 6 /end CHARACTERISTIC
/begin CHARACTERISTIC CAL_gsi_rpm_per_kph_close_ratio "Calibration: slip gear speed ratios cr. Tunable map/constant (not a live channel); log to see wheel slip and traction-control intervention." VAL_BLK 0x4000D3E0 RL_VALUE_UWORD 0 NO_COMPU_METHOD 0 65535 NUMBER 6 /end CHARACTERISTIC
/begin CHARACTERISTIC CAL_gsi_rpm_per_kph_standard "Calibration: slip gear speed ratios long. Tunable map/constant (not a live channel); log to see wheel slip and traction-control intervention." VAL_BLK 0x4000D3EC RL_VALUE_UWORD 0 NO_COMPU_METHOD 0 65535 NUMBER 6 /end CHARACTERISTIC
/begin CHARACTERISTIC CAL_gear_advisory_upshift_rpm_gear1 "u8_rspeed_4+500rpm" VALUE 0x4000D3F8 RL_VALUE_UBYTE 0 CM_u8_rspeed_4_500rpm 500 1520 /end CHARACTERISTIC
/begin CHARACTERISTIC CAL_gear_advisory_upshift_rpm_manual "Calibration: slip threshold per gear manual. Tunable map/constant (not a live channel); log to see wheel slip and traction-control intervention. (RPM; raw*4+500)" VAL_BLK 0x4000D3F9 RL_VALUE_UBYTE 0 CM_u8_rspeed_4_500rpm 500 1520 NUMBER 5 /end CHARACTERISTIC
/begin CHARACTERISTIC CAL_gear_advisory_upshift_rpm_ips "Calibration: slip slip threshold per gear IPS. Tunable map/constant (not a live channel); log to see wheel slip and traction-control intervention. (RPM; raw*4+500)" VAL_BLK 0x4000D3FE RL_VALUE_UBYTE 0 CM_u8_rspeed_4_500rpm 500 1520 NUMBER 5 /end CHARACTERISTIC
/begin CHARACTERISTIC CAL_cluster_gear_advisory_lamp_type "Calibration: slip detect mode. Tunable map/constant (not a live channel); log to see wheel slip and traction-control intervention." VALUE 0x4000D403 RL_VALUE_UBYTE 0 NO_COMPU_METHOD 0 255 /end CHARACTERISTIC
/begin CHARACTERISTIC CAL_gsi_pedal_applied_threshold "u16_factor_1/1023" VALUE 0x4000D404 RL_VALUE_UWORD 0 CM_u16_factor_1_1023 0 6406.15835777126 /end CHARACTERISTIC
/begin CHARACTERISTIC CAL_gsi_steering_angle_inhibit "Calibration: slip steering limit. Tunable map/constant (not a live channel); log to see wheel slip and traction-control intervention. (deg; raw/10)" VALUE 0x4000D406 RL_VALUE_UWORD 0 CM_u16_angle_1_10deg 0 6553.5 /end CHARACTERISTIC
/begin CHARACTERISTIC CAL_gsi_max_gear_rpm "uint16_t" VALUE 0x4000D408 RL_VALUE_UWORD 0 NO_COMPU_METHOD 0 65535 /end CHARACTERISTIC
/begin CHARACTERISTIC CAL_gsi_speed_offset_kph "uint8_t" VALUE 0x4000D40A RL_VALUE_UBYTE 0 NO_COMPU_METHOD 0 255 /end CHARACTERISTIC
/begin CHARACTERISTIC CAL_overrev_advisory_coolant_max "u8_temp_5/8-40c" VALUE 0x4000D40B RL_VALUE_UBYTE 0 CM_u8_temp_5_8_40c -40 119.375 /end CHARACTERISTIC
/begin CHARACTERISTIC CAL_gsi_upshift_delay "Calibration: slip timer per gear intervention. Tunable map/constant (not a live channel); log to see wheel slip and traction-control intervention." VALUE 0x4000D40C RL_VALUE_UBYTE 0 NO_COMPU_METHOD 0 255 /end CHARACTERISTIC
/begin CHARACTERISTIC CAL_gsi_cornering_inhibit_threshold "uint8_t" VALUE 0x4000D40D RL_VALUE_UBYTE 0 NO_COMPU_METHOD 0 255 /end CHARACTERISTIC
/begin CHARACTERISTIC CAL_gsi_cornering_inhibit_hysteresis "uint8_t" VALUE 0x4000D40E RL_VALUE_UBYTE 0 NO_COMPU_METHOD 0 255 /end CHARACTERISTIC
/begin CHARACTERISTIC CAL_overrev_advisory_margin_scale "u8_factor_1/100" VALUE 0x4000D40F RL_VALUE_UBYTE 0 CM_u8_factor_1_100 0 255 /end CHARACTERISTIC
/begin CHARACTERISTIC CAL_gsi_steering_rate_term_max "uint8_t" VALUE 0x4000D410 RL_VALUE_UBYTE 0 NO_COMPU_METHOD 0 255 /end CHARACTERISTIC
/begin CHARACTERISTIC CAL_gsi_steering_rate_filter_coeff "uint8_t" VALUE 0x4000D411 RL_VALUE_UBYTE 0 NO_COMPU_METHOD 0 255 /end CHARACTERISTIC
/begin CHARACTERISTIC CAL_gsi_pedal_applied_hold_time "uint8_t" VALUE 0x4000D412 RL_VALUE_UBYTE 0 NO_COMPU_METHOD 0 255 /end CHARACTERISTIC
/begin CHARACTERISTIC CAL_gsi_downshift_idle_margin "uint8_t" VALUE 0x4000D413 RL_VALUE_UBYTE 0 NO_COMPU_METHOD 0 255 /end CHARACTERISTIC
/begin CHARACTERISTIC CAL_gsi_downshift_rpm_offset "uint8_t" VALUE 0x4000D414 RL_VALUE_UBYTE 0 NO_COMPU_METHOD 0 255 /end CHARACTERISTIC
/begin CHARACTERISTIC CAL_gsi_downshift_delay "uint8_t" VALUE 0x4000D415 RL_VALUE_UBYTE 0 NO_COMPU_METHOD 0 255 /end CHARACTERISTIC
/begin CHARACTERISTIC CAL_gsi_max_gear_step "uint8_t" VALUE 0x4000D416 RL_VALUE_UBYTE 0 NO_COMPU_METHOD 0 255 /end CHARACTERISTIC
/begin CHARACTERISTIC CAL_tps_obd_throttle_model_step_max_opening "uint8_t" VALUE 0x4000D417 RL_VALUE_UBYTE 0 NO_COMPU_METHOD 0 255 /end CHARACTERISTIC
/begin CHARACTERISTIC CAL_gsi_max_gear_step_4000D418 "uint8_t" VALUE 0x4000D418 RL_VALUE_UBYTE 0 NO_COMPU_METHOD 0 255 /end CHARACTERISTIC
/begin CHARACTERISTIC CAL_gsi_gear1_drive_away_speed "u8_speed_kph" VALUE 0x4000D419 RL_VALUE_UBYTE 0 CM_u8_speed_kph 0 255 /end CHARACTERISTIC
/begin CHARACTERISTIC CAL_unused_array2 "byte[938]" VAL_BLK 0x4000D41A RL_VALUE_UBYTE 0 NO_COMPU_METHOD 0 255 NUMBER 938 /end CHARACTERISTIC
/begin AXIS_PTS CAL_ign_base_ips_X_rpm "X-axis breakpoints for the 'ignition base IPS' table. Defines the lookup grid (not a live channel); change only when re-axing the map. (RPM; raw*125/4+500)" 0x4000D7C4 NO_INPUT_QUANTITY RL_AXIS_UBYTE 0 CM_u8_rspeed_125_4_500rpm 20 500 8468.75 /end AXIS_PTS
/begin AXIS_PTS CAL_ign_base_ips_Y_load "Y-axis breakpoints for the 'ignition base IPS' table. Defines the lookup grid (not a live channel); change only when re-axing the map. (mg/stroke; raw*4)" 0x4000D7D8 NO_INPUT_QUANTITY RL_AXIS_UBYTE 0 CM_u8_load_4mg_stroke 20 0 1020 /end AXIS_PTS
/begin CHARACTERISTIC CAL_ign_base_ips "Calibration: ignition base IPS. Tunable map/constant (not a live channel); log spark advance to confirm the timing strategy and headroom to knock. (deg; raw/4-10)" MAP 0x4000D7EC RL_VALUE_UBYTE 0 CM_u8_angle_1_4_10deg -10 53.75
 /begin AXIS_DESCR COM_AXIS NO_INPUT_QUANTITY CM_u8_rspeed_125_4_500rpm 20 500 8468.75 AXIS_PTS_REF CAL_ign_base_ips_X_rpm /end AXIS_DESCR
 /begin AXIS_DESCR COM_AXIS NO_INPUT_QUANTITY CM_u8_load_4mg_stroke 20 0 1020 AXIS_PTS_REF CAL_ign_base_ips_Y_load /end AXIS_DESCR
/end CHARACTERISTIC
/begin CHARACTERISTIC CAL_obd_ii_P0106 "Calibration that arms/thresholds the P0106 monitor (MAP/baro rationality). Fixed value -- it sets when that DTC trips, not a live channel." VALUE 0x4000D97D RL_VALUE_UBYTE 0 NO_COMPU_METHOD 0 255 /end CHARACTERISTIC
/begin CHARACTERISTIC CAL_obd_ii_P0107 "Calibration that arms/thresholds the P0107 monitor (MAP/baro circuit low). Fixed value -- it sets when that DTC trips, not a live channel." VALUE 0x4000D97E RL_VALUE_UBYTE 0 NO_COMPU_METHOD 0 255 /end CHARACTERISTIC
/begin CHARACTERISTIC CAL_obd_ii_P0108 "Calibration that arms/thresholds the P0108 monitor (MAP/baro circuit high). Fixed value -- it sets when that DTC trips, not a live channel." VALUE 0x4000D97F RL_VALUE_UBYTE 0 NO_COMPU_METHOD 0 255 /end CHARACTERISTIC
/begin CHARACTERISTIC CAL_obd_ii_P0111 "Calibration that arms/thresholds the P0111 monitor (IAT rationality). Fixed value -- it sets when that DTC trips, not a live channel." VALUE 0x4000D981 RL_VALUE_UBYTE 0 NO_COMPU_METHOD 0 255 /end CHARACTERISTIC
/begin CHARACTERISTIC CAL_obd_ii_P0112 "Calibration that arms/thresholds the P0112 monitor (IAT circuit low). Fixed value -- it sets when that DTC trips, not a live channel." VALUE 0x4000D982 RL_VALUE_UBYTE 0 NO_COMPU_METHOD 0 255 /end CHARACTERISTIC
/begin CHARACTERISTIC CAL_obd_ii_P0113 "Calibration that arms/thresholds the P0113 monitor (IAT circuit high). Fixed value -- it sets when that DTC trips, not a live channel." VALUE 0x4000D983 RL_VALUE_UBYTE 0 NO_COMPU_METHOD 0 255 /end CHARACTERISTIC
/begin CHARACTERISTIC CAL_obd_ii_P0071 "Calibration that arms/thresholds the P0071 monitor (ambient air temp sensor rationality). Fixed value -- it sets when that DTC trips, not a live channel." VALUE 0x4000D984 RL_VALUE_UBYTE 0 NO_COMPU_METHOD 0 255 /end CHARACTERISTIC
/begin CHARACTERISTIC CAL_obd_ii_P0116 "Calibration that arms/thresholds the P0116 monitor (coolant-temp rationality). Fixed value -- it sets when that DTC trips, not a live channel." VALUE 0x4000D985 RL_VALUE_UBYTE 0 NO_COMPU_METHOD 0 255 /end CHARACTERISTIC
/begin CHARACTERISTIC CAL_obd_ii_P0117 "Calibration that arms/thresholds the P0117 monitor (coolant-temp circuit low). Fixed value -- it sets when that DTC trips, not a live channel." VALUE 0x4000D986 RL_VALUE_UBYTE 0 NO_COMPU_METHOD 0 255 /end CHARACTERISTIC
/begin CHARACTERISTIC CAL_obd_ii_P0118 "Calibration that arms/thresholds the P0118 monitor (coolant-temp circuit high). Fixed value -- it sets when that DTC trips, not a live channel." VALUE 0x4000D987 RL_VALUE_UBYTE 0 NO_COMPU_METHOD 0 255 /end CHARACTERISTIC
/begin CHARACTERISTIC CAL_obd_ii_P2170 "Calibration that arms/thresholds the P2170 monitor (exhaust bypass valve stuck). Fixed value -- it sets when that DTC trips, not a live channel." VALUE 0x4000D988 RL_VALUE_UBYTE 0 NO_COMPU_METHOD 0 255 /end CHARACTERISTIC
/begin CHARACTERISTIC CAL_obd_ii_P2171 "Calibration that arms/thresholds the P2171 monitor (exhaust bypass valve). Fixed value -- it sets when that DTC trips, not a live channel." VALUE 0x4000D989 RL_VALUE_UBYTE 0 NO_COMPU_METHOD 0 255 /end CHARACTERISTIC
/begin CHARACTERISTIC CAL_obd_ii_P0122 "Calibration that arms/thresholds the P0122 monitor (TPS/pedal A circuit low). Fixed value -- it sets when that DTC trips, not a live channel." VALUE 0x4000D98A RL_VALUE_UBYTE 0 NO_COMPU_METHOD 0 255 /end CHARACTERISTIC
/begin CHARACTERISTIC CAL_obd_ii_P0123 "Calibration that arms/thresholds the P0123 monitor (TPS/pedal A circuit high). Fixed value -- it sets when that DTC trips, not a live channel." VALUE 0x4000D98B RL_VALUE_UBYTE 0 NO_COMPU_METHOD 0 255 /end CHARACTERISTIC
/begin CHARACTERISTIC CAL_obd_ii_P2191 "Calibration that arms/thresholds the P2191 monitor (bank1 lean at load). Fixed value -- it sets when that DTC trips, not a live channel." VALUE 0x4000D98C RL_VALUE_UBYTE 0 NO_COMPU_METHOD 0 255 /end CHARACTERISTIC
/begin CHARACTERISTIC CAL_obd_ii_P0128 "Calibration that arms/thresholds the P0128 monitor (coolant below thermostat regulating temp). Fixed value -- it sets when that DTC trips, not a live channel." VALUE 0x4000D98D RL_VALUE_UBYTE 0 NO_COMPU_METHOD 0 255 /end CHARACTERISTIC
/begin CHARACTERISTIC CAL_obd_ii_P0131 "Calibration that arms/thresholds the P0131 monitor (O2 B1S1 low). Fixed value -- it sets when that DTC trips, not a live channel." VALUE 0x4000D98E RL_VALUE_UBYTE 0 NO_COMPU_METHOD 0 255 /end CHARACTERISTIC
/begin CHARACTERISTIC CAL_obd_ii_P0132 "Calibration that arms/thresholds the P0132 monitor (O2 B1S1 high). Fixed value -- it sets when that DTC trips, not a live channel." VALUE 0x4000D98F RL_VALUE_UBYTE 0 NO_COMPU_METHOD 0 255 /end CHARACTERISTIC
/begin CHARACTERISTIC CAL_obd_ii_P0133 "Calibration that arms/thresholds the P0133 monitor (O2 B1S1 slow response). Fixed value -- it sets when that DTC trips, not a live channel." VALUE 0x4000D990 RL_VALUE_UBYTE 0 NO_COMPU_METHOD 0 255 /end CHARACTERISTIC
/begin CHARACTERISTIC CAL_obd_ii_P0134 "Calibration that arms/thresholds the P0134 monitor (O2 B1S1 inactive). Fixed value -- it sets when that DTC trips, not a live channel." VALUE 0x4000D991 RL_VALUE_UBYTE 0 NO_COMPU_METHOD 0 255 /end CHARACTERISTIC
/begin CHARACTERISTIC CAL_obd_ii_P0135 "Calibration that arms/thresholds the P0135 monitor (O2 B1S1 heater). Fixed value -- it sets when that DTC trips, not a live channel." VALUE 0x4000D992 RL_VALUE_UBYTE 0 NO_COMPU_METHOD 0 255 /end CHARACTERISTIC
/begin CHARACTERISTIC CAL_obd_ii_P2193 "Calibration that arms/thresholds the P2193 monitor (bank2 lean at load). Fixed value -- it sets when that DTC trips, not a live channel." VALUE 0x4000D993 RL_VALUE_UBYTE 0 NO_COMPU_METHOD 0 255 /end CHARACTERISTIC
/begin CHARACTERISTIC CAL_obd_ii_P0137 "Calibration that arms/thresholds the P0137 monitor (O2 B1S2 low). Fixed value -- it sets when that DTC trips, not a live channel." VALUE 0x4000D994 RL_VALUE_UBYTE 0 NO_COMPU_METHOD 0 255 /end CHARACTERISTIC
/begin CHARACTERISTIC CAL_obd_ii_P0138 "Calibration that arms/thresholds the P0138 monitor (O2 B1S2 high). Fixed value -- it sets when that DTC trips, not a live channel." VALUE 0x4000D995 RL_VALUE_UBYTE 0 NO_COMPU_METHOD 0 255 /end CHARACTERISTIC
/begin CHARACTERISTIC CAL_obd_ii_P0139 "Calibration that arms/thresholds the P0139 monitor (O2 B1S2 slow response). Fixed value -- it sets when that DTC trips, not a live channel." VALUE 0x4000D996 RL_VALUE_UBYTE 0 NO_COMPU_METHOD 0 255 /end CHARACTERISTIC
/begin CHARACTERISTIC CAL_obd_ii_P0140 "Calibration that arms/thresholds the P0140 monitor (O2 B1S2 inactive). Fixed value -- it sets when that DTC trips, not a live channel." VALUE 0x4000D997 RL_VALUE_UBYTE 0 NO_COMPU_METHOD 0 255 /end CHARACTERISTIC
/begin CHARACTERISTIC CAL_obd_ii_P0141 "Calibration that arms/thresholds the P0141 monitor (O2 B1S2 heater). Fixed value -- it sets when that DTC trips, not a live channel." VALUE 0x4000D998 RL_VALUE_UBYTE 0 NO_COMPU_METHOD 0 255 /end CHARACTERISTIC
/begin CHARACTERISTIC CAL_obd_ii_P0102 "Calibration that arms/thresholds the P0102 monitor (MAF circuit low). Fixed value -- it sets when that DTC trips, not a live channel." VALUE 0x4000D999 RL_VALUE_UBYTE 0 NO_COMPU_METHOD 0 255 /end CHARACTERISTIC
/begin CHARACTERISTIC CAL_obd_ii_P0103 "Calibration that arms/thresholds the P0103 monitor (MAF circuit high). Fixed value -- it sets when that DTC trips, not a live channel." VALUE 0x4000D99A RL_VALUE_UBYTE 0 NO_COMPU_METHOD 0 255 /end CHARACTERISTIC
/begin CHARACTERISTIC CAL_obd_ii_P0101 "Calibration that arms/thresholds the P0101 monitor (MAF rationality). Fixed value -- it sets when that DTC trips, not a live channel." VALUE 0x4000D99B RL_VALUE_UBYTE 0 NO_COMPU_METHOD 0 255 /end CHARACTERISTIC
/begin CHARACTERISTIC CAL_obd_ii_P2122 "Calibration that arms/thresholds the P2122 monitor (pedal D low). Fixed value -- it sets when that DTC trips, not a live channel." VALUE 0x4000D99C RL_VALUE_UBYTE 0 NO_COMPU_METHOD 0 255 /end CHARACTERISTIC
/begin CHARACTERISTIC CAL_obd_ii_P2123 "Calibration that arms/thresholds the P2123 monitor (pedal D high). Fixed value -- it sets when that DTC trips, not a live channel." VALUE 0x4000D99D RL_VALUE_UBYTE 0 NO_COMPU_METHOD 0 255 /end CHARACTERISTIC
/begin CHARACTERISTIC CAL_obd_ii_P2127 "Calibration that arms/thresholds the P2127 monitor (pedal E low). Fixed value -- it sets when that DTC trips, not a live channel." VALUE 0x4000D99E RL_VALUE_UBYTE 0 NO_COMPU_METHOD 0 255 /end CHARACTERISTIC
/begin CHARACTERISTIC CAL_obd_ii_P2128 "Calibration that arms/thresholds the P2128 monitor (pedal E high). Fixed value -- it sets when that DTC trips, not a live channel." VALUE 0x4000D99F RL_VALUE_UBYTE 0 NO_COMPU_METHOD 0 255 /end CHARACTERISTIC
/begin CHARACTERISTIC CAL_obd_ii_P0222 "Calibration that arms/thresholds the P0222 monitor (TPS/pedal B circuit low). Fixed value -- it sets when that DTC trips, not a live channel." VALUE 0x4000D9A0 RL_VALUE_UBYTE 0 NO_COMPU_METHOD 0 255 /end CHARACTERISTIC
/begin CHARACTERISTIC CAL_obd_ii_P0223 "Calibration that arms/thresholds the P0223 monitor (TPS/pedal B circuit high). Fixed value -- it sets when that DTC trips, not a live channel." VALUE 0x4000D9A1 RL_VALUE_UBYTE 0 NO_COMPU_METHOD 0 255 /end CHARACTERISTIC
/begin CHARACTERISTIC CAL_obd_ii_P2135 "Calibration that arms/thresholds the P2135 monitor (TPS A/B correlation). Fixed value -- it sets when that DTC trips, not a live channel." VALUE 0x4000D9A2 RL_VALUE_UBYTE 0 NO_COMPU_METHOD 0 255 /end CHARACTERISTIC
/begin CHARACTERISTIC CAL_obd_ii_P0638 "Calibration that arms/thresholds the P0638 monitor (throttle actuator control rationality bank1). Fixed value -- it sets when that DTC trips, not a live channel." VALUE 0x4000D9A3 RL_VALUE_UBYTE 0 NO_COMPU_METHOD 0 255 /end CHARACTERISTIC
/begin CHARACTERISTIC CAL_obd_ii_P2119 "Calibration that arms/thresholds the P2119 monitor (throttle body rationality). Fixed value -- it sets when that DTC trips, not a live channel." VALUE 0x4000D9A4 RL_VALUE_UBYTE 0 NO_COMPU_METHOD 0 255 /end CHARACTERISTIC
/begin CHARACTERISTIC CAL_obd_ii_P1106 "Calibration that arms/thresholds the P1106 monitor (mfr MAP/baro intermittent). Fixed value -- it sets when that DTC trips, not a live channel." VALUE 0x4000D9A5 RL_VALUE_UBYTE 0 NO_COMPU_METHOD 0 255 /end CHARACTERISTIC
/begin CHARACTERISTIC CAL_obd_ii_P0171 "Calibration that arms/thresholds the P0171 monitor (bank1 too lean). Fixed value -- it sets when that DTC trips, not a live channel." VALUE 0x4000D9A6 RL_VALUE_UBYTE 0 NO_COMPU_METHOD 0 255 /end CHARACTERISTIC
/begin CHARACTERISTIC CAL_obd_ii_P0172 "Calibration that arms/thresholds the P0172 monitor (bank1 too rich). Fixed value -- it sets when that DTC trips, not a live channel." VALUE 0x4000D9A7 RL_VALUE_UBYTE 0 NO_COMPU_METHOD 0 255 /end CHARACTERISTIC
/begin CHARACTERISTIC CAL_obd_ii_P0076 "Calibration that arms/thresholds the P0076 monitor (intake VVT solenoid bank1 low). Fixed value -- it sets when that DTC trips, not a live channel." VALUE 0x4000D9A9 RL_VALUE_UBYTE 0 NO_COMPU_METHOD 0 255 /end CHARACTERISTIC
/begin CHARACTERISTIC CAL_obd_ii_P0077 "Calibration that arms/thresholds the P0077 monitor (intake VVT solenoid bank1 high). Fixed value -- it sets when that DTC trips, not a live channel." VALUE 0x4000D9AA RL_VALUE_UBYTE 0 NO_COMPU_METHOD 0 255 /end CHARACTERISTIC
/begin CHARACTERISTIC CAL_obd_ii_P0261 "Calibration that arms/thresholds the P0261 monitor (injector cyl1 low). Fixed value -- it sets when that DTC trips, not a live channel." VALUE 0x4000D9AB RL_VALUE_UBYTE 0 NO_COMPU_METHOD 0 255 /end CHARACTERISTIC
/begin CHARACTERISTIC CAL_obd_ii_P0262 "Calibration that arms/thresholds the P0262 monitor (injector cyl1 high). Fixed value -- it sets when that DTC trips, not a live channel." VALUE 0x4000D9AC RL_VALUE_UBYTE 0 NO_COMPU_METHOD 0 255 /end CHARACTERISTIC
/begin CHARACTERISTIC CAL_obd_ii_P0264 "Calibration that arms/thresholds the P0264 monitor (injector cyl2 low). Fixed value -- it sets when that DTC trips, not a live channel." VALUE 0x4000D9AD RL_VALUE_UBYTE 0 NO_COMPU_METHOD 0 255 /end CHARACTERISTIC
/begin CHARACTERISTIC CAL_obd_ii_P0265 "Calibration that arms/thresholds the P0265 monitor (injector cyl2 high). Fixed value -- it sets when that DTC trips, not a live channel." VALUE 0x4000D9AE RL_VALUE_UBYTE 0 NO_COMPU_METHOD 0 255 /end CHARACTERISTIC
/begin CHARACTERISTIC CAL_obd_ii_P0267 "Calibration that arms/thresholds the P0267 monitor (injector cyl3 low). Fixed value -- it sets when that DTC trips, not a live channel." VALUE 0x4000D9AF RL_VALUE_UBYTE 0 NO_COMPU_METHOD 0 255 /end CHARACTERISTIC
/begin CHARACTERISTIC CAL_obd_ii_P0268 "Calibration that arms/thresholds the P0268 monitor (injector cyl3 high). Fixed value -- it sets when that DTC trips, not a live channel." VALUE 0x4000D9B0 RL_VALUE_UBYTE 0 NO_COMPU_METHOD 0 255 /end CHARACTERISTIC
/begin CHARACTERISTIC CAL_obd_ii_P0270 "Calibration that arms/thresholds the P0270 monitor (injector cyl4 low). Fixed value -- it sets when that DTC trips, not a live channel." VALUE 0x4000D9B1 RL_VALUE_UBYTE 0 NO_COMPU_METHOD 0 255 /end CHARACTERISTIC
/begin CHARACTERISTIC CAL_obd_ii_P0271 "Calibration that arms/thresholds the P0271 monitor (injector cyl4 high). Fixed value -- it sets when that DTC trips, not a live channel." VALUE 0x4000D9B2 RL_VALUE_UBYTE 0 NO_COMPU_METHOD 0 255 /end CHARACTERISTIC
/begin CHARACTERISTIC CAL_obd_ii_P0273 "Calibration that arms/thresholds the P0273 monitor (injector cyl5 low). Fixed value -- it sets when that DTC trips, not a live channel." VALUE 0x4000D9B3 RL_VALUE_UBYTE 0 NO_COMPU_METHOD 0 255 /end CHARACTERISTIC
/begin CHARACTERISTIC CAL_obd_ii_P0274 "Calibration that arms/thresholds the P0274 monitor (injector cyl5 high). Fixed value -- it sets when that DTC trips, not a live channel." VALUE 0x4000D9B4 RL_VALUE_UBYTE 0 NO_COMPU_METHOD 0 255 /end CHARACTERISTIC
/begin CHARACTERISTIC CAL_obd_ii_P0276 "Calibration that arms/thresholds the P0276 monitor (injector cyl6 low). Fixed value -- it sets when that DTC trips, not a live channel." VALUE 0x4000D9B5 RL_VALUE_UBYTE 0 NO_COMPU_METHOD 0 255 /end CHARACTERISTIC
/begin CHARACTERISTIC CAL_obd_ii_P0277 "Calibration that arms/thresholds the P0277 monitor (injector cyl6 high). Fixed value -- it sets when that DTC trips, not a live channel." VALUE 0x4000D9B6 RL_VALUE_UBYTE 0 NO_COMPU_METHOD 0 255 /end CHARACTERISTIC
/begin CHARACTERISTIC CAL_obd_ii_P0628 "Calibration that arms/thresholds the P0628 monitor (fuel pump control low). Fixed value -- it sets when that DTC trips, not a live channel." VALUE 0x4000D9B7 RL_VALUE_UBYTE 0 NO_COMPU_METHOD 0 255 /end CHARACTERISTIC
/begin CHARACTERISTIC CAL_obd_ii_P0351 "Calibration that arms/thresholds the P0351 monitor (ignition coil 1). Fixed value -- it sets when that DTC trips, not a live channel." VALUE 0x4000D9B8 RL_VALUE_UBYTE 0 NO_COMPU_METHOD 0 255 /end CHARACTERISTIC
/begin CHARACTERISTIC CAL_obd_ii_P0352 "Calibration that arms/thresholds the P0352 monitor (ignition coil 2). Fixed value -- it sets when that DTC trips, not a live channel." VALUE 0x4000D9B9 RL_VALUE_UBYTE 0 NO_COMPU_METHOD 0 255 /end CHARACTERISTIC
/begin CHARACTERISTIC CAL_obd_ii_P0353 "Calibration that arms/thresholds the P0353 monitor (ignition coil 3). Fixed value -- it sets when that DTC trips, not a live channel." VALUE 0x4000D9BA RL_VALUE_UBYTE 0 NO_COMPU_METHOD 0 255 /end CHARACTERISTIC
/begin CHARACTERISTIC CAL_obd_ii_P0354 "Calibration that arms/thresholds the P0354 monitor (ignition coil 4). Fixed value -- it sets when that DTC trips, not a live channel." VALUE 0x4000D9BB RL_VALUE_UBYTE 0 NO_COMPU_METHOD 0 255 /end CHARACTERISTIC
/begin CHARACTERISTIC CAL_obd_ii_P0629 "Calibration that arms/thresholds the P0629 monitor (fuel pump control high). Fixed value -- it sets when that DTC trips, not a live channel." VALUE 0x4000D9BC RL_VALUE_UBYTE 0 NO_COMPU_METHOD 0 255 /end CHARACTERISTIC
/begin CHARACTERISTIC CAL_obd_ii_P0300 "Calibration that arms/thresholds the P0300 monitor (random/multiple misfire). Fixed value -- it sets when that DTC trips, not a live channel." VALUE 0x4000D9BD RL_VALUE_UBYTE 0 NO_COMPU_METHOD 0 255 /end CHARACTERISTIC
/begin CHARACTERISTIC CAL_obd_ii_P0301 "Calibration that arms/thresholds the P0301 monitor (cyl1 misfire). Fixed value -- it sets when that DTC trips, not a live channel." VALUE 0x4000D9BE RL_VALUE_UBYTE 0 NO_COMPU_METHOD 0 255 /end CHARACTERISTIC
/begin CHARACTERISTIC CAL_obd_ii_P0302 "Calibration that arms/thresholds the P0302 monitor (cyl2 misfire). Fixed value -- it sets when that DTC trips, not a live channel." VALUE 0x4000D9BF RL_VALUE_UBYTE 0 NO_COMPU_METHOD 0 255 /end CHARACTERISTIC
/begin CHARACTERISTIC CAL_obd_ii_P0303 "Calibration that arms/thresholds the P0303 monitor (cyl3 misfire). Fixed value -- it sets when that DTC trips, not a live channel." VALUE 0x4000D9C0 RL_VALUE_UBYTE 0 NO_COMPU_METHOD 0 255 /end CHARACTERISTIC
/begin CHARACTERISTIC CAL_obd_ii_P0304 "Calibration that arms/thresholds the P0304 monitor (cyl4 misfire). Fixed value -- it sets when that DTC trips, not a live channel." VALUE 0x4000D9C1 RL_VALUE_UBYTE 0 NO_COMPU_METHOD 0 255 /end CHARACTERISTIC
/begin CHARACTERISTIC CAL_obd_ii_P0305 "Calibration that arms/thresholds the P0305 monitor (cyl5 misfire). Fixed value -- it sets when that DTC trips, not a live channel." VALUE 0x4000D9C2 RL_VALUE_UBYTE 0 NO_COMPU_METHOD 0 255 /end CHARACTERISTIC
/begin CHARACTERISTIC CAL_obd_ii_P0306 "Calibration that arms/thresholds the P0306 monitor (cyl6 misfire). Fixed value -- it sets when that DTC trips, not a live channel." VALUE 0x4000D9C3 RL_VALUE_UBYTE 0 NO_COMPU_METHOD 0 255 /end CHARACTERISTIC
/begin CHARACTERISTIC CAL_obd_ii_P0700 "Calibration that arms/thresholds the P0700 monitor (transmission MIL request). Fixed value -- it sets when that DTC trips, not a live channel." VALUE 0x4000D9C4 RL_VALUE_UBYTE 0 NO_COMPU_METHOD 0 255 /end CHARACTERISTIC
/begin CHARACTERISTIC CAL_obd_ii_P0571 "Calibration that arms/thresholds the P0571 monitor (brake switch). Fixed value -- it sets when that DTC trips, not a live channel." VALUE 0x4000D9C5 RL_VALUE_UBYTE 0 NO_COMPU_METHOD 0 255 /end CHARACTERISTIC
/begin CHARACTERISTIC CAL_obd_ii_P0327 "Calibration that arms/thresholds the P0327 monitor (knock sensor1 low). Fixed value -- it sets when that DTC trips, not a live channel." VALUE 0x4000D9C6 RL_VALUE_UBYTE 0 NO_COMPU_METHOD 0 255 /end CHARACTERISTIC
/begin CHARACTERISTIC CAL_obd_ii_P0328 "Calibration that arms/thresholds the P0328 monitor (knock sensor1 high). Fixed value -- it sets when that DTC trips, not a live channel." VALUE 0x4000D9C7 RL_VALUE_UBYTE 0 NO_COMPU_METHOD 0 255 /end CHARACTERISTIC
/begin CHARACTERISTIC CAL_obd_ii_P0335 "Calibration that arms/thresholds the P0335 monitor (crank position sensor). Fixed value -- it sets when that DTC trips, not a live channel." VALUE 0x4000D9C8 RL_VALUE_UBYTE 0 NO_COMPU_METHOD 0 255 /end CHARACTERISTIC
/begin CHARACTERISTIC CAL_obd_ii_P0826 "Calibration that arms/thresholds the P0826 monitor (shift switch). Fixed value -- it sets when that DTC trips, not a live channel." VALUE 0x4000D9C9 RL_VALUE_UBYTE 0 NO_COMPU_METHOD 0 255 /end CHARACTERISTIC
/begin CHARACTERISTIC CAL_obd_ii_P1301 "Calibration that arms/thresholds the P1301 monitor (mfr misfire (cat/igniter)). Fixed value -- it sets when that DTC trips, not a live channel." VALUE 0x4000D9CA RL_VALUE_UBYTE 0 NO_COMPU_METHOD 0 255 /end CHARACTERISTIC
/begin CHARACTERISTIC CAL_obd_ii_P1302 "Calibration that arms/thresholds the P1302 monitor (mfr misfire). Fixed value -- it sets when that DTC trips, not a live channel." VALUE 0x4000D9CB RL_VALUE_UBYTE 0 NO_COMPU_METHOD 0 255 /end CHARACTERISTIC
/begin CHARACTERISTIC CAL_obd_ii_P0014 "Calibration that arms/thresholds the P0014 monitor (exhaust cam bank1 over-advanced). Fixed value -- it sets when that DTC trips, not a live channel." VALUE 0x4000D9CC RL_VALUE_UBYTE 0 NO_COMPU_METHOD 0 255 /end CHARACTERISTIC
/begin CHARACTERISTIC CAL_obd_ii_P0015 "Calibration that arms/thresholds the P0015 monitor (exhaust cam bank1 retarded). Fixed value -- it sets when that DTC trips, not a live channel." VALUE 0x4000D9CD RL_VALUE_UBYTE 0 NO_COMPU_METHOD 0 255 /end CHARACTERISTIC
/begin CHARACTERISTIC CAL_obd_ii_P0024 "Calibration that arms/thresholds the P0024 monitor (exhaust cam bank2 over-advanced). Fixed value -- it sets when that DTC trips, not a live channel." VALUE 0x4000D9CE RL_VALUE_UBYTE 0 NO_COMPU_METHOD 0 255 /end CHARACTERISTIC
/begin CHARACTERISTIC CAL_obd_ii_P0025 "Calibration that arms/thresholds the P0025 monitor (exhaust cam bank2 retarded). Fixed value -- it sets when that DTC trips, not a live channel." VALUE 0x4000D9CF RL_VALUE_UBYTE 0 NO_COMPU_METHOD 0 255 /end CHARACTERISTIC
/begin CHARACTERISTIC CAL_obd_ii_P0079 "Calibration that arms/thresholds the P0079 monitor (exhaust VVT solenoid bank1 low). Fixed value -- it sets when that DTC trips, not a live channel." VALUE 0x4000D9D0 RL_VALUE_UBYTE 0 NO_COMPU_METHOD 0 255 /end CHARACTERISTIC
/begin CHARACTERISTIC CAL_obd_ii_P0080 "Calibration that arms/thresholds the P0080 monitor (exhaust VVT solenoid bank1 high). Fixed value -- it sets when that DTC trips, not a live channel." VALUE 0x4000D9D1 RL_VALUE_UBYTE 0 NO_COMPU_METHOD 0 255 /end CHARACTERISTIC
/begin CHARACTERISTIC CAL_obd_ii_P0082 "Calibration that arms/thresholds the P0082 monitor (intake VVT solenoid bank2 low). Fixed value -- it sets when that DTC trips, not a live channel." VALUE 0x4000D9D2 RL_VALUE_UBYTE 0 NO_COMPU_METHOD 0 255 /end CHARACTERISTIC
/begin CHARACTERISTIC CAL_obd_ii_P0083 "Calibration that arms/thresholds the P0083 monitor (intake VVT solenoid bank2 high). Fixed value -- it sets when that DTC trips, not a live channel." VALUE 0x4000D9D3 RL_VALUE_UBYTE 0 NO_COMPU_METHOD 0 255 /end CHARACTERISTIC
/begin CHARACTERISTIC CAL_obd_ii_P0420 "Calibration that arms/thresholds the P0420 monitor (catalyst efficiency bank1). Fixed value -- it sets when that DTC trips, not a live channel." VALUE 0x4000D9D4 RL_VALUE_UBYTE 0 NO_COMPU_METHOD 0 255 /end CHARACTERISTIC
/begin CHARACTERISTIC CAL_obd_ii_P0085 "Calibration that arms/thresholds the P0085 monitor (exhaust VVT solenoid bank2 low). Fixed value -- it sets when that DTC trips, not a live channel." VALUE 0x4000D9D5 RL_VALUE_UBYTE 0 NO_COMPU_METHOD 0 255 /end CHARACTERISTIC
/begin CHARACTERISTIC CAL_obd_ii_P0086 "Calibration that arms/thresholds the P0086 monitor (exhaust VVT solenoid bank2 high). Fixed value -- it sets when that DTC trips, not a live channel." VALUE 0x4000D9D6 RL_VALUE_UBYTE 0 NO_COMPU_METHOD 0 255 /end CHARACTERISTIC
/begin CHARACTERISTIC CAL_obd_ii_P0827 "Calibration that arms/thresholds the P0827 monitor (shift switch low). Fixed value -- it sets when that DTC trips, not a live channel." VALUE 0x4000D9D7 RL_VALUE_UBYTE 0 NO_COMPU_METHOD 0 255 /end CHARACTERISTIC
/begin CHARACTERISTIC CAL_obd_ii_P1809 "Calibration that arms/thresholds the P1809 monitor (mfr transmission). Fixed value -- it sets when that DTC trips, not a live channel." VALUE 0x4000D9D8 RL_VALUE_UBYTE 0 NO_COMPU_METHOD 0 255 /end CHARACTERISTIC
/begin CHARACTERISTIC CAL_obd_ii_P0430 "Calibration that arms/thresholds the P0430 monitor (catalyst efficiency bank2). Fixed value -- it sets when that DTC trips, not a live channel." VALUE 0x4000D9D9 RL_VALUE_UBYTE 0 NO_COMPU_METHOD 0 255 /end CHARACTERISTIC
/begin CHARACTERISTIC CAL_obd_ii_P0355 "Calibration that arms/thresholds the P0355 monitor (ignition coil 5). Fixed value -- it sets when that DTC trips, not a live channel." VALUE 0x4000D9DA RL_VALUE_UBYTE 0 NO_COMPU_METHOD 0 255 /end CHARACTERISTIC
/begin CHARACTERISTIC CAL_obd_ii_P0356 "Calibration that arms/thresholds the P0356 monitor (ignition coil 6). Fixed value -- it sets when that DTC trips, not a live channel." VALUE 0x4000D9DB RL_VALUE_UBYTE 0 NO_COMPU_METHOD 0 255 /end CHARACTERISTIC
/begin CHARACTERISTIC CAL_obd_ii_P0579 "Calibration that arms/thresholds the P0579 monitor (cruise switch rationality). Fixed value -- it sets when that DTC trips, not a live channel." VALUE 0x4000D9DC RL_VALUE_UBYTE 0 NO_COMPU_METHOD 0 255 /end CHARACTERISTIC
/begin CHARACTERISTIC CAL_obd_ii_P1104 "Calibration that arms/thresholds the P1104 monitor (mfr MAF/intake). Fixed value -- it sets when that DTC trips, not a live channel." VALUE 0x4000D9DD RL_VALUE_UBYTE 0 NO_COMPU_METHOD 0 255 /end CHARACTERISTIC
/begin CHARACTERISTIC CAL_obd_ii_P0828 "Calibration that arms/thresholds the P0828 monitor (shift switch high). Fixed value -- it sets when that DTC trips, not a live channel." VALUE 0x4000D9DE RL_VALUE_UBYTE 0 NO_COMPU_METHOD 0 255 /end CHARACTERISTIC
/begin CHARACTERISTIC CAL_obd_ii_P0441 "Calibration that arms/thresholds the P0441 monitor (EVAP purge flow). Fixed value -- it sets when that DTC trips, not a live channel." VALUE 0x4000D9DF RL_VALUE_UBYTE 0 NO_COMPU_METHOD 0 255 /end CHARACTERISTIC
/begin CHARACTERISTIC CAL_obd_ii_P0442 "Calibration that arms/thresholds the P0442 monitor (EVAP small leak). Fixed value -- it sets when that DTC trips, not a live channel." VALUE 0x4000D9E0 RL_VALUE_UBYTE 0 NO_COMPU_METHOD 0 255 /end CHARACTERISTIC
/begin CHARACTERISTIC CAL_obd_ii_P050B "Calibration: OBD P050B. Tunable map/constant (not a live channel); adjust to change this behavior." VALUE 0x4000D9E1 RL_VALUE_UBYTE 0 NO_COMPU_METHOD 0 255 /end CHARACTERISTIC
/begin CHARACTERISTIC CAL_obd_ii_P0444 "Calibration that arms/thresholds the P0444 monitor (EVAP purge valve open). Fixed value -- it sets when that DTC trips, not a live channel." VALUE 0x4000D9E2 RL_VALUE_UBYTE 0 NO_COMPU_METHOD 0 255 /end CHARACTERISTIC
/begin CHARACTERISTIC CAL_obd_ii_P0445 "Calibration that arms/thresholds the P0445 monitor (EVAP purge valve shorted). Fixed value -- it sets when that DTC trips, not a live channel." VALUE 0x4000D9E3 RL_VALUE_UBYTE 0 NO_COMPU_METHOD 0 255 /end CHARACTERISTIC
/begin CHARACTERISTIC CAL_obd_ii_P0446 "Calibration that arms/thresholds the P0446 monitor (EVAP vent control). Fixed value -- it sets when that DTC trips, not a live channel." VALUE 0x4000D9E4 RL_VALUE_UBYTE 0 NO_COMPU_METHOD 0 255 /end CHARACTERISTIC
/begin CHARACTERISTIC CAL_obd_ii_P0447 "Calibration that arms/thresholds the P0447 monitor (EVAP vent open). Fixed value -- it sets when that DTC trips, not a live channel." VALUE 0x4000D9E5 RL_VALUE_UBYTE 0 NO_COMPU_METHOD 0 255 /end CHARACTERISTIC
/begin CHARACTERISTIC CAL_obd_ii_P0448 "Calibration that arms/thresholds the P0448 monitor (EVAP vent shorted). Fixed value -- it sets when that DTC trips, not a live channel." VALUE 0x4000D9E6 RL_VALUE_UBYTE 0 NO_COMPU_METHOD 0 255 /end CHARACTERISTIC
/begin CHARACTERISTIC CAL_obd_ii_P050A "Calibration: OBD P050A. Tunable map/constant (not a live channel); adjust to change this behavior." VALUE 0x4000D9E7 RL_VALUE_UBYTE 0 NO_COMPU_METHOD 0 255 /end CHARACTERISTIC
/begin CHARACTERISTIC CAL_obd_ii_P0451 "Calibration that arms/thresholds the P0451 monitor (EVAP pressure sensor rationality). Fixed value -- it sets when that DTC trips, not a live channel." VALUE 0x4000D9E8 RL_VALUE_UBYTE 0 NO_COMPU_METHOD 0 255 /end CHARACTERISTIC
/begin CHARACTERISTIC CAL_obd_ii_P0452 "Calibration that arms/thresholds the P0452 monitor (EVAP pressure sensor low). Fixed value -- it sets when that DTC trips, not a live channel." VALUE 0x4000D9E9 RL_VALUE_UBYTE 0 NO_COMPU_METHOD 0 255 /end CHARACTERISTIC
/begin CHARACTERISTIC CAL_obd_ii_P0453 "Calibration that arms/thresholds the P0453 monitor (EVAP pressure sensor high). Fixed value -- it sets when that DTC trips, not a live channel." VALUE 0x4000D9EA RL_VALUE_UBYTE 0 NO_COMPU_METHOD 0 255 /end CHARACTERISTIC
/begin CHARACTERISTIC CAL_obd_ii_P0480 "Calibration that arms/thresholds the P0480 monitor (cooling fan1 relay). Fixed value -- it sets when that DTC trips, not a live channel." VALUE 0x4000D9EB RL_VALUE_UBYTE 0 NO_COMPU_METHOD 0 255 /end CHARACTERISTIC
/begin CHARACTERISTIC CAL_obd_ii_P0481 "Calibration that arms/thresholds the P0481 monitor (cooling fan2 relay). Fixed value -- it sets when that DTC trips, not a live channel." VALUE 0x4000D9EC RL_VALUE_UBYTE 0 NO_COMPU_METHOD 0 255 /end CHARACTERISTIC
/begin CHARACTERISTIC CAL_obd_ii_P0341 "Calibration that arms/thresholds the P0341 monitor (cam position sensor A rationality). Fixed value -- it sets when that DTC trips, not a live channel." VALUE 0x4000D9ED RL_VALUE_UBYTE 0 NO_COMPU_METHOD 0 255 /end CHARACTERISTIC
/begin CHARACTERISTIC CAL_obd_ii_P0346 "Calibration that arms/thresholds the P0346 monitor (cam position sensor bank2 rationality). Fixed value -- it sets when that DTC trips, not a live channel." VALUE 0x4000D9EE RL_VALUE_UBYTE 0 NO_COMPU_METHOD 0 255 /end CHARACTERISTIC
/begin CHARACTERISTIC CAL_obd_ii_P0366 "Calibration that arms/thresholds the P0366 monitor (cam position sensor B bank1). Fixed value -- it sets when that DTC trips, not a live channel." VALUE 0x4000D9EF RL_VALUE_UBYTE 0 NO_COMPU_METHOD 0 255 /end CHARACTERISTIC
/begin CHARACTERISTIC CAL_obd_ii_P0391 "Calibration that arms/thresholds the P0391 monitor (cam position sensor B bank2). Fixed value -- it sets when that DTC trips, not a live channel." VALUE 0x4000D9F0 RL_VALUE_UBYTE 0 NO_COMPU_METHOD 0 255 /end CHARACTERISTIC
/begin CHARACTERISTIC CAL_obd_ii_P0482 "Calibration that arms/thresholds the P0482 monitor (cooling fan3 relay). Fixed value -- it sets when that DTC trips, not a live channel." VALUE 0x4000D9F1 RL_VALUE_UBYTE 0 NO_COMPU_METHOD 0 255 /end CHARACTERISTIC
/begin CHARACTERISTIC CAL_obd_ii_P0461 "Calibration that arms/thresholds the P0461 monitor (fuel level sensor rationality). Fixed value -- it sets when that DTC trips, not a live channel." VALUE 0x4000D9F2 RL_VALUE_UBYTE 0 NO_COMPU_METHOD 0 255 /end CHARACTERISTIC
/begin CHARACTERISTIC CAL_obd_ii_P0462 "Calibration that arms/thresholds the P0462 monitor (fuel level sensor low). Fixed value -- it sets when that DTC trips, not a live channel." VALUE 0x4000D9F3 RL_VALUE_UBYTE 0 NO_COMPU_METHOD 0 255 /end CHARACTERISTIC
/begin CHARACTERISTIC CAL_obd_ii_P0463 "Calibration that arms/thresholds the P0463 monitor (fuel level sensor high). Fixed value -- it sets when that DTC trips, not a live channel." VALUE 0x4000D9F4 RL_VALUE_UBYTE 0 NO_COMPU_METHOD 0 255 /end CHARACTERISTIC
/begin CHARACTERISTIC CAL_obd_ii_P0523 "Calibration that arms/thresholds the P0523 monitor (oil pressure sensor/switch high). Fixed value -- it sets when that DTC trips, not a live channel." VALUE 0x4000D9F5 RL_VALUE_UBYTE 0 NO_COMPU_METHOD 0 255 /end CHARACTERISTIC
/begin CHARACTERISTIC CAL_obd_ii_P0563 "Calibration that arms/thresholds the P0563 monitor (system voltage high). Fixed value -- it sets when that DTC trips, not a live channel." VALUE 0x4000D9F6 RL_VALUE_UBYTE 0 NO_COMPU_METHOD 0 255 /end CHARACTERISTIC
/begin CHARACTERISTIC CAL_obd_ii_P0562 "Calibration that arms/thresholds the P0562 monitor (system voltage low). Fixed value -- it sets when that DTC trips, not a live channel." VALUE 0x4000D9F7 RL_VALUE_UBYTE 0 NO_COMPU_METHOD 0 255 /end CHARACTERISTIC
/begin CHARACTERISTIC CAL_obd_ii_P0685 "Calibration that arms/thresholds the P0685 monitor (ECU power relay). Fixed value -- it sets when that DTC trips, not a live channel." VALUE 0x4000D9F8 RL_VALUE_UBYTE 0 NO_COMPU_METHOD 0 255 /end CHARACTERISTIC
/begin CHARACTERISTIC CAL_obd_ii_P0610 "Calibration that arms/thresholds the P0610 monitor (vehicle options error). Fixed value -- it sets when that DTC trips, not a live channel." VALUE 0x4000D9F9 RL_VALUE_UBYTE 0 NO_COMPU_METHOD 0 255 /end CHARACTERISTIC
/begin CHARACTERISTIC CAL_obd_ii_P0646 "Calibration that arms/thresholds the P0646 monitor (A/C clutch relay low). Fixed value -- it sets when that DTC trips, not a live channel." VALUE 0x4000D9FA RL_VALUE_UBYTE 0 NO_COMPU_METHOD 0 255 /end CHARACTERISTIC
/begin CHARACTERISTIC CAL_obd_ii_P0647 "Calibration that arms/thresholds the P0647 monitor (A/C clutch relay high). Fixed value -- it sets when that DTC trips, not a live channel." VALUE 0x4000D9FB RL_VALUE_UBYTE 0 NO_COMPU_METHOD 0 255 /end CHARACTERISTIC
/begin CHARACTERISTIC CAL_obd_ii_P0500 "Calibration that arms/thresholds the P0500 monitor (vehicle speed sensor). Fixed value -- it sets when that DTC trips, not a live channel." VALUE 0x4000D9FC RL_VALUE_UBYTE 0 NO_COMPU_METHOD 0 255 /end CHARACTERISTIC
/begin CHARACTERISTIC CAL_obd_ii_P0506 "Calibration that arms/thresholds the P0506 monitor (idle speed too low). Fixed value -- it sets when that DTC trips, not a live channel." VALUE 0x4000D9FD RL_VALUE_UBYTE 0 NO_COMPU_METHOD 0 255 /end CHARACTERISTIC
/begin CHARACTERISTIC CAL_obd_ii_P0507 "Calibration that arms/thresholds the P0507 monitor (idle speed too high). Fixed value -- it sets when that DTC trips, not a live channel." VALUE 0x4000D9FE RL_VALUE_UBYTE 0 NO_COMPU_METHOD 0 255 /end CHARACTERISTIC
/begin CHARACTERISTIC CAL_obd_ii_P1113 "Calibration that arms/thresholds the P1113 monitor (mfr IAT). Fixed value -- it sets when that DTC trips, not a live channel." VALUE 0x4000D9FF RL_VALUE_UBYTE 0 NO_COMPU_METHOD 0 255 /end CHARACTERISTIC
/begin CHARACTERISTIC CAL_obd_ii_P0661 "Calibration that arms/thresholds the P0661 monitor (intake manifold runner (VIMS) control low). Fixed value -- it sets when that DTC trips, not a live channel." VALUE 0x4000DA00 RL_VALUE_UBYTE 0 NO_COMPU_METHOD 0 255 /end CHARACTERISTIC
/begin CHARACTERISTIC CAL_obd_ii_P0662 "Calibration that arms/thresholds the P0662 monitor (intake manifold runner (VIMS) control high). Fixed value -- it sets when that DTC trips, not a live channel." VALUE 0x4000DA01 RL_VALUE_UBYTE 0 NO_COMPU_METHOD 0 255 /end CHARACTERISTIC
/begin CHARACTERISTIC CAL_obd_ii_P0616 "Calibration that arms/thresholds the P0616 monitor (starter relay low). Fixed value -- it sets when that DTC trips, not a live channel." VALUE 0x4000DA02 RL_VALUE_UBYTE 0 NO_COMPU_METHOD 0 255 /end CHARACTERISTIC
/begin CHARACTERISTIC CAL_obd_ii_P0617 "Calibration that arms/thresholds the P0617 monitor (starter relay high). Fixed value -- it sets when that DTC trips, not a live channel." VALUE 0x4000DA03 RL_VALUE_UBYTE 0 NO_COMPU_METHOD 0 255 /end CHARACTERISTIC
/begin CHARACTERISTIC CAL_obd_ii_P0630 "Calibration that arms/thresholds the P0630 monitor (VIN not programmed). Fixed value -- it sets when that DTC trips, not a live channel." VALUE 0x4000DA04 RL_VALUE_UBYTE 0 NO_COMPU_METHOD 0 255 /end CHARACTERISTIC
/end MODULE
/end PROJECT
