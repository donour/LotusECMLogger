ASAP2_VERSION 1 61
/begin PROJECT C132E0278 "Lotus T6 C132E0278"
/begin HEADER "" VERSION "generated v1" /end HEADER
/begin MODULE C132E0278 ""
/begin MOD_COMMON "" BYTE_ORDER MSB_FIRST ALIGNMENT_BYTE 1 ALIGNMENT_WORD 2 ALIGNMENT_LONG 4 /end MOD_COMMON
/begin RECORD_LAYOUT RL_VALUE_UBYTE FNC_VALUES 1 UBYTE ROW_DIR DIRECT /end RECORD_LAYOUT
/begin RECORD_LAYOUT RL_AXIS_UBYTE AXIS_PTS_X 1 UBYTE INDEX_INCR DIRECT /end RECORD_LAYOUT
/begin RECORD_LAYOUT RL_VALUE_UWORD FNC_VALUES 1 UWORD ROW_DIR DIRECT /end RECORD_LAYOUT
/begin RECORD_LAYOUT RL_AXIS_UWORD AXIS_PTS_X 1 UWORD INDEX_INCR DIRECT /end RECORD_LAYOUT
/begin RECORD_LAYOUT RL_VALUE_SWORD FNC_VALUES 1 SWORD ROW_DIR DIRECT /end RECORD_LAYOUT
/begin COMPU_METHOD CM_i16_pressure_mbar "i16_pressure_mbar" RAT_FUNC "%8.0" "mbar" COEFFS 0 1 0 0 0 1 /end COMPU_METHOD
/begin COMPU_METHOD CM_u16_afr_1_100 "u16_afr_1/100" RAT_FUNC "%10.2" "AFR" COEFFS 0 1 0 0 0 0.01 /end COMPU_METHOD
/begin COMPU_METHOD CM_u16_factor_1_1000 "u16_factor_1/1000" RAT_FUNC "%9.1" "%" COEFFS 0 1 0 0 0 0.1 /end COMPU_METHOD
/begin COMPU_METHOD CM_u16_factor_1_10000 "u16_factor_1/10000" RAT_FUNC "%10.2" "%" COEFFS 0 1 0 0 0 0.01 /end COMPU_METHOD
/begin COMPU_METHOD CM_u16_factor_1_1023 "u16_factor_1/1023" RAT_FUNC "%12.4" "%" COEFFS 0 1 0 0 0 0.0977517106549365 /end COMPU_METHOD
/begin COMPU_METHOD CM_u16_flow_10mg_s "u16_flow_10mg/s" RAT_FUNC "%8.0" "mg/s" COEFFS 0 1 0 0 0 10 /end COMPU_METHOD
/begin COMPU_METHOD CM_u16_mass_g "u16_mass_g" RAT_FUNC "%8.0" "g" COEFFS 0 1 0 0 0 1 /end COMPU_METHOD
/begin COMPU_METHOD CM_u16_rspeed_1_4rpm "u16_rspeed_1/4rpm" RAT_FUNC "%10.2" "rpm" COEFFS 0 1 0 0 0 0.25 /end COMPU_METHOD
/begin COMPU_METHOD CM_u16_time_10us "u16_time_10us" RAT_FUNC "%8.0" "us" COEFFS 0 1 0 0 0 10 /end COMPU_METHOD
/begin COMPU_METHOD CM_u16_voltage_5_1023v "u16_voltage_5/1023v" RAT_FUNC "%12.4" "V" COEFFS 0 1 0 0 0 0.00488758553274682 /end COMPU_METHOD
/begin COMPU_METHOD CM_u8_angle_1_4deg "u8_angle_1/4deg" RAT_FUNC "%10.2" "deg" COEFFS 0 1 0 0 0 0.25 /end COMPU_METHOD
/begin COMPU_METHOD CM_u8_factor_1_100 "u8_factor_1/100" RAT_FUNC "%8.0" "%" COEFFS 0 1 0 0 0 1 /end COMPU_METHOD
/begin COMPU_METHOD CM_u8_factor_1_255 "u8_factor_1/255" RAT_FUNC "%12.4" "%" COEFFS 0 1 0 0 0 0.392156862745098 /end COMPU_METHOD
/begin COMPU_METHOD CM_u8_factor_1_256 "u8_factor_1/256" RAT_FUNC "%12.4" "%" COEFFS 0 1 0 0 0 0.390625 /end COMPU_METHOD
/begin COMPU_METHOD CM_u8_factor_1_2560 "u8_factor_1/2560" RAT_FUNC "%12.4" "%" COEFFS 0 1 0 0 0 0.0390625 /end COMPU_METHOD
/begin COMPU_METHOD CM_u8_flow_100mg_s "u8_flow_100mg/s" RAT_FUNC "%8.0" "mg/s" COEFFS 0 1 0 0 0 100 /end COMPU_METHOD
/begin COMPU_METHOD CM_u8_flow_160mg_s "u8_flow_160mg/s" RAT_FUNC "%8.0" "mg/s" COEFFS 0 1 0 0 0 160 /end COMPU_METHOD
/begin COMPU_METHOD CM_u8_flow_200mg_s "u8_flow_200mg/s" RAT_FUNC "%8.0" "mg/s" COEFFS 0 1 0 0 0 200 /end COMPU_METHOD
/begin COMPU_METHOD CM_u8_flow_500mg_s "u8_flow_500mg/s" RAT_FUNC "%8.0" "mg/s" COEFFS 0 1 0 0 0 500 /end COMPU_METHOD
/begin COMPU_METHOD CM_u8_flow_g_s "u8_flow_g/s" RAT_FUNC "%8.0" "g/s" COEFFS 0 1 0 0 0 1 /end COMPU_METHOD
/begin COMPU_METHOD CM_u8_load_4mg_stroke "u8_load_4mg/stroke" RAT_FUNC "%8.0" "mg/stroke" COEFFS 0 1 0 0 0 4 /end COMPU_METHOD
/begin COMPU_METHOD CM_u8_load_mg_stroke "u8_load_mg/stroke" RAT_FUNC "%8.0" "mg/stroke" COEFFS 0 1 0 0 0 1 /end COMPU_METHOD
/begin COMPU_METHOD CM_u8_mass_5g "u8_mass_5g" RAT_FUNC "%8.0" "g" COEFFS 0 1 0 0 0 5 /end COMPU_METHOD
/begin COMPU_METHOD CM_u8_mass_64g "u8_mass_64g" RAT_FUNC "%8.0" "g" COEFFS 0 1 0 0 0 64 /end COMPU_METHOD
/begin COMPU_METHOD CM_u8_pressure_1_10mbar "u8_pressure_1/10mbar" RAT_FUNC "%9.1" "mbar" COEFFS 0 1 0 0 0 0.1 /end COMPU_METHOD
/begin COMPU_METHOD CM_u8_pressure_4mbar "u8_pressure_4mbar" RAT_FUNC "%8.0" "mbar" COEFFS 0 1 0 0 0 4 /end COMPU_METHOD
/begin COMPU_METHOD CM_u8_rspeed_125_4_500rpm "u8_rspeed_125/4+500rpm" RAT_FUNC "%10.2" "rpm" COEFFS 0 1 -500 0 0 31.25 /end COMPU_METHOD
/begin COMPU_METHOD CM_u8_rspeed_2rpm "u8_rspeed_2rpm" RAT_FUNC "%8.0" "rpm" COEFFS 0 1 0 0 0 2 /end COMPU_METHOD
/begin COMPU_METHOD CM_u8_rspeed_50rpm "u8_rspeed_50rpm" RAT_FUNC "%8.0" "rpm" COEFFS 0 1 0 0 0 50 /end COMPU_METHOD
/begin COMPU_METHOD CM_u8_rspeed_rpm "u8_rspeed_rpm" RAT_FUNC "%8.0" "rpm" COEFFS 0 1 0 0 0 1 /end COMPU_METHOD
/begin COMPU_METHOD CM_u8_speed_kph "u8_speed_kph" RAT_FUNC "%8.0" "km/h" COEFFS 0 1 0 0 0 1 /end COMPU_METHOD
/begin COMPU_METHOD CM_u8_temp_5_8_40c "u8_temp_5/8-40c" RAT_FUNC "%11.3" "°C" COEFFS 0 1 40 0 0 0.625 /end COMPU_METHOD
/begin COMPU_METHOD CM_u8_tempdelta_5_8c "u8_tempdelta_5/8c" RAT_FUNC "%11.3" "°C" COEFFS 0 1 0 0 0 0.625 /end COMPU_METHOD
/begin COMPU_METHOD CM_u8_time_100ms "u8_time_100ms" RAT_FUNC "%8.0" "ms" COEFFS 0 1 0 0 0 100 /end COMPU_METHOD
/begin COMPU_METHOD CM_u8_time_10s "u8_time_10s" RAT_FUNC "%8.0" "s" COEFFS 0 1 0 0 0 10 /end COMPU_METHOD
/begin COMPU_METHOD CM_u8_time_25ms "u8_time_25ms" RAT_FUNC "%8.0" "ms" COEFFS 0 1 0 0 0 25 /end COMPU_METHOD
/begin COMPU_METHOD CM_u8_time_5ms "u8_time_5ms" RAT_FUNC "%8.0" "ms" COEFFS 0 1 0 0 0 5 /end COMPU_METHOD
/begin COMPU_METHOD CM_u8_time_ms "u8_time_ms" RAT_FUNC "%8.0" "ms" COEFFS 0 1 0 0 0 1 /end COMPU_METHOD
/begin COMPU_METHOD CM_u8_time_s "u8_time_s" RAT_FUNC "%8.0" "s" COEFFS 0 1 0 0 0 1 /end COMPU_METHOD
/begin COMPU_METHOD CM_u8_time_us "u8_time_us" RAT_FUNC "%8.0" "us" COEFFS 0 1 0 0 0 1 /end COMPU_METHOD
/begin COMPU_METHOD CM_u8_torque_nm "u8_torque_nm" RAT_FUNC "%8.0" "Nm" COEFFS 0 1 0 0 0 1 /end COMPU_METHOD
/begin COMPU_METHOD CM_u8_volume_1_10gallon "u8_volume_1/10gallon" RAT_FUNC "%9.1" "gallon" COEFFS 0 1 0 0 0 0.1 /end COMPU_METHOD
/begin CHARACTERISTIC CAL_obd_ii_countdown_unknown "Calibration: OBD countdown; u16_time_100ms timer = cal*10." VALUE 0x40008699 RL_VALUE_UBYTE 0 CM_u8_time_s 0 255 /end CHARACTERISTIC
/begin CHARACTERISTIC CAL_obd_ii_readiness_bit3_enable "Calibration: OBD monitor-pass bit 3 enable (stock 0xFF = true)." VALUE 0x400086D6 RL_VALUE_UBYTE 0 NO_COMPU_METHOD 0 255 /end CHARACTERISTIC
/begin CHARACTERISTIC CAL_obd_ii_idle_air_output_limit "Calibration: purge enable when obd_ii_idle_air_output > cal*10. (0091 0x40008ecf)" VALUE 0x400086FF RL_VALUE_UBYTE 0 CM_u8_flow_100mg_s 0 25500 /end CHARACTERISTIC
/begin CHARACTERISTIC CAL_obd_ii_idle_air_output_threshold "Calibration: purge disable when obd_ii_idle_air_output < cal*10 (hysteresis low side). (0091 0x40008ed0)" VALUE 0x40008700 RL_VALUE_UBYTE 0 CM_u8_flow_100mg_s 0 25500 /end CHARACTERISTIC
/begin CHARACTERISTIC CAL_obd_ii_o2_tps_transient_threshold "u8_factor_1/1023" VALUE 0x4000872E RL_VALUE_UBYTE 0 CM_u16_factor_1_1023 0 24.9266862170088 /end CHARACTERISTIC
/begin CHARACTERISTIC CAL_obd_ii_o2_tps_transient_settle_ticks "Calibration: catalyst-monitor O2 filter hold-off after TPS transient. (0091 0x40008f00)" VALUE 0x40008730 RL_VALUE_UWORD 0 CM_u8_time_5ms 0 327675 /end CHARACTERISTIC
/begin CHARACTERISTIC CAL_obd_ii_o2_response_load_stability_max "Calibration: O2 response load-stability max (vs load in mg/stroke)." VALUE 0x400087CA RL_VALUE_UBYTE 0 CM_u8_load_mg_stroke 0 255 /end CHARACTERISTIC
/begin CHARACTERISTIC CAL_obd_ii_o2_response_alphaN_blackout "Calibration: catalyst monitor O2 response blackout after alpha-N. (0091 0x40008f9b)" VALUE 0x400087CB RL_VALUE_UBYTE 0 CM_u8_time_5ms 0 1275 /end CHARACTERISTIC
/begin CHARACTERISTIC CAL_obd_ii_commanded_evap_purge_max "uint8_t" VALUE 0x40008802 RL_VALUE_UBYTE 0 NO_COMPU_METHOD 0 255 /end CHARACTERISTIC
/begin CHARACTERISTIC CAL_obd_ii_commanded_evap_purge_min "uint8_t" VALUE 0x40008803 RL_VALUE_UBYTE 0 NO_COMPU_METHOD 0 255 /end CHARACTERISTIC
/begin CHARACTERISTIC CAL_obd_ii_diag_unknown "Calibration: OBD diagnostic enable (tested != 0 with CAL_obd_ii_standards_supported)." VALUE 0x400088E6 RL_VALUE_UBYTE 0 NO_COMPU_METHOD 0 255 /end CHARACTERISTIC
/begin CHARACTERISTIC CAL_obd_ii_coolant_warmup_thresholds "Calibration: OBD warm-up coolant thresholds (vs coolant_temp)." VAL_BLK 0x4000C9C4 RL_VALUE_UBYTE 0 CM_u8_temp_5_8_40c -40 119.375 NUMBER 2 /end CHARACTERISTIC
/begin CHARACTERISTIC CAL_obd_ii_monitors_completed_min "Calibration: monitors completed this drive cycle threshold." VALUE 0x4000C9C6 RL_VALUE_UBYTE 0 NO_COMPU_METHOD 0 255 /end CHARACTERISTIC
/begin CHARACTERISTIC CAL_obd_ii_similar_cond_load_window "uint8_t" VALUE 0x4000C9C7 RL_VALUE_UBYTE 0 NO_COMPU_METHOD 0 255 /end CHARACTERISTIC
/begin CHARACTERISTIC CAL_obd_ii_similar_cond_load_tol "Calibration: OBD similar-conditions load tolerance. (0091 0x4000d198)" VALUE 0x4000C9C8 RL_VALUE_UBYTE 0 CM_u8_factor_1_255 0 100 /end CHARACTERISTIC
/begin CHARACTERISTIC CAL_obd_ii_cat_monitor_maf_min "u8_flow_500mg/s" VALUE 0x4000C9C9 RL_VALUE_UBYTE 0 CM_u8_flow_500mg_s 0 127500 /end CHARACTERISTIC
/begin CHARACTERISTIC CAL_obd_ii_similar_cond_rpm_tol "Calibration: OBD similar-conditions rpm tolerance. (0091 0x4000d19a)" VALUE 0x4000C9CA RL_VALUE_UWORD 0 CM_u16_rspeed_1_4rpm 0 16383.75 /end CHARACTERISTIC
/begin CHARACTERISTIC CAL_obd_ii_similar_cond_debounce_reload "Calibration: OBD similar-conditions debounce. (0091 0x4000d19c)" VALUE 0x4000C9CC RL_VALUE_UWORD 0 CM_u8_time_5ms 0 327675 /end CHARACTERISTIC
/begin CHARACTERISTIC CAL_obd_ii_o2_lean_period_excess_max "u16_time_5ms" VALUE 0x4000C9CE RL_VALUE_UWORD 0 CM_u8_time_5ms 0 327675 /end CHARACTERISTIC
/begin CHARACTERISTIC CAL_obd_ii_o2_rich_period_excess_max "u16_time_5ms" VALUE 0x4000C9D0 RL_VALUE_UWORD 0 CM_u8_time_5ms 0 327675 /end CHARACTERISTIC
/begin CHARACTERISTIC CAL_misfire_inhibit_tps_rate_declutched "Calibration: misfire detection inhibited above this TPS rate (declutched). (0091 0x4000d1a2)" VALUE 0x4000C9D2 RL_VALUE_UBYTE 0 CM_u16_factor_1_1023 0 24.9266862170088 /end CHARACTERISTIC
/begin CHARACTERISTIC CAL_misfire_inhibit_tps_rate_pos "Calibration: misfire inhibit, positive TPS rate. (0091 0x4000d1a3)" VALUE 0x4000C9D3 RL_VALUE_UBYTE 0 CM_u16_factor_1_1023 0 24.9266862170088 /end CHARACTERISTIC
/begin CHARACTERISTIC CAL_misfire_inhibit_tps_rate_neg "Calibration: misfire inhibit, negative TPS rate. (0091 0x4000d1a4)" VALUE 0x4000C9D4 RL_VALUE_UBYTE 0 CM_u16_factor_1_1023 0 24.9266862170088 /end CHARACTERISTIC
/begin CHARACTERISTIC CAL_obd_ii_monitor_coolant_min "Calibration: oil-pressure/monitor logic needs coolant > this. 0278-only." VALUE 0x4000C9D5 RL_VALUE_UBYTE 0 CM_u8_temp_5_8_40c -40 119.375 /end CHARACTERISTIC
/begin CHARACTERISTIC CAL_obd_ii_monitor_debounce_cycles "Calibration: speed/timing monitor debounce reload." VALUE 0x4000C9D9 RL_VALUE_UBYTE 0 NO_COMPU_METHOD 0 255 /end CHARACTERISTIC
/begin CHARACTERISTIC CAL_obd_ii_maf_adc_high_limit "Calibration: MAF ADC high fault limit. (0091 0x4000d1aa CAL_obd_ii_adc_maf_unknown1)" VALUE 0x4000C9DA RL_VALUE_UWORD 0 CM_u16_voltage_5_1023v 0 320.307917888563 /end CHARACTERISTIC
/begin CHARACTERISTIC CAL_obd_ii_maf_adc_low_limit "Calibration: MAF ADC low fault limit. (0091 0x4000d1ac, misnamed CAL_obd_ii_monitor_debounce_cycles)" VALUE 0x4000C9DC RL_VALUE_UWORD 0 CM_u16_voltage_5_1023v 0 320.307917888563 /end CHARACTERISTIC
/begin CHARACTERISTIC CAL_obd_ii_brake_pedal_conflict_count "Calibration: brake/pedal conflict time. (0091 0x4000d1ae)" VALUE 0x4000C9DE RL_VALUE_UBYTE 0 CM_u8_time_100ms 0 25500 /end CHARACTERISTIC
/begin CHARACTERISTIC CAL_obd_ii_P0571_switch_mismatch_time "Calibration: P0571 brake switch mismatch time. (0091 0x4000d1af)" VALUE 0x4000C9DF RL_VALUE_UBYTE 0 CM_u8_time_100ms 0 25500 /end CHARACTERISTIC
/begin CHARACTERISTIC CAL_obd_ii_P0571_brake_check_min_speed "Calibration: P0571 brake check min speed. (0091 0x4000d1b0)" VALUE 0x4000C9E0 RL_VALUE_UBYTE 0 CM_u8_speed_kph 0 255 /end CHARACTERISTIC
/begin CHARACTERISTIC CAL_obd_ii_P0441_runtime_min "Calibration: evap monitor runtime min (cal*20). (0091 0x4000d1b2)" VALUE 0x4000C9E2 RL_VALUE_UBYTE 0 CM_u8_time_100ms 0 25500 /end CHARACTERISTIC
/begin CHARACTERISTIC CAL_misfire_per_cyl_learn_enable "Calibration: misfire per-cylinder learn enable. (0091 0x4000d1b5)" VALUE 0x4000C9E5 RL_VALUE_UBYTE 0 NO_COMPU_METHOD 0 255 /end CHARACTERISTIC
/begin CHARACTERISTIC CAL_obd_ii_o2_sensor1_voltage_threshold "u16_voltage_5/1023v" VALUE 0x4000C9E6 RL_VALUE_UWORD 0 CM_u16_voltage_5_1023v 0 320.307917888563 /end CHARACTERISTIC
/begin CHARACTERISTIC CAL_obd_ii_o2_sensor1_voltage_limit "u16_voltage_5/1023v" VALUE 0x4000C9E8 RL_VALUE_UWORD 0 CM_u16_voltage_5_1023v 0 320.307917888563 /end CHARACTERISTIC
/begin CHARACTERISTIC CAL_obd_ii_o2_sensor2_voltage_threshold "u16_voltage_5/1023v" VALUE 0x4000C9EA RL_VALUE_UWORD 0 CM_u16_voltage_5_1023v 0 320.307917888563 /end CHARACTERISTIC
/begin CHARACTERISTIC CAL_obd_ii_o2_sensor2_voltage_limit "u16_voltage_5/1023v" VALUE 0x4000C9EC RL_VALUE_UWORD 0 CM_u16_voltage_5_1023v 0 320.307917888563 /end CHARACTERISTIC
/begin CHARACTERISTIC CAL_obd_ii_cat_monitor_baro_min "Calibration: cat monitor baro min. (0091 0x4000d1c2)" VALUE 0x4000C9F2 RL_VALUE_UWORD 0 CM_i16_pressure_mbar 0 65535 /end CHARACTERISTIC
/begin CHARACTERISTIC CAL_obd_ii_cat_monitor_ect_min "u8_temp_5/8-40c" VALUE 0x4000C9F4 RL_VALUE_UBYTE 0 CM_u8_temp_5_8_40c -40 119.375 /end CHARACTERISTIC
/begin CHARACTERISTIC CAL_obd_ii_cat_efficiency_iat_min "u8_temp_5/8-40c" VALUE 0x4000C9F5 RL_VALUE_UBYTE 0 CM_u8_temp_5_8_40c -40 119.375 /end CHARACTERISTIC
/begin CHARACTERISTIC CAL_obd_ii_P0420_maf_min "u16_flow_10mg/s" VALUE 0x4000C9F6 RL_VALUE_UWORD 0 CM_u16_flow_10mg_s 0 655350 /end CHARACTERISTIC
/begin CHARACTERISTIC CAL_obd_ii_P0420_maf_max "u16_flow_10mg/s" VALUE 0x4000C9F8 RL_VALUE_UWORD 0 CM_u16_flow_10mg_s 0 655350 /end CHARACTERISTIC
/begin CHARACTERISTIC CAL_obd_ii_postcat_o2_mean_filter_gain "Calibration: OBD-II postcat O2 voltage scaling." VALUE 0x4000C9FA RL_VALUE_UBYTE 0 CM_u8_factor_1_2560 0 9.9609375 /end CHARACTERISTIC
/begin CHARACTERISTIC CAL_obd_ii_cat_mon_post_dfco_holdoff_prescaler "Calibration: cat monitor post-DFCO hold-off prescaler. (0091 0x4000d1cb)" VALUE 0x4000C9FB RL_VALUE_UBYTE 0 NO_COMPU_METHOD 0 255 /end CHARACTERISTIC
/begin CHARACTERISTIC CAL_obd_ii_o2_flatline_band "Calibration: O2 flat-line detection band. (0091 0x4000d1cc)" VALUE 0x4000C9FC RL_VALUE_UBYTE 0 NO_COMPU_METHOD 0 255 /end CHARACTERISTIC
/begin CHARACTERISTIC CAL_obd_ii_o2_activity_rate_inband "u8_time_100ms" VALUE 0x4000C9FD RL_VALUE_UBYTE 0 CM_u8_time_100ms 0 25500 /end CHARACTERISTIC
/begin CHARACTERISTIC CAL_obd_ii_P0420_car_speed_max "u8_speed_kph" VALUE 0x4000C9FE RL_VALUE_UBYTE 0 CM_u8_speed_kph 0 255 /end CHARACTERISTIC
/begin CHARACTERISTIC CAL_obd_ii_P0420_car_speed_min "u8_speed_kph" VALUE 0x4000C9FF RL_VALUE_UBYTE 0 CM_u8_speed_kph 0 255 /end CHARACTERISTIC
/begin CHARACTERISTIC CAL_obd_ii_o2_slow_response_arm_dwell "u16_time_5ms" VALUE 0x4000CA0A RL_VALUE_UWORD 0 CM_u8_time_5ms 0 327675 /end CHARACTERISTIC
/begin CHARACTERISTIC CAL_obd_ii_P0562_sample_count "Calibration: P0562 sample count. (0091 0x4000d1e0)" VALUE 0x4000CA10 RL_VALUE_UBYTE 0 CM_u8_time_100ms 0 25500 /end CHARACTERISTIC
/begin CHARACTERISTIC CAL_obd_ii_P0563_sample_count "Calibration: P0563 sample count. (0091 0x4000d1e1)" VALUE 0x4000CA11 RL_VALUE_UBYTE 0 CM_u8_time_100ms 0 25500 /end CHARACTERISTIC
/begin CHARACTERISTIC CAL_obd_ii_dtc_clear_warmup_cycles "Calibration: warm-up cycles before a healed DTC clears (stock 40)." VALUE 0x4000CA12 RL_VALUE_UBYTE 0 NO_COMPU_METHOD 0 255 /end CHARACTERISTIC
/begin CHARACTERISTIC CAL_obd_ii_P0128_iat_min "Calibration: P0128 thermostat check IAT min. (0091 0x4000d1e3)" VALUE 0x4000CA13 RL_VALUE_UBYTE 0 CM_u8_temp_5_8_40c -40 119.375 /end CHARACTERISTIC
/begin CHARACTERISTIC CAL_obd_ii_cat_precat_o2_lean_thresh "u16_voltage_5/1023v" VALUE 0x4000CA16 RL_VALUE_UWORD 0 CM_u16_voltage_5_1023v 0 320.307917888563 /end CHARACTERISTIC
/begin CHARACTERISTIC CAL_obd_ii_cat_precat_o2_rich_thresh "u16_voltage_5/1023v" VALUE 0x4000CA18 RL_VALUE_UWORD 0 CM_u16_voltage_5_1023v 0 320.307917888563 /end CHARACTERISTIC
/begin CHARACTERISTIC CAL_obd_ii_postcat_o2_switch_band_lean "u16_voltage_5/1023v" VALUE 0x4000CA1A RL_VALUE_UWORD 0 CM_u16_voltage_5_1023v 0 320.307917888563 /end CHARACTERISTIC
/begin CHARACTERISTIC CAL_obd_ii_postcat_o2_switch_band_rich "u16_voltage_5/1023v" VALUE 0x4000CA1C RL_VALUE_UWORD 0 CM_u16_voltage_5_1023v 0 320.307917888563 /end CHARACTERISTIC
/begin CHARACTERISTIC CAL_obd_ii_cat_switch_ratio_fail_threshold "u16_factor_1/1000" VALUE 0x4000CA1E RL_VALUE_UWORD 0 CM_u16_factor_1_1000 0 6553.5 /end CHARACTERISTIC
/begin CHARACTERISTIC CAL_obd_ii_vvt_cam_error_limit "Cam position error limit (deg = val/4) for all four cams (P0011/12/14/15/21/22/24/25). Was CAL_obd_ii_vvt_exhaust_error_bank1_limit." VALUE 0x4000CA20 RL_VALUE_SWORD 0 CM_u8_angle_1_4deg -8192 8191.75 /end CHARACTERISTIC
/begin CHARACTERISTIC CAL_obd_ii_P0171_ltft_limit "i16_percent_1/10" VALUE 0x4000CA22 RL_VALUE_SWORD 0 CM_u16_factor_1_1000 -3276.8 3276.7 /end CHARACTERISTIC
/begin CHARACTERISTIC CAL_obd_ii_P0172_ltft_limit "i16_percent_1/10" VALUE 0x4000CA24 RL_VALUE_SWORD 0 CM_u16_factor_1_1000 -3276.8 3276.7 /end CHARACTERISTIC
/begin CHARACTERISTIC CAL_obd_ii_o2_response_car_speed_min "u8_speed_kph" VALUE 0x4000CA26 RL_VALUE_UBYTE 0 CM_u8_speed_kph 0 255 /end CHARACTERISTIC
/begin CHARACTERISTIC CAL_obd_ii_o2_response_car_speed_max "u8_speed_kph" VALUE 0x4000CA27 RL_VALUE_UBYTE 0 CM_u8_speed_kph 0 255 /end CHARACTERISTIC
/begin CHARACTERISTIC CAL_obd_ii_o2_transition_count "u8_count" VALUE 0x4000CA28 RL_VALUE_UBYTE 0 NO_COMPU_METHOD 0 255 /end CHARACTERISTIC
/begin CHARACTERISTIC CAL_obd_ii_cat_check_o2_rich_time_max "Calibration: cat check O2 rich time max (cal*5). (0091 0x4000d1f9)" VALUE 0x4000CA29 RL_VALUE_UBYTE 0 CM_u8_time_25ms 0 6375 /end CHARACTERISTIC
/begin CHARACTERISTIC CAL_obd_ii_mode06_o2_switch_time_min "Calibration: Mode 06 O2 switch time min. (0091 same name)" VALUE 0x4000CA2A RL_VALUE_UWORD 0 CM_u8_time_5ms 0 327675 /end CHARACTERISTIC
/begin CHARACTERISTIC CAL_obd_ii_mode06_o2_switch_time_max "u16_time_5ms" VALUE 0x4000CA2C RL_VALUE_UWORD 0 CM_u8_time_5ms 0 327675 /end CHARACTERISTIC
/begin CHARACTERISTIC CAL_obd_ii_P0111_mass_air_min "Calibration: P0111 accumulated air min. (0091 0x4000d1fe)" VALUE 0x4000CA2E RL_VALUE_UBYTE 0 CM_u8_mass_5g 0 1275 /end CHARACTERISTIC
/begin CHARACTERISTIC CAL_obd_ii_cac_temp_agreement_tol "Calibration: |charge-cooler temp - manifold temp| fault tolerance. 0278-only." VALUE 0x4000CA2F RL_VALUE_UBYTE 0 CM_u8_tempdelta_5_8c 0 159.375 /end CHARACTERISTIC
/begin CHARACTERISTIC CAL_misfire_enable_coolant_min "Calibration: misfire enable coolant minimum (°C = val*5/8−40)." VALUE 0x4000CA30 RL_VALUE_UBYTE 0 CM_u8_temp_5_8_40c -40 119.375 /end CHARACTERISTIC
/begin CHARACTERISTIC CAL_misfire_enable_coolant_max "Calibration: misfire enable coolant maximum (°C = val*5/8−40)." VALUE 0x4000CA31 RL_VALUE_UBYTE 0 CM_u8_temp_5_8_40c -40 119.375 /end CHARACTERISTIC
/begin CHARACTERISTIC CAL_obd_ii_load_model_diff_filter_alpha "Calibration: IIR weight for MAF-vs-speed-density load difference diag. 0278-only." VALUE 0x4000CA35 RL_VALUE_UBYTE 0 CM_u8_factor_1_256 0 99.609375 /end CHARACTERISTIC
/begin CHARACTERISTIC CAL_misfire_enable_rpm_min "Calibration: misfire enable RPM minimum (RPM = val*125/4+500)." VALUE 0x4000CA36 RL_VALUE_UBYTE 0 CM_u8_rspeed_125_4_500rpm 500 8468.75 /end CHARACTERISTIC
/begin CHARACTERISTIC CAL_misfire_enable_rpm_max "Calibration: misfire enable RPM maximum (RPM = val*125/4+500)." VALUE 0x4000CA37 RL_VALUE_UBYTE 0 CM_u8_rspeed_125_4_500rpm 500 8468.75 /end CHARACTERISTIC
/begin CHARACTERISTIC CAL_obd_ii_P0500_test_time "u16_time_100ms" VALUE 0x4000CA38 RL_VALUE_UWORD 0 CM_u8_time_100ms 0 6553500 /end CHARACTERISTIC
/begin CHARACTERISTIC CAL_misfire_failed_bank_scaling "Calibration: misfire failed bank scaling (val/255)." VALUE 0x4000CA3A RL_VALUE_UBYTE 0 CM_u8_factor_1_255 0 100 /end CHARACTERISTIC
/begin CHARACTERISTIC CAL_obd_ii_P0685_voltage_delta "Calibration: P0685 ignition vs ECU voltage delta." VALUE 0x4000CA3B RL_VALUE_UBYTE 0 CM_u16_voltage_5_1023v 0 1.24633431085044 /end CHARACTERISTIC
/begin CHARACTERISTIC CAL_obd_ii_P0500_car_speed_min "u8_speed_kph" VALUE 0x4000CA3C RL_VALUE_UBYTE 0 CM_u8_speed_kph 0 255 /end CHARACTERISTIC
/begin CHARACTERISTIC CAL_obd_ii_crank_cam_error_count_max "u8_count" VALUE 0x4000CA3D RL_VALUE_UBYTE 0 NO_COMPU_METHOD 0 255 /end CHARACTERISTIC
/begin CHARACTERISTIC CAL_obd_ii_o2_activity_rate_outband "u8_time_100ms" VALUE 0x4000CA3E RL_VALUE_UBYTE 0 CM_u8_time_100ms 0 25500 /end CHARACTERISTIC
/begin CHARACTERISTIC CAL_obd_ii_speed_sensor_monitor_rpm_min "Calibration: speed/timing sensor monitors need rpm >= this. (0091 0x4000d20f CAL_engine_speed_3_threshold_0)" VALUE 0x4000CA3F RL_VALUE_UBYTE 0 CM_u8_rspeed_125_4_500rpm 500 8468.75 /end CHARACTERISTIC
/begin CHARACTERISTIC CAL_obd_ii_idle_learn_limit "u8_flow_100mg/s" VALUE 0x4000CA45 RL_VALUE_UBYTE 0 CM_u8_flow_100mg_s 0 25500 /end CHARACTERISTIC
/begin CHARACTERISTIC CAL_obd_ii_idle_error_fail_count "u8_count" VALUE 0x4000CA46 RL_VALUE_UBYTE 0 NO_COMPU_METHOD 0 255 /end CHARACTERISTIC
/begin CHARACTERISTIC CAL_obd_ii_vvt_monitor_coolant_min "Calibration: VVT monitor coolant min. (0091 0x4000d218)" VALUE 0x4000CA48 RL_VALUE_UBYTE 0 CM_u8_temp_5_8_40c -40 119.375 /end CHARACTERISTIC
/begin CHARACTERISTIC CAL_obd_ii_vvt_error_fail_count "u8_count" VALUE 0x4000CA49 RL_VALUE_UBYTE 0 NO_COMPU_METHOD 0 255 /end CHARACTERISTIC
/begin CHARACTERISTIC CAL_obd_ii_vvt_monitor_min_runtime "Calibration: VVT monitor runtime min. (0091 0x4000d21a)" VALUE 0x4000CA4A RL_VALUE_UWORD 0 CM_u8_time_5ms 0 327675 /end CHARACTERISTIC
/begin CHARACTERISTIC CAL_misfire_inhibit_tps_rate_hold "Calibration: misfire inhibit hold after TPS transient. (0091 0x4000d21c)" VALUE 0x4000CA4C RL_VALUE_UWORD 0 CM_u8_time_5ms 0 327675 /end CHARACTERISTIC
/begin CHARACTERISTIC CAL_misfire_enable_conditions_hold "Calibration: misfire enable conditions hold. (0091 0x4000d21e)" VALUE 0x4000CA4E RL_VALUE_UWORD 0 CM_u8_time_5ms 0 327675 /end CHARACTERISTIC
/begin CHARACTERISTIC CAL_obd_ii_fuel_pump_monitor_inj_flow_min "Calibration: fuel pump/pressure monitors need injector flow >= this. 0278-only (0091 slot = P1302 hold-off)." VALUE 0x4000CA50 RL_VALUE_UWORD 0 NO_COMPU_METHOD 0 65535 /end CHARACTERISTIC
/begin CHARACTERISTIC CAL_obd_ii_P0071_air_temp_limit "Calibration: P0071 air temp plausibility [hi,lo]. (0091 0x4000d222)" VAL_BLK 0x4000CA52 RL_VALUE_UBYTE 0 CM_u8_temp_5_8_40c -40 119.375 NUMBER 2 /end CHARACTERISTIC
/begin CHARACTERISTIC CAL_obd_ii_P0171_learn_time_threshold "u8_time_10us" VALUE 0x4000CA56 RL_VALUE_UBYTE 0 CM_u16_time_10us 0 2550 /end CHARACTERISTIC
/begin CHARACTERISTIC CAL_obd_ii_P0172_learn_time_threshold "u8_time_10us" VALUE 0x4000CA57 RL_VALUE_UBYTE 0 CM_u16_time_10us 0 2550 /end CHARACTERISTIC
/begin CHARACTERISTIC CAL_obd_ii_accel_pedal_correlation_max_diff "Calibration: pedal correlation max difference. (0091 0x4000d228)" VALUE 0x4000CA58 RL_VALUE_UWORD 0 CM_u16_factor_1_1023 0 6406.15835777126 /end CHARACTERISTIC
/begin CHARACTERISTIC CAL_obd_ii_common_tests_complete "uint8_t" VALUE 0x4000CA5A RL_VALUE_UBYTE 0 NO_COMPU_METHOD 0 255 /end CHARACTERISTIC
/begin CHARACTERISTIC CAL_obd_ii_common_tests_available "uint8_t" VALUE 0x4000CA5B RL_VALUE_UBYTE 0 NO_COMPU_METHOD 0 255 /end CHARACTERISTIC
/begin CHARACTERISTIC CAL_obd_ii_o2_sensors_present "Calibration: OBD-II O2 sensors present." VALUE 0x4000CA5D RL_VALUE_UBYTE 0 NO_COMPU_METHOD 0 255 /end CHARACTERISTIC
/begin CHARACTERISTIC CAL_obd_ii_standards_supported "Calibration: OBD-II standards supported." VALUE 0x4000CA5E RL_VALUE_UBYTE 0 NO_COMPU_METHOD 0 255 /end CHARACTERISTIC
/begin CHARACTERISTIC CAL_obd_ii_o2_slow_response_sample_count "u8_count" VALUE 0x4000CA5F RL_VALUE_UBYTE 0 NO_COMPU_METHOD 0 255 /end CHARACTERISTIC
/begin CHARACTERISTIC CAL_obd_ii_o2_r2l_time_max_asym "u8_time_5ms" VALUE 0x4000CA60 RL_VALUE_UBYTE 0 CM_u8_time_5ms 0 1275 /end CHARACTERISTIC
/begin CHARACTERISTIC CAL_obd_ii_o2_l2r_time_max_asym "u8_time_5ms" VALUE 0x4000CA61 RL_VALUE_UBYTE 0 CM_u8_time_5ms 0 1275 /end CHARACTERISTIC
/begin CHARACTERISTIC CAL_obd_ii_o2_slow_response_limit_lean_to_rich "u16_time_5ms" VALUE 0x4000CA62 RL_VALUE_UWORD 0 CM_u8_time_5ms 0 327675 /end CHARACTERISTIC
/begin CHARACTERISTIC CAL_obd_ii_o2_slow_response_limit_rich_to_lean "u16_time_5ms" VALUE 0x4000CA64 RL_VALUE_UWORD 0 CM_u8_time_5ms 0 327675 /end CHARACTERISTIC
/begin CHARACTERISTIC CAL_obd_ii_P050A_idle_error_high "Calibration: P050A idle error high. (0091 0x4000d237)" VALUE 0x4000CA67 RL_VALUE_UBYTE 0 CM_u8_rspeed_2rpm 0 510 /end CHARACTERISTIC
/begin CHARACTERISTIC CAL_obd_ii_P050A_idle_error_low "Calibration: P050A idle error low. (0091 0x4000d238)" VALUE 0x4000CA68 RL_VALUE_UBYTE 0 CM_u8_rspeed_2rpm 0 510 /end CHARACTERISTIC
/begin CHARACTERISTIC CAL_obd_ii_P0133_min_coolant_temp "u8_temp_5/8-40c" VALUE 0x4000CA69 RL_VALUE_UBYTE 0 CM_u8_temp_5_8_40c -40 119.375 /end CHARACTERISTIC
/begin CHARACTERISTIC CAL_obd_ii_switch_voltage_debounce "u8_time_s" VALUE 0x4000CA6E RL_VALUE_UBYTE 0 CM_u8_time_s 0 255 /end CHARACTERISTIC
/begin CHARACTERISTIC CAL_obd_ii_engine_speed_3_threshold_1 "Calibration: monitor-completion rpm min. (0091 0x4000d23f)" VALUE 0x4000CA6F RL_VALUE_UBYTE 0 CM_u8_rspeed_125_4_500rpm 500 8468.75 /end CHARACTERISTIC
/begin CHARACTERISTIC CAL_obd_ii_vvt_ok_pass_count "u8_count" VALUE 0x4000CA70 RL_VALUE_UBYTE 0 NO_COMPU_METHOD 0 255 /end CHARACTERISTIC
/begin CHARACTERISTIC CAL_obd_ii_o2_switch_time_threshold "uint8_t" VALUE 0x4000CA78 RL_VALUE_UBYTE 0 NO_COMPU_METHOD 0 255 /end CHARACTERISTIC
/begin CHARACTERISTIC CAL_obd_ii_o2_switch_time_min "u8_time_5ms" VALUE 0x4000CA79 RL_VALUE_UBYTE 0 CM_u8_time_5ms 0 1275 /end CHARACTERISTIC
/begin CHARACTERISTIC CAL_obd_ii_P2173_load_difference_max "Calibration: P2173 load difference max. (0091 0x4000d258)" VALUE 0x4000CA88 RL_VALUE_UWORD 0 CM_u8_load_mg_stroke 0 65535 /end CHARACTERISTIC
/begin CHARACTERISTIC CAL_obd_ii_o2_precat_diag_timer "Calibration: pre-cat O2 diag timer reload (u16_time_5ms timers)." VALUE 0x4000CA8A RL_VALUE_UWORD 0 CM_u8_time_5ms 0 327675 /end CHARACTERISTIC
/begin CHARACTERISTIC CAL_obd_ii_mode2f_timeout "Calibration: OBD-II mode2f timeout (ms = val*100)." VALUE 0x4000CA8C RL_VALUE_UWORD 0 CM_u8_time_100ms 0 6553500 /end CHARACTERISTIC
/begin CHARACTERISTIC CAL_misfire_rough_road_hold "Calibration: misfire rough-road hold. (0091 0x4000d25e)" VALUE 0x4000CA8E RL_VALUE_UWORD 0 CM_u8_time_5ms 0 327675 /end CHARACTERISTIC
/begin CHARACTERISTIC CAL_obd_ii_mode2f_injector_test_interval "Calibration: Mode 2F injector test interval. (0091 0x4000d262)" VALUE 0x4000CA92 RL_VALUE_UBYTE 0 CM_u8_time_5ms 0 1275 /end CHARACTERISTIC
/begin CHARACTERISTIC CAL_obd_ii_mode2f_injector_test_pulse "Calibration: Mode 2F injector test pulse (x10 -> us)." VALUE 0x4000CA94 RL_VALUE_UWORD 0 CM_u8_time_us 0 65535 /end CHARACTERISTIC
/begin CHARACTERISTIC CAL_obd_ii_mode2f_injector_test_duration "u16_time_5ms" VALUE 0x4000CA96 RL_VALUE_UWORD 0 CM_u8_time_5ms 0 327675 /end CHARACTERISTIC
/begin CHARACTERISTIC CAL_obd_ii_mode08_evap_test_duration "u16_time_5ms" VALUE 0x4000CA98 RL_VALUE_UWORD 0 CM_u8_time_5ms 0 327675 /end CHARACTERISTIC
/begin CHARACTERISTIC CAL_obd_ii_wheel_speed_correlation_rpm_max "Calibration: wheel speed correlation rpm max. (0091 0x4000d26a)" VALUE 0x4000CA9A RL_VALUE_UBYTE 0 CM_u8_rspeed_125_4_500rpm 500 8468.75 /end CHARACTERISTIC
/begin CHARACTERISTIC CAL_obd_ii_P0106_partload_rpm_window "Calibration: P0106 part-load rpm window [lo,hi]. (0091 0x4000d276)" VAL_BLK 0x4000CAA6 RL_VALUE_UBYTE 0 CM_u8_rspeed_125_4_500rpm 500 8468.75 NUMBER 2 /end CHARACTERISTIC
/begin CHARACTERISTIC CAL_obd_ii_P0106_partload_tps_window "Calibration: P0106 part-load TPS window. (0091 0x4000d278)" VAL_BLK 0x4000CAA8 RL_VALUE_UBYTE 0 CM_u8_factor_1_255 0 100 NUMBER 2 /end CHARACTERISTIC
/begin CHARACTERISTIC CAL_obd_ii_P0106_partload_tps_rate_max "Calibration: P0106 part-load TPS rate max. (0091 0x4000d27a)" VALUE 0x4000CAAA RL_VALUE_UBYTE 0 NO_COMPU_METHOD 0 255 /end CHARACTERISTIC
/begin CHARACTERISTIC CAL_obd_ii_paddle_shift_voltage_stable_time "Calibration: paddle shift voltage stable time (cal*10). (0091 0x4000d27b)" VALUE 0x4000CAAB RL_VALUE_UBYTE 0 CM_u8_time_s 0 255 /end CHARACTERISTIC
/begin CHARACTERISTIC CAL_obd_ii_mode2f_coil_test_interval "Calibration: Mode 2F coil test interval. (0091 0x4000d27d)" VALUE 0x4000CAAD RL_VALUE_UBYTE 0 CM_u8_time_5ms 0 1275 /end CHARACTERISTIC
/begin CHARACTERISTIC CAL_obd_ii_mode2f_coil_test_pulse_count "Calibration: Mode 2F coil test duration (loads obd_ii_mode2f_test_timers, u16_time_5ms)." VALUE 0x4000CAAE RL_VALUE_UWORD 0 CM_u8_time_5ms 0 327675 /end CHARACTERISTIC
/begin CHARACTERISTIC CAL_obd_ii_oil_pressure_sensor_voltage_high "Calibration: analog oil pressure sensor voltage high fault limit. 0278-only." VALUE 0x4000CAB2 RL_VALUE_UWORD 0 CM_u16_voltage_5_1023v 0 320.307917888563 /end CHARACTERISTIC
/begin CHARACTERISTIC CAL_obd_ii_oil_pressure_switch_low_voltage "Calibration: OBD-II oil pressure switch low voltage (V = val*5/1023)." VALUE 0x4000CAB4 RL_VALUE_UWORD 0 CM_u16_voltage_5_1023v 0 320.307917888563 /end CHARACTERISTIC
/begin CHARACTERISTIC CAL_obd_ii_fuel_pressure_sensor_voltage_low "Calibration: fuel pressure sensor voltage low fault limit. 0278-only." VALUE 0x4000CABA RL_VALUE_UWORD 0 CM_u16_voltage_5_1023v 0 320.307917888563 /end CHARACTERISTIC
/begin CHARACTERISTIC CAL_obd_ii_P0106_baro_error_limits "Calibration: P0106 baro error limits [+,-]. (0091 0x4000d28c)" VAL_BLK 0x4000CABC RL_VALUE_UWORD 0 CM_i16_pressure_mbar 0 65535 NUMBER 2 /end CHARACTERISTIC
/begin CHARACTERISTIC CAL_obd_ii_P0171_P0172_trim_zone_time_min "Calibration: fuel trim zone time min (compared with u16_time_100ms counters; stock 3000 = 300 s)." VALUE 0x4000CAC0 RL_VALUE_UWORD 0 CM_u8_time_100ms 0 6553500 /end CHARACTERISTIC
/begin CHARACTERISTIC CAL_obd_ii_fuel_trim_zone3_time_min "Calibration: fuel trim zone 3 time min. (0091 0x4000d292)" VALUE 0x4000CAC2 RL_VALUE_UWORD 0 CM_u8_time_100ms 0 6553500 /end CHARACTERISTIC
/begin CHARACTERISTIC CAL_obd_ii_o2_precat_activity_window "u16_time_5ms" VALUE 0x4000CAC4 RL_VALUE_UWORD 0 CM_u8_time_5ms 0 327675 /end CHARACTERISTIC
/begin CHARACTERISTIC CAL_obd_ii_o2_postcat_activity_min "u16_time_5ms" VALUE 0x4000CAC6 RL_VALUE_UWORD 0 CM_u8_time_5ms 0 327675 /end CHARACTERISTIC
/begin CHARACTERISTIC CAL_obd_ii_o2_slow_response_runtime_limit_unknown "u16_time_5ms" VALUE 0x4000CAC8 RL_VALUE_UWORD 0 CM_u8_time_5ms 0 327675 /end CHARACTERISTIC
/begin CHARACTERISTIC CAL_obd_ii_fuel_pressure_sensor_voltage_high "Calibration: fuel pressure sensor voltage high fault limit. 0278-only." VALUE 0x4000CACA RL_VALUE_UWORD 0 CM_u16_voltage_5_1023v 0 320.307917888563 /end CHARACTERISTIC
/begin CHARACTERISTIC CAL_obd_ii_cat_monitor_min_engine_runtime "Calibration: OBD-II cat monitor minimum engine runtime (ms = val*5)." VALUE 0x4000CAD0 RL_VALUE_UWORD 0 CM_u8_time_5ms 0 327675 /end CHARACTERISTIC
/begin CHARACTERISTIC CAL_obd_ii_o2_min_voltage_init "Calibration: initial value of O2 min-voltage trackers." VALUE 0x4000CAD6 RL_VALUE_UWORD 0 CM_u16_voltage_5_1023v 0 320.307917888563 /end CHARACTERISTIC
/begin CHARACTERISTIC CAL_misfire_emissions_limit "Calibration: misfire emissions limit." VALUE 0x4000CAD8 RL_VALUE_UBYTE 0 NO_COMPU_METHOD 0 255 /end CHARACTERISTIC
/begin CHARACTERISTIC CAL_obd_ii_iat_activity_min_delta "Calibration: IAT sensor voltage max-min must exceed this (activity check). 0278-only." VALUE 0x4000CADB RL_VALUE_UBYTE 0 NO_COMPU_METHOD 0 255 /end CHARACTERISTIC
/begin CHARACTERISTIC CAL_obd_ii_P0128_runtime_to_lowspeed_ratio_min "Calibration: P0128 runtime/low-speed ratio min. (0091 0x4000d2ac)" VALUE 0x4000CADC RL_VALUE_UBYTE 0 NO_COMPU_METHOD 0 255 /end CHARACTERISTIC
/begin CHARACTERISTIC CAL_obd_ii_P0128_lowspeed_threshold "Calibration: P0128 low-speed threshold. (0091 0x4000d2ad)" VALUE 0x4000CADD RL_VALUE_UBYTE 0 CM_u8_speed_kph 0 255 /end CHARACTERISTIC
/begin CHARACTERISTIC CAL_obd_ii_P0111_iat_agreement_tol "Calibration: P0111 IAT agreement tolerance. (0091 0x4000d2ae)" VALUE 0x4000CADE RL_VALUE_UBYTE 0 CM_u8_tempdelta_5_8c 0 159.375 /end CHARACTERISTIC
/begin CHARACTERISTIC CAL_obd_ii_P0116_coolant_deviation_max "Calibration: P0116 coolant deviation max. (0091 0x4000d2af)" VALUE 0x4000CADF RL_VALUE_UBYTE 0 CM_u8_tempdelta_5_8c 0 159.375 /end CHARACTERISTIC
/begin CHARACTERISTIC CAL_obd_ii_runtime_since_start_threshold_unknown "Calibration: P0116 cold-start window runtime. (0091 0x4000d2b0)" VALUE 0x4000CAE0 RL_VALUE_UWORD 0 CM_u8_time_5ms 0 327675 /end CHARACTERISTIC
/begin CHARACTERISTIC CAL_obd_ii_fuel_type "Calibration: OBD-II fuel type." VALUE 0x4000CAE2 RL_VALUE_UBYTE 0 NO_COMPU_METHOD 0 255 /end CHARACTERISTIC
/begin CHARACTERISTIC CAL_obd_ii_thermostat_monitor_runtime_min "Calibration: thermostat monitor needs runtime (s) >= this. (0091 0x4000d2b3 CAL_obd_ii_temp_unknown2)" VALUE 0x4000CAE3 RL_VALUE_UBYTE 0 NO_COMPU_METHOD 0 255 /end CHARACTERISTIC
/begin CHARACTERISTIC CAL_obd_ii_P0116_coolant_deviation_max_coldstart "Calibration: P0116 coolant deviation max during cold-start window. 0278-only (0091 slot = u16 runtime)." VALUE 0x4000CAE8 RL_VALUE_UBYTE 0 CM_u8_tempdelta_5_8c 0 159.375 /end CHARACTERISTIC
/begin CHARACTERISTIC CAL_obd_ii_P0116_coolant_stopped_min "Calibration: P0116 cold-start window needs engine-off coolant > this. 0278-only." VALUE 0x4000CAE9 RL_VALUE_UBYTE 0 CM_u8_temp_5_8_40c -40 119.375 /end CHARACTERISTIC
/begin CHARACTERISTIC CAL_obd_ii_commanded_evap_purge_threshold "u16_factor_1/255" VALUE 0x4000CAF6 RL_VALUE_UWORD 0 CM_u8_factor_1_255 0 25700 /end CHARACTERISTIC
/begin CHARACTERISTIC CAL_obd_ii_fuel_pump_monitor_fuel_level_min "Calibration: fuel pump/pressure monitor inhibited below this fuel level. 0278-only." VALUE 0x4000CB02 RL_VALUE_UBYTE 0 CM_u8_volume_1_10gallon 0 25.5 /end CHARACTERISTIC
/begin CHARACTERISTIC CAL_obd_ii_evap_vapor_pressure_limit "Calibration: (0091 0x4000d2d4 CAL_obd_ii_evap_vapor_pressure_limit)" VALUE 0x4000CB04 RL_VALUE_SWORD 0 CM_u8_pressure_1_10mbar -3276.8 3276.7 /end CHARACTERISTIC
/begin CHARACTERISTIC CAL_obd_ii_commanded_evap_purge_limit "Calibration: (0091 0x4000d2e0 CAL_obd_ii_commanded_evap_purge_limit)" VALUE 0x4000CB10 RL_VALUE_UWORD 0 CM_u8_factor_1_255 0 25700 /end CHARACTERISTIC
/begin CHARACTERISTIC CAL_obd_ii_commanded_evap_purge_limit_0 "Calibration: (0091 0x4000d2e2 CAL_obd_ii_commanded_evap_purge_limit_0)" VALUE 0x4000CB12 RL_VALUE_UWORD 0 CM_u8_factor_1_255 0 25700 /end CHARACTERISTIC
/begin CHARACTERISTIC CAL_obd_ii_map_sensor_voltage_high "Calibration: MAP sensor voltage high fault limit. 0278-only." VALUE 0x4000CB14 RL_VALUE_UWORD 0 CM_u16_voltage_5_1023v 0 320.307917888563 /end CHARACTERISTIC
/begin CHARACTERISTIC CAL_obd_ii_map_sensor_voltage_low "Calibration: MAP sensor voltage low fault limit. 0278-only." VALUE 0x4000CB16 RL_VALUE_UWORD 0 CM_u16_voltage_5_1023v 0 320.307917888563 /end CHARACTERISTIC
/begin CHARACTERISTIC CAL_obd_ii_fuel_pump_monitor_coolant_min "Calibration: fuel pump/pressure monitor needs coolant >= this. 0278-only." VALUE 0x4000CB18 RL_VALUE_UBYTE 0 CM_u8_temp_5_8_40c -40 119.375 /end CHARACTERISTIC
/begin CHARACTERISTIC CAL_obd_ii_fuel_pump_monitor_runtime_min "Calibration: fuel pump/pressure monitor needs runtime > cal<<8 (5 ms). 0278-only." VALUE 0x4000CB19 RL_VALUE_UBYTE 0 NO_COMPU_METHOD 0 255 /end CHARACTERISTIC
/begin CHARACTERISTIC CAL_obd_ii_fuel_pressure_high_threshold "Calibration: fuel pressure above target by > cal<<4 counts -> high fault count. 0278-only." VALUE 0x4000CB1D RL_VALUE_UBYTE 0 NO_COMPU_METHOD 0 255 /end CHARACTERISTIC
/begin CHARACTERISTIC CAL_obd_ii_P0111_maf_low_band_hysteresis "Calibration: (0091 0x4000d2f0 CAL_obd_ii_P0111_maf_low_band_hysteresis)" VALUE 0x4000CB20 RL_VALUE_UBYTE 0 CM_u8_flow_200mg_s 0 51000 /end CHARACTERISTIC
/begin CHARACTERISTIC CAL_obd_ii_P0128_start_coolant_max "Calibration: (0091 0x4000d2f1 CAL_obd_ii_P0128_start_coolant_max)" VALUE 0x4000CB21 RL_VALUE_UBYTE 0 CM_u8_temp_5_8_40c -40 119.375 /end CHARACTERISTIC
/begin CHARACTERISTIC CAL_obd_ii_P0128_start_coolant_min "Calibration: (0091 0x4000d2f3 CAL_obd_ii_P0128_start_coolant_min)" VALUE 0x4000CB23 RL_VALUE_UBYTE 0 CM_u8_temp_5_8_40c -40 119.375 /end CHARACTERISTIC
/begin CHARACTERISTIC CAL_obd_ii_cat_monitor_iat_min "Calibration: cat/O2 monitor engine-air window low. (0091 CAL_obd_ii_cat_unknown11)" VALUE 0x4000CB28 RL_VALUE_UBYTE 0 CM_u8_temp_5_8_40c -40 119.375 /end CHARACTERISTIC
/begin CHARACTERISTIC CAL_obd_ii_cat_monitor_iat_max "Calibration: cat/O2 monitor engine-air window high. (0091 CAL_obd_ii_cat_unknown10)" VALUE 0x4000CB29 RL_VALUE_UBYTE 0 CM_u8_temp_5_8_40c -40 119.375 /end CHARACTERISTIC
/begin CHARACTERISTIC CAL_obd_ii_cat_monitor_runtime_min "Calibration: cat/O2 monitor runtime min. (0091 CAL_obd_ii_cat_unknown2)" VALUE 0x4000CB2A RL_VALUE_UWORD 0 CM_u8_time_5ms 0 327675 /end CHARACTERISTIC
/begin CHARACTERISTIC CAL_obd_ii_cat_unknown3 "u16_pressure_mbar" VALUE 0x4000CB2C RL_VALUE_UWORD 0 CM_i16_pressure_mbar 0 65535 /end CHARACTERISTIC
/begin CHARACTERISTIC CAL_obd_ii_cat_o2_monitor_iat_min "Calibration: cat/O2 monitor needs engine air > this. (0091 CAL_obd_ii_unknown5)" VALUE 0x4000CB2E RL_VALUE_UBYTE 0 CM_u8_temp_5_8_40c -40 119.375 /end CHARACTERISTIC
/begin CHARACTERISTIC CAL_obd_ii_cat_cold_start_coolant_min "Calibration: readiness init cold-start coolant window low. (0091 name)" VALUE 0x4000CB2F RL_VALUE_UBYTE 0 CM_u8_temp_5_8_40c -40 119.375 /end CHARACTERISTIC
/begin CHARACTERISTIC CAL_obd_ii_cat_cold_start_coolant_max "Calibration: readiness init cold-start coolant window high. (0091 CAL_coolant_temp_threshold_2)" VALUE 0x4000CB30 RL_VALUE_UBYTE 0 CM_u8_temp_5_8_40c -40 119.375 /end CHARACTERISTIC
/begin CHARACTERISTIC CAL_obd_ii_cat_monitor_low_speed_max "Calibration: cat monitor window counts down while speed < this. (0091 CAL_obd_ii_cat_unknown6)" VALUE 0x4000CB31 RL_VALUE_UBYTE 0 CM_u8_speed_kph 0 255 /end CHARACTERISTIC
/begin CHARACTERISTIC CAL_obd_ii_cat_monitor_speed_min "Calibration: cat monitor needs speed > this. (0091 CAL_obd_ii_cat_unknown9)" VALUE 0x4000CB32 RL_VALUE_UBYTE 0 CM_u8_speed_kph 0 255 /end CHARACTERISTIC
/begin CHARACTERISTIC CAL_obd_ii_cat_monitor_coolant_min_above_iat "Calibration: (0091 0x4000d303 CAL_obd_ii_cat_monitor_coolant_min_above_iat)" VALUE 0x4000CB33 RL_VALUE_UBYTE 0 CM_u8_tempdelta_5_8c 0 159.375 /end CHARACTERISTIC
/begin CHARACTERISTIC CAL_obd_ii_cat_monitor_init_counter_2 "Calibration: (0091 0x4000d304 CAL_obd_ii_cat_monitor_init_counter_2)" VALUE 0x4000CB34 RL_VALUE_UWORD 0 CM_u8_time_100ms 0 6553500 /end CHARACTERISTIC
/begin CHARACTERISTIC CAL_obd_ii_cat_monitor_run_time_min "Calibration: (0091 0x4000d306 CAL_obd_ii_cat_monitor_run_time_min)" VALUE 0x4000CB36 RL_VALUE_UWORD 0 CM_u8_time_100ms 0 6553500 /end CHARACTERISTIC
/begin CHARACTERISTIC CAL_obd_ii_cat_monitor_window_time "Calibration: (0091 0x4000d308 CAL_obd_ii_cat_monitor_window_time)" VALUE 0x4000CB38 RL_VALUE_UWORD 0 CM_u8_time_100ms 0 6553500 /end CHARACTERISTIC
/begin CHARACTERISTIC CAL_obd_ii_cat_monitor_stable_time "u16_time_100ms" VALUE 0x4000CB3A RL_VALUE_UWORD 0 CM_u8_time_100ms 0 6553500 /end CHARACTERISTIC
/begin CHARACTERISTIC CAL_obd_ii_evap_stability_window_samples "Calibration: (0091 0x4000d30c CAL_obd_ii_evap_stability_window_samples)" VALUE 0x4000CB3C RL_VALUE_UBYTE 0 NO_COMPU_METHOD 0 255 /end CHARACTERISTIC
/begin CHARACTERISTIC CAL_obd_ii_evap_entry_settle_delay "u8_time_100ms" VALUE 0x4000CB3D RL_VALUE_UBYTE 0 CM_u8_time_100ms 0 25500 /end CHARACTERISTIC
/begin CHARACTERISTIC CAL_obd_ii_evap_refuel_level_rise_threshold "Calibration: refuel detection: fuel level rise threshold (1/10 US gal in 0278)." VALUE 0x4000CB3E RL_VALUE_UBYTE 0 CM_u8_volume_1_10gallon 0 25.5 /end CHARACTERISTIC
/begin CHARACTERISTIC CAL_obd_ii_evap_fuel_level_noise_count_limit "Calibration: (0091 0x4000d30f CAL_obd_ii_evap_fuel_level_noise_count_limit)" VALUE 0x4000CB3F RL_VALUE_UBYTE 0 NO_COMPU_METHOD 0 255 /end CHARACTERISTIC
/begin CHARACTERISTIC CAL_obd_ii_evap_pressure_noise_count_limit "Calibration: (0091 0x4000d310 CAL_obd_ii_evap_pressure_noise_count_limit)" VALUE 0x4000CB40 RL_VALUE_UBYTE 0 NO_COMPU_METHOD 0 255 /end CHARACTERISTIC
/begin CHARACTERISTIC CAL_obd_ii_evap_fuel_level_noise_threshold "Calibration: (0091 0x4000d311 CAL_obd_ii_evap_fuel_level_noise_threshold)" VALUE 0x4000CB41 RL_VALUE_UBYTE 0 CM_u8_volume_1_10gallon 0 25.5 /end CHARACTERISTIC
/begin CHARACTERISTIC CAL_obd_ii_evap_pressure_noise_threshold "Calibration: evap pressure noise threshold (1/10 mbar)." VALUE 0x4000CB42 RL_VALUE_SWORD 0 CM_u8_pressure_1_10mbar -3276.8 3276.7 /end CHARACTERISTIC
/begin CHARACTERISTIC CAL_obd_ii_ac_load_diag_tolerance_pct "u8_factor_1/100" VALUE 0x4000CB4C RL_VALUE_UBYTE 0 CM_u8_factor_1_100 0 255 /end CHARACTERISTIC
/begin CHARACTERISTIC CAL_obd_ii_P0451_pressure_swing_min "Calibration: (0091 0x4000d31e CAL_obd_ii_P0451_pressure_swing_min)" VALUE 0x4000CB4E RL_VALUE_SWORD 0 CM_u8_pressure_1_10mbar -3276.8 3276.7 /end CHARACTERISTIC
/begin CHARACTERISTIC CAL_obd_ii_ac_load_diag_rpm_min "Calibration: (0091 0x4000d32d CAL_obd_ii_ac_load_diag_rpm_min)" VALUE 0x4000CB5D RL_VALUE_UBYTE 0 CM_u8_rspeed_50rpm 0 12750 /end CHARACTERISTIC
/begin CHARACTERISTIC CAL_obd_ii_B1422_fail_threshold "A/C compressor fault count threshold for B1422 (letter 2 = B). Was P1422." VALUE 0x4000CB5E RL_VALUE_UBYTE 0 NO_COMPU_METHOD 0 255 /end CHARACTERISTIC
/begin CHARACTERISTIC CAL_obd_ii_P0806_gear_changes_min "Calibration: (0091 0x4000d32f CAL_obd_ii_P0806_gear_changes_min)" VALUE 0x4000CB5F RL_VALUE_UBYTE 0 NO_COMPU_METHOD 0 255 /end CHARACTERISTIC
/begin CHARACTERISTIC CAL_obd_ii_P0806_clutch_span_min "Calibration: (0091 0x4000d330 CAL_obd_ii_P0806_clutch_span_min)" VALUE 0x4000CB60 RL_VALUE_UWORD 0 CM_u16_voltage_5_1023v 0 320.307917888563 /end CHARACTERISTIC
/begin CHARACTERISTIC CAL_clutch_pos_voltage_threshold "u16_voltage_5/1023v" VALUE 0x4000CB62 RL_VALUE_UWORD 0 CM_u16_voltage_5_1023v 0 320.307917888563 /end CHARACTERISTIC
/begin CHARACTERISTIC CAL_obd_ii_P0806_clutch_voltage_max "Calibration: (0091 0x4000d334 CAL_obd_ii_P0806_clutch_voltage_max)" VALUE 0x4000CB64 RL_VALUE_UWORD 0 CM_u16_voltage_5_1023v 0 320.307917888563 /end CHARACTERISTIC
/begin CHARACTERISTIC CAL_obd_ii_fuel_pressure_low_threshold "Calibration: fuel pressure below target by > cal*16 counts -> low fault count. 0278-only." VALUE 0x4000CB93 RL_VALUE_UBYTE 0 NO_COMPU_METHOD 0 255 /end CHARACTERISTIC
/begin CHARACTERISTIC CAL_obd_ii_coolant_rationality_delta_threshold "Calibration: coolant rationality delta threshold. (0091 CAL_obd_ii_unknown7)" VALUE 0x4000CB94 RL_VALUE_UBYTE 0 NO_COMPU_METHOD 0 255 /end CHARACTERISTIC
/begin CHARACTERISTIC CAL_obd_ii_coolant_rationality_sample_count "Calibration: coolant rationality sample count." VALUE 0x4000CB95 RL_VALUE_UBYTE 0 NO_COMPU_METHOD 0 255 /end CHARACTERISTIC
/begin CHARACTERISTIC CAL_obd_ii_coolant_rationality_count "Calibration: (0091 0x4000d366 CAL_obd_ii_coolant_rationality_count)" VALUE 0x4000CB96 RL_VALUE_UBYTE 0 NO_COMPU_METHOD 0 255 /end CHARACTERISTIC
/begin CHARACTERISTIC CAL_obd_ii_coolant_rationality_holdoff_time "u8_time_100ms" VALUE 0x4000CB97 RL_VALUE_UBYTE 0 CM_u8_time_100ms 0 25500 /end CHARACTERISTIC
/begin CHARACTERISTIC CAL_obd_ii_fuel_pressure_high_debounce "Calibration: fuel pressure high fault debounce." VALUE 0x4000CB9A RL_VALUE_UBYTE 0 NO_COMPU_METHOD 0 255 /end CHARACTERISTIC
/begin CHARACTERISTIC CAL_obd_ii_fuel_pressure_low_debounce "Calibration: fuel pressure low fault debounce." VALUE 0x4000CB9B RL_VALUE_UBYTE 0 NO_COMPU_METHOD 0 255 /end CHARACTERISTIC
/begin CHARACTERISTIC CAL_obd_ii_P0111_maf_low_band "u8_flow_200mg/s" VALUE 0x4000CB9C RL_VALUE_UBYTE 0 CM_u8_flow_200mg_s 0 51000 /end CHARACTERISTIC
/begin CHARACTERISTIC CAL_obd_ii_P0111_maf_high_band "u8_flow_200mg/s" VALUE 0x4000CB9D RL_VALUE_UBYTE 0 CM_u8_flow_200mg_s 0 51000 /end CHARACTERISTIC
/begin CHARACTERISTIC CAL_obd_ii_P0111_maf_debounce_time "u8_time_100ms" VALUE 0x4000CB9E RL_VALUE_UBYTE 0 CM_u8_time_100ms 0 25500 /end CHARACTERISTIC
/begin CHARACTERISTIC CAL_obd_ii_P0111_iat_span_min "Calibration: (0091 0x4000d36f CAL_obd_ii_P0111_iat_span_min)" VALUE 0x4000CB9F RL_VALUE_UBYTE 0 CM_u16_voltage_5_1023v 0 1.24633431085044 /end CHARACTERISTIC
/begin CHARACTERISTIC CAL_obd_ii_P0111_airflow_stage_time "Calibration: (0091 0x4000d370 CAL_obd_ii_P0111_airflow_stage_time)" VALUE 0x4000CBA0 RL_VALUE_UBYTE 0 CM_u8_time_100ms 0 25500 /end CHARACTERISTIC
/begin CHARACTERISTIC CAL_obd_ii_P0111_high_airflow_time "Calibration: (0091 0x4000d371 CAL_obd_ii_P0111_high_airflow_time)" VALUE 0x4000CBA1 RL_VALUE_UBYTE 0 CM_u8_time_s 0 255 /end CHARACTERISTIC
/begin CHARACTERISTIC CAL_obd_ii_high_load_monitor_afr_max "u16_afr_1/100" VALUE 0x4000CBA2 RL_VALUE_UWORD 0 CM_u16_afr_1_100 0 655.35 /end CHARACTERISTIC
/begin CHARACTERISTIC CAL_obd_ii_P2191_lean_confirm_time "u8_time_100ms" VALUE 0x4000CBA4 RL_VALUE_UBYTE 0 CM_u8_time_100ms 0 25500 /end CHARACTERISTIC
/begin CHARACTERISTIC CAL_obd_ii_P2192_rich_confirm_time "u8_time_100ms" VALUE 0x4000CBA5 RL_VALUE_UBYTE 0 CM_u8_time_100ms 0 25500 /end CHARACTERISTIC
/begin CHARACTERISTIC CAL_obd_ii_high_load_monitor_load_min "u8_load_4mg/stroke" VALUE 0x4000CBA6 RL_VALUE_UBYTE 0 CM_u8_load_4mg_stroke 0 1020 /end CHARACTERISTIC
/begin CHARACTERISTIC CAL_obd_ii_drive_cycle_car_speed_min "Calibration: (0091 0x4000d377 CAL_obd_ii_drive_cycle_car_speed_min)" VALUE 0x4000CBA7 RL_VALUE_UBYTE 0 CM_u8_speed_kph 0 255 /end CHARACTERISTIC
/begin CHARACTERISTIC CAL_obd_ii_drive_cycle_idle_time "u16_time_100ms" VALUE 0x4000CBA8 RL_VALUE_UWORD 0 CM_u8_time_100ms 0 6553500 /end CHARACTERISTIC
/begin CHARACTERISTIC CAL_obd_ii_drive_cycle_runtime "Calibration: (0091 0x4000d37a CAL_obd_ii_drive_cycle_runtime)" VALUE 0x4000CBAA RL_VALUE_UWORD 0 CM_u8_time_100ms 0 6553500 /end CHARACTERISTIC
/begin CHARACTERISTIC CAL_obd_ii_gd_speed_time "Calibration: (0091 0x4000d37c CAL_obd_ii_gd_speed_time)" VALUE 0x4000CBAC RL_VALUE_UWORD 0 CM_u8_time_100ms 0 6553500 /end CHARACTERISTIC
/begin CHARACTERISTIC CAL_obd_ii_monitor_rpm_delta_max "u16_rspeed_rpm" VALUE 0x4000CBAE RL_VALUE_UWORD 0 CM_u8_rspeed_rpm 0 65535 /end CHARACTERISTIC
/begin CHARACTERISTIC CAL_obd_ii_gd_speed_min "Calibration: OBD state update needs car speed > this. (0091 CAL_obd_ii_unknown5)" VALUE 0x4000CBB1 RL_VALUE_UBYTE 0 CM_u8_speed_kph 0 255 /end CHARACTERISTIC
/begin CHARACTERISTIC CAL_obd_ii_evap_monitor_settle_count "Calibration: evap monitor settle counter." VALUE 0x4000CBB2 RL_VALUE_UBYTE 0 NO_COMPU_METHOD 0 255 /end CHARACTERISTIC
/begin CHARACTERISTIC CAL_obd_ii_evap_purge_settle_debounce "u8_time_100ms" VALUE 0x4000CBB3 RL_VALUE_UBYTE 0 CM_u8_time_100ms 0 25500 /end CHARACTERISTIC
/begin CHARACTERISTIC CAL_obd_ii_P0451_debounce_count "u8_count" VALUE 0x4000CBB5 RL_VALUE_UBYTE 0 NO_COMPU_METHOD 0 255 /end CHARACTERISTIC
/begin CHARACTERISTIC CAL_obd_ii_o2_period_consistency_tol "u8_time_5ms" VALUE 0x4000CBB8 RL_VALUE_UBYTE 0 CM_u8_time_5ms 0 1275 /end CHARACTERISTIC
/begin CHARACTERISTIC CAL_obd_ii_o2_imbalance_sample_count "Calibration: (0091 0x4000d389 CAL_obd_ii_o2_imbalance_sample_count)" VALUE 0x4000CBB9 RL_VALUE_UBYTE 0 NO_COMPU_METHOD 0 255 /end CHARACTERISTIC
/begin CHARACTERISTIC CAL_obd_ii_o2_slow_response_maf_limit_unknown2 "u16_flow_10mg/s" VALUE 0x4000CBBA RL_VALUE_UWORD 0 CM_u16_flow_10mg_s 0 655350 /end CHARACTERISTIC
/begin CHARACTERISTIC CAL_obd_ii_o2_precat_diag_init_counter "u16_time_5ms" VALUE 0x4000CBBC RL_VALUE_UWORD 0 CM_u8_time_5ms 0 327675 /end CHARACTERISTIC
/begin CHARACTERISTIC CAL_obd_ii_o2_period_excess_max "u8_time_5ms" VALUE 0x4000CBBE RL_VALUE_UBYTE 0 CM_u8_time_5ms 0 1275 /end CHARACTERISTIC
/begin CHARACTERISTIC CAL_obd_ii_o2_imbalance_accum_cap "u8_time_5ms" VALUE 0x4000CBBF RL_VALUE_UBYTE 0 CM_u8_time_5ms 0 1275 /end CHARACTERISTIC
/begin CHARACTERISTIC CAL_obd_ii_cat_check_transient_blackout "Calibration: (0091 0x4000d390 CAL_obd_ii_cat_check_transient_blackout)" VALUE 0x4000CBC0 RL_VALUE_UWORD 0 CM_u8_time_5ms 0 327675 /end CHARACTERISTIC
/begin CHARACTERISTIC CAL_obd_ii_cat_check_tps_rate_max "Calibration: (0091 0x4000d392 CAL_obd_ii_cat_check_tps_rate_max)" VALUE 0x4000CBC2 RL_VALUE_UBYTE 0 CM_u16_factor_1_1023 0 24.9266862170088 /end CHARACTERISTIC
/begin CHARACTERISTIC CAL_obd_ii_monitor_tps_min "Calibration: monitor completion needs tps_8bit >= this. (0091 CAL_obd_ii_tps_unknown1)" VALUE 0x4000CBC3 RL_VALUE_UBYTE 0 CM_u8_factor_1_255 0 100 /end CHARACTERISTIC
/begin CHARACTERISTIC CAL_obd_ii_monitor_rpm_min "Calibration: monitor completion needs rpm >= this. (0091 CAL_obd_ii_rpm_unknown1)" VALUE 0x4000CBC6 RL_VALUE_UWORD 0 CM_u8_rspeed_rpm 0 65535 /end CHARACTERISTIC
/begin CHARACTERISTIC CAL_obd_ii_o2_slow_response_maf_limit_unknown "u16_flow_10mg/s" VALUE 0x4000CBC8 RL_VALUE_UWORD 0 CM_u16_flow_10mg_s 0 655350 /end CHARACTERISTIC
/begin CHARACTERISTIC CAL_obd_ii_o2_precat_diag_reset_counter "u16_time_5ms" VALUE 0x4000CBCA RL_VALUE_UWORD 0 CM_u8_time_5ms 0 327675 /end CHARACTERISTIC
/begin CHARACTERISTIC CAL_obd_ii_P0579_switch_changes_max "Calibration: (0091 0x4000d3a0 CAL_obd_ii_P0579_switch_changes_max)" VALUE 0x4000CBD0 RL_VALUE_UBYTE 0 NO_COMPU_METHOD 0 255 /end CHARACTERISTIC
/begin CHARACTERISTIC CAL_obd_ii_P0579_stuck_timeout "uint8_t" VALUE 0x4000CBD1 RL_VALUE_UBYTE 0 NO_COMPU_METHOD 0 255 /end CHARACTERISTIC
/begin CHARACTERISTIC CAL_clutch_sensor_confidence_max "Calibration: clutch sensor confidence maximum." VALUE 0x4000CBD2 RL_VALUE_UWORD 0 NO_COMPU_METHOD 0 65535 /end CHARACTERISTIC
/begin CHARACTERISTIC CAL_clutch_variance_threshold "Calibration: clutch variance threshold." VALUE 0x4000CBD4 RL_VALUE_UBYTE 0 NO_COMPU_METHOD 0 255 /end CHARACTERISTIC
/begin CHARACTERISTIC CAL_clutch_confidence_decrement "Calibration: clutch confidence decrement." VALUE 0x4000CBD5 RL_VALUE_UBYTE 0 NO_COMPU_METHOD 0 255 /end CHARACTERISTIC
/begin CHARACTERISTIC CAL_clutch_confidence_increment "Calibration: clutch confidence increment." VALUE 0x4000CBD6 RL_VALUE_UBYTE 0 NO_COMPU_METHOD 0 255 /end CHARACTERISTIC
/begin CHARACTERISTIC CAL_obd_ii_P219A_imbalance_window_count "Calibration: (0091 0x4000d3a7 CAL_obd_ii_P219A_imbalance_window_count)" VALUE 0x4000CBD7 RL_VALUE_UBYTE 0 NO_COMPU_METHOD 0 255 /end CHARACTERISTIC
/begin CHARACTERISTIC CAL_obd_ii_P219A_load_min "u16_load_mg/stroke" VALUE 0x4000CBD8 RL_VALUE_UWORD 0 CM_u8_load_mg_stroke 0 65535 /end CHARACTERISTIC
/begin CHARACTERISTIC CAL_obd_ii_P219A_load_max "u16_load_mg/stroke" VALUE 0x4000CBDA RL_VALUE_UWORD 0 CM_u8_load_mg_stroke 0 65535 /end CHARACTERISTIC
/begin CHARACTERISTIC CAL_obd_ii_P219A_rpm_min "u8_rspeed_125/4+500rpm" VALUE 0x4000CBDC RL_VALUE_UBYTE 0 CM_u8_rspeed_125_4_500rpm 500 8468.75 /end CHARACTERISTIC
/begin CHARACTERISTIC CAL_obd_ii_P219A_rpm_max "u8_rspeed_125/4+500rpm" VALUE 0x4000CBDD RL_VALUE_UBYTE 0 CM_u8_rspeed_125_4_500rpm 500 8468.75 /end CHARACTERISTIC
/begin CHARACTERISTIC CAL_obd_ii_P219A_maf_min "u16_flow_10mg/s" VALUE 0x4000CBDE RL_VALUE_UWORD 0 CM_u16_flow_10mg_s 0 655350 /end CHARACTERISTIC
/begin CHARACTERISTIC CAL_obd_ii_P219A_maf_max "u16_flow_10mg/s" VALUE 0x4000CBE0 RL_VALUE_UWORD 0 CM_u16_flow_10mg_s 0 655350 /end CHARACTERISTIC
/begin CHARACTERISTIC CAL_obd_ii_fuel_learn_eng_speed_delta_max "Calibration: (0091 0x4000d3b2 CAL_obd_ii_fuel_learn_eng_speed_delta_max)" VALUE 0x4000CBE2 RL_VALUE_UWORD 0 CM_u8_rspeed_rpm 0 65535 /end CHARACTERISTIC
/begin CHARACTERISTIC CAL_obd_ii_P219A_coolant_min "u8_temp_5/8-40c" VALUE 0x4000CBE4 RL_VALUE_UBYTE 0 CM_u8_temp_5_8_40c -40 119.375 /end CHARACTERISTIC
/begin CHARACTERISTIC CAL_obd_ii_fuel_learn_max_load_delta "Calibration: (0091 0x4000d3b5 CAL_obd_ii_fuel_learn_max_load_delta)" VALUE 0x4000CBE5 RL_VALUE_UBYTE 0 CM_u8_load_mg_stroke 0 255 /end CHARACTERISTIC
/begin CHARACTERISTIC CAL_obd_ii_fuel_learn_inhibit_holdoff_ticks "Calibration: (0091 0x4000d3b6 CAL_obd_ii_fuel_learn_inhibit_holdoff_ticks)" VALUE 0x4000CBE6 RL_VALUE_UWORD 0 CM_u8_time_ms 0 65535 /end CHARACTERISTIC
/begin CHARACTERISTIC CAL_obd_ii_o2_imbalance_sample_total "Calibration: O2 imbalance total sample count. (0091 shares name with 0xcbb9 slot)" VALUE 0x4000CBE8 RL_VALUE_UWORD 0 NO_COMPU_METHOD 0 65535 /end CHARACTERISTIC
/begin CHARACTERISTIC CAL_obd_ii_o2_imbalance_threshold "u16_factor_1/1000" VALUE 0x4000CBEA RL_VALUE_UWORD 0 CM_u16_factor_1_1000 0 6553.5 /end CHARACTERISTIC
/begin CHARACTERISTIC CAL_obd_ii_o2_imbalance_sample_period "Calibration: (0091 0x4000d3bc CAL_obd_ii_o2_imbalance_sample_period)" VALUE 0x4000CBEC RL_VALUE_UBYTE 0 CM_u8_time_ms 0 255 /end CHARACTERISTIC
/begin CHARACTERISTIC CAL_obd_ii_P0101_idle_coolant_min "Calibration: (0091 0x4000d3bd CAL_obd_ii_P0101_idle_coolant_min)" VALUE 0x4000CBED RL_VALUE_UBYTE 0 CM_u8_temp_5_8_40c -40 119.375 /end CHARACTERISTIC
/begin CHARACTERISTIC CAL_obd_ii_P0101_idle_dwell_min "Calibration: (0091 0x4000d3be CAL_obd_ii_P0101_idle_dwell_min)" VALUE 0x4000CBEE RL_VALUE_UBYTE 0 CM_u8_time_100ms 0 25500 /end CHARACTERISTIC
/begin CHARACTERISTIC CAL_obd_ii_P0101_idle_iat_max "Calibration: (0091 0x4000d3bf CAL_obd_ii_P0101_idle_iat_max)" VALUE 0x4000CBEF RL_VALUE_UBYTE 0 CM_u8_temp_5_8_40c -40 119.375 /end CHARACTERISTIC
/begin CHARACTERISTIC CAL_obd_ii_P0101_runtime_min "Calibration: (0091 0x4000d3c0 CAL_obd_ii_P0101_runtime_min)" VALUE 0x4000CBF0 RL_VALUE_UBYTE 0 CM_u8_time_s 0 255 /end CHARACTERISTIC
/begin CHARACTERISTIC CAL_obd_ii_P0101_load_tolerance_pct_idle "Calibration: (0091 0x4000d3c1 CAL_obd_ii_P0101_load_tolerance_pct_idle)" VALUE 0x4000CBF1 RL_VALUE_UBYTE 0 CM_u8_factor_1_100 0 255 /end CHARACTERISTIC
/begin CHARACTERISTIC CAL_obd_ii_P0101_baro_min "Calibration: (0091 0x4000d3c2 CAL_obd_ii_P0101_baro_min)" VALUE 0x4000CBF2 RL_VALUE_UWORD 0 CM_i16_pressure_mbar 0 65535 /end CHARACTERISTIC
/begin CHARACTERISTIC CAL_obd_ii_P0101_plausibility_enable "bool" VALUE 0x4000CBF4 RL_VALUE_UBYTE 0 NO_COMPU_METHOD 0 255 /end CHARACTERISTIC
/begin CHARACTERISTIC CAL_obd_ii_knock_no_activity_count "Calibration: knock no-activity count." VALUE 0x4000CBF5 RL_VALUE_UBYTE 0 NO_COMPU_METHOD 0 255 /end CHARACTERISTIC
/begin CHARACTERISTIC CAL_obd_ii_knock_monitor_sample_count "Calibration: (0091 0x4000d3c6 CAL_obd_ii_knock_monitor_sample_count)" VALUE 0x4000CBF6 RL_VALUE_UWORD 0 CM_u8_time_100ms 0 6553500 /end CHARACTERISTIC
/begin CHARACTERISTIC CAL_gsi_downshift_idle_margin "Calibration: (0091 0x4000d413 CAL_gsi_downshift_idle_margin)" VALUE 0x4000CC43 RL_VALUE_UBYTE 0 NO_COMPU_METHOD 0 255 /end CHARACTERISTIC
/begin CHARACTERISTIC CAL_obd_ii_P0191_stuck_check_count_fueling "Calibration: P0191 stuck-check samples (fueling)." VALUE 0x4000CC4A RL_VALUE_UBYTE 0 NO_COMPU_METHOD 0 255 /end CHARACTERISTIC
/begin CHARACTERISTIC CAL_obd_ii_P0191_stuck_check_count_dfco "Calibration: P0191 stuck-check samples (DFCO)." VALUE 0x4000CC4B RL_VALUE_UBYTE 0 NO_COMPU_METHOD 0 255 /end CHARACTERISTIC
/begin CHARACTERISTIC CAL_obd_ii_P0191_pressure_span_min "Calibration: P0191: rail pressure max-min must exceed this (mbar) to prove sensor activity. 0278-only (GT430 monitor; 0091 slot is CAL_unused_array2)." VALUE 0x4000CC4C RL_VALUE_UBYTE 0 NO_COMPU_METHOD 0 255 /end CHARACTERISTIC
/begin CHARACTERISTIC CAL_obd_ii_P0191_pid_correction_span_min "Calibration: P0191: pump PID correction span threshold (cal<<3). 0278-only (GT430 monitor; 0091 slot is CAL_unused_array2)." VALUE 0x4000CC4D RL_VALUE_UBYTE 0 NO_COMPU_METHOD 0 255 /end CHARACTERISTIC
/begin CHARACTERISTIC CAL_obd_ii_P0191_trim_check_count "Calibration: P0191 trim cross-check debounce." VALUE 0x4000CC5F RL_VALUE_UBYTE 0 NO_COMPU_METHOD 0 255 /end CHARACTERISTIC
/begin CHARACTERISTIC CAL_obd_ii_P0191_maf_min "Calibration: P0191 MAF min (vs obd_ii_maf_flow)." VALUE 0x4000CC60 RL_VALUE_UWORD 0 CM_u16_flow_10mg_s 0 655350 /end CHARACTERISTIC
/begin CHARACTERISTIC CAL_obd_ii_P0191_flow_min "Calibration: P0191 fueling stuck-check needs DAT_400016a8 flow > this. 0278-only (GT430 monitor; 0091 slot is CAL_unused_array2)." VALUE 0x4000CC62 RL_VALUE_UWORD 0 NO_COMPU_METHOD 0 65535 /end CHARACTERISTIC
/begin CHARACTERISTIC CAL_obd_ii_P0191_pid_correction_limit "Calibration: P0191 fuel pump PID correction limit (pump terms are u16_factor_1/10000)." VALUE 0x4000CC64 RL_VALUE_UWORD 0 CM_u16_factor_1_10000 0 655.35 /end CHARACTERISTIC
/begin CHARACTERISTIC CAL_obd_ii_P0096_air_mass_min "Calibration: P0096 needs accumulated air > cal<<6 g." VALUE 0x4000CC66 RL_VALUE_UBYTE 0 CM_u8_mass_64g 0 16320 /end CHARACTERISTIC
/begin CHARACTERISTIC CAL_obd_ii_P0096_high_flow_maf_min "Calibration: P0096 high-flow MAF min (cal<<4 in 10 mg/s)." VALUE 0x4000CC67 RL_VALUE_UBYTE 0 CM_u8_flow_160mg_s 0 40800 /end CHARACTERISTIC
/begin CHARACTERISTIC CAL_obd_ii_P0096_idle_phase_dwell "Calibration: P0096 idle phase dwell counter reload. 0278-only (GT430 monitor; 0091 slot is CAL_unused_array2)." VALUE 0x4000CC68 RL_VALUE_UBYTE 0 NO_COMPU_METHOD 0 255 /end CHARACTERISTIC
/begin CHARACTERISTIC CAL_obd_ii_P0096_high_flow_phase_dwell "Calibration: P0096 high-flow phase dwell counter reload. 0278-only (GT430 monitor; 0091 slot is CAL_unused_array2)." VALUE 0x4000CC69 RL_VALUE_UBYTE 0 NO_COMPU_METHOD 0 255 /end CHARACTERISTIC
/begin CHARACTERISTIC CAL_obd_ii_P0096_high_flow_phase_count "Calibration: P0096 high-flow phases required." VALUE 0x4000CC6A RL_VALUE_UBYTE 0 NO_COMPU_METHOD 0 255 /end CHARACTERISTIC
/begin CHARACTERISTIC CAL_obd_ii_P0096_idle_phase_count "Calibration: P0096 idle phases required." VALUE 0x4000CC6B RL_VALUE_UBYTE 0 NO_COMPU_METHOD 0 255 /end CHARACTERISTIC
/begin CHARACTERISTIC CAL_obd_ii_P0191_dual_sensor_agree_count "Calibration: P0191 dual-sensor agreement count." VALUE 0x4000CC6C RL_VALUE_UBYTE 0 NO_COMPU_METHOD 0 255 /end CHARACTERISTIC
/begin CHARACTERISTIC CAL_obd_ii_P0191_dual_sensor_delta_max "Calibration: P0191: |rail pressure 1 - 2| limit (cal<<2 mbar) with cylinders cut. 0278-only (GT430 monitor; 0091 slot is CAL_unused_array2)." VALUE 0x4000CC6D RL_VALUE_UBYTE 0 NO_COMPU_METHOD 0 255 /end CHARACTERISTIC
/begin CHARACTERISTIC CAL_obd_ii_P0191_cyl_cut_settle_count "Calibration: P0191 cylinder-cut settle count." VALUE 0x4000CC6E RL_VALUE_UBYTE 0 NO_COMPU_METHOD 0 255 /end CHARACTERISTIC
/begin CHARACTERISTIC CAL_obd_ii_P1109_high_load_phase_dwell "Calibration: P1109 high-load phase dwell reload. 0278-only (GT430 monitor; 0091 slot is CAL_unused_array2)." VALUE 0x4000CC6F RL_VALUE_UBYTE 0 NO_COMPU_METHOD 0 255 /end CHARACTERISTIC
/begin CHARACTERISTIC CAL_obd_ii_P1109_high_load_phase_count "Calibration: P1109 high-load phases required." VALUE 0x4000CC70 RL_VALUE_UBYTE 0 NO_COMPU_METHOD 0 255 /end CHARACTERISTIC
/begin CHARACTERISTIC CAL_obd_ii_P1109_idle_phase_dwell "Calibration: P1109 idle phase dwell reload. 0278-only (GT430 monitor; 0091 slot is CAL_unused_array2)." VALUE 0x4000CC71 RL_VALUE_UBYTE 0 NO_COMPU_METHOD 0 255 /end CHARACTERISTIC
/begin CHARACTERISTIC CAL_obd_ii_P1109_idle_phase_count "Calibration: P1109 idle phases required." VALUE 0x4000CC72 RL_VALUE_UBYTE 0 NO_COMPU_METHOD 0 255 /end CHARACTERISTIC
/begin CHARACTERISTIC CAL_obd_ii_P1109_high_load_tps_min "Calibration: P1109 high-load phase needs requested TPS > this. 0278-only (GT430 monitor; 0091 slot is CAL_unused_array2)." VALUE 0x4000CC73 RL_VALUE_UBYTE 0 CM_u8_factor_1_255 0 100 /end CHARACTERISTIC
/begin CHARACTERISTIC CAL_obd_ii_P1109_map_voltage_span_min "Calibration: P1109: MAP voltage max-min must exceed this (activity). 0278-only (GT430 monitor; 0091 slot is CAL_unused_array2)." VALUE 0x4000CC74 RL_VALUE_UWORD 0 CM_u16_voltage_5_1023v 0 320.307917888563 /end CHARACTERISTIC
/begin CHARACTERISTIC CAL_obd_ii_P1109_map_agree_count "Calibration: P1109 MAP agreement count." VALUE 0x4000CC76 RL_VALUE_UBYTE 0 NO_COMPU_METHOD 0 255 /end CHARACTERISTIC
/begin CHARACTERISTIC CAL_obd_ii_P1109_map_delta_max "Calibration: P1109 |MAP - MAP2| limit (cal<<2 mbar). 0278-only (GT430 monitor; 0091 slot is CAL_unused_array2)." VALUE 0x4000CC77 RL_VALUE_UBYTE 0 NO_COMPU_METHOD 0 255 /end CHARACTERISTIC
/begin CHARACTERISTIC CAL_obd_ii_P1109_tps_rate_max "Calibration: P1109 model compare only when |TPS rate| <= this." VALUE 0x4000CC78 RL_VALUE_UWORD 0 CM_u16_factor_1_1023 0 6406.15835777126 /end CHARACTERISTIC
/begin CHARACTERISTIC CAL_obd_ii_P1109_load_model_tol "Calibration: P1109 |SD load - MAF load| tolerance (mode 0). 0278-only (GT430 monitor; 0091 slot is CAL_unused_array2)." VALUE 0x4000CC7A RL_VALUE_UBYTE 0 NO_COMPU_METHOD 0 255 /end CHARACTERISTIC
/begin CHARACTERISTIC CAL_obd_ii_P1109_steady_settle "Calibration: P1109 steady-state settle counter reload. 0278-only (GT430 monitor; 0091 slot is CAL_unused_array2)." VALUE 0x4000CC7B RL_VALUE_UBYTE 0 NO_COMPU_METHOD 0 255 /end CHARACTERISTIC
/begin CHARACTERISTIC CAL_obd_ii_P1109_model_agree_count "Calibration: P1109 model agreement count." VALUE 0x4000CC7C RL_VALUE_UBYTE 0 NO_COMPU_METHOD 0 255 /end CHARACTERISTIC
/begin CHARACTERISTIC CAL_obd_ii_P1109_rpm_max "Calibration: P1109 model compare rpm max. 0278-only (GT430 monitor; 0091 slot is CAL_unused_array2)." VALUE 0x4000CC7D RL_VALUE_UBYTE 0 CM_u8_rspeed_125_4_500rpm 500 8468.75 /end CHARACTERISTIC
/begin CHARACTERISTIC CAL_obd_ii_P1109_load_max "Calibration: P1109 model compare load max. 0278-only (GT430 monitor; 0091 slot is CAL_unused_array2)." VALUE 0x4000CC7E RL_VALUE_UBYTE 0 CM_u8_load_4mg_stroke 0 1020 /end CHARACTERISTIC
/begin CHARACTERISTIC CAL_obd_ii_P1109_use_map_model "Calibration: P1109 mode: 1 = MAP vs calculated MAP, 0 = SD load vs MAF load. 0278-only (GT430 monitor; 0091 slot is CAL_unused_array2)." VALUE 0x4000CC7F RL_VALUE_UBYTE 0 NO_COMPU_METHOD 0 255 /end CHARACTERISTIC
/begin CHARACTERISTIC CAL_obd_ii_P1109_map_model_tol "Calibration: P1109 |MAP - calculated MAP| tolerance (mode 1). 0278-only (GT430 monitor; 0091 slot is CAL_unused_array2)." VALUE 0x4000CC80 RL_VALUE_UBYTE 0 NO_COMPU_METHOD 0 255 /end CHARACTERISTIC
/begin CHARACTERISTIC CAL_obd_ii_map_baro_engine_off_tol "Calibration: engine-off |baro - MAP| tolerance (mbar)." VALUE 0x4000CC81 RL_VALUE_UBYTE 0 CM_i16_pressure_mbar 0 255 /end CHARACTERISTIC
/begin CHARACTERISTIC CAL_obd_ii_map_baro_engine_off_pass_count "Calibration: engine-off MAP/baro pass count." VALUE 0x4000CC82 RL_VALUE_UBYTE 0 NO_COMPU_METHOD 0 255 /end CHARACTERISTIC
/begin CHARACTERISTIC CAL_obd_ii_map_baro_engine_off_fail_count "Calibration: engine-off MAP/baro fail count." VALUE 0x4000CC83 RL_VALUE_UBYTE 0 NO_COMPU_METHOD 0 255 /end CHARACTERISTIC
/begin CHARACTERISTIC CAL_obd_ii_P1109_pass_period "Calibration: P1109 pass period counter reload. 0278-only (GT430 monitor; 0091 slot is CAL_unused_array2)." VALUE 0x4000CC84 RL_VALUE_UBYTE 0 NO_COMPU_METHOD 0 255 /end CHARACTERISTIC
/begin CHARACTERISTIC CAL_obd_ii_mat_ambient_heatsoak_delta "Calibration: manifold temp - ambient > this flags heat soak. 0278-only (GT430 monitor; 0091 slot is CAL_unused_array2)." VALUE 0x4000CC85 RL_VALUE_UBYTE 0 CM_u8_tempdelta_5_8c 0 159.375 /end CHARACTERISTIC
/begin CHARACTERISTIC CAL_obd_ii_temp_sensor_soak_time "Calibration: engine-off soak count threshold for cold-start temp sensor cross-check. 0278-only (GT430 monitor; 0091 slot is CAL_unused_array2)." VALUE 0x4000CC86 RL_VALUE_UWORD 0 NO_COMPU_METHOD 0 65535 /end CHARACTERISTIC
/begin CHARACTERISTIC CAL_obd_ii_cold_start_coolant_agree_tol "Calibration: cold start: |coolant - other temp sensor| < this = agree. 0278-only (GT430 monitor; 0091 slot is CAL_unused_array2)." VALUE 0x4000CC88 RL_VALUE_UBYTE 0 CM_u8_tempdelta_5_8c 0 159.375 /end CHARACTERISTIC
/begin CHARACTERISTIC CAL_obd_ii_cold_start_ambient_low_margin "Calibration: cold start: ambient reads low vs others by > this. 0278-only (GT430 monitor; 0091 slot is CAL_unused_array2)." VALUE 0x4000CC89 RL_VALUE_UBYTE 0 CM_u8_tempdelta_5_8c 0 159.375 /end CHARACTERISTIC
/begin CHARACTERISTIC CAL_obd_ii_cold_start_ambient_high_margin "Calibration: cold start: ambient reads high vs others by > this. 0278-only (GT430 monitor; 0091 slot is CAL_unused_array2)." VALUE 0x4000CC8A RL_VALUE_UBYTE 0 CM_u8_tempdelta_5_8c 0 159.375 /end CHARACTERISTIC
/begin CHARACTERISTIC CAL_obd_ii_cold_start_iat_drop_max "Calibration: cold start: captured IAT - current IAT > this aborts. 0278-only (GT430 monitor; 0091 slot is CAL_unused_array2)." VALUE 0x4000CC8B RL_VALUE_UBYTE 0 CM_u8_tempdelta_5_8c 0 159.375 /end CHARACTERISTIC
/begin CHARACTERISTIC CAL_obd_ii_cold_start_low_flow_count "Calibration: cold start low-flow dwell (cal<<3). 0278-only (GT430 monitor; 0091 slot is CAL_unused_array2)." VALUE 0x4000CC8C RL_VALUE_UBYTE 0 NO_COMPU_METHOD 0 255 /end CHARACTERISTIC
/begin CHARACTERISTIC CAL_obd_ii_cold_start_low_flow_maf_max "Calibration: cold-start low-flow MAF max (cal<<4 in 10 mg/s)." VALUE 0x4000CC8D RL_VALUE_UBYTE 0 CM_u8_flow_160mg_s 0 40800 /end CHARACTERISTIC
/begin CHARACTERISTIC CAL_obd_ii_cold_start_iat_low_margin "Calibration: cold start: IAT reads low vs others by > this. 0278-only (GT430 monitor; 0091 slot is CAL_unused_array2)." VALUE 0x4000CC8E RL_VALUE_UBYTE 0 CM_u8_tempdelta_5_8c 0 159.375 /end CHARACTERISTIC
/begin CHARACTERISTIC CAL_obd_ii_cold_start_iat_high_margin "Calibration: cold start: IAT reads high vs others by > this. 0278-only (GT430 monitor; 0091 slot is CAL_unused_array2)." VALUE 0x4000CC8F RL_VALUE_UBYTE 0 CM_u8_tempdelta_5_8c 0 159.375 /end CHARACTERISTIC
/begin CHARACTERISTIC CAL_obd_ii_cold_start_coolant_low_margin "Calibration: cold start: coolant reads low vs others by > this (255 = off). 0278-only (GT430 monitor; 0091 slot is CAL_unused_array2)." VALUE 0x4000CC90 RL_VALUE_UBYTE 0 CM_u8_tempdelta_5_8c 0 159.375 /end CHARACTERISTIC
/begin CHARACTERISTIC CAL_obd_ii_cold_start_coolant_high_margin "Calibration: cold start: coolant reads high vs others by > this (255 = off). 0278-only (GT430 monitor; 0091 slot is CAL_unused_array2)." VALUE 0x4000CC91 RL_VALUE_UBYTE 0 CM_u8_tempdelta_5_8c 0 159.375 /end CHARACTERISTIC
/begin CHARACTERISTIC CAL_obd_ii_cold_start_mat_low_margin "Calibration: cold start: manifold temp reads low vs others by > this. 0278-only (GT430 monitor; 0091 slot is CAL_unused_array2)." VALUE 0x4000CC92 RL_VALUE_UBYTE 0 CM_u8_tempdelta_5_8c 0 159.375 /end CHARACTERISTIC
/begin CHARACTERISTIC CAL_obd_ii_cold_start_mat_high_margin "Calibration: cold start: manifold temp reads high vs others by > this. 0278-only (GT430 monitor; 0091 slot is CAL_unused_array2)." VALUE 0x4000CC93 RL_VALUE_UBYTE 0 CM_u8_tempdelta_5_8c 0 159.375 /end CHARACTERISTIC
/begin CHARACTERISTIC CAL_obd_ii_trans_fluid_temp_high "Calibration: IPS trans fluid temp high (vs trans_fluid_temp_u8)." VALUE 0x4000CCA0 RL_VALUE_UBYTE 0 CM_u8_temp_5_8_40c -40 119.375 /end CHARACTERISTIC
/begin CHARACTERISTIC CAL_obd_ii_P0897_debounce "Calibration: P0897 debounce." VALUE 0x4000CCA1 RL_VALUE_UBYTE 0 NO_COMPU_METHOD 0 255 /end CHARACTERISTIC
/begin CHARACTERISTIC CAL_obd_ii_trans_fluid_pump_time_min "Calibration: IPS trans fluid pump run-time threshold (P0712/P0713). 0278-only." VALUE 0x4000CCA2 RL_VALUE_UWORD 0 NO_COMPU_METHOD 0 65535 /end CHARACTERISTIC
/begin CHARACTERISTIC CAL_obd_ii_trans_fluid_temp_window "Calibration: IPS trans fluid check temp window [hi,lo]." VAL_BLK 0x4000CCAA RL_VALUE_UBYTE 0 CM_u8_temp_5_8_40c -40 119.375 NUMBER 2 /end CHARACTERISTIC
/begin CHARACTERISTIC CAL_obd_ii_trans_fluid_speed_window "Calibration: IPS trans fluid check car-speed window [hi,lo]. 0278-only." VAL_BLK 0x4000CCAC RL_VALUE_UBYTE 0 CM_u8_speed_kph 0 255 NUMBER 2 /end CHARACTERISTIC
/begin CHARACTERISTIC CAL_obd_ii_P0712 "Calibration: OBD-II P0712 (OBD-II monitor enable level)." VALUE 0x4000D1AC RL_VALUE_UBYTE 0 NO_COMPU_METHOD 0 255 /end CHARACTERISTIC
/begin CHARACTERISTIC CAL_obd_ii_P0106 "Calibration: OBD-II P0106 (OBD-II monitor enable level)." VALUE 0x4000D1AD RL_VALUE_UBYTE 0 NO_COMPU_METHOD 0 255 /end CHARACTERISTIC
/begin CHARACTERISTIC CAL_obd_ii_P0107 "Calibration: OBD-II P0107 (OBD-II monitor enable level)." VALUE 0x4000D1AE RL_VALUE_UBYTE 0 NO_COMPU_METHOD 0 255 /end CHARACTERISTIC
/begin CHARACTERISTIC CAL_obd_ii_P0108 "Calibration: OBD-II P0108 (OBD-II monitor enable level)." VALUE 0x4000D1AF RL_VALUE_UBYTE 0 NO_COMPU_METHOD 0 255 /end CHARACTERISTIC
/begin CHARACTERISTIC CAL_obd_ii_P0713 "Calibration: OBD-II P0713 (OBD-II monitor enable level)." VALUE 0x4000D1B0 RL_VALUE_UBYTE 0 NO_COMPU_METHOD 0 255 /end CHARACTERISTIC
/begin CHARACTERISTIC CAL_obd_ii_P0111 "Calibration: OBD-II P0111 (OBD-II monitor enable level)." VALUE 0x4000D1B1 RL_VALUE_UBYTE 0 NO_COMPU_METHOD 0 255 /end CHARACTERISTIC
/begin CHARACTERISTIC CAL_obd_ii_P0112 "Calibration: OBD-II P0112 (OBD-II monitor enable level)." VALUE 0x4000D1B2 RL_VALUE_UBYTE 0 NO_COMPU_METHOD 0 255 /end CHARACTERISTIC
/begin CHARACTERISTIC CAL_obd_ii_P0113 "Calibration: OBD-II P0113 (OBD-II monitor enable level)." VALUE 0x4000D1B3 RL_VALUE_UBYTE 0 NO_COMPU_METHOD 0 255 /end CHARACTERISTIC
/begin CHARACTERISTIC CAL_obd_ii_P0071 "Calibration: OBD-II P0071 (OBD-II monitor enable level)." VALUE 0x4000D1B4 RL_VALUE_UBYTE 0 NO_COMPU_METHOD 0 255 /end CHARACTERISTIC
/begin CHARACTERISTIC CAL_obd_ii_P0116 "Calibration: OBD-II P0116 (OBD-II monitor enable level)." VALUE 0x4000D1B5 RL_VALUE_UBYTE 0 NO_COMPU_METHOD 0 255 /end CHARACTERISTIC
/begin CHARACTERISTIC CAL_obd_ii_P0117 "Calibration: OBD-II P0117 (OBD-II monitor enable level)." VALUE 0x4000D1B6 RL_VALUE_UBYTE 0 NO_COMPU_METHOD 0 255 /end CHARACTERISTIC
/begin CHARACTERISTIC CAL_obd_ii_P0118 "Calibration: OBD-II P0118 (OBD-II monitor enable level)." VALUE 0x4000D1B7 RL_VALUE_UBYTE 0 NO_COMPU_METHOD 0 255 /end CHARACTERISTIC
/begin CHARACTERISTIC CAL_obd_ii_P2170 "Calibration: OBD-II P2170 (OBD-II monitor enable level)." VALUE 0x4000D1B8 RL_VALUE_UBYTE 0 NO_COMPU_METHOD 0 255 /end CHARACTERISTIC
/begin CHARACTERISTIC CAL_obd_ii_P2171 "Calibration: OBD-II P2171 (OBD-II monitor enable level)." VALUE 0x4000D1B9 RL_VALUE_UBYTE 0 NO_COMPU_METHOD 0 255 /end CHARACTERISTIC
/begin CHARACTERISTIC CAL_obd_ii_P0122 "Calibration: OBD-II P0122 (OBD-II monitor enable level)." VALUE 0x4000D1BA RL_VALUE_UBYTE 0 NO_COMPU_METHOD 0 255 /end CHARACTERISTIC
/begin CHARACTERISTIC CAL_obd_ii_P0123 "Calibration: OBD-II P0123 (OBD-II monitor enable level)." VALUE 0x4000D1BB RL_VALUE_UBYTE 0 NO_COMPU_METHOD 0 255 /end CHARACTERISTIC
/begin CHARACTERISTIC CAL_obd_ii_P2191 "Calibration: OBD-II P2191 (OBD-II monitor enable level)." VALUE 0x4000D1BC RL_VALUE_UBYTE 0 NO_COMPU_METHOD 0 255 /end CHARACTERISTIC
/begin CHARACTERISTIC CAL_obd_ii_P0128 "Calibration: OBD-II P0128 (OBD-II monitor enable level)." VALUE 0x4000D1BD RL_VALUE_UBYTE 0 NO_COMPU_METHOD 0 255 /end CHARACTERISTIC
/begin CHARACTERISTIC CAL_obd_ii_P0131 "Calibration: OBD-II P0131 (OBD-II monitor enable level)." VALUE 0x4000D1BE RL_VALUE_UBYTE 0 NO_COMPU_METHOD 0 255 /end CHARACTERISTIC
/begin CHARACTERISTIC CAL_obd_ii_P0132 "Calibration: OBD-II P0132 (OBD-II monitor enable level)." VALUE 0x4000D1BF RL_VALUE_UBYTE 0 NO_COMPU_METHOD 0 255 /end CHARACTERISTIC
/begin CHARACTERISTIC CAL_obd_ii_P0133 "Calibration: OBD-II P0133 (OBD-II monitor enable level)." VALUE 0x4000D1C0 RL_VALUE_UBYTE 0 NO_COMPU_METHOD 0 255 /end CHARACTERISTIC
/begin CHARACTERISTIC CAL_obd_ii_P0134 "Calibration: OBD-II P0134 (OBD-II monitor enable level)." VALUE 0x4000D1C1 RL_VALUE_UBYTE 0 NO_COMPU_METHOD 0 255 /end CHARACTERISTIC
/begin CHARACTERISTIC CAL_obd_ii_P0135 "Calibration: OBD-II P0135 (OBD-II monitor enable level)." VALUE 0x4000D1C2 RL_VALUE_UBYTE 0 NO_COMPU_METHOD 0 255 /end CHARACTERISTIC
/begin CHARACTERISTIC CAL_obd_ii_P2193 "Calibration: OBD-II P2193 (OBD-II monitor enable level)." VALUE 0x4000D1C3 RL_VALUE_UBYTE 0 NO_COMPU_METHOD 0 255 /end CHARACTERISTIC
/begin CHARACTERISTIC CAL_obd_ii_P0137 "Calibration: OBD-II P0137 (OBD-II monitor enable level)." VALUE 0x4000D1C4 RL_VALUE_UBYTE 0 NO_COMPU_METHOD 0 255 /end CHARACTERISTIC
/begin CHARACTERISTIC CAL_obd_ii_P0138 "Calibration: OBD-II P0138 (OBD-II monitor enable level)." VALUE 0x4000D1C5 RL_VALUE_UBYTE 0 NO_COMPU_METHOD 0 255 /end CHARACTERISTIC
/begin CHARACTERISTIC CAL_obd_ii_P0139 "Calibration: OBD-II P0139 (OBD-II monitor enable level)." VALUE 0x4000D1C6 RL_VALUE_UBYTE 0 NO_COMPU_METHOD 0 255 /end CHARACTERISTIC
/begin CHARACTERISTIC CAL_obd_ii_P0140 "Calibration: OBD-II P0140 (OBD-II monitor enable level)." VALUE 0x4000D1C7 RL_VALUE_UBYTE 0 NO_COMPU_METHOD 0 255 /end CHARACTERISTIC
/begin CHARACTERISTIC CAL_obd_ii_P0141 "Calibration: OBD-II P0141 (OBD-II monitor enable level)." VALUE 0x4000D1C8 RL_VALUE_UBYTE 0 NO_COMPU_METHOD 0 255 /end CHARACTERISTIC
/begin CHARACTERISTIC CAL_obd_ii_P0102 "Calibration: OBD-II P0102 (OBD-II monitor enable level)." VALUE 0x4000D1C9 RL_VALUE_UBYTE 0 NO_COMPU_METHOD 0 255 /end CHARACTERISTIC
/begin CHARACTERISTIC CAL_obd_ii_P0103 "Calibration: OBD-II P0103 (OBD-II monitor enable level)." VALUE 0x4000D1CA RL_VALUE_UBYTE 0 NO_COMPU_METHOD 0 255 /end CHARACTERISTIC
/begin CHARACTERISTIC CAL_obd_ii_P0101_manual "Calibration: OBD-II P0101 manual (OBD-II monitor enable level)." VALUE 0x4000D1CB RL_VALUE_UBYTE 0 NO_COMPU_METHOD 0 255 /end CHARACTERISTIC
/begin CHARACTERISTIC CAL_obd_ii_P2122 "Calibration: OBD-II P2122 (OBD-II monitor enable level)." VALUE 0x4000D1CC RL_VALUE_UBYTE 0 NO_COMPU_METHOD 0 255 /end CHARACTERISTIC
/begin CHARACTERISTIC CAL_obd_ii_P2123 "Calibration: OBD-II P2123 (OBD-II monitor enable level)." VALUE 0x4000D1CD RL_VALUE_UBYTE 0 NO_COMPU_METHOD 0 255 /end CHARACTERISTIC
/begin CHARACTERISTIC CAL_obd_ii_P2127 "Calibration: OBD-II P2127 (OBD-II monitor enable level)." VALUE 0x4000D1CE RL_VALUE_UBYTE 0 NO_COMPU_METHOD 0 255 /end CHARACTERISTIC
/begin CHARACTERISTIC CAL_obd_ii_P2128 "Calibration: OBD-II P2128 (OBD-II monitor enable level)." VALUE 0x4000D1CF RL_VALUE_UBYTE 0 NO_COMPU_METHOD 0 255 /end CHARACTERISTIC
/begin CHARACTERISTIC CAL_obd_ii_P0222 "Calibration: OBD-II P0222 (OBD-II monitor enable level)." VALUE 0x4000D1D0 RL_VALUE_UBYTE 0 NO_COMPU_METHOD 0 255 /end CHARACTERISTIC
/begin CHARACTERISTIC CAL_obd_ii_P0223 "Calibration: OBD-II P0223 (OBD-II monitor enable level)." VALUE 0x4000D1D1 RL_VALUE_UBYTE 0 NO_COMPU_METHOD 0 255 /end CHARACTERISTIC
/begin CHARACTERISTIC CAL_obd_ii_P2135 "Calibration: OBD-II P2135 (OBD-II monitor enable level)." VALUE 0x4000D1D2 RL_VALUE_UBYTE 0 NO_COMPU_METHOD 0 255 /end CHARACTERISTIC
/begin CHARACTERISTIC CAL_obd_ii_P0638 "Calibration: OBD-II P0638 (OBD-II monitor enable level)." VALUE 0x4000D1D3 RL_VALUE_UBYTE 0 NO_COMPU_METHOD 0 255 /end CHARACTERISTIC
/begin CHARACTERISTIC CAL_obd_ii_P2119 "Calibration: OBD-II P2119 (OBD-II monitor enable level)." VALUE 0x4000D1D4 RL_VALUE_UBYTE 0 NO_COMPU_METHOD 0 255 /end CHARACTERISTIC
/begin CHARACTERISTIC CAL_obd_ii_P1106 "Calibration: OBD-II P1106 (OBD-II monitor enable level)." VALUE 0x4000D1D5 RL_VALUE_UBYTE 0 NO_COMPU_METHOD 0 255 /end CHARACTERISTIC
/begin CHARACTERISTIC CAL_obd_ii_P0171 "Calibration: OBD-II P0171 (OBD-II monitor enable level)." VALUE 0x4000D1D6 RL_VALUE_UBYTE 0 NO_COMPU_METHOD 0 255 /end CHARACTERISTIC
/begin CHARACTERISTIC CAL_obd_ii_P0172 "Calibration: OBD-II P0172 (OBD-II monitor enable level)." VALUE 0x4000D1D7 RL_VALUE_UBYTE 0 NO_COMPU_METHOD 0 255 /end CHARACTERISTIC
/begin CHARACTERISTIC CAL_obd_ii_P0627 "Calibration: OBD-II P0627 (OBD-II monitor enable level)." VALUE 0x4000D1D8 RL_VALUE_UBYTE 0 NO_COMPU_METHOD 0 255 /end CHARACTERISTIC
/begin CHARACTERISTIC CAL_obd_ii_P0076 "Calibration: OBD-II P0076 (OBD-II monitor enable level)." VALUE 0x4000D1D9 RL_VALUE_UBYTE 0 NO_COMPU_METHOD 0 255 /end CHARACTERISTIC
/begin CHARACTERISTIC CAL_obd_ii_P0077 "Calibration: OBD-II P0077 (OBD-II monitor enable level)." VALUE 0x4000D1DA RL_VALUE_UBYTE 0 NO_COMPU_METHOD 0 255 /end CHARACTERISTIC
/begin CHARACTERISTIC CAL_obd_ii_P0261 "Calibration: OBD-II P0261 (OBD-II monitor enable level)." VALUE 0x4000D1DB RL_VALUE_UBYTE 0 NO_COMPU_METHOD 0 255 /end CHARACTERISTIC
/begin CHARACTERISTIC CAL_obd_ii_P0262 "Calibration: OBD-II P0262 (OBD-II monitor enable level)." VALUE 0x4000D1DC RL_VALUE_UBYTE 0 NO_COMPU_METHOD 0 255 /end CHARACTERISTIC
/begin CHARACTERISTIC CAL_obd_ii_P0264 "Calibration: OBD-II P0264 (OBD-II monitor enable level)." VALUE 0x4000D1DD RL_VALUE_UBYTE 0 NO_COMPU_METHOD 0 255 /end CHARACTERISTIC
/begin CHARACTERISTIC CAL_obd_ii_P0265 "Calibration: OBD-II P0265 (OBD-II monitor enable level)." VALUE 0x4000D1DE RL_VALUE_UBYTE 0 NO_COMPU_METHOD 0 255 /end CHARACTERISTIC
/begin CHARACTERISTIC CAL_obd_ii_P0267 "Calibration: OBD-II P0267 (OBD-II monitor enable level)." VALUE 0x4000D1DF RL_VALUE_UBYTE 0 NO_COMPU_METHOD 0 255 /end CHARACTERISTIC
/begin CHARACTERISTIC CAL_obd_ii_P0268 "Calibration: OBD-II P0268 (OBD-II monitor enable level)." VALUE 0x4000D1E0 RL_VALUE_UBYTE 0 NO_COMPU_METHOD 0 255 /end CHARACTERISTIC
/begin CHARACTERISTIC CAL_obd_ii_P0270 "Calibration: OBD-II P0270 (OBD-II monitor enable level)." VALUE 0x4000D1E1 RL_VALUE_UBYTE 0 NO_COMPU_METHOD 0 255 /end CHARACTERISTIC
/begin CHARACTERISTIC CAL_obd_ii_P0271 "Calibration: OBD-II P0271 (OBD-II monitor enable level)." VALUE 0x4000D1E2 RL_VALUE_UBYTE 0 NO_COMPU_METHOD 0 255 /end CHARACTERISTIC
/begin CHARACTERISTIC CAL_obd_ii_P0273 "Calibration: OBD-II P0273 (OBD-II monitor enable level)." VALUE 0x4000D1E3 RL_VALUE_UBYTE 0 NO_COMPU_METHOD 0 255 /end CHARACTERISTIC
/begin CHARACTERISTIC CAL_obd_ii_P0274 "Calibration: OBD-II P0274 (OBD-II monitor enable level)." VALUE 0x4000D1E4 RL_VALUE_UBYTE 0 NO_COMPU_METHOD 0 255 /end CHARACTERISTIC
/begin CHARACTERISTIC CAL_obd_ii_P0276 "Calibration: OBD-II P0276 (OBD-II monitor enable level)." VALUE 0x4000D1E5 RL_VALUE_UBYTE 0 NO_COMPU_METHOD 0 255 /end CHARACTERISTIC
/begin CHARACTERISTIC CAL_obd_ii_P0277 "Calibration: OBD-II P0277 (OBD-II monitor enable level)." VALUE 0x4000D1E6 RL_VALUE_UBYTE 0 NO_COMPU_METHOD 0 255 /end CHARACTERISTIC
/begin CHARACTERISTIC CAL_obd_ii_P025C "Calibration: OBD-II P025C (OBD-II monitor enable level)." VALUE 0x4000D1E7 RL_VALUE_UBYTE 0 NO_COMPU_METHOD 0 255 /end CHARACTERISTIC
/begin CHARACTERISTIC CAL_obd_ii_P0351 "Calibration: OBD-II P0351 (OBD-II monitor enable level)." VALUE 0x4000D1E8 RL_VALUE_UBYTE 0 NO_COMPU_METHOD 0 255 /end CHARACTERISTIC
/begin CHARACTERISTIC CAL_obd_ii_P0352 "Calibration: OBD-II P0352 (OBD-II monitor enable level)." VALUE 0x4000D1E9 RL_VALUE_UBYTE 0 NO_COMPU_METHOD 0 255 /end CHARACTERISTIC
/begin CHARACTERISTIC CAL_obd_ii_P0353 "Calibration: OBD-II P0353 (OBD-II monitor enable level)." VALUE 0x4000D1EA RL_VALUE_UBYTE 0 NO_COMPU_METHOD 0 255 /end CHARACTERISTIC
/begin CHARACTERISTIC CAL_obd_ii_P0354 "Calibration: OBD-II P0354 (OBD-II monitor enable level)." VALUE 0x4000D1EB RL_VALUE_UBYTE 0 NO_COMPU_METHOD 0 255 /end CHARACTERISTIC
/begin CHARACTERISTIC CAL_obd_ii_P025D "Calibration: OBD-II P025D (OBD-II monitor enable level)." VALUE 0x4000D1EC RL_VALUE_UBYTE 0 NO_COMPU_METHOD 0 255 /end CHARACTERISTIC
/begin CHARACTERISTIC CAL_obd_ii_P0300 "Calibration: OBD-II P0300 (OBD-II monitor enable level)." VALUE 0x4000D1ED RL_VALUE_UBYTE 0 NO_COMPU_METHOD 0 255 /end CHARACTERISTIC
/begin CHARACTERISTIC CAL_obd_ii_P0301 "Calibration: OBD-II P0301 (OBD-II monitor enable level)." VALUE 0x4000D1EE RL_VALUE_UBYTE 0 NO_COMPU_METHOD 0 255 /end CHARACTERISTIC
/begin CHARACTERISTIC CAL_obd_ii_P0302 "Calibration: OBD-II P0302 (OBD-II monitor enable level)." VALUE 0x4000D1EF RL_VALUE_UBYTE 0 NO_COMPU_METHOD 0 255 /end CHARACTERISTIC
/begin CHARACTERISTIC CAL_obd_ii_P0303 "Calibration: OBD-II P0303 (OBD-II monitor enable level)." VALUE 0x4000D1F0 RL_VALUE_UBYTE 0 NO_COMPU_METHOD 0 255 /end CHARACTERISTIC
/begin CHARACTERISTIC CAL_obd_ii_P0304 "Calibration: OBD-II P0304 (OBD-II monitor enable level)." VALUE 0x4000D1F1 RL_VALUE_UBYTE 0 NO_COMPU_METHOD 0 255 /end CHARACTERISTIC
/begin CHARACTERISTIC CAL_obd_ii_P0305 "Calibration: OBD-II P0305 (OBD-II monitor enable level)." VALUE 0x4000D1F2 RL_VALUE_UBYTE 0 NO_COMPU_METHOD 0 255 /end CHARACTERISTIC
/begin CHARACTERISTIC CAL_obd_ii_P0306 "Calibration: OBD-II P0306 (OBD-II monitor enable level)." VALUE 0x4000D1F3 RL_VALUE_UBYTE 0 NO_COMPU_METHOD 0 255 /end CHARACTERISTIC
/begin CHARACTERISTIC CAL_obd_ii_P0700 "Calibration: OBD-II P0700 (OBD-II monitor enable level)." VALUE 0x4000D1F4 RL_VALUE_UBYTE 0 NO_COMPU_METHOD 0 255 /end CHARACTERISTIC
/begin CHARACTERISTIC CAL_obd_ii_P0571 "Calibration: OBD-II P0571 (OBD-II monitor enable level)." VALUE 0x4000D1F5 RL_VALUE_UBYTE 0 NO_COMPU_METHOD 0 255 /end CHARACTERISTIC
/begin CHARACTERISTIC CAL_obd_ii_P0327 "Calibration: OBD-II P0327 (OBD-II monitor enable level)." VALUE 0x4000D1F6 RL_VALUE_UBYTE 0 NO_COMPU_METHOD 0 255 /end CHARACTERISTIC
/begin CHARACTERISTIC CAL_obd_ii_P0328 "Calibration: OBD-II P0328 (OBD-II monitor enable level)." VALUE 0x4000D1F7 RL_VALUE_UBYTE 0 NO_COMPU_METHOD 0 255 /end CHARACTERISTIC
/begin CHARACTERISTIC CAL_obd_ii_P0335 "Calibration: OBD-II P0335 (OBD-II monitor enable level)." VALUE 0x4000D1F8 RL_VALUE_UBYTE 0 NO_COMPU_METHOD 0 255 /end CHARACTERISTIC
/begin CHARACTERISTIC CAL_obd_ii_P0826 "Calibration: OBD-II P0826 (OBD-II monitor enable level)." VALUE 0x4000D1F9 RL_VALUE_UBYTE 0 NO_COMPU_METHOD 0 255 /end CHARACTERISTIC
/begin CHARACTERISTIC CAL_obd_ii_P1301 "Calibration: OBD-II P1301 (OBD-II monitor enable level)." VALUE 0x4000D1FA RL_VALUE_UBYTE 0 NO_COMPU_METHOD 0 255 /end CHARACTERISTIC
/begin CHARACTERISTIC CAL_obd_ii_P1302 "Calibration: OBD-II P1302 (OBD-II monitor enable level)." VALUE 0x4000D1FB RL_VALUE_UBYTE 0 NO_COMPU_METHOD 0 255 /end CHARACTERISTIC
/begin CHARACTERISTIC CAL_obd_ii_P0014 "Calibration: OBD-II P0014 (OBD-II monitor enable level)." VALUE 0x4000D1FC RL_VALUE_UBYTE 0 NO_COMPU_METHOD 0 255 /end CHARACTERISTIC
/begin CHARACTERISTIC CAL_obd_ii_P0015 "Calibration: OBD-II P0015 (OBD-II monitor enable level)." VALUE 0x4000D1FD RL_VALUE_UBYTE 0 NO_COMPU_METHOD 0 255 /end CHARACTERISTIC
/begin CHARACTERISTIC CAL_obd_ii_P0024 "Calibration: OBD-II P0024 (OBD-II monitor enable level)." VALUE 0x4000D1FE RL_VALUE_UBYTE 0 NO_COMPU_METHOD 0 255 /end CHARACTERISTIC
/begin CHARACTERISTIC CAL_obd_ii_P0025 "Calibration: OBD-II P0025 (OBD-II monitor enable level)." VALUE 0x4000D1FF RL_VALUE_UBYTE 0 NO_COMPU_METHOD 0 255 /end CHARACTERISTIC
/begin CHARACTERISTIC CAL_obd_ii_P0079 "Calibration: OBD-II P0079 (OBD-II monitor enable level)." VALUE 0x4000D200 RL_VALUE_UBYTE 0 NO_COMPU_METHOD 0 255 /end CHARACTERISTIC
/begin CHARACTERISTIC CAL_obd_ii_P0080 "Calibration: OBD-II P0080 (OBD-II monitor enable level)." VALUE 0x4000D201 RL_VALUE_UBYTE 0 NO_COMPU_METHOD 0 255 /end CHARACTERISTIC
/begin CHARACTERISTIC CAL_obd_ii_P0082 "Calibration: OBD-II P0082 (OBD-II monitor enable level)." VALUE 0x4000D202 RL_VALUE_UBYTE 0 NO_COMPU_METHOD 0 255 /end CHARACTERISTIC
/begin CHARACTERISTIC CAL_obd_ii_P0083 "Calibration: OBD-II P0083 (OBD-II monitor enable level)." VALUE 0x4000D203 RL_VALUE_UBYTE 0 NO_COMPU_METHOD 0 255 /end CHARACTERISTIC
/begin CHARACTERISTIC CAL_obd_ii_P0420 "Calibration: OBD-II P0420 (OBD-II monitor enable level)." VALUE 0x4000D204 RL_VALUE_UBYTE 0 NO_COMPU_METHOD 0 255 /end CHARACTERISTIC
/begin CHARACTERISTIC CAL_obd_ii_P0085 "Calibration: OBD-II P0085 (OBD-II monitor enable level)." VALUE 0x4000D205 RL_VALUE_UBYTE 0 NO_COMPU_METHOD 0 255 /end CHARACTERISTIC
/begin CHARACTERISTIC CAL_obd_ii_P0086 "Calibration: OBD-II P0086 (OBD-II monitor enable level)." VALUE 0x4000D206 RL_VALUE_UBYTE 0 NO_COMPU_METHOD 0 255 /end CHARACTERISTIC
/begin CHARACTERISTIC CAL_obd_ii_P0827 "Calibration: OBD-II P0827 (OBD-II monitor enable level)." VALUE 0x4000D207 RL_VALUE_UBYTE 0 NO_COMPU_METHOD 0 255 /end CHARACTERISTIC
/begin CHARACTERISTIC CAL_obd_ii_P1809 "Calibration: OBD-II P1809 (OBD-II monitor enable level)." VALUE 0x4000D208 RL_VALUE_UBYTE 0 NO_COMPU_METHOD 0 255 /end CHARACTERISTIC
/begin CHARACTERISTIC CAL_obd_ii_P0430 "Calibration: OBD-II P0430 (OBD-II monitor enable level)." VALUE 0x4000D209 RL_VALUE_UBYTE 0 NO_COMPU_METHOD 0 255 /end CHARACTERISTIC
/begin CHARACTERISTIC CAL_obd_ii_P0355 "Calibration: OBD-II P0355 (OBD-II monitor enable level)." VALUE 0x4000D20A RL_VALUE_UBYTE 0 NO_COMPU_METHOD 0 255 /end CHARACTERISTIC
/begin CHARACTERISTIC CAL_obd_ii_P0356 "Calibration: OBD-II P0356 (OBD-II monitor enable level)." VALUE 0x4000D20B RL_VALUE_UBYTE 0 NO_COMPU_METHOD 0 255 /end CHARACTERISTIC
/begin CHARACTERISTIC CAL_obd_ii_P0579 "Calibration: OBD-II P0579 (OBD-II monitor enable level)." VALUE 0x4000D20C RL_VALUE_UBYTE 0 NO_COMPU_METHOD 0 255 /end CHARACTERISTIC
/begin CHARACTERISTIC CAL_obd_ii_P1104 "Calibration: OBD-II P1104 (OBD-II monitor enable level)." VALUE 0x4000D20D RL_VALUE_UBYTE 0 NO_COMPU_METHOD 0 255 /end CHARACTERISTIC
/begin CHARACTERISTIC CAL_obd_ii_P0828 "Calibration: OBD-II P0828 (OBD-II monitor enable level)." VALUE 0x4000D20E RL_VALUE_UBYTE 0 NO_COMPU_METHOD 0 255 /end CHARACTERISTIC
/begin CHARACTERISTIC CAL_obd_ii_P0441 "Calibration: OBD-II P0441 (OBD-II monitor enable level)." VALUE 0x4000D20F RL_VALUE_UBYTE 0 NO_COMPU_METHOD 0 255 /end CHARACTERISTIC
/begin CHARACTERISTIC CAL_obd_ii_P0442 "Calibration: OBD-II P0442 (OBD-II monitor enable level)." VALUE 0x4000D210 RL_VALUE_UBYTE 0 NO_COMPU_METHOD 0 255 /end CHARACTERISTIC
/begin CHARACTERISTIC CAL_obd_ii_P050B "Calibration: OBD-II P050B (OBD-II monitor enable level)." VALUE 0x4000D211 RL_VALUE_UBYTE 0 NO_COMPU_METHOD 0 255 /end CHARACTERISTIC
/begin CHARACTERISTIC CAL_obd_ii_P0444 "Calibration: OBD-II P0444 (OBD-II monitor enable level)." VALUE 0x4000D212 RL_VALUE_UBYTE 0 NO_COMPU_METHOD 0 255 /end CHARACTERISTIC
/begin CHARACTERISTIC CAL_obd_ii_P0445 "Calibration: OBD-II P0445 (OBD-II monitor enable level)." VALUE 0x4000D213 RL_VALUE_UBYTE 0 NO_COMPU_METHOD 0 255 /end CHARACTERISTIC
/begin CHARACTERISTIC CAL_obd_ii_P0446 "Calibration: OBD-II P0446 (OBD-II monitor enable level)." VALUE 0x4000D214 RL_VALUE_UBYTE 0 NO_COMPU_METHOD 0 255 /end CHARACTERISTIC
/begin CHARACTERISTIC CAL_obd_ii_P0447 "Calibration: OBD-II P0447 (OBD-II monitor enable level)." VALUE 0x4000D215 RL_VALUE_UBYTE 0 NO_COMPU_METHOD 0 255 /end CHARACTERISTIC
/begin CHARACTERISTIC CAL_obd_ii_P0448 "Calibration: OBD-II P0448 (OBD-II monitor enable level)." VALUE 0x4000D216 RL_VALUE_UBYTE 0 NO_COMPU_METHOD 0 255 /end CHARACTERISTIC
/begin CHARACTERISTIC CAL_obd_ii_P050A "Calibration: OBD-II P050A (OBD-II monitor enable level)." VALUE 0x4000D217 RL_VALUE_UBYTE 0 NO_COMPU_METHOD 0 255 /end CHARACTERISTIC
/begin CHARACTERISTIC CAL_obd_ii_P0451 "Calibration: OBD-II P0451 (OBD-II monitor enable level)." VALUE 0x4000D218 RL_VALUE_UBYTE 0 NO_COMPU_METHOD 0 255 /end CHARACTERISTIC
/begin CHARACTERISTIC CAL_obd_ii_P0452 "Calibration: OBD-II P0452 (OBD-II monitor enable level)." VALUE 0x4000D219 RL_VALUE_UBYTE 0 NO_COMPU_METHOD 0 255 /end CHARACTERISTIC
/begin CHARACTERISTIC CAL_obd_ii_P0453 "Calibration: OBD-II P0453 (OBD-II monitor enable level)." VALUE 0x4000D21A RL_VALUE_UBYTE 0 NO_COMPU_METHOD 0 255 /end CHARACTERISTIC
/begin CHARACTERISTIC CAL_obd_ii_P0480 "Calibration: OBD-II P0480 (OBD-II monitor enable level)." VALUE 0x4000D21B RL_VALUE_UBYTE 0 NO_COMPU_METHOD 0 255 /end CHARACTERISTIC
/begin CHARACTERISTIC CAL_obd_ii_P1109 "Calibration: OBD-II P1109 (OBD-II monitor enable level)." VALUE 0x4000D21C RL_VALUE_UBYTE 0 NO_COMPU_METHOD 0 255 /end CHARACTERISTIC
/begin CHARACTERISTIC CAL_obd_ii_P0341 "Calibration: OBD-II P0341 (OBD-II monitor enable level)." VALUE 0x4000D21D RL_VALUE_UBYTE 0 NO_COMPU_METHOD 0 255 /end CHARACTERISTIC
/begin CHARACTERISTIC CAL_obd_ii_P0346 "Calibration: OBD-II P0346 (OBD-II monitor enable level)." VALUE 0x4000D21E RL_VALUE_UBYTE 0 NO_COMPU_METHOD 0 255 /end CHARACTERISTIC
/begin CHARACTERISTIC CAL_obd_ii_P0366 "Calibration: OBD-II P0366 (OBD-II monitor enable level)." VALUE 0x4000D21F RL_VALUE_UBYTE 0 NO_COMPU_METHOD 0 255 /end CHARACTERISTIC
/begin CHARACTERISTIC CAL_obd_ii_P0391 "Calibration: OBD-II P0391 (OBD-II monitor enable level)." VALUE 0x4000D220 RL_VALUE_UBYTE 0 NO_COMPU_METHOD 0 255 /end CHARACTERISTIC
/begin CHARACTERISTIC CAL_obd_ii_P0482 "Calibration: OBD-II P0482 (OBD-II monitor enable level)." VALUE 0x4000D221 RL_VALUE_UBYTE 0 NO_COMPU_METHOD 0 255 /end CHARACTERISTIC
/begin CHARACTERISTIC CAL_obd_ii_P0461 "Calibration: OBD-II P0461 (OBD-II monitor enable level)." VALUE 0x4000D222 RL_VALUE_UBYTE 0 NO_COMPU_METHOD 0 255 /end CHARACTERISTIC
/begin CHARACTERISTIC CAL_obd_ii_P0462 "Calibration: OBD-II P0462 (OBD-II monitor enable level)." VALUE 0x4000D223 RL_VALUE_UBYTE 0 NO_COMPU_METHOD 0 255 /end CHARACTERISTIC
/begin CHARACTERISTIC CAL_obd_ii_P0463 "Calibration: OBD-II P0463 (OBD-II monitor enable level)." VALUE 0x4000D224 RL_VALUE_UBYTE 0 NO_COMPU_METHOD 0 255 /end CHARACTERISTIC
/begin CHARACTERISTIC CAL_obd_ii_P0523 "Calibration: OBD-II P0523 (OBD-II monitor enable level)." VALUE 0x4000D225 RL_VALUE_UBYTE 0 NO_COMPU_METHOD 0 255 /end CHARACTERISTIC
/begin CHARACTERISTIC CAL_obd_ii_P0563 "Calibration: OBD-II P0563 (OBD-II monitor enable level)." VALUE 0x4000D226 RL_VALUE_UBYTE 0 NO_COMPU_METHOD 0 255 /end CHARACTERISTIC
/begin CHARACTERISTIC CAL_obd_ii_P0562 "Calibration: OBD-II P0562 (OBD-II monitor enable level)." VALUE 0x4000D227 RL_VALUE_UBYTE 0 NO_COMPU_METHOD 0 255 /end CHARACTERISTIC
/begin CHARACTERISTIC CAL_obd_ii_P0685 "Calibration: OBD-II P0685 (OBD-II monitor enable level)." VALUE 0x4000D228 RL_VALUE_UBYTE 0 NO_COMPU_METHOD 0 255 /end CHARACTERISTIC
/begin CHARACTERISTIC CAL_obd_ii_P0610 "Calibration: OBD-II P0610 (OBD-II monitor enable level)." VALUE 0x4000D229 RL_VALUE_UBYTE 0 NO_COMPU_METHOD 0 255 /end CHARACTERISTIC
/begin CHARACTERISTIC CAL_obd_ii_P0646 "Calibration: OBD-II P0646 (OBD-II monitor enable level)." VALUE 0x4000D22A RL_VALUE_UBYTE 0 NO_COMPU_METHOD 0 255 /end CHARACTERISTIC
/begin CHARACTERISTIC CAL_obd_ii_P0647 "Calibration: OBD-II P0647 (OBD-II monitor enable level)." VALUE 0x4000D22B RL_VALUE_UBYTE 0 NO_COMPU_METHOD 0 255 /end CHARACTERISTIC
/begin CHARACTERISTIC CAL_obd_ii_P0500 "Calibration: OBD-II P0500 (OBD-II monitor enable level)." VALUE 0x4000D22C RL_VALUE_UBYTE 0 NO_COMPU_METHOD 0 255 /end CHARACTERISTIC
/begin CHARACTERISTIC CAL_obd_ii_P0506 "Calibration: OBD-II P0506 (OBD-II monitor enable level)." VALUE 0x4000D22D RL_VALUE_UBYTE 0 NO_COMPU_METHOD 0 255 /end CHARACTERISTIC
/begin CHARACTERISTIC CAL_obd_ii_P0507 "Calibration: OBD-II P0507 (OBD-II monitor enable level)." VALUE 0x4000D22E RL_VALUE_UBYTE 0 NO_COMPU_METHOD 0 255 /end CHARACTERISTIC
/begin CHARACTERISTIC CAL_obd_ii_P0096 "Calibration: OBD-II P0096 (OBD-II monitor enable level)." VALUE 0x4000D22F RL_VALUE_UBYTE 0 NO_COMPU_METHOD 0 255 /end CHARACTERISTIC
/begin CHARACTERISTIC CAL_obd_ii_P0072 "Calibration: OBD-II P0072 (OBD-II monitor enable level)." VALUE 0x4000D230 RL_VALUE_UBYTE 0 NO_COMPU_METHOD 0 255 /end CHARACTERISTIC
/begin CHARACTERISTIC CAL_obd_ii_P0073 "Calibration: OBD-II P0073 (OBD-II monitor enable level)." VALUE 0x4000D231 RL_VALUE_UBYTE 0 NO_COMPU_METHOD 0 255 /end CHARACTERISTIC
/begin CHARACTERISTIC CAL_obd_ii_P0616 "Calibration: OBD-II P0616 (OBD-II monitor enable level)." VALUE 0x4000D232 RL_VALUE_UBYTE 0 NO_COMPU_METHOD 0 255 /end CHARACTERISTIC
/begin CHARACTERISTIC CAL_obd_ii_P0617 "Calibration: OBD-II P0617 (OBD-II monitor enable level)." VALUE 0x4000D233 RL_VALUE_UBYTE 0 NO_COMPU_METHOD 0 255 /end CHARACTERISTIC
/begin CHARACTERISTIC CAL_obd_ii_P0630 "Calibration: OBD-II P0630 (OBD-II monitor enable level)." VALUE 0x4000D234 RL_VALUE_UBYTE 0 NO_COMPU_METHOD 0 255 /end CHARACTERISTIC
/begin CHARACTERISTIC CAL_obd_ii_P2138 "Calibration: OBD-II P2138 (OBD-II monitor enable level)." VALUE 0x4000D235 RL_VALUE_UBYTE 0 NO_COMPU_METHOD 0 255 /end CHARACTERISTIC
/begin CHARACTERISTIC CAL_obd_ii_P2602 "Calibration: OBD-II P2602 (OBD-II monitor enable level)." VALUE 0x4000D236 RL_VALUE_UBYTE 0 NO_COMPU_METHOD 0 255 /end CHARACTERISTIC
/begin CHARACTERISTIC CAL_obd_ii_P2603 "Calibration: OBD-II P2603 (OBD-II monitor enable level)." VALUE 0x4000D237 RL_VALUE_UBYTE 0 NO_COMPU_METHOD 0 255 /end CHARACTERISTIC
/begin CHARACTERISTIC CAL_obd_ii_P0011 "Calibration: OBD-II P0011 (OBD-II monitor enable level)." VALUE 0x4000D238 RL_VALUE_UBYTE 0 NO_COMPU_METHOD 0 255 /end CHARACTERISTIC
/begin CHARACTERISTIC CAL_obd_ii_P0012 "Calibration: OBD-II P0012 (OBD-II monitor enable level)." VALUE 0x4000D239 RL_VALUE_UBYTE 0 NO_COMPU_METHOD 0 255 /end CHARACTERISTIC
/begin CHARACTERISTIC CAL_obd_ii_P0601 "Calibration: OBD-II P0601 (OBD-II monitor enable level)." VALUE 0x4000D23A RL_VALUE_UBYTE 0 NO_COMPU_METHOD 0 255 /end CHARACTERISTIC
/begin CHARACTERISTIC CAL_obd_ii_P0606 "Calibration: OBD-II P0606 (OBD-II monitor enable level)." VALUE 0x4000D23B RL_VALUE_UBYTE 0 NO_COMPU_METHOD 0 255 /end CHARACTERISTIC
/begin CHARACTERISTIC CAL_obd_ii_P0455 "Calibration: OBD-II P0455 (OBD-II monitor enable level)." VALUE 0x4000D23C RL_VALUE_UBYTE 0 NO_COMPU_METHOD 0 255 /end CHARACTERISTIC
/begin CHARACTERISTIC CAL_obd_ii_P0456 "Calibration: OBD-II P0456 (OBD-II monitor enable level)." VALUE 0x4000D23D RL_VALUE_UBYTE 0 NO_COMPU_METHOD 0 255 /end CHARACTERISTIC
/begin CHARACTERISTIC CAL_obd_ii_P0016 "Calibration: OBD-II P0016 (OBD-II monitor enable level)." VALUE 0x4000D23E RL_VALUE_UBYTE 0 NO_COMPU_METHOD 0 255 /end CHARACTERISTIC
/begin CHARACTERISTIC CAL_obd_ii_P2173 "Calibration: OBD-II P2173 (OBD-II monitor enable level)." VALUE 0x4000D23F RL_VALUE_UBYTE 0 NO_COMPU_METHOD 0 255 /end CHARACTERISTIC
/begin CHARACTERISTIC CAL_obd_ii_P2104 "Calibration: OBD-II P2104 (OBD-II monitor enable level)." VALUE 0x4000D240 RL_VALUE_UBYTE 0 NO_COMPU_METHOD 0 255 /end CHARACTERISTIC
/begin CHARACTERISTIC CAL_obd_ii_P2105 "Calibration: OBD-II P2105 (OBD-II monitor enable level)." VALUE 0x4000D241 RL_VALUE_UBYTE 0 NO_COMPU_METHOD 0 255 /end CHARACTERISTIC
/begin CHARACTERISTIC CAL_obd_ii_P2106 "Calibration: OBD-II P2106 (OBD-II monitor enable level)." VALUE 0x4000D242 RL_VALUE_UBYTE 0 NO_COMPU_METHOD 0 255 /end CHARACTERISTIC
/begin CHARACTERISTIC CAL_obd_ii_P2107 "Calibration: OBD-II P2107 (OBD-II monitor enable level)." VALUE 0x4000D243 RL_VALUE_UBYTE 0 NO_COMPU_METHOD 0 255 /end CHARACTERISTIC
/begin CHARACTERISTIC CAL_obd_ii_P2100 "Calibration: OBD-II P2100 (OBD-II monitor enable level)." VALUE 0x4000D244 RL_VALUE_UBYTE 0 NO_COMPU_METHOD 0 255 /end CHARACTERISTIC
/begin CHARACTERISTIC CAL_obd_ii_P2102 "Calibration: OBD-II P2102 (OBD-II monitor enable level)." VALUE 0x4000D245 RL_VALUE_UBYTE 0 NO_COMPU_METHOD 0 255 /end CHARACTERISTIC
/begin CHARACTERISTIC CAL_obd_ii_P2103 "Calibration: OBD-II P2103 (OBD-II monitor enable level)." VALUE 0x4000D246 RL_VALUE_UBYTE 0 NO_COMPU_METHOD 0 255 /end CHARACTERISTIC
/begin CHARACTERISTIC CAL_obd_ii_P2108 "Calibration: OBD-II P2108 (OBD-II monitor enable level)." VALUE 0x4000D247 RL_VALUE_UBYTE 0 NO_COMPU_METHOD 0 255 /end CHARACTERISTIC
/begin CHARACTERISTIC CAL_obd_ii_P0151 "Calibration: OBD-II P0151 (OBD-II monitor enable level)." VALUE 0x4000D248 RL_VALUE_UBYTE 0 NO_COMPU_METHOD 0 255 /end CHARACTERISTIC
/begin CHARACTERISTIC CAL_obd_ii_P0152 "Calibration: OBD-II P0152 (OBD-II monitor enable level)." VALUE 0x4000D249 RL_VALUE_UBYTE 0 NO_COMPU_METHOD 0 255 /end CHARACTERISTIC
/begin CHARACTERISTIC CAL_obd_ii_P0153 "Calibration: OBD-II P0153 (OBD-II monitor enable level)." VALUE 0x4000D24A RL_VALUE_UBYTE 0 NO_COMPU_METHOD 0 255 /end CHARACTERISTIC
/begin CHARACTERISTIC CAL_obd_ii_P0154 "Calibration: OBD-II P0154 (OBD-II monitor enable level)." VALUE 0x4000D24B RL_VALUE_UBYTE 0 NO_COMPU_METHOD 0 255 /end CHARACTERISTIC
/begin CHARACTERISTIC CAL_obd_ii_P0155 "Calibration: OBD-II P0155 (OBD-II monitor enable level)." VALUE 0x4000D24C RL_VALUE_UBYTE 0 NO_COMPU_METHOD 0 255 /end CHARACTERISTIC
/begin CHARACTERISTIC CAL_obd_ii_P0157 "Calibration: OBD-II P0157 (OBD-II monitor enable level)." VALUE 0x4000D24D RL_VALUE_UBYTE 0 NO_COMPU_METHOD 0 255 /end CHARACTERISTIC
/begin CHARACTERISTIC CAL_obd_ii_P0158 "Calibration: OBD-II P0158 (OBD-II monitor enable level)." VALUE 0x4000D24E RL_VALUE_UBYTE 0 NO_COMPU_METHOD 0 255 /end CHARACTERISTIC
/begin CHARACTERISTIC CAL_obd_ii_P0159 "Calibration: OBD-II P0159 (OBD-II monitor enable level)." VALUE 0x4000D24F RL_VALUE_UBYTE 0 NO_COMPU_METHOD 0 255 /end CHARACTERISTIC
/begin CHARACTERISTIC CAL_obd_ii_P0160 "Calibration: OBD-II P0160 (OBD-II monitor enable level)." VALUE 0x4000D250 RL_VALUE_UBYTE 0 NO_COMPU_METHOD 0 255 /end CHARACTERISTIC
/begin CHARACTERISTIC CAL_obd_ii_P0161 "Calibration: OBD-II P0161 (OBD-II monitor enable level)." VALUE 0x4000D251 RL_VALUE_UBYTE 0 NO_COMPU_METHOD 0 255 /end CHARACTERISTIC
/begin CHARACTERISTIC CAL_obd_ii_P0174 "Calibration: OBD-II P0174 (OBD-II monitor enable level)." VALUE 0x4000D252 RL_VALUE_UBYTE 0 NO_COMPU_METHOD 0 255 /end CHARACTERISTIC
/begin CHARACTERISTIC CAL_obd_ii_P0175 "Calibration: OBD-II P0175 (OBD-II monitor enable level)." VALUE 0x4000D253 RL_VALUE_UBYTE 0 NO_COMPU_METHOD 0 255 /end CHARACTERISTIC
/begin CHARACTERISTIC CAL_obd_ii_P0332 "Calibration: OBD-II P0332 (OBD-II monitor enable level)." VALUE 0x4000D254 RL_VALUE_UBYTE 0 NO_COMPU_METHOD 0 255 /end CHARACTERISTIC
/begin CHARACTERISTIC CAL_obd_ii_P0333 "Calibration: OBD-II P0333 (OBD-II monitor enable level)." VALUE 0x4000D255 RL_VALUE_UBYTE 0 NO_COMPU_METHOD 0 255 /end CHARACTERISTIC
/begin CHARACTERISTIC CAL_obd_ii_P0021 "Calibration: OBD-II P0021 (OBD-II monitor enable level)." VALUE 0x4000D256 RL_VALUE_UBYTE 0 NO_COMPU_METHOD 0 255 /end CHARACTERISTIC
/begin CHARACTERISTIC CAL_obd_ii_P0022 "Calibration: OBD-II P0022 (OBD-II monitor enable level)." VALUE 0x4000D257 RL_VALUE_UBYTE 0 NO_COMPU_METHOD 0 255 /end CHARACTERISTIC
/begin CHARACTERISTIC CAL_obd_ii_P0017 "Calibration: OBD-II P0017 (OBD-II monitor enable level)." VALUE 0x4000D258 RL_VALUE_UBYTE 0 NO_COMPU_METHOD 0 255 /end CHARACTERISTIC
/begin CHARACTERISTIC CAL_obd_ii_P0018 "Calibration: OBD-II P0018 (OBD-II monitor enable level)." VALUE 0x4000D259 RL_VALUE_UBYTE 0 NO_COMPU_METHOD 0 255 /end CHARACTERISTIC
/begin CHARACTERISTIC CAL_obd_ii_P0019 "Calibration: OBD-II P0019 (OBD-II monitor enable level)." VALUE 0x4000D25A RL_VALUE_UBYTE 0 NO_COMPU_METHOD 0 255 /end CHARACTERISTIC
/begin CHARACTERISTIC CAL_obd_ii_P0578 "Calibration: OBD-II P0578 (OBD-II monitor enable level)." VALUE 0x4000D25B RL_VALUE_UBYTE 0 NO_COMPU_METHOD 0 255 /end CHARACTERISTIC
/begin CHARACTERISTIC CAL_obd_ii_P0564 "Calibration: OBD-II P0564 (OBD-II monitor enable level)." VALUE 0x4000D25C RL_VALUE_UBYTE 0 NO_COMPU_METHOD 0 255 /end CHARACTERISTIC
/begin CHARACTERISTIC CAL_obd_ii_P0806 "Calibration: OBD-II P0806 (OBD-II monitor enable level)." VALUE 0x4000D25D RL_VALUE_UBYTE 0 NO_COMPU_METHOD 0 255 /end CHARACTERISTIC
/begin CHARACTERISTIC CAL_obd_ii_P0807 "Calibration: OBD-II P0807 (OBD-II monitor enable level)." VALUE 0x4000D25E RL_VALUE_UBYTE 0 NO_COMPU_METHOD 0 255 /end CHARACTERISTIC
/begin CHARACTERISTIC CAL_obd_ii_P0808 "Calibration: OBD-II P0808 (OBD-II monitor enable level)." VALUE 0x4000D25F RL_VALUE_UBYTE 0 NO_COMPU_METHOD 0 255 /end CHARACTERISTIC
/begin CHARACTERISTIC CAL_obd_ii_P2612 "Calibration: OBD-II P2612 (OBD-II monitor enable level)." VALUE 0x4000D260 RL_VALUE_UBYTE 0 NO_COMPU_METHOD 0 255 /end CHARACTERISTIC
/begin CHARACTERISTIC CAL_obd_ii_P2613 "Calibration: OBD-II P2613 (OBD-II monitor enable level)." VALUE 0x4000D261 RL_VALUE_UBYTE 0 NO_COMPU_METHOD 0 255 /end CHARACTERISTIC
/begin CHARACTERISTIC CAL_obd_ii_P0537 "Calibration: OBD-II P0537 (OBD-II monitor enable level)." VALUE 0x4000D262 RL_VALUE_UBYTE 0 NO_COMPU_METHOD 0 255 /end CHARACTERISTIC
/begin CHARACTERISTIC CAL_obd_ii_P0538 "Calibration: OBD-II P0538 (OBD-II monitor enable level)." VALUE 0x4000D263 RL_VALUE_UBYTE 0 NO_COMPU_METHOD 0 255 /end CHARACTERISTIC
/begin CHARACTERISTIC CAL_obd_ii_U0155 "Calibration: OBD-II U0155 (OBD-II monitor enable level)." VALUE 0x4000D264 RL_VALUE_UBYTE 0 NO_COMPU_METHOD 0 255 /end CHARACTERISTIC
/begin CHARACTERISTIC CAL_obd_ii_U0101 "Calibration: OBD-II U0101 (OBD-II monitor enable level)." VALUE 0x4000D265 RL_VALUE_UBYTE 0 NO_COMPU_METHOD 0 255 /end CHARACTERISTIC
/begin CHARACTERISTIC CAL_obd_ii_U0122 "Calibration: OBD-II U0122 (OBD-II monitor enable level)." VALUE 0x4000D266 RL_VALUE_UBYTE 0 NO_COMPU_METHOD 0 255 /end CHARACTERISTIC
/begin CHARACTERISTIC CAL_obd_ii_U0316 "Calibration: OBD-II U0316 (OBD-II monitor enable level)." VALUE 0x4000D267 RL_VALUE_UBYTE 0 NO_COMPU_METHOD 0 255 /end CHARACTERISTIC
/begin CHARACTERISTIC CAL_obd_ii_U0141 "Calibration: OBD-II U0141 (OBD-II monitor enable level)." VALUE 0x4000D268 RL_VALUE_UBYTE 0 NO_COMPU_METHOD 0 255 /end CHARACTERISTIC
/begin CHARACTERISTIC CAL_obd_ii_U0302 "Calibration: OBD-II U0302 (OBD-II monitor enable level)." VALUE 0x4000D269 RL_VALUE_UBYTE 0 NO_COMPU_METHOD 0 255 /end CHARACTERISTIC
/begin CHARACTERISTIC CAL_obd_ii_U0416 "Calibration: OBD-II U0416 (OBD-II monitor enable level)." VALUE 0x4000D26A RL_VALUE_UBYTE 0 NO_COMPU_METHOD 0 255 /end CHARACTERISTIC
/begin CHARACTERISTIC CAL_obd_ii_U0123 "Calibration: OBD-II U0123 (OBD-II monitor enable level)." VALUE 0x4000D26B RL_VALUE_UBYTE 0 NO_COMPU_METHOD 0 255 /end CHARACTERISTIC
/begin CHARACTERISTIC CAL_obd_ii_U0513 "Calibration: OBD-II U0513 (OBD-II monitor enable level)." VALUE 0x4000D26C RL_VALUE_UBYTE 0 NO_COMPU_METHOD 0 255 /end CHARACTERISTIC
/begin CHARACTERISTIC CAL_obd_ii_U0109 "Calibration: OBD-II U0109 (OBD-II monitor enable level)." VALUE 0x4000D26D RL_VALUE_UBYTE 0 NO_COMPU_METHOD 0 255 /end CHARACTERISTIC
/begin CHARACTERISTIC CAL_obd_ii_B1422 "Calibration: OBD-II B1422 (OBD-II monitor enable level)." VALUE 0x4000D278 RL_VALUE_UBYTE 0 NO_COMPU_METHOD 0 255 /end CHARACTERISTIC
/begin CHARACTERISTIC CAL_obd_ii_P219A "Calibration: OBD-II P219A (OBD-II monitor enable level)." VALUE 0x4000D279 RL_VALUE_UBYTE 0 NO_COMPU_METHOD 0 255 /end CHARACTERISTIC
/begin CHARACTERISTIC CAL_obd_ii_P219B "Calibration: OBD-II P219B (OBD-II monitor enable level)." VALUE 0x4000D27A RL_VALUE_UBYTE 0 NO_COMPU_METHOD 0 255 /end CHARACTERISTIC
/begin CHARACTERISTIC CAL_obd_ii_P2336 "Calibration: OBD-II P2336 (OBD-II monitor enable level)." VALUE 0x4000D27B RL_VALUE_UBYTE 0 NO_COMPU_METHOD 0 255 /end CHARACTERISTIC
/begin CHARACTERISTIC CAL_obd_ii_P2337 "Calibration: OBD-II P2337 (OBD-II monitor enable level)." VALUE 0x4000D27C RL_VALUE_UBYTE 0 NO_COMPU_METHOD 0 255 /end CHARACTERISTIC
/begin CHARACTERISTIC CAL_obd_ii_P2338 "Calibration: OBD-II P2338 (OBD-II monitor enable level)." VALUE 0x4000D27D RL_VALUE_UBYTE 0 NO_COMPU_METHOD 0 255 /end CHARACTERISTIC
/begin CHARACTERISTIC CAL_obd_ii_P2339 "Calibration: OBD-II P2339 (OBD-II monitor enable level)." VALUE 0x4000D27E RL_VALUE_UBYTE 0 NO_COMPU_METHOD 0 255 /end CHARACTERISTIC
/begin CHARACTERISTIC CAL_obd_ii_P2340 "Calibration: OBD-II P2340 (OBD-II monitor enable level)." VALUE 0x4000D27F RL_VALUE_UBYTE 0 NO_COMPU_METHOD 0 255 /end CHARACTERISTIC
/begin CHARACTERISTIC CAL_obd_ii_P2341 "Calibration: OBD-II P2341 (OBD-II monitor enable level)." VALUE 0x4000D280 RL_VALUE_UBYTE 0 NO_COMPU_METHOD 0 255 /end CHARACTERISTIC
/begin CHARACTERISTIC CAL_obd_ii_P1562 "Calibration: OBD-II P1562 (OBD-II monitor enable level)." VALUE 0x4000D281 RL_VALUE_UBYTE 0 NO_COMPU_METHOD 0 255 /end CHARACTERISTIC
/begin CHARACTERISTIC CAL_obd_ii_P0097 "Calibration: OBD-II P0097 (OBD-II monitor enable level)." VALUE 0x4000D282 RL_VALUE_UBYTE 0 NO_COMPU_METHOD 0 255 /end CHARACTERISTIC
/begin CHARACTERISTIC CAL_obd_ii_P0098 "Calibration: OBD-II P0098 (OBD-II monitor enable level)." VALUE 0x4000D283 RL_VALUE_UBYTE 0 NO_COMPU_METHOD 0 255 /end CHARACTERISTIC
/begin CHARACTERISTIC CAL_obd_ii_P1107 "Calibration: OBD-II P1107 (OBD-II monitor enable level)." VALUE 0x4000D284 RL_VALUE_UBYTE 0 NO_COMPU_METHOD 0 255 /end CHARACTERISTIC
/begin CHARACTERISTIC CAL_obd_ii_P1108 "Calibration: OBD-II P1108 (OBD-II monitor enable level)." VALUE 0x4000D285 RL_VALUE_UBYTE 0 NO_COMPU_METHOD 0 255 /end CHARACTERISTIC
/begin CHARACTERISTIC CAL_obd_ii_P0522 "Calibration: OBD-II P0522 (OBD-II monitor enable level)." VALUE 0x4000D286 RL_VALUE_UBYTE 0 NO_COMPU_METHOD 0 255 /end CHARACTERISTIC
/begin CHARACTERISTIC CAL_obd_ii_P0524 "Calibration: OBD-II P0524 (OBD-II monitor enable level)." VALUE 0x4000D287 RL_VALUE_UBYTE 0 NO_COMPU_METHOD 0 255 /end CHARACTERISTIC
/begin CHARACTERISTIC CAL_obd_ii_P0192 "Calibration: OBD-II P0192 (OBD-II monitor enable level)." VALUE 0x4000D288 RL_VALUE_UBYTE 0 NO_COMPU_METHOD 0 255 /end CHARACTERISTIC
/begin CHARACTERISTIC CAL_obd_ii_P0193 "Calibration: OBD-II P0193 (OBD-II monitor enable level)." VALUE 0x4000D289 RL_VALUE_UBYTE 0 NO_COMPU_METHOD 0 255 /end CHARACTERISTIC
/begin CHARACTERISTIC CAL_obd_ii_P023B "Calibration: OBD-II P023B (OBD-II monitor enable level)." VALUE 0x4000D28A RL_VALUE_UBYTE 0 NO_COMPU_METHOD 0 255 /end CHARACTERISTIC
/begin CHARACTERISTIC CAL_obd_ii_P023C "Calibration: OBD-II P023C (OBD-II monitor enable level)." VALUE 0x4000D28B RL_VALUE_UBYTE 0 NO_COMPU_METHOD 0 255 /end CHARACTERISTIC
/begin CHARACTERISTIC CAL_obd_ii_P123B "Calibration: OBD-II P123B (OBD-II monitor enable level)." VALUE 0x4000D28C RL_VALUE_UBYTE 0 NO_COMPU_METHOD 0 255 /end CHARACTERISTIC
/begin CHARACTERISTIC CAL_obd_ii_P123C "Calibration: OBD-II P123C (OBD-II monitor enable level)." VALUE 0x4000D28D RL_VALUE_UBYTE 0 NO_COMPU_METHOD 0 255 /end CHARACTERISTIC
/begin CHARACTERISTIC CAL_obd_ii_P0087 "Calibration: OBD-II P0087 (OBD-II monitor enable level)." VALUE 0x4000D28E RL_VALUE_UBYTE 0 NO_COMPU_METHOD 0 255 /end CHARACTERISTIC
/begin CHARACTERISTIC CAL_obd_ii_P0088 "Calibration: OBD-II P0088 (OBD-II monitor enable level)." VALUE 0x4000D28F RL_VALUE_UBYTE 0 NO_COMPU_METHOD 0 255 /end CHARACTERISTIC
/begin CHARACTERISTIC CAL_obd_ii_P0191 "Calibration: OBD-II P0191 (OBD-II monitor enable level)." VALUE 0x4000D290 RL_VALUE_UBYTE 0 NO_COMPU_METHOD 0 255 /end CHARACTERISTIC
/begin CHARACTERISTIC CAL_obd_ii_P2754 "Calibration: OBD-II P2754 (OBD-II monitor enable level)." VALUE 0x4000D291 RL_VALUE_UBYTE 0 NO_COMPU_METHOD 0 255 /end CHARACTERISTIC
/begin CHARACTERISTIC CAL_obd_ii_P2755 "Calibration: OBD-II P2755 (OBD-II monitor enable level)." VALUE 0x4000D292 RL_VALUE_UBYTE 0 NO_COMPU_METHOD 0 255 /end CHARACTERISTIC
/begin CHARACTERISTIC CAL_obd_ii_P0897 "Calibration: OBD-II P0897 (OBD-II monitor enable level)." VALUE 0x4000D293 RL_VALUE_UBYTE 0 NO_COMPU_METHOD 0 255 /end CHARACTERISTIC
/begin CHARACTERISTIC CAL_obd_ii_P2797 "Calibration: OBD-II P2797 (OBD-II monitor enable level)." VALUE 0x4000D294 RL_VALUE_UBYTE 0 NO_COMPU_METHOD 0 255 /end CHARACTERISTIC
/begin CHARACTERISTIC CAL_obd_ii_P0101_ips "Calibration: OBD-II P0101 IPS (OBD-II monitor enable level)." VALUE 0x4000D295 RL_VALUE_UBYTE 0 NO_COMPU_METHOD 0 255 /end CHARACTERISTIC
/begin CHARACTERISTIC CAL_obd_ii_P0014_maturing_limit "u8_count" VALUE 0x4000D3A6 RL_VALUE_UBYTE 0 NO_COMPU_METHOD 0 255 /end CHARACTERISTIC
/begin CHARACTERISTIC CAL_obd_ii_P0106_debounce_count "Calibration: (0091 0x4000db77 CAL_obd_ii_P0106_debounce_count)" VALUE 0x4000D3A7 RL_VALUE_UBYTE 0 NO_COMPU_METHOD 0 255 /end CHARACTERISTIC
/begin CHARACTERISTIC CAL_obd_ii_P0107_debounce_count "Calibration: (0091 0x4000db78 CAL_obd_ii_P0107_debounce_count)" VALUE 0x4000D3A8 RL_VALUE_UBYTE 0 NO_COMPU_METHOD 0 255 /end CHARACTERISTIC
/begin CHARACTERISTIC CAL_obd_ii_P0108_debounce_count "Calibration: (0091 0x4000db79 CAL_obd_ii_P0108_debounce_count)" VALUE 0x4000D3A9 RL_VALUE_UBYTE 0 NO_COMPU_METHOD 0 255 /end CHARACTERISTIC
/begin CHARACTERISTIC CAL_obd_ii_P0015_maturing_limit "u8_count" VALUE 0x4000D3AA RL_VALUE_UBYTE 0 NO_COMPU_METHOD 0 255 /end CHARACTERISTIC
/begin CHARACTERISTIC CAL_obd_ii_P0111_debounce_count "Calibration: (0091 0x4000db7b CAL_obd_ii_P0111_debounce_count)" VALUE 0x4000D3AB RL_VALUE_UBYTE 0 NO_COMPU_METHOD 0 255 /end CHARACTERISTIC
/begin CHARACTERISTIC CAL_obd_ii_P0112_debounce_count "Calibration: (0091 0x4000db7c CAL_obd_ii_P0112_debounce_count)" VALUE 0x4000D3AC RL_VALUE_UBYTE 0 NO_COMPU_METHOD 0 255 /end CHARACTERISTIC
/begin CHARACTERISTIC CAL_obd_ii_P0113_debounce_count "Calibration: (0091 0x4000db7d CAL_obd_ii_P0113_debounce_count)" VALUE 0x4000D3AD RL_VALUE_UBYTE 0 NO_COMPU_METHOD 0 255 /end CHARACTERISTIC
/begin CHARACTERISTIC CAL_obd_ii_P0024_maturing_limit "u8_count" VALUE 0x4000D3AE RL_VALUE_UBYTE 0 NO_COMPU_METHOD 0 255 /end CHARACTERISTIC
/begin CHARACTERISTIC CAL_obd_ii_P0116_debounce_count "Calibration: (0091 0x4000db7f CAL_obd_ii_P0116_debounce_count)" VALUE 0x4000D3AF RL_VALUE_UBYTE 0 NO_COMPU_METHOD 0 255 /end CHARACTERISTIC
/begin CHARACTERISTIC CAL_obd_ii_P0117_debounce_count "Calibration: (0091 0x4000db80 CAL_obd_ii_P0117_debounce_count)" VALUE 0x4000D3B0 RL_VALUE_UBYTE 0 NO_COMPU_METHOD 0 255 /end CHARACTERISTIC
/begin CHARACTERISTIC CAL_obd_ii_P0118_debounce_count "Calibration: (0091 0x4000db81 CAL_obd_ii_P0118_debounce_count)" VALUE 0x4000D3B1 RL_VALUE_UBYTE 0 NO_COMPU_METHOD 0 255 /end CHARACTERISTIC
/begin CHARACTERISTIC CAL_obd_ii_P0025_debounce_count "Calibration: (0091 0x4000db82 CAL_obd_ii_P0025_debounce_count)" VALUE 0x4000D3B2 RL_VALUE_UBYTE 0 NO_COMPU_METHOD 0 255 /end CHARACTERISTIC
/begin CHARACTERISTIC CAL_obd_ii_P0571_debounce_count "Calibration: (0091 0x4000db83 CAL_obd_ii_P0571_debounce_count)" VALUE 0x4000D3B3 RL_VALUE_UBYTE 0 NO_COMPU_METHOD 0 255 /end CHARACTERISTIC
/begin CHARACTERISTIC CAL_obd_ii_P0122_debounce_count "Calibration: (0091 0x4000db84 CAL_obd_ii_P0122_debounce_count)" VALUE 0x4000D3B4 RL_VALUE_UBYTE 0 NO_COMPU_METHOD 0 255 /end CHARACTERISTIC
/begin CHARACTERISTIC CAL_obd_ii_P0123_debounce_count "Calibration: (0091 0x4000db85 CAL_obd_ii_P0123_debounce_count)" VALUE 0x4000D3B5 RL_VALUE_UBYTE 0 NO_COMPU_METHOD 0 255 /end CHARACTERISTIC
/begin CHARACTERISTIC CAL_obd_ii_P0131_debounce_count "u8_count" VALUE 0x4000D3B6 RL_VALUE_UBYTE 0 NO_COMPU_METHOD 0 255 /end CHARACTERISTIC
/begin CHARACTERISTIC CAL_obd_ii_P0132_fail_count "u8_count" VALUE 0x4000D3B7 RL_VALUE_UBYTE 0 NO_COMPU_METHOD 0 255 /end CHARACTERISTIC
/begin CHARACTERISTIC CAL_obd_ii_P0137_fail_count "u8_count" VALUE 0x4000D3B8 RL_VALUE_UBYTE 0 NO_COMPU_METHOD 0 255 /end CHARACTERISTIC
/begin CHARACTERISTIC CAL_obd_ii_P0138_fail_count "u8_count" VALUE 0x4000D3B9 RL_VALUE_UBYTE 0 NO_COMPU_METHOD 0 255 /end CHARACTERISTIC
/begin CHARACTERISTIC CAL_obd_ii_P0102_debounce_count "Calibration: (0091 0x4000db8a CAL_obd_ii_P0102_debounce_count)" VALUE 0x4000D3BA RL_VALUE_UBYTE 0 NO_COMPU_METHOD 0 255 /end CHARACTERISTIC
/begin CHARACTERISTIC CAL_obd_ii_P0103_debounce_count "Calibration: (0091 0x4000db8b CAL_obd_ii_P0103_debounce_count)" VALUE 0x4000D3BB RL_VALUE_UBYTE 0 NO_COMPU_METHOD 0 255 /end CHARACTERISTIC
/begin CHARACTERISTIC CAL_obd_ii_P0139_debounce_count "u8_count" VALUE 0x4000D3BC RL_VALUE_UBYTE 0 NO_COMPU_METHOD 0 255 /end CHARACTERISTIC
/begin CHARACTERISTIC CAL_obd_ii_P0101_maturing_limit "Calibration: (0091 0x4000db8d CAL_obd_ii_P0101_maturing_limit)" VALUE 0x4000D3BD RL_VALUE_UBYTE 0 NO_COMPU_METHOD 0 255 /end CHARACTERISTIC
/begin CHARACTERISTIC CAL_obd_ii_P0128_fail_count "u8_count" VALUE 0x4000D3BE RL_VALUE_UBYTE 0 NO_COMPU_METHOD 0 255 /end CHARACTERISTIC
/begin CHARACTERISTIC CAL_obd_ii_P0076_debounce_count "u8_count" VALUE 0x4000D3BF RL_VALUE_UBYTE 0 NO_COMPU_METHOD 0 255 /end CHARACTERISTIC
/begin CHARACTERISTIC CAL_obd_ii_P0077_debounce_count "u8_count" VALUE 0x4000D3C0 RL_VALUE_UBYTE 0 NO_COMPU_METHOD 0 255 /end CHARACTERISTIC
/begin CHARACTERISTIC CAL_obd_ii_P0452_debounce_count "Calibration: (0091 0x4000db91 CAL_obd_ii_P0452_debounce_count)" VALUE 0x4000D3C1 RL_VALUE_UBYTE 0 NO_COMPU_METHOD 0 255 /end CHARACTERISTIC
/begin CHARACTERISTIC CAL_obd_ii_P0453_debounce_count "Calibration: (0091 0x4000db92 CAL_obd_ii_P0453_debounce_count)" VALUE 0x4000D3C2 RL_VALUE_UBYTE 0 NO_COMPU_METHOD 0 255 /end CHARACTERISTIC
/begin CHARACTERISTIC CAL_obd_ii_P0351_debounce_count "Calibration: (0091 0x4000db93 CAL_obd_ii_P0351_debounce_count)" VALUE 0x4000D3C3 RL_VALUE_UBYTE 0 NO_COMPU_METHOD 0 255 /end CHARACTERISTIC
/begin CHARACTERISTIC CAL_obd_ii_P0352_debounce_count "Calibration: (0091 0x4000db94 CAL_obd_ii_P0352_debounce_count)" VALUE 0x4000D3C4 RL_VALUE_UBYTE 0 NO_COMPU_METHOD 0 255 /end CHARACTERISTIC
/begin CHARACTERISTIC CAL_obd_ii_P0353_debounce_count "Calibration: (0091 0x4000db95 CAL_obd_ii_P0353_debounce_count)" VALUE 0x4000D3C5 RL_VALUE_UBYTE 0 NO_COMPU_METHOD 0 255 /end CHARACTERISTIC
/begin CHARACTERISTIC CAL_obd_ii_P0354_debounce_count "Calibration: (0091 0x4000db96 CAL_obd_ii_P0354_debounce_count)" VALUE 0x4000D3C6 RL_VALUE_UBYTE 0 NO_COMPU_METHOD 0 255 /end CHARACTERISTIC
/begin CHARACTERISTIC CAL_obd_ii_P0327_debounce_count "Calibration: (0091 0x4000db97 CAL_obd_ii_P0327_debounce_count)" VALUE 0x4000D3C7 RL_VALUE_UBYTE 0 NO_COMPU_METHOD 0 255 /end CHARACTERISTIC
/begin CHARACTERISTIC CAL_obd_ii_P0328_debounce_count "Calibration: (0091 0x4000db98 CAL_obd_ii_P0328_debounce_count)" VALUE 0x4000D3C8 RL_VALUE_UBYTE 0 NO_COMPU_METHOD 0 255 /end CHARACTERISTIC
/begin CHARACTERISTIC CAL_obd_ii_P0563_debounce_count "Calibration: (0091 0x4000db99 CAL_obd_ii_P0563_debounce_count)" VALUE 0x4000D3C9 RL_VALUE_UBYTE 0 NO_COMPU_METHOD 0 255 /end CHARACTERISTIC
/begin CHARACTERISTIC CAL_obd_ii_P0562_debounce_count "Calibration: (0091 0x4000db9a CAL_obd_ii_P0562_debounce_count)" VALUE 0x4000D3CA RL_VALUE_UBYTE 0 NO_COMPU_METHOD 0 255 /end CHARACTERISTIC
/begin CHARACTERISTIC CAL_obd_ii_P0646_debounce_count "Calibration: (0091 0x4000db9b CAL_obd_ii_P0646_debounce_count)" VALUE 0x4000D3CB RL_VALUE_UBYTE 0 NO_COMPU_METHOD 0 255 /end CHARACTERISTIC
/begin CHARACTERISTIC CAL_obd_ii_P0647_debounce_count "Calibration: (0091 0x4000db9c CAL_obd_ii_P0647_debounce_count)" VALUE 0x4000D3CC RL_VALUE_UBYTE 0 NO_COMPU_METHOD 0 255 /end CHARACTERISTIC
/begin CHARACTERISTIC CAL_obd_ii_P0444_debounce_count "Calibration: (0091 0x4000db9d CAL_obd_ii_P0444_debounce_count)" VALUE 0x4000D3CD RL_VALUE_UBYTE 0 NO_COMPU_METHOD 0 255 /end CHARACTERISTIC
/begin CHARACTERISTIC CAL_obd_ii_P0445_debounce_count "Calibration: (0091 0x4000db9e CAL_obd_ii_P0445_debounce_count)" VALUE 0x4000D3CE RL_VALUE_UBYTE 0 NO_COMPU_METHOD 0 255 /end CHARACTERISTIC
/begin CHARACTERISTIC CAL_obd_ii_P0447_debounce_count "Calibration: (0091 0x4000db9f CAL_obd_ii_P0447_debounce_count)" VALUE 0x4000D3CF RL_VALUE_UBYTE 0 NO_COMPU_METHOD 0 255 /end CHARACTERISTIC
/begin CHARACTERISTIC CAL_obd_ii_P0448_debounce_count "Calibration: (0091 0x4000dba0 CAL_obd_ii_P0448_debounce_count)" VALUE 0x4000D3D0 RL_VALUE_UBYTE 0 NO_COMPU_METHOD 0 255 /end CHARACTERISTIC
/begin CHARACTERISTIC CAL_obd_ii_P0451_fail_debounce_count "Calibration: P0451 pass/fail debounce counter max. (0091 0x4000dba1, which reuses the name of 0x4000d385)" VALUE 0x4000D3D1 RL_VALUE_UBYTE 0 NO_COMPU_METHOD 0 255 /end CHARACTERISTIC
/begin CHARACTERISTIC CAL_obd_ii_P0079_debounce_count "Calibration: (0091 0x4000dba2 CAL_obd_ii_P0079_debounce_count)" VALUE 0x4000D3D2 RL_VALUE_UBYTE 0 NO_COMPU_METHOD 0 255 /end CHARACTERISTIC
/begin CHARACTERISTIC CAL_obd_ii_P0261_debounce_count "Calibration: (0091 0x4000dba3 CAL_obd_ii_P0261_debounce_count)" VALUE 0x4000D3D3 RL_VALUE_UBYTE 0 NO_COMPU_METHOD 0 255 /end CHARACTERISTIC
/begin CHARACTERISTIC CAL_obd_ii_P0262_debounce_count "Calibration: (0091 0x4000dba4 CAL_obd_ii_P0262_debounce_count)" VALUE 0x4000D3D4 RL_VALUE_UBYTE 0 NO_COMPU_METHOD 0 255 /end CHARACTERISTIC
/begin CHARACTERISTIC CAL_obd_ii_P0264_debounce_count "Calibration: (0091 0x4000dba5 CAL_obd_ii_P0264_debounce_count)" VALUE 0x4000D3D5 RL_VALUE_UBYTE 0 NO_COMPU_METHOD 0 255 /end CHARACTERISTIC
/begin CHARACTERISTIC CAL_obd_ii_P0265_debounce_count "Calibration: (0091 0x4000dba6 CAL_obd_ii_P0265_debounce_count)" VALUE 0x4000D3D6 RL_VALUE_UBYTE 0 NO_COMPU_METHOD 0 255 /end CHARACTERISTIC
/begin CHARACTERISTIC CAL_obd_ii_P0267_debounce_count "Calibration: DTC debounce/fail count. (0091 0x4000dba7 CAL_obd_ii_P0267_debounce_count)" VALUE 0x4000D3D7 RL_VALUE_UBYTE 0 NO_COMPU_METHOD 0 255 /end CHARACTERISTIC
/begin CHARACTERISTIC CAL_obd_ii_P0268_debounce_count "Calibration: DTC debounce/fail count. (0091 0x4000dba8 CAL_obd_ii_P0268_debounce_count)" VALUE 0x4000D3D8 RL_VALUE_UBYTE 0 NO_COMPU_METHOD 0 255 /end CHARACTERISTIC
/begin CHARACTERISTIC CAL_obd_ii_P0270_debounce_count "Calibration: DTC debounce/fail count. (0091 0x4000dba9 CAL_obd_ii_P0270_debounce_count)" VALUE 0x4000D3D9 RL_VALUE_UBYTE 0 NO_COMPU_METHOD 0 255 /end CHARACTERISTIC
/begin CHARACTERISTIC CAL_obd_ii_P0271_debounce_count "Calibration: DTC debounce/fail count. (0091 0x4000dbaa CAL_obd_ii_P0271_debounce_count)" VALUE 0x4000D3DA RL_VALUE_UBYTE 0 NO_COMPU_METHOD 0 255 /end CHARACTERISTIC
/begin CHARACTERISTIC CAL_obd_ii_P0273_debounce_count "Calibration: DTC debounce/fail count. (0091 0x4000dbab CAL_obd_ii_P0273_debounce_count)" VALUE 0x4000D3DB RL_VALUE_UBYTE 0 NO_COMPU_METHOD 0 255 /end CHARACTERISTIC
/begin CHARACTERISTIC CAL_obd_ii_P0274_debounce_count "Calibration: DTC debounce/fail count. (0091 0x4000dbac CAL_obd_ii_P0274_debounce_count)" VALUE 0x4000D3DC RL_VALUE_UBYTE 0 NO_COMPU_METHOD 0 255 /end CHARACTERISTIC
/begin CHARACTERISTIC CAL_obd_ii_P0276_debounce_count "Calibration: DTC debounce/fail count. (0091 0x4000dbad CAL_obd_ii_P0276_debounce_count)" VALUE 0x4000D3DD RL_VALUE_UBYTE 0 NO_COMPU_METHOD 0 255 /end CHARACTERISTIC
/begin CHARACTERISTIC CAL_obd_ii_P0277_debounce_count "Calibration: DTC debounce/fail count. (0091 0x4000dbae CAL_obd_ii_P0277_debounce_count)" VALUE 0x4000D3DE RL_VALUE_UBYTE 0 NO_COMPU_METHOD 0 255 /end CHARACTERISTIC
/begin CHARACTERISTIC CAL_obd_ii_P0629_debounce_count "Calibration: DTC debounce/fail count. (0091 0x4000dbaf CAL_obd_ii_P0629_debounce_count)" VALUE 0x4000D3DF RL_VALUE_UBYTE 0 NO_COMPU_METHOD 0 255 /end CHARACTERISTIC
/begin CHARACTERISTIC CAL_obd_ii_P0080_debounce_count "Calibration: DTC debounce/fail count. (0091 0x4000dbb0 CAL_obd_ii_P0080_debounce_count)" VALUE 0x4000D3E0 RL_VALUE_UBYTE 0 NO_COMPU_METHOD 0 255 /end CHARACTERISTIC
/begin CHARACTERISTIC CAL_obd_ii_P0082_debounce_count "Calibration: DTC debounce/fail count. (0091 0x4000dbb1 CAL_obd_ii_P0082_debounce_count)" VALUE 0x4000D3E1 RL_VALUE_UBYTE 0 NO_COMPU_METHOD 0 255 /end CHARACTERISTIC
/begin CHARACTERISTIC CAL_obd_ii_P0083_debounce_count "Calibration: DTC debounce/fail count. (0091 0x4000dbb2 CAL_obd_ii_P0083_debounce_count)" VALUE 0x4000D3E2 RL_VALUE_UBYTE 0 NO_COMPU_METHOD 0 255 /end CHARACTERISTIC
/begin CHARACTERISTIC CAL_obd_ii_P0085_debounce_count "Calibration: DTC debounce/fail count. (0091 0x4000dbb3 CAL_obd_ii_P0085_debounce_count)" VALUE 0x4000D3E3 RL_VALUE_UBYTE 0 NO_COMPU_METHOD 0 255 /end CHARACTERISTIC
/begin CHARACTERISTIC CAL_obd_ii_P0086_debounce_count "Calibration: DTC debounce/fail count. (0091 0x4000dbb4 CAL_obd_ii_P0086_debounce_count)" VALUE 0x4000D3E4 RL_VALUE_UBYTE 0 NO_COMPU_METHOD 0 255 /end CHARACTERISTIC
/begin CHARACTERISTIC CAL_obd_ii_P0628_debounce_count "Calibration: DTC debounce/fail count. (0091 0x4000dbb5 CAL_obd_ii_P0628_debounce_count)" VALUE 0x4000D3E5 RL_VALUE_UBYTE 0 NO_COMPU_METHOD 0 255 /end CHARACTERISTIC
/begin CHARACTERISTIC CAL_obd_ii_P1106_debounce_count "Calibration: DTC debounce/fail count. (0091 0x4000dbb6 CAL_obd_ii_P1106_debounce_count)" VALUE 0x4000D3E6 RL_VALUE_UBYTE 0 NO_COMPU_METHOD 0 255 /end CHARACTERISTIC
/begin CHARACTERISTIC CAL_obd_ii_P0480_debounce_count "Calibration: DTC debounce/fail count. (0091 0x4000dbb7 CAL_obd_ii_P0480_debounce_count)" VALUE 0x4000D3E7 RL_VALUE_UBYTE 0 NO_COMPU_METHOD 0 255 /end CHARACTERISTIC
/begin CHARACTERISTIC CAL_obd_ii_P2122_debounce_count "Calibration: DTC debounce/fail count. (0091 0x4000dbb9 CAL_obd_ii_P2122_debounce_count)" VALUE 0x4000D3E9 RL_VALUE_UBYTE 0 NO_COMPU_METHOD 0 255 /end CHARACTERISTIC
/begin CHARACTERISTIC CAL_obd_ii_P2123_debounce_count "Calibration: DTC debounce/fail count. (0091 0x4000dbba CAL_obd_ii_P2123_debounce_count)" VALUE 0x4000D3EA RL_VALUE_UBYTE 0 NO_COMPU_METHOD 0 255 /end CHARACTERISTIC
/begin CHARACTERISTIC CAL_obd_ii_P2127_debounce_count "Calibration: DTC debounce/fail count. (0091 0x4000dbbb CAL_obd_ii_P2127_debounce_count)" VALUE 0x4000D3EB RL_VALUE_UBYTE 0 NO_COMPU_METHOD 0 255 /end CHARACTERISTIC
/begin CHARACTERISTIC CAL_obd_ii_P2128_debounce_count "Calibration: DTC debounce/fail count. (0091 0x4000dbbc CAL_obd_ii_P2128_debounce_count)" VALUE 0x4000D3EC RL_VALUE_UBYTE 0 NO_COMPU_METHOD 0 255 /end CHARACTERISTIC
/begin CHARACTERISTIC CAL_obd_ii_P0420_debounce_count "Calibration: DTC debounce/fail count. (0091 0x4000dbbd CAL_obd_ii_P0420_debounce_count)" VALUE 0x4000D3ED RL_VALUE_UBYTE 0 NO_COMPU_METHOD 0 255 /end CHARACTERISTIC
/begin CHARACTERISTIC CAL_obd_ii_P0222_debounce_count "Calibration: DTC debounce/fail count. (0091 0x4000dbbe CAL_obd_ii_P0222_debounce_count)" VALUE 0x4000D3EE RL_VALUE_UBYTE 0 NO_COMPU_METHOD 0 255 /end CHARACTERISTIC
/begin CHARACTERISTIC CAL_obd_ii_P0223_debounce_count "Calibration: DTC debounce/fail count. (0091 0x4000dbbf CAL_obd_ii_P0223_debounce_count)" VALUE 0x4000D3EF RL_VALUE_UBYTE 0 NO_COMPU_METHOD 0 255 /end CHARACTERISTIC
/begin CHARACTERISTIC CAL_obd_ii_P2135_debounce_count "Calibration: DTC debounce/fail count. (0091 0x4000dbc0 CAL_obd_ii_P2135_debounce_count)" VALUE 0x4000D3F0 RL_VALUE_UBYTE 0 NO_COMPU_METHOD 0 255 /end CHARACTERISTIC
/begin CHARACTERISTIC CAL_obd_ii_P0430_debounce_count "Calibration: DTC debounce/fail count. (0091 0x4000dbc2 CAL_obd_ii_P0430_debounce_count)" VALUE 0x4000D3F2 RL_VALUE_UBYTE 0 NO_COMPU_METHOD 0 255 /end CHARACTERISTIC
/begin CHARACTERISTIC CAL_obd_ii_P2138_debounce_count "Calibration: DTC debounce/fail count. (0091 0x4000dbc3 CAL_obd_ii_P2138_debounce_count)" VALUE 0x4000D3F3 RL_VALUE_UBYTE 0 NO_COMPU_METHOD 0 255 /end CHARACTERISTIC
/begin CHARACTERISTIC CAL_obd_ii_P2602_debounce_count "Calibration: DTC debounce/fail count. (0091 0x4000dbc4 CAL_obd_ii_P2602_debounce_count)" VALUE 0x4000D3F4 RL_VALUE_UBYTE 0 NO_COMPU_METHOD 0 255 /end CHARACTERISTIC
/begin CHARACTERISTIC CAL_obd_ii_P2603_debounce_count "Calibration: DTC debounce/fail count. (0091 0x4000dbc5 CAL_obd_ii_P2603_debounce_count)" VALUE 0x4000D3F5 RL_VALUE_UBYTE 0 NO_COMPU_METHOD 0 255 /end CHARACTERISTIC
/begin CHARACTERISTIC CAL_obd_ii_P0011_debounce_count "Calibration: DTC debounce/fail count. (0091 0x4000dbc6 CAL_obd_ii_P0011_debounce_count)" VALUE 0x4000D3F6 RL_VALUE_UBYTE 0 NO_COMPU_METHOD 0 255 /end CHARACTERISTIC
/begin CHARACTERISTIC CAL_obd_ii_P0012_debounce_count "Calibration: DTC debounce/fail count. (0091 0x4000dbc7 CAL_obd_ii_P0012_debounce_count)" VALUE 0x4000D3F7 RL_VALUE_UBYTE 0 NO_COMPU_METHOD 0 255 /end CHARACTERISTIC
/begin CHARACTERISTIC CAL_obd_ii_P0171_debounce_count "Calibration: DTC debounce/fail count. (0091 0x4000dbc8 CAL_obd_ii_P0171_debounce_count)" VALUE 0x4000D3F8 RL_VALUE_UBYTE 0 NO_COMPU_METHOD 0 255 /end CHARACTERISTIC
/begin CHARACTERISTIC CAL_obd_ii_P0172_debounce_count "Calibration: DTC debounce/fail count. (0091 0x4000dbc9 CAL_obd_ii_P0172_debounce_count)" VALUE 0x4000D3F9 RL_VALUE_UBYTE 0 NO_COMPU_METHOD 0 255 /end CHARACTERISTIC
/begin CHARACTERISTIC CAL_obd_ii_P1301_debounce_count "Calibration: DTC debounce/fail count. (0091 0x4000dbca CAL_obd_ii_P1301_debounce_count)" VALUE 0x4000D3FA RL_VALUE_UBYTE 0 NO_COMPU_METHOD 0 255 /end CHARACTERISTIC
/begin CHARACTERISTIC CAL_obd_ii_P1302_debounce_count "Calibration: DTC debounce/fail count. (0091 0x4000dbcb CAL_obd_ii_P1302_debounce_count)" VALUE 0x4000D3FB RL_VALUE_UBYTE 0 NO_COMPU_METHOD 0 255 /end CHARACTERISTIC
/begin CHARACTERISTIC CAL_obd_ii_P0133_debounce_count "Calibration: DTC debounce/fail count. (0091 0x4000dbcc CAL_obd_ii_P0133_debounce_count)" VALUE 0x4000D3FC RL_VALUE_UBYTE 0 NO_COMPU_METHOD 0 255 /end CHARACTERISTIC
/begin CHARACTERISTIC CAL_obd_ii_P0134_debounce_count "Calibration: DTC debounce/fail count. (0091 0x4000dbcd CAL_obd_ii_P0134_debounce_count)" VALUE 0x4000D3FD RL_VALUE_UBYTE 0 NO_COMPU_METHOD 0 255 /end CHARACTERISTIC
/begin CHARACTERISTIC CAL_obd_ii_P0135_debounce_count "Calibration: DTC debounce/fail count. (0091 0x4000dbce CAL_obd_ii_P0135_debounce_count)" VALUE 0x4000D3FE RL_VALUE_UBYTE 0 NO_COMPU_METHOD 0 255 /end CHARACTERISTIC
/begin CHARACTERISTIC CAL_obd_ii_P0355_debounce_count "Calibration: DTC debounce/fail count. (0091 0x4000dbcf CAL_obd_ii_P0355_debounce_count)" VALUE 0x4000D3FF RL_VALUE_UBYTE 0 NO_COMPU_METHOD 0 255 /end CHARACTERISTIC
/begin CHARACTERISTIC CAL_obd_ii_P0140_debounce_count "Calibration: DTC debounce/fail count. (0091 0x4000dbd0 CAL_obd_ii_P0140_debounce_count)" VALUE 0x4000D400 RL_VALUE_UBYTE 0 NO_COMPU_METHOD 0 255 /end CHARACTERISTIC
/begin CHARACTERISTIC CAL_obd_ii_P0141_heater_current_debounce_count "Calibration: DTC debounce/fail count. (0091 0x4000dbd1 CAL_obd_ii_P0141_heater_current_debounce_count)" VALUE 0x4000D401 RL_VALUE_UBYTE 0 NO_COMPU_METHOD 0 255 /end CHARACTERISTIC
/begin CHARACTERISTIC CAL_obd_ii_P0356_debounce_count "Calibration: DTC debounce/fail count. (0091 0x4000dbd2 CAL_obd_ii_P0356_debounce_count)" VALUE 0x4000D402 RL_VALUE_UBYTE 0 NO_COMPU_METHOD 0 255 /end CHARACTERISTIC
/begin CHARACTERISTIC CAL_obd_ii_P0579_fail_count "Calibration: P0579 fail count." VALUE 0x4000D403 RL_VALUE_UBYTE 0 NO_COMPU_METHOD 0 255 /end CHARACTERISTIC
/begin CHARACTERISTIC CAL_obd_ii_P1104_debounce_count "Calibration: DTC debounce/fail count. (0091 0x4000dbd4 CAL_obd_ii_P1104_debounce_count)" VALUE 0x4000D404 RL_VALUE_UBYTE 0 NO_COMPU_METHOD 0 255 /end CHARACTERISTIC
/begin CHARACTERISTIC CAL_obd_ii_P0335_debounce_count "Calibration: DTC debounce/fail count. (0091 0x4000dbd5 CAL_obd_ii_P0335_debounce_count)" VALUE 0x4000D405 RL_VALUE_UBYTE 0 NO_COMPU_METHOD 0 255 /end CHARACTERISTIC
/begin CHARACTERISTIC CAL_obd_ii_P0523_debounce_count "Calibration: DTC debounce/fail count. (0091 0x4000dbd6 CAL_obd_ii_P0523_debounce_count)" VALUE 0x4000D406 RL_VALUE_UBYTE 0 NO_COMPU_METHOD 0 255 /end CHARACTERISTIC
/begin CHARACTERISTIC CAL_obd_ii_P0500_debounce_count "Calibration: DTC debounce/fail count. (0091 0x4000dbd7 CAL_obd_ii_P0500_debounce_count)" VALUE 0x4000D407 RL_VALUE_UBYTE 0 NO_COMPU_METHOD 0 255 /end CHARACTERISTIC
/begin CHARACTERISTIC CAL_obd_ii_P0506_debounce_count "Calibration: DTC debounce/fail count. (0091 0x4000dbd8 CAL_obd_ii_P0506_debounce_count)" VALUE 0x4000D408 RL_VALUE_UBYTE 0 NO_COMPU_METHOD 0 255 /end CHARACTERISTIC
/begin CHARACTERISTIC CAL_obd_ii_P0507_debounce_count "u8_count" VALUE 0x4000D409 RL_VALUE_UBYTE 0 NO_COMPU_METHOD 0 255 /end CHARACTERISTIC
/begin CHARACTERISTIC CAL_obd_ii_P0441_fail_count "Calibration: DTC debounce/fail count. (0091 0x4000dbda CAL_obd_ii_P0441_fail_count)" VALUE 0x4000D40A RL_VALUE_UBYTE 0 NO_COMPU_METHOD 0 255 /end CHARACTERISTIC
/begin CHARACTERISTIC CAL_obd_ii_P0442_debounce_count "Calibration: DTC debounce/fail count. (0091 0x4000dbdb CAL_obd_ii_P0442_debounce_count)" VALUE 0x4000D40B RL_VALUE_UBYTE 0 NO_COMPU_METHOD 0 255 /end CHARACTERISTIC
/begin CHARACTERISTIC CAL_obd_ii_P0301_debounce_count "Calibration: DTC debounce/fail count. (0091 0x4000dbdc CAL_obd_ii_P0301_debounce_count)" VALUE 0x4000D40C RL_VALUE_UBYTE 0 NO_COMPU_METHOD 0 255 /end CHARACTERISTIC
/begin CHARACTERISTIC CAL_obd_ii_P0302_debounce_count "Calibration: DTC debounce/fail count. (0091 0x4000dbdd CAL_obd_ii_P0302_debounce_count)" VALUE 0x4000D40D RL_VALUE_UBYTE 0 NO_COMPU_METHOD 0 255 /end CHARACTERISTIC
/begin CHARACTERISTIC CAL_obd_ii_P0303_debounce_count "Calibration: DTC debounce/fail count. (0091 0x4000dbde CAL_obd_ii_P0303_debounce_count)" VALUE 0x4000D40E RL_VALUE_UBYTE 0 NO_COMPU_METHOD 0 255 /end CHARACTERISTIC
/begin CHARACTERISTIC CAL_obd_ii_P0304_debounce_count "Calibration: DTC debounce/fail count. (0091 0x4000dbdf CAL_obd_ii_P0304_debounce_count)" VALUE 0x4000D40F RL_VALUE_UBYTE 0 NO_COMPU_METHOD 0 255 /end CHARACTERISTIC
/begin CHARACTERISTIC CAL_obd_ii_P0305_debounce_count "Calibration: DTC debounce/fail count. (0091 0x4000dbe0 CAL_obd_ii_P0305_debounce_count)" VALUE 0x4000D410 RL_VALUE_UBYTE 0 NO_COMPU_METHOD 0 255 /end CHARACTERISTIC
/begin CHARACTERISTIC CAL_obd_ii_P0306_debounce_count "Calibration: DTC debounce/fail count. (0091 0x4000dbe1 CAL_obd_ii_P0306_debounce_count)" VALUE 0x4000D411 RL_VALUE_UBYTE 0 NO_COMPU_METHOD 0 255 /end CHARACTERISTIC
/begin CHARACTERISTIC CAL_obd_ii_P0300_debounce_count "Calibration: DTC debounce/fail count. (0091 0x4000dbe2 CAL_obd_ii_P0300_debounce_count)" VALUE 0x4000D412 RL_VALUE_UBYTE 0 NO_COMPU_METHOD 0 255 /end CHARACTERISTIC
/begin CHARACTERISTIC CAL_obd_ii_P0461_debounce_count "Calibration: DTC debounce/fail count. (0091 0x4000dbe3 CAL_obd_ii_P0461_debounce_count)" VALUE 0x4000D413 RL_VALUE_UBYTE 0 NO_COMPU_METHOD 0 255 /end CHARACTERISTIC
/begin CHARACTERISTIC CAL_obd_ii_P0462_debounce_count "Calibration: DTC debounce/fail count. (0091 0x4000dbe4 CAL_obd_ii_P0462_debounce_count)" VALUE 0x4000D414 RL_VALUE_UBYTE 0 NO_COMPU_METHOD 0 255 /end CHARACTERISTIC
/begin CHARACTERISTIC CAL_obd_ii_P0463_debounce_count "Calibration: DTC debounce/fail count. (0091 0x4000dbe5 CAL_obd_ii_P0463_debounce_count)" VALUE 0x4000D415 RL_VALUE_UBYTE 0 NO_COMPU_METHOD 0 255 /end CHARACTERISTIC
/begin CHARACTERISTIC CAL_obd_ii_P0446_fail_count "Calibration: DTC debounce/fail count. (0091 0x4000dbe6 CAL_obd_ii_P0446_fail_count)" VALUE 0x4000D416 RL_VALUE_UBYTE 0 NO_COMPU_METHOD 0 255 /end CHARACTERISTIC
/begin CHARACTERISTIC CAL_obd_ii_P0482_debounce_count "Calibration: DTC debounce/fail count. (0091 0x4000dbe7 CAL_obd_ii_P0482_debounce_count)" VALUE 0x4000D417 RL_VALUE_UBYTE 0 NO_COMPU_METHOD 0 255 /end CHARACTERISTIC
/begin CHARACTERISTIC CAL_obd_ii_P2119_debounce_count "Calibration: DTC debounce/fail count. (0091 0x4000dbe8 CAL_obd_ii_P2119_debounce_count)" VALUE 0x4000D418 RL_VALUE_UBYTE 0 NO_COMPU_METHOD 0 255 /end CHARACTERISTIC
/begin CHARACTERISTIC CAL_obd_ii_P0455_debounce_count "Calibration: DTC debounce/fail count. (0091 0x4000dbe9 CAL_obd_ii_P0455_debounce_count)" VALUE 0x4000D419 RL_VALUE_UBYTE 0 NO_COMPU_METHOD 0 255 /end CHARACTERISTIC
/begin CHARACTERISTIC CAL_obd_ii_P0456_debounce_count "Calibration: DTC debounce/fail count. (0091 0x4000dbea CAL_obd_ii_P0456_debounce_count)" VALUE 0x4000D41A RL_VALUE_UBYTE 0 NO_COMPU_METHOD 0 255 /end CHARACTERISTIC
/begin CHARACTERISTIC CAL_obd_ii_P0016_debounce_count "Calibration: DTC debounce/fail count. (0091 0x4000dbeb CAL_obd_ii_P0016_debounce_count)" VALUE 0x4000D41B RL_VALUE_UBYTE 0 NO_COMPU_METHOD 0 255 /end CHARACTERISTIC
/begin CHARACTERISTIC CAL_obd_ii_P2173_fail_count "Calibration: DTC debounce/fail count. (0091 0x4000dbec CAL_obd_ii_P2173_fail_count)" VALUE 0x4000D41C RL_VALUE_UBYTE 0 NO_COMPU_METHOD 0 255 /end CHARACTERISTIC
/begin CHARACTERISTIC CAL_obd_ii_P2104_debounce_count "Calibration: DTC debounce/fail count. (0091 0x4000dbed CAL_obd_ii_P2104_debounce_count)" VALUE 0x4000D41D RL_VALUE_UBYTE 0 NO_COMPU_METHOD 0 255 /end CHARACTERISTIC
/begin CHARACTERISTIC CAL_obd_ii_P2105_debounce_count "Calibration: DTC debounce/fail count. (0091 0x4000dbee CAL_obd_ii_P2105_debounce_count)" VALUE 0x4000D41E RL_VALUE_UBYTE 0 NO_COMPU_METHOD 0 255 /end CHARACTERISTIC
/begin CHARACTERISTIC CAL_obd_ii_P2106_debounce_count "Calibration: DTC debounce/fail count. (0091 0x4000dbef CAL_obd_ii_P2106_debounce_count)" VALUE 0x4000D41F RL_VALUE_UBYTE 0 NO_COMPU_METHOD 0 255 /end CHARACTERISTIC
/begin CHARACTERISTIC CAL_obd_ii_P2107_debounce_count "Calibration: DTC debounce/fail count. (0091 0x4000dbf0 CAL_obd_ii_P2107_debounce_count)" VALUE 0x4000D420 RL_VALUE_UBYTE 0 NO_COMPU_METHOD 0 255 /end CHARACTERISTIC
/begin CHARACTERISTIC CAL_obd_ii_P2100_debounce_count "Calibration: DTC debounce/fail count. (0091 0x4000dbf1 CAL_obd_ii_P2100_debounce_count)" VALUE 0x4000D421 RL_VALUE_UBYTE 0 NO_COMPU_METHOD 0 255 /end CHARACTERISTIC
/begin CHARACTERISTIC CAL_obd_ii_P2102_debounce_count "Calibration: DTC debounce/fail count. (0091 0x4000dbf2 CAL_obd_ii_P2102_debounce_count)" VALUE 0x4000D422 RL_VALUE_UBYTE 0 NO_COMPU_METHOD 0 255 /end CHARACTERISTIC
/begin CHARACTERISTIC CAL_obd_ii_P2103_debounce_count "Calibration: DTC debounce/fail count. (0091 0x4000dbf3 CAL_obd_ii_P2103_debounce_count)" VALUE 0x4000D423 RL_VALUE_UBYTE 0 NO_COMPU_METHOD 0 255 /end CHARACTERISTIC
/begin CHARACTERISTIC CAL_obd_ii_P2108_debounce_count "Calibration: DTC debounce/fail count. (0091 0x4000dbf4 CAL_obd_ii_P2108_debounce_count)" VALUE 0x4000D424 RL_VALUE_UBYTE 0 NO_COMPU_METHOD 0 255 /end CHARACTERISTIC
/begin CHARACTERISTIC CAL_obd_ii_P0685_debounce_count "Calibration: DTC debounce/fail count. (0091 0x4000dbf5 CAL_obd_ii_P0685_debounce_count)" VALUE 0x4000D425 RL_VALUE_UBYTE 0 NO_COMPU_METHOD 0 255 /end CHARACTERISTIC
/begin CHARACTERISTIC CAL_obd_ii_P0151_fail_count "u8_count" VALUE 0x4000D426 RL_VALUE_UBYTE 0 NO_COMPU_METHOD 0 255 /end CHARACTERISTIC
/begin CHARACTERISTIC CAL_obd_ii_P0152_fail_count "u8_count" VALUE 0x4000D427 RL_VALUE_UBYTE 0 NO_COMPU_METHOD 0 255 /end CHARACTERISTIC
/begin CHARACTERISTIC CAL_obd_ii_P0157_fail_count "u8_count" VALUE 0x4000D428 RL_VALUE_UBYTE 0 NO_COMPU_METHOD 0 255 /end CHARACTERISTIC
/begin CHARACTERISTIC CAL_obd_ii_P0158_fail_count "Calibration: P0158 fail count." VALUE 0x4000D429 RL_VALUE_UBYTE 0 NO_COMPU_METHOD 0 255 /end CHARACTERISTIC
/begin CHARACTERISTIC CAL_obd_ii_P0159_debounce_count "Calibration: DTC debounce/fail count. (0091 0x4000dbfa CAL_obd_ii_P0159_debounce_count)" VALUE 0x4000D42A RL_VALUE_UBYTE 0 NO_COMPU_METHOD 0 255 /end CHARACTERISTIC
/begin CHARACTERISTIC CAL_obd_ii_P0332_debounce_count "Calibration: DTC debounce/fail count. (0091 0x4000dbfb CAL_obd_ii_P0332_debounce_count)" VALUE 0x4000D42B RL_VALUE_UBYTE 0 NO_COMPU_METHOD 0 255 /end CHARACTERISTIC
/begin CHARACTERISTIC CAL_obd_ii_P0333_debounce_count "Calibration: DTC debounce/fail count. (0091 0x4000dbfc CAL_obd_ii_P0333_debounce_count)" VALUE 0x4000D42C RL_VALUE_UBYTE 0 NO_COMPU_METHOD 0 255 /end CHARACTERISTIC
/begin CHARACTERISTIC CAL_obd_ii_P0021_debounce_count "Calibration: DTC debounce/fail count. (0091 0x4000dbfe CAL_obd_ii_P0021_debounce_count)" VALUE 0x4000D42E RL_VALUE_UBYTE 0 NO_COMPU_METHOD 0 255 /end CHARACTERISTIC
/begin CHARACTERISTIC CAL_obd_ii_P0022_debounce_count "Calibration: DTC debounce/fail count. (0091 0x4000dbff CAL_obd_ii_P0022_debounce_count)" VALUE 0x4000D42F RL_VALUE_UBYTE 0 NO_COMPU_METHOD 0 255 /end CHARACTERISTIC
/begin CHARACTERISTIC CAL_obd_ii_P0174_debounce_count "Calibration: DTC debounce/fail count. (0091 0x4000dc00 CAL_obd_ii_P0174_debounce_count)" VALUE 0x4000D430 RL_VALUE_UBYTE 0 NO_COMPU_METHOD 0 255 /end CHARACTERISTIC
/begin CHARACTERISTIC CAL_obd_ii_P0175_debounce_count "Calibration: DTC debounce/fail count. (0091 0x4000dc01 CAL_obd_ii_P0175_debounce_count)" VALUE 0x4000D431 RL_VALUE_UBYTE 0 NO_COMPU_METHOD 0 255 /end CHARACTERISTIC
/begin CHARACTERISTIC CAL_obd_ii_P0153_debounce_count "Calibration: DTC debounce/fail count. (0091 0x4000dc02 CAL_obd_ii_P0153_debounce_count)" VALUE 0x4000D432 RL_VALUE_UBYTE 0 NO_COMPU_METHOD 0 255 /end CHARACTERISTIC
/begin CHARACTERISTIC CAL_obd_ii_P0154_debounce_count "Calibration: DTC debounce/fail count. (0091 0x4000dc03 CAL_obd_ii_P0154_debounce_count)" VALUE 0x4000D433 RL_VALUE_UBYTE 0 NO_COMPU_METHOD 0 255 /end CHARACTERISTIC
/begin CHARACTERISTIC CAL_obd_ii_P0155_debounce_count "Calibration: DTC debounce/fail count. (0091 0x4000dc04 CAL_obd_ii_P0155_debounce_count)" VALUE 0x4000D434 RL_VALUE_UBYTE 0 NO_COMPU_METHOD 0 255 /end CHARACTERISTIC
/begin CHARACTERISTIC CAL_obd_ii_P0160_debounce_count "Calibration: DTC debounce/fail count. (0091 0x4000dc05 CAL_obd_ii_P0160_debounce_count)" VALUE 0x4000D435 RL_VALUE_UBYTE 0 NO_COMPU_METHOD 0 255 /end CHARACTERISTIC
/begin CHARACTERISTIC CAL_obd_ii_P0161_debounce_count "Calibration: DTC debounce/fail count. (0091 0x4000dc06 CAL_obd_ii_P0161_debounce_count)" VALUE 0x4000D436 RL_VALUE_UBYTE 0 NO_COMPU_METHOD 0 255 /end CHARACTERISTIC
/begin CHARACTERISTIC CAL_obd_ii_P0017_debounce_count "Calibration: DTC debounce/fail count. (0091 0x4000dc07 CAL_obd_ii_P0017_debounce_count)" VALUE 0x4000D437 RL_VALUE_UBYTE 0 NO_COMPU_METHOD 0 255 /end CHARACTERISTIC
/begin CHARACTERISTIC CAL_obd_ii_P0018_debounce_count "Calibration: DTC debounce/fail count. (0091 0x4000dc08 CAL_obd_ii_P0018_debounce_count)" VALUE 0x4000D438 RL_VALUE_UBYTE 0 NO_COMPU_METHOD 0 255 /end CHARACTERISTIC
/begin CHARACTERISTIC CAL_obd_ii_P0019_debounce_count "Calibration: DTC debounce/fail count. (0091 0x4000dc09 CAL_obd_ii_P0019_debounce_count)" VALUE 0x4000D439 RL_VALUE_UBYTE 0 NO_COMPU_METHOD 0 255 /end CHARACTERISTIC
/begin CHARACTERISTIC CAL_obd_ii_P1113_debounce_count "Calibration: DTC debounce/fail count. (0091 0x4000dc0a CAL_obd_ii_P1113_debounce_count)" VALUE 0x4000D43A RL_VALUE_UBYTE 0 NO_COMPU_METHOD 0 255 /end CHARACTERISTIC
/begin CHARACTERISTIC CAL_obd_ii_P0661_debounce_count "Calibration: DTC debounce/fail count. (0091 0x4000dc0b CAL_obd_ii_P0661_debounce_count)" VALUE 0x4000D43B RL_VALUE_UBYTE 0 NO_COMPU_METHOD 0 255 /end CHARACTERISTIC
/begin CHARACTERISTIC CAL_obd_ii_P0662_debounce_count "Calibration: DTC debounce/fail count. (0091 0x4000dc0c CAL_obd_ii_P0662_debounce_count)" VALUE 0x4000D43C RL_VALUE_UBYTE 0 NO_COMPU_METHOD 0 255 /end CHARACTERISTIC
/begin CHARACTERISTIC CAL_obd_ii_P0616_debounce_count "Calibration: DTC debounce/fail count. (0091 0x4000dc0d CAL_obd_ii_P0616_debounce_count)" VALUE 0x4000D43D RL_VALUE_UBYTE 0 NO_COMPU_METHOD 0 255 /end CHARACTERISTIC
/begin CHARACTERISTIC CAL_obd_ii_P0617_debounce_count "Calibration: DTC debounce/fail count. (0091 0x4000dc0e CAL_obd_ii_P0617_debounce_count)" VALUE 0x4000D43E RL_VALUE_UBYTE 0 NO_COMPU_METHOD 0 255 /end CHARACTERISTIC
/begin CHARACTERISTIC CAL_obd_ii_P0341_debounce_count "Calibration: DTC debounce/fail count. (0091 0x4000dc0f CAL_obd_ii_P0341_debounce_count)" VALUE 0x4000D43F RL_VALUE_UBYTE 0 NO_COMPU_METHOD 0 255 /end CHARACTERISTIC
/begin CHARACTERISTIC CAL_obd_ii_P0346_debounce_count "Calibration: DTC debounce/fail count. (0091 0x4000dc10 CAL_obd_ii_P0346_debounce_count)" VALUE 0x4000D440 RL_VALUE_UBYTE 0 NO_COMPU_METHOD 0 255 /end CHARACTERISTIC
/begin CHARACTERISTIC CAL_obd_ii_P0366_debounce_count "Calibration: DTC debounce/fail count. (0091 0x4000dc11 CAL_obd_ii_P0366_debounce_count)" VALUE 0x4000D441 RL_VALUE_UBYTE 0 NO_COMPU_METHOD 0 255 /end CHARACTERISTIC
/begin CHARACTERISTIC CAL_obd_ii_P0391_debounce_count "Calibration: DTC debounce/fail count. (0091 0x4000dc12 CAL_obd_ii_P0391_debounce_count)" VALUE 0x4000D442 RL_VALUE_UBYTE 0 NO_COMPU_METHOD 0 255 /end CHARACTERISTIC
/begin CHARACTERISTIC CAL_obd_ii_P0578_fail_count "Calibration: P0578 fail count." VALUE 0x4000D443 RL_VALUE_UBYTE 0 NO_COMPU_METHOD 0 255 /end CHARACTERISTIC
/begin CHARACTERISTIC CAL_obd_ii_P0564_debounce_count "Calibration: (0091 0x4000dc14 CAL_obd_ii_P0564_debounce_count)" VALUE 0x4000D444 RL_VALUE_UBYTE 0 NO_COMPU_METHOD 0 255 /end CHARACTERISTIC
/begin CHARACTERISTIC CAL_obd_ii_P0806_debounce_count "Calibration: (0091 0x4000dc15 CAL_obd_ii_P0806_debounce_count)" VALUE 0x4000D445 RL_VALUE_UBYTE 0 NO_COMPU_METHOD 0 255 /end CHARACTERISTIC
/begin CHARACTERISTIC CAL_obd_ii_P0807_debounce_count "Calibration: (0091 0x4000dc16 CAL_obd_ii_P0807_debounce_count)" VALUE 0x4000D446 RL_VALUE_UBYTE 0 NO_COMPU_METHOD 0 255 /end CHARACTERISTIC
/begin CHARACTERISTIC CAL_obd_ii_P0808_debounce_count "Calibration: (0091 0x4000dc17 CAL_obd_ii_P0808_debounce_count)" VALUE 0x4000D447 RL_VALUE_UBYTE 0 NO_COMPU_METHOD 0 255 /end CHARACTERISTIC
/begin CHARACTERISTIC CAL_obd_ii_P2612_debounce_count "Calibration: (0091 0x4000dc18 CAL_obd_ii_P2612_debounce_count)" VALUE 0x4000D448 RL_VALUE_UBYTE 0 NO_COMPU_METHOD 0 255 /end CHARACTERISTIC
/begin CHARACTERISTIC CAL_obd_ii_P2613_debounce_count "Calibration: (0091 0x4000dc19 CAL_obd_ii_P2613_debounce_count)" VALUE 0x4000D449 RL_VALUE_UBYTE 0 NO_COMPU_METHOD 0 255 /end CHARACTERISTIC
/begin CHARACTERISTIC CAL_obd_ii_P0537_debounce_count "Calibration: (0091 0x4000dc1a CAL_obd_ii_P0537_debounce_count)" VALUE 0x4000D44A RL_VALUE_UBYTE 0 NO_COMPU_METHOD 0 255 /end CHARACTERISTIC
/begin CHARACTERISTIC CAL_obd_ii_P0538_debounce_count "Calibration: (0091 0x4000dc1b CAL_obd_ii_P0538_debounce_count)" VALUE 0x4000D44B RL_VALUE_UBYTE 0 NO_COMPU_METHOD 0 255 /end CHARACTERISTIC
/begin CHARACTERISTIC CAL_obd_ii_U0127_debounce_count "Calibration: (0091 0x4000dc1c CAL_obd_ii_U0127_debounce_count)" VALUE 0x4000D44C RL_VALUE_UBYTE 0 NO_COMPU_METHOD 0 255 /end CHARACTERISTIC
/begin CHARACTERISTIC CAL_obd_ii_U0101_pass_counter_max "Calibration: (0091 0x4000dc1d CAL_obd_ii_U0101_pass_counter_max)" VALUE 0x4000D44D RL_VALUE_UBYTE 0 NO_COMPU_METHOD 0 255 /end CHARACTERISTIC
/begin CHARACTERISTIC CAL_obd_ii_U0122_pass_counter_max "Calibration: (0091 0x4000dc1e CAL_obd_ii_U0122_pass_counter_max)" VALUE 0x4000D44E RL_VALUE_UBYTE 0 NO_COMPU_METHOD 0 255 /end CHARACTERISTIC
/begin CHARACTERISTIC CAL_obd_ii_U0316_debounce_count "u8_count" VALUE 0x4000D44F RL_VALUE_UBYTE 0 NO_COMPU_METHOD 0 255 /end CHARACTERISTIC
/begin CHARACTERISTIC CAL_obd_ii_P0141_debounce_count "u8_count" VALUE 0x4000D450 RL_VALUE_UBYTE 0 NO_COMPU_METHOD 0 255 /end CHARACTERISTIC
/begin CHARACTERISTIC CAL_obd_ii_P050A_debounce_count "Calibration: (0091 0x4000dc21 CAL_obd_ii_P050A_debounce_count)" VALUE 0x4000D451 RL_VALUE_UBYTE 0 NO_COMPU_METHOD 0 255 /end CHARACTERISTIC
/begin CHARACTERISTIC CAL_obd_ii_P0071_maturing_limit "Calibration: P0071 maturing limit." VALUE 0x4000D452 RL_VALUE_UBYTE 0 NO_COMPU_METHOD 0 255 /end CHARACTERISTIC
/begin CHARACTERISTIC CAL_obd_ii_P050B_maturing_limit "u8_count" VALUE 0x4000D453 RL_VALUE_UBYTE 0 NO_COMPU_METHOD 0 255 /end CHARACTERISTIC
/begin CHARACTERISTIC CAL_obd_ii_P2170_pass_counter_max "Calibration: (0091 0x4000dc24 CAL_obd_ii_P2170_pass_counter_max)" VALUE 0x4000D454 RL_VALUE_UBYTE 0 NO_COMPU_METHOD 0 255 /end CHARACTERISTIC
/begin CHARACTERISTIC CAL_obd_ii_P2171_debounce_count "Calibration: (0091 0x4000dc25 CAL_obd_ii_P2171_debounce_count)" VALUE 0x4000D455 RL_VALUE_UBYTE 0 NO_COMPU_METHOD 0 255 /end CHARACTERISTIC
/begin CHARACTERISTIC CAL_obd_ii_P0826_debounce_count "Calibration: (0091 0x4000dc26 CAL_obd_ii_P0826_debounce_count)" VALUE 0x4000D456 RL_VALUE_UBYTE 0 NO_COMPU_METHOD 0 255 /end CHARACTERISTIC
/begin CHARACTERISTIC CAL_obd_ii_P0827_debounce_count "Calibration: (0091 0x4000dc27 CAL_obd_ii_P0827_debounce_count)" VALUE 0x4000D457 RL_VALUE_UBYTE 0 NO_COMPU_METHOD 0 255 /end CHARACTERISTIC
/begin CHARACTERISTIC CAL_obd_ii_P0828_debounce_count "Calibration: (0091 0x4000dc28 CAL_obd_ii_P0828_debounce_count)" VALUE 0x4000D458 RL_VALUE_UBYTE 0 NO_COMPU_METHOD 0 255 /end CHARACTERISTIC
/begin CHARACTERISTIC CAL_obd_ii_U0302_debounce_count "Calibration: (0091 0x4000dc29 CAL_obd_ii_U0302_debounce_count)" VALUE 0x4000D459 RL_VALUE_UBYTE 0 NO_COMPU_METHOD 0 255 /end CHARACTERISTIC
/begin CHARACTERISTIC CAL_obd_ii_U0416_debounce_count "Calibration: (0091 0x4000dc2a CAL_obd_ii_U0416_debounce_count)" VALUE 0x4000D45A RL_VALUE_UBYTE 0 NO_COMPU_METHOD 0 255 /end CHARACTERISTIC
/begin CHARACTERISTIC CAL_obd_ii_P2191_debounce_count "Calibration: (0091 0x4000dc2b CAL_obd_ii_P2191_debounce_count)" VALUE 0x4000D45B RL_VALUE_UBYTE 0 NO_COMPU_METHOD 0 255 /end CHARACTERISTIC
/begin CHARACTERISTIC CAL_obd_ii_P2193_debounce_count "Calibration: (0091 0x4000dc2c CAL_obd_ii_P2193_debounce_count)" VALUE 0x4000D45C RL_VALUE_UBYTE 0 NO_COMPU_METHOD 0 255 /end CHARACTERISTIC
/begin CHARACTERISTIC CAL_obd_ii_P1809_debounce_count "Calibration: (0091 0x4000dc2d CAL_obd_ii_P1809_debounce_count)" VALUE 0x4000D45D RL_VALUE_UBYTE 0 NO_COMPU_METHOD 0 255 /end CHARACTERISTIC
/begin CHARACTERISTIC CAL_obd_ii_P2336_maturing_limit "Calibration: P2336 maturing limit." VALUE 0x4000D45E RL_VALUE_UBYTE 0 NO_COMPU_METHOD 0 255 /end CHARACTERISTIC
/begin CHARACTERISTIC CAL_obd_ii_P2337_maturing_limit "u8_count" VALUE 0x4000D45F RL_VALUE_UBYTE 0 NO_COMPU_METHOD 0 255 /end CHARACTERISTIC
/begin CHARACTERISTIC CAL_obd_ii_P2338_maturing_limit "u8_count" VALUE 0x4000D460 RL_VALUE_UBYTE 0 NO_COMPU_METHOD 0 255 /end CHARACTERISTIC
/begin CHARACTERISTIC CAL_obd_ii_P2339_maturing_limit "u8_count" VALUE 0x4000D461 RL_VALUE_UBYTE 0 NO_COMPU_METHOD 0 255 /end CHARACTERISTIC
/begin CHARACTERISTIC CAL_obd_ii_P2340_maturing_limit "Calibration: (0091 0x4000dc32 CAL_obd_ii_P2340_maturing_limit)" VALUE 0x4000D462 RL_VALUE_UBYTE 0 NO_COMPU_METHOD 0 255 /end CHARACTERISTIC
/begin CHARACTERISTIC CAL_obd_ii_P2341_maturing_limit "Calibration: (0091 0x4000dc33 CAL_obd_ii_P2341_maturing_limit)" VALUE 0x4000D463 RL_VALUE_UBYTE 0 NO_COMPU_METHOD 0 255 /end CHARACTERISTIC
/begin CHARACTERISTIC CAL_obd_ii_U0123_debounce_count "Calibration: (0091 0x4000dc34 CAL_obd_ii_U0123_debounce_count)" VALUE 0x4000D464 RL_VALUE_UBYTE 0 NO_COMPU_METHOD 0 255 /end CHARACTERISTIC
/begin CHARACTERISTIC CAL_obd_ii_U0513_debounce_count "Calibration: (0091 0x4000dc35 CAL_obd_ii_U0513_debounce_count)" VALUE 0x4000D465 RL_VALUE_UBYTE 0 NO_COMPU_METHOD 0 255 /end CHARACTERISTIC
/begin CHARACTERISTIC CAL_obd_ii_P1562_debounce_count "Calibration: (0091 0x4000dc36 CAL_obd_ii_P1562_debounce_count)" VALUE 0x4000D466 RL_VALUE_UBYTE 0 NO_COMPU_METHOD 0 255 /end CHARACTERISTIC
/begin CHARACTERISTIC CAL_obd_ii_P0097_debounce_count "Calibration: 0278-only debounce/fail count (0091 slot is CAL_unused_array5)." VALUE 0x4000D467 RL_VALUE_UBYTE 0 NO_COMPU_METHOD 0 255 /end CHARACTERISTIC
/begin CHARACTERISTIC CAL_obd_ii_P0098_debounce_count "Calibration: 0278-only debounce/fail count (0091 slot is CAL_unused_array5)." VALUE 0x4000D468 RL_VALUE_UBYTE 0 NO_COMPU_METHOD 0 255 /end CHARACTERISTIC
/begin CHARACTERISTIC CAL_obd_ii_P1107_debounce_count "Calibration: 0278-only debounce/fail count (0091 slot is CAL_unused_array5)." VALUE 0x4000D469 RL_VALUE_UBYTE 0 NO_COMPU_METHOD 0 255 /end CHARACTERISTIC
/begin CHARACTERISTIC CAL_obd_ii_P1108_debounce_count "Calibration: 0278-only debounce/fail count (0091 slot is CAL_unused_array5)." VALUE 0x4000D46A RL_VALUE_UBYTE 0 NO_COMPU_METHOD 0 255 /end CHARACTERISTIC
/begin CHARACTERISTIC CAL_obd_ii_P0522_debounce_count "Calibration: 0278-only debounce/fail count (0091 slot is CAL_unused_array5)." VALUE 0x4000D46B RL_VALUE_UBYTE 0 NO_COMPU_METHOD 0 255 /end CHARACTERISTIC
/begin CHARACTERISTIC CAL_obd_ii_P0192_debounce_count "Calibration: 0278-only debounce/fail count (0091 slot is CAL_unused_array5)." VALUE 0x4000D46C RL_VALUE_UBYTE 0 NO_COMPU_METHOD 0 255 /end CHARACTERISTIC
/begin CHARACTERISTIC CAL_obd_ii_P0193_debounce_count "Calibration: 0278-only debounce/fail count (0091 slot is CAL_unused_array5)." VALUE 0x4000D46D RL_VALUE_UBYTE 0 NO_COMPU_METHOD 0 255 /end CHARACTERISTIC
/begin CHARACTERISTIC CAL_obd_ii_P023B_debounce_count "Calibration: 0278-only debounce/fail count (0091 slot is CAL_unused_array5). CAC pump circuit." VALUE 0x4000D46E RL_VALUE_UBYTE 0 NO_COMPU_METHOD 0 255 /end CHARACTERISTIC
/begin CHARACTERISTIC CAL_obd_ii_P023C_debounce_count "Calibration: 0278-only debounce/fail count (0091 slot is CAL_unused_array5). CAC pump circuit." VALUE 0x4000D46F RL_VALUE_UBYTE 0 NO_COMPU_METHOD 0 255 /end CHARACTERISTIC
/begin CHARACTERISTIC CAL_obd_ii_P0087_debounce_count "Calibration: 0278-only debounce/fail count (0091 slot is CAL_unused_array5). fuel rail pressure low." VALUE 0x4000D470 RL_VALUE_UBYTE 0 NO_COMPU_METHOD 0 255 /end CHARACTERISTIC
/begin CHARACTERISTIC CAL_obd_ii_P0088_debounce_count "Calibration: 0278-only debounce/fail count (0091 slot is CAL_unused_array5). fuel rail pressure high." VALUE 0x4000D471 RL_VALUE_UBYTE 0 NO_COMPU_METHOD 0 255 /end CHARACTERISTIC
/begin CHARACTERISTIC CAL_obd_ii_P0072_debounce_count "Calibration: 0278-only debounce/fail count (0091 slot is CAL_unused_array5)." VALUE 0x4000D472 RL_VALUE_UBYTE 0 NO_COMPU_METHOD 0 255 /end CHARACTERISTIC
/begin CHARACTERISTIC CAL_obd_ii_P0897_debounce_count "Calibration: 0278-only debounce/fail count (0091 slot is CAL_unused_array5). IPS trans fluid." VALUE 0x4000D473 RL_VALUE_UBYTE 0 NO_COMPU_METHOD 0 255 /end CHARACTERISTIC
/begin CHARACTERISTIC CAL_obd_ii_P0073_debounce_count "Calibration: 0278-only debounce/fail count (0091 slot is CAL_unused_array5)." VALUE 0x4000D474 RL_VALUE_UBYTE 0 NO_COMPU_METHOD 0 255 /end CHARACTERISTIC
/begin CHARACTERISTIC CAL_obd_ii_P2797_debounce_count "Calibration: 0278-only debounce/fail count (0091 slot is CAL_unused_array5). IPS trans fluid pump; set at pump setup only (DTC tentative)." VALUE 0x4000D475 RL_VALUE_UBYTE 0 NO_COMPU_METHOD 0 255 /end CHARACTERISTIC
/begin CHARACTERISTIC CAL_obd_ii_P0712_debounce_count "Calibration: 0278-only debounce/fail count (0091 slot is CAL_unused_array5). IPS trans fluid temp low." VALUE 0x4000D476 RL_VALUE_UBYTE 0 NO_COMPU_METHOD 0 255 /end CHARACTERISTIC
/begin CHARACTERISTIC CAL_obd_ii_P0713_debounce_count "Calibration: 0278-only debounce/fail count (0091 slot is CAL_unused_array5). IPS trans fluid temp high." VALUE 0x4000D477 RL_VALUE_UBYTE 0 NO_COMPU_METHOD 0 255 /end CHARACTERISTIC
/begin AXIS_PTS CAL_misfire_comp_maf_manual_X_coolant_temp "Calibration: X-axis (coolant temp) for the misfire compensation MAF manual table (°C = val*5/8−40; 4-element array)." 0x4000D5A0 coolant_temp_engine_stopped RL_AXIS_UWORD 0 CM_u8_temp_5_8_40c 4 -40 40919.375 /end AXIS_PTS
/begin AXIS_PTS CAL_misfire_comp_maf_manual_Y_maf_accum "Calibration: Y axis (accumulated air, g) of misfire MAF comp manual." 0x4000D5A8 maf_accumulated_since_start_raw RL_AXIS_UWORD 0 CM_u16_mass_g 5 0 65535 /end AXIS_PTS
/begin CHARACTERISTIC CAL_misfire_comp_maf_manual "Calibration: misfire compensation MAF manual (20-element array)." MAP 0x4000D5B2 RL_VALUE_UWORD 0 NO_COMPU_METHOD 0 65535
 /begin AXIS_DESCR COM_AXIS coolant_temp_engine_stopped CM_u8_temp_5_8_40c 4 -40 40919.375 AXIS_PTS_REF CAL_misfire_comp_maf_manual_X_coolant_temp /end AXIS_DESCR
 /begin AXIS_DESCR COM_AXIS maf_accumulated_since_start_raw CM_u16_mass_g 5 0 65535 AXIS_PTS_REF CAL_misfire_comp_maf_manual_Y_maf_accum /end AXIS_DESCR
/end CHARACTERISTIC
/begin AXIS_PTS CAL_misfire_comp_maf_ips_X_coolant_temp "Calibration: X-axis (coolant temp) for the misfire compensation MAF IPS table (°C = val*5/8−40; 4-element array)." 0x4000D5DA coolant_temp_engine_stopped RL_AXIS_UWORD 0 CM_u8_temp_5_8_40c 4 -40 40919.375 /end AXIS_PTS
/begin AXIS_PTS CAL_misfire_comp_maf_ips_Y_maf_accum "Calibration: Y axis (accumulated air, g) of misfire MAF comp IPS." 0x4000D5E2 maf_accumulated_since_start_raw RL_AXIS_UWORD 0 CM_u16_mass_g 5 0 65535 /end AXIS_PTS
/begin CHARACTERISTIC CAL_misfire_comp_maf_ips "Calibration: misfire compensation MAF IPS (20-element array)." MAP 0x4000D5EC RL_VALUE_SWORD 0 NO_COMPU_METHOD -32768 32767
 /begin AXIS_DESCR COM_AXIS coolant_temp_engine_stopped CM_u8_temp_5_8_40c 4 -40 40919.375 AXIS_PTS_REF CAL_misfire_comp_maf_ips_X_coolant_temp /end AXIS_DESCR
 /begin AXIS_DESCR COM_AXIS maf_accumulated_since_start_raw CM_u16_mass_g 5 0 65535 AXIS_PTS_REF CAL_misfire_comp_maf_ips_Y_maf_accum /end AXIS_DESCR
/end CHARACTERISTIC
/begin AXIS_PTS CAL_misfire_sensitivity_manual_X_rpm "Calibration: X-axis (rpm) for the misfire sensitivity manual table (RPM; 8-element array)." 0x4000D78C engine_speed_16bit RL_AXIS_UWORD 0 CM_u8_rspeed_rpm 8 0 65535 /end AXIS_PTS
/begin AXIS_PTS CAL_misfire_sensitivity_manual_Y_load "Calibration: Y-axis (load) for the misfire sensitivity manual table (mg/stroke; 8-element array)." 0x4000D79C V_CAL_misfire_sensitivity_manual_Y_load RL_AXIS_UWORD 0 CM_u8_load_mg_stroke 8 0 65535 /end AXIS_PTS
/begin CHARACTERISTIC CAL_misfire_sensitivity_manual "Calibration: misfire sensitivity manual (64-element array)." MAP 0x4000D7AC RL_VALUE_UWORD 0 NO_COMPU_METHOD 0 65535
 /begin AXIS_DESCR COM_AXIS engine_speed_16bit CM_u8_rspeed_rpm 8 0 65535 AXIS_PTS_REF CAL_misfire_sensitivity_manual_X_rpm /end AXIS_DESCR
 /begin AXIS_DESCR COM_AXIS V_CAL_misfire_sensitivity_manual_Y_load CM_u8_load_mg_stroke 8 0 65535 AXIS_PTS_REF CAL_misfire_sensitivity_manual_Y_load /end AXIS_DESCR
/end CHARACTERISTIC
/begin AXIS_PTS CAL_misfire_sensitivity_ips_X_rpm "Calibration: X-axis (rpm) for the misfire sensitivity IPS table (RPM; 8-element array)." 0x4000D82C engine_speed_16bit RL_AXIS_UWORD 0 CM_u8_rspeed_rpm 8 0 65535 /end AXIS_PTS
/begin AXIS_PTS CAL_misfire_sensitivity_ips_Y_load "Calibration: Y-axis (load) for the misfire sensitivity IPS table (mg/stroke; 8-element array)." 0x4000D83C V_CAL_misfire_sensitivity_ips_Y_load RL_AXIS_UWORD 0 CM_u8_load_mg_stroke 8 0 65535 /end AXIS_PTS
/begin CHARACTERISTIC CAL_misfire_sensitivity_ips "Calibration: misfire sensitivity IPS (64-element array)." MAP 0x4000D84C RL_VALUE_UWORD 0 NO_COMPU_METHOD 0 65535
 /begin AXIS_DESCR COM_AXIS engine_speed_16bit CM_u8_rspeed_rpm 8 0 65535 AXIS_PTS_REF CAL_misfire_sensitivity_ips_X_rpm /end AXIS_DESCR
 /begin AXIS_DESCR COM_AXIS V_CAL_misfire_sensitivity_ips_Y_load CM_u8_load_mg_stroke 8 0 65535 AXIS_PTS_REF CAL_misfire_sensitivity_ips_Y_load /end AXIS_DESCR
/end CHARACTERISTIC
/begin AXIS_PTS CAL_obd_ii_cat_monitor_threshold_ips_X_maf_flow "X-axis: obd_ii_maf_flow/100 (g/s). Was typed u8_mass_g." 0x4000D8CC NO_INPUT_QUANTITY RL_AXIS_UBYTE 0 CM_u8_flow_g_s 8 0 255 /end AXIS_PTS
/begin CHARACTERISTIC CAL_obd_ii_cat_monitor_threshold_ips "Calibration: MAF compensation IPS (8-element array)." CURVE 0x4000D8D4 RL_VALUE_UBYTE 0 NO_COMPU_METHOD 0 255
 /begin AXIS_DESCR COM_AXIS NO_INPUT_QUANTITY CM_u8_flow_g_s 8 0 255 AXIS_PTS_REF CAL_obd_ii_cat_monitor_threshold_ips_X_maf_flow /end AXIS_DESCR
/end CHARACTERISTIC
/begin AXIS_PTS CAL_misfire_detect_torque_threshold_X_rpm "Calibration: X-axis (rpm) for the misfire detect torque threshold table (RPM = val*125/4+500; 8-element array)." 0x4000D9DC engine_speed_8bit RL_AXIS_UBYTE 0 CM_u8_rspeed_125_4_500rpm 8 500 8468.75 /end AXIS_PTS
/begin CHARACTERISTIC CAL_misfire_detect_torque_threshold "Calibration: misfire detect torque threshold (Nm; 8-element array)." CURVE 0x4000D9E4 RL_VALUE_UBYTE 0 CM_u8_torque_nm 0 255
 /begin AXIS_DESCR COM_AXIS engine_speed_8bit CM_u8_rspeed_125_4_500rpm 8 500 8468.75 AXIS_PTS_REF CAL_misfire_detect_torque_threshold_X_rpm /end AXIS_DESCR
/end CHARACTERISTIC
/begin AXIS_PTS CAL_misfire_base_threshold_manual_X_rpm "Calibration: X-axis (rpm) for the misfire base threshold manual table (RPM; 16-element array)." 0x4000DA10 engine_speed_16bit RL_AXIS_UWORD 0 CM_u8_rspeed_rpm 16 0 65535 /end AXIS_PTS
/begin AXIS_PTS CAL_misfire_base_threshold_manual_Y_load "Calibration: Y-axis (load) for the misfire base threshold manual table (mg/stroke; 16-element array)." 0x4000DA30 V_CAL_misfire_base_threshold_manual_Y_load RL_AXIS_UWORD 0 CM_u8_load_mg_stroke 16 0 65535 /end AXIS_PTS
/begin CHARACTERISTIC CAL_misfire_base_threshold_manual "Calibration: misfire base threshold, manual. (0091 i16_misfire_threshold_raw)" MAP 0x4000DA50 RL_VALUE_SWORD 0 NO_COMPU_METHOD -32768 32767
 /begin AXIS_DESCR COM_AXIS engine_speed_16bit CM_u8_rspeed_rpm 16 0 65535 AXIS_PTS_REF CAL_misfire_base_threshold_manual_X_rpm /end AXIS_DESCR
 /begin AXIS_DESCR COM_AXIS V_CAL_misfire_base_threshold_manual_Y_load CM_u8_load_mg_stroke 16 0 65535 AXIS_PTS_REF CAL_misfire_base_threshold_manual_Y_load /end AXIS_DESCR
/end CHARACTERISTIC
/begin AXIS_PTS CAL_misfire_cat_damage_limit_X_rpm "Calibration: X-axis (rpm) for the misfire cat damage limit table (RPM = val*125/4+500; 8-element array)." 0x4000DC50 engine_speed_8bit RL_AXIS_UBYTE 0 CM_u8_rspeed_125_4_500rpm 8 500 8468.75 /end AXIS_PTS
/begin AXIS_PTS CAL_misfire_cat_damage_limit_Y_load "Calibration: Y-axis (load) for the misfire cat damage limit table (mg/stroke = val*4; 8-element array)." 0x4000DC58 load_mass_per_stroke RL_AXIS_UBYTE 0 CM_u8_load_4mg_stroke 8 0 1020 /end AXIS_PTS
/begin CHARACTERISTIC CAL_misfire_cat_damage_limit "Calibration: misfire cat damage limit (64-element array)." MAP 0x4000DC60 RL_VALUE_UBYTE 0 NO_COMPU_METHOD 0 255
 /begin AXIS_DESCR COM_AXIS engine_speed_8bit CM_u8_rspeed_125_4_500rpm 8 500 8468.75 AXIS_PTS_REF CAL_misfire_cat_damage_limit_X_rpm /end AXIS_DESCR
 /begin AXIS_DESCR COM_AXIS load_mass_per_stroke CM_u8_load_4mg_stroke 8 0 1020 AXIS_PTS_REF CAL_misfire_cat_damage_limit_Y_load /end AXIS_DESCR
/end CHARACTERISTIC
/begin AXIS_PTS CAL_misfire_base_threshold_ips_X_rpm "Calibration: X-axis (rpm) for the misfire base threshold IPS table (RPM; 16-element array)." 0x4000DCA0 engine_speed_16bit RL_AXIS_UWORD 0 CM_u8_rspeed_rpm 16 0 65535 /end AXIS_PTS
/begin AXIS_PTS CAL_misfire_base_threshold_ips_Y_load "Calibration: Y-axis (load) for the misfire base threshold IPS table (mg/stroke; 16-element array)." 0x4000DCC0 V_CAL_misfire_base_threshold_ips_Y_load RL_AXIS_UWORD 0 CM_u8_load_mg_stroke 16 0 65535 /end AXIS_PTS
/begin CHARACTERISTIC CAL_misfire_base_threshold_ips "Calibration: misfire base threshold, IPS. (0091 i16_misfire_threshold_raw)" MAP 0x4000DCE0 RL_VALUE_SWORD 0 NO_COMPU_METHOD -32768 32767
 /begin AXIS_DESCR COM_AXIS engine_speed_16bit CM_u8_rspeed_rpm 16 0 65535 AXIS_PTS_REF CAL_misfire_base_threshold_ips_X_rpm /end AXIS_DESCR
 /begin AXIS_DESCR COM_AXIS V_CAL_misfire_base_threshold_ips_Y_load CM_u8_load_mg_stroke 16 0 65535 AXIS_PTS_REF CAL_misfire_base_threshold_ips_Y_load /end AXIS_DESCR
/end CHARACTERISTIC
/begin AXIS_PTS CAL_obd_ii_cat_monitor_threshold_manual_X_maf_flow "X-axis: obd_ii_maf_flow/100 (g/s). Was typed u8_mass_g." 0x4000DEF0 NO_INPUT_QUANTITY RL_AXIS_UBYTE 0 CM_u8_flow_g_s 8 0 255 /end AXIS_PTS
/begin CHARACTERISTIC CAL_obd_ii_cat_monitor_threshold_manual "Calibration: MAF compensation manual (8-element array)." CURVE 0x4000DEF8 RL_VALUE_UBYTE 0 NO_COMPU_METHOD 0 255
 /begin AXIS_DESCR COM_AXIS NO_INPUT_QUANTITY CM_u8_flow_g_s 8 0 255 AXIS_PTS_REF CAL_obd_ii_cat_monitor_threshold_manual_X_maf_flow /end AXIS_DESCR
/end CHARACTERISTIC
/begin CHARACTERISTIC CAL_obd_ii_P0101_load_tolerance_X_rpm "Calibration: X axis of CAL_obd_ii_P0101_load_tolerance_pct. (0091 0x4000e7ca)" VAL_BLK 0x4000DFFA RL_VALUE_UBYTE 0 CM_u8_rspeed_125_4_500rpm 500 8468.75 NUMBER 8 /end CHARACTERISTIC
/begin CHARACTERISTIC CAL_obd_ii_P0101_load_tolerance_pct "Calibration: P0101 load tolerance vs rpm. (0091 0x4000e7d2)" VAL_BLK 0x4000E002 RL_VALUE_UBYTE 0 CM_u8_factor_1_100 0 255 NUMBER 8 /end CHARACTERISTIC
/begin AXIS_PTS CAL_obd_ii_P0106_throttle_vacuum_rpm_lo_X_tps "Calibration: X axis of CAL_obd_ii_P0106_throttle_vacuum_rpm_lo. (0091 0x4000e828)" 0x4000E058 NO_INPUT_QUANTITY RL_AXIS_UBYTE 0 CM_u8_factor_1_255 8 0 100 /end AXIS_PTS
/begin AXIS_PTS CAL_obd_ii_P0106_throttle_vacuum_rpm_lo_Y_load "Calibration: Y axis of CAL_obd_ii_P0106_throttle_vacuum_rpm_lo. (0091 0x4000e830)" 0x4000E060 NO_INPUT_QUANTITY RL_AXIS_UBYTE 0 CM_u8_load_4mg_stroke 8 0 1020 /end AXIS_PTS
/begin CHARACTERISTIC CAL_obd_ii_P0106_throttle_vacuum_rpm_lo "Calibration: P0106 expected manifold vacuum, low rpm. (0091 0x4000e838)" MAP 0x4000E068 RL_VALUE_UBYTE 0 CM_u8_pressure_4mbar 0 1020
 /begin AXIS_DESCR COM_AXIS NO_INPUT_QUANTITY CM_u8_factor_1_255 8 0 100 AXIS_PTS_REF CAL_obd_ii_P0106_throttle_vacuum_rpm_lo_X_tps /end AXIS_DESCR
 /begin AXIS_DESCR COM_AXIS NO_INPUT_QUANTITY CM_u8_load_4mg_stroke 8 0 1020 AXIS_PTS_REF CAL_obd_ii_P0106_throttle_vacuum_rpm_lo_Y_load /end AXIS_DESCR
/end CHARACTERISTIC
/begin AXIS_PTS CAL_obd_ii_P0106_throttle_vacuum_rpm_hi_X_tps "Calibration: X axis of CAL_obd_ii_P0106_throttle_vacuum_rpm_hi. (0091 0x4000e878)" 0x4000E0A8 NO_INPUT_QUANTITY RL_AXIS_UBYTE 0 CM_u8_factor_1_255 8 0 100 /end AXIS_PTS
/begin AXIS_PTS CAL_obd_ii_P0106_throttle_vacuum_rpm_hi_Y_load "Calibration: Y axis of CAL_obd_ii_P0106_throttle_vacuum_rpm_hi. (0091 0x4000e880)" 0x4000E0B0 NO_INPUT_QUANTITY RL_AXIS_UBYTE 0 CM_u8_load_4mg_stroke 8 0 1020 /end AXIS_PTS
/begin CHARACTERISTIC CAL_obd_ii_P0106_throttle_vacuum_rpm_hi "Calibration: P0106 expected manifold vacuum, high rpm. (0091 0x4000e888)" MAP 0x4000E0B8 RL_VALUE_UBYTE 0 CM_u8_pressure_4mbar 0 1020
 /begin AXIS_DESCR COM_AXIS NO_INPUT_QUANTITY CM_u8_factor_1_255 8 0 100 AXIS_PTS_REF CAL_obd_ii_P0106_throttle_vacuum_rpm_hi_X_tps /end AXIS_DESCR
 /begin AXIS_DESCR COM_AXIS NO_INPUT_QUANTITY CM_u8_load_4mg_stroke 8 0 1020 AXIS_PTS_REF CAL_obd_ii_P0106_throttle_vacuum_rpm_hi_Y_load /end AXIS_DESCR
/end CHARACTERISTIC
/begin AXIS_PTS CAL_obd_ii_thermostat_monitor_time_X_start_coolant "Calibration: X axis (engine-off coolant) of CAL_obd_ii_thermostat_monitor_time. 0278-only." 0x4000E12E NO_INPUT_QUANTITY RL_AXIS_UBYTE 0 CM_u8_temp_5_8_40c 13 -40 119.375 /end AXIS_PTS
/begin CHARACTERISTIC CAL_obd_ii_thermostat_monitor_time "Calibration: thermostat monitor time budget; u32_time_5ms = value*2000." CURVE 0x4000E13B RL_VALUE_UBYTE 0 CM_u8_time_10s 0 2550
 /begin AXIS_DESCR COM_AXIS NO_INPUT_QUANTITY CM_u8_temp_5_8_40c 13 -40 119.375 AXIS_PTS_REF CAL_obd_ii_thermostat_monitor_time_X_start_coolant /end AXIS_DESCR
/end CHARACTERISTIC
/begin AXIS_PTS CAL_obd_ii_o2_lean_time_baseline_X_maf "Calibration: X axis (MAF/100) of CAL_obd_ii_o2_lean_time_baseline. (0091 0x4000e918)" 0x4000E148 NO_INPUT_QUANTITY RL_AXIS_UBYTE 0 CM_u8_flow_g_s 8 0 255 /end AXIS_PTS
/begin CHARACTERISTIC CAL_obd_ii_o2_lean_time_baseline "Calibration: O2 lean-time baseline vs MAF. (0091 0x4000e920)" CURVE 0x4000E150 RL_VALUE_UBYTE 0 NO_COMPU_METHOD 0 255
 /begin AXIS_DESCR COM_AXIS NO_INPUT_QUANTITY CM_u8_flow_g_s 8 0 255 AXIS_PTS_REF CAL_obd_ii_o2_lean_time_baseline_X_maf /end AXIS_DESCR
/end CHARACTERISTIC
/begin AXIS_PTS CAL_obd_ii_o2_rich_time_baseline_X_maf "Calibration: X axis (MAF/100) of CAL_obd_ii_o2_rich_time_baseline. (0091 0x4000e928)" 0x4000E158 NO_INPUT_QUANTITY RL_AXIS_UBYTE 0 CM_u8_flow_g_s 8 0 255 /end AXIS_PTS
/begin CHARACTERISTIC CAL_obd_ii_o2_rich_time_baseline "Calibration: O2 rich-time baseline vs MAF. (0091 0x4000e930)" CURVE 0x4000E160 RL_VALUE_UBYTE 0 CM_u8_time_5ms 0 1275
 /begin AXIS_DESCR COM_AXIS NO_INPUT_QUANTITY CM_u8_flow_g_s 8 0 255 AXIS_PTS_REF CAL_obd_ii_o2_rich_time_baseline_X_maf /end AXIS_DESCR
/end CHARACTERISTIC
/begin GROUP G_Emissions_misfire "misfire"
 /begin REF_CHARACTERISTIC CAL_misfire_base_threshold_ips CAL_misfire_base_threshold_ips_X_rpm CAL_misfire_base_threshold_ips_Y_load CAL_misfire_base_threshold_manual CAL_misfire_base_threshold_manual_X_rpm CAL_misfire_base_threshold_manual_Y_load CAL_misfire_cat_damage_limit CAL_misfire_cat_damage_limit_X_rpm CAL_misfire_cat_damage_limit_Y_load CAL_misfire_comp_maf_ips CAL_misfire_comp_maf_ips_X_coolant_temp CAL_misfire_comp_maf_ips_Y_maf_accum CAL_misfire_comp_maf_manual CAL_misfire_comp_maf_manual_X_coolant_temp CAL_misfire_comp_maf_manual_Y_maf_accum CAL_misfire_detect_torque_threshold CAL_misfire_detect_torque_threshold_X_rpm CAL_misfire_emissions_limit CAL_misfire_enable_conditions_hold CAL_misfire_enable_coolant_max CAL_misfire_enable_coolant_min CAL_misfire_enable_rpm_max CAL_misfire_enable_rpm_min CAL_misfire_failed_bank_scaling CAL_misfire_inhibit_tps_rate_declutched CAL_misfire_inhibit_tps_rate_hold CAL_misfire_inhibit_tps_rate_neg CAL_misfire_inhibit_tps_rate_pos CAL_misfire_per_cyl_learn_enable CAL_misfire_rough_road_hold CAL_misfire_sensitivity_ips CAL_misfire_sensitivity_ips_X_rpm CAL_misfire_sensitivity_ips_Y_load CAL_misfire_sensitivity_manual CAL_misfire_sensitivity_manual_X_rpm CAL_misfire_sensitivity_manual_Y_load /end REF_CHARACTERISTIC
/end GROUP
/begin GROUP G_Diagnostics "OBD-II diagnostics" ROOT
 /begin REF_CHARACTERISTIC CAL_obd_ii_B1422 CAL_obd_ii_B1422_fail_threshold CAL_obd_ii_P0011 CAL_obd_ii_P0011_debounce_count CAL_obd_ii_P0012 CAL_obd_ii_P0012_debounce_count CAL_obd_ii_P0014 CAL_obd_ii_P0014_maturing_limit CAL_obd_ii_P0015 CAL_obd_ii_P0015_maturing_limit CAL_obd_ii_P0016 CAL_obd_ii_P0016_debounce_count CAL_obd_ii_P0017 CAL_obd_ii_P0017_debounce_count CAL_obd_ii_P0018 CAL_obd_ii_P0018_debounce_count CAL_obd_ii_P0019 CAL_obd_ii_P0019_debounce_count CAL_obd_ii_P0021 CAL_obd_ii_P0021_debounce_count CAL_obd_ii_P0022 CAL_obd_ii_P0022_debounce_count CAL_obd_ii_P0024 CAL_obd_ii_P0024_maturing_limit CAL_obd_ii_P0025 CAL_obd_ii_P0025_debounce_count CAL_obd_ii_P0071 CAL_obd_ii_P0071_air_temp_limit CAL_obd_ii_P0071_maturing_limit CAL_obd_ii_P0072 CAL_obd_ii_P0072_debounce_count CAL_obd_ii_P0073 CAL_obd_ii_P0073_debounce_count CAL_obd_ii_P0076 CAL_obd_ii_P0076_debounce_count CAL_obd_ii_P0077 CAL_obd_ii_P0077_debounce_count CAL_obd_ii_P0079 CAL_obd_ii_P0079_debounce_count CAL_obd_ii_P0080 CAL_obd_ii_P0080_debounce_count CAL_obd_ii_P0082 CAL_obd_ii_P0082_debounce_count CAL_obd_ii_P0083 CAL_obd_ii_P0083_debounce_count CAL_obd_ii_P0085 CAL_obd_ii_P0085_debounce_count CAL_obd_ii_P0086 CAL_obd_ii_P0086_debounce_count CAL_obd_ii_P0087 CAL_obd_ii_P0087_debounce_count CAL_obd_ii_P0088 CAL_obd_ii_P0088_debounce_count CAL_obd_ii_P0096 CAL_obd_ii_P0096_air_mass_min CAL_obd_ii_P0096_high_flow_maf_min CAL_obd_ii_P0096_high_flow_phase_count CAL_obd_ii_P0096_high_flow_phase_dwell CAL_obd_ii_P0096_idle_phase_count CAL_obd_ii_P0096_idle_phase_dwell CAL_obd_ii_P0097 CAL_obd_ii_P0097_debounce_count CAL_obd_ii_P0098 CAL_obd_ii_P0098_debounce_count CAL_obd_ii_P0101_baro_min CAL_obd_ii_P0101_idle_coolant_min CAL_obd_ii_P0101_idle_dwell_min CAL_obd_ii_P0101_idle_iat_max CAL_obd_ii_P0101_ips CAL_obd_ii_P0101_load_tolerance_X_rpm CAL_obd_ii_P0101_load_tolerance_pct CAL_obd_ii_P0101_load_tolerance_pct_idle CAL_obd_ii_P0101_manual CAL_obd_ii_P0101_maturing_limit CAL_obd_ii_P0101_plausibility_enable CAL_obd_ii_P0101_runtime_min CAL_obd_ii_P0102 CAL_obd_ii_P0102_debounce_count CAL_obd_ii_P0103 CAL_obd_ii_P0103_debounce_count CAL_obd_ii_P0106 CAL_obd_ii_P0106_baro_error_limits CAL_obd_ii_P0106_debounce_count CAL_obd_ii_P0106_partload_rpm_window CAL_obd_ii_P0106_partload_tps_rate_max CAL_obd_ii_P0106_partload_tps_window CAL_obd_ii_P0106_throttle_vacuum_rpm_hi CAL_obd_ii_P0106_throttle_vacuum_rpm_hi_X_tps CAL_obd_ii_P0106_throttle_vacuum_rpm_hi_Y_load CAL_obd_ii_P0106_throttle_vacuum_rpm_lo CAL_obd_ii_P0106_throttle_vacuum_rpm_lo_X_tps CAL_obd_ii_P0106_throttle_vacuum_rpm_lo_Y_load CAL_obd_ii_P0107 CAL_obd_ii_P0107_debounce_count CAL_obd_ii_P0108 CAL_obd_ii_P0108_debounce_count CAL_obd_ii_P0111 CAL_obd_ii_P0111_airflow_stage_time CAL_obd_ii_P0111_debounce_count CAL_obd_ii_P0111_high_airflow_time CAL_obd_ii_P0111_iat_agreement_tol CAL_obd_ii_P0111_iat_span_min CAL_obd_ii_P0111_maf_debounce_time CAL_obd_ii_P0111_maf_high_band CAL_obd_ii_P0111_maf_low_band CAL_obd_ii_P0111_maf_low_band_hysteresis CAL_obd_ii_P0111_mass_air_min CAL_obd_ii_P0112 CAL_obd_ii_P0112_debounce_count CAL_obd_ii_P0113 CAL_obd_ii_P0113_debounce_count CAL_obd_ii_P0116 CAL_obd_ii_P0116_coolant_deviation_max CAL_obd_ii_P0116_coolant_deviation_max_coldstart CAL_obd_ii_P0116_coolant_stopped_min CAL_obd_ii_P0116_debounce_count CAL_obd_ii_P0117 CAL_obd_ii_P0117_debounce_count CAL_obd_ii_P0118 CAL_obd_ii_P0118_debounce_count CAL_obd_ii_P0122 CAL_obd_ii_P0122_debounce_count CAL_obd_ii_P0123 CAL_obd_ii_P0123_debounce_count CAL_obd_ii_P0128 CAL_obd_ii_P0128_fail_count CAL_obd_ii_P0128_iat_min CAL_obd_ii_P0128_lowspeed_threshold CAL_obd_ii_P0128_runtime_to_lowspeed_ratio_min CAL_obd_ii_P0128_start_coolant_max CAL_obd_ii_P0128_start_coolant_min CAL_obd_ii_P0131 CAL_obd_ii_P0131_debounce_count CAL_obd_ii_P0132 CAL_obd_ii_P0132_fail_count CAL_obd_ii_P0133 CAL_obd_ii_P0133_debounce_count CAL_obd_ii_P0133_min_coolant_temp CAL_obd_ii_P0134 CAL_obd_ii_P0134_debounce_count CAL_obd_ii_P0135 CAL_obd_ii_P0135_debounce_count CAL_obd_ii_P0137 CAL_obd_ii_P0137_fail_count CAL_obd_ii_P0138 CAL_obd_ii_P0138_fail_count CAL_obd_ii_P0139 CAL_obd_ii_P0139_debounce_count CAL_obd_ii_P0140 CAL_obd_ii_P0140_debounce_count CAL_obd_ii_P0141 CAL_obd_ii_P0141_debounce_count CAL_obd_ii_P0141_heater_current_debounce_count CAL_obd_ii_P0151 CAL_obd_ii_P0151_fail_count CAL_obd_ii_P0152 CAL_obd_ii_P0152_fail_count CAL_obd_ii_P0153 CAL_obd_ii_P0153_debounce_count CAL_obd_ii_P0154 CAL_obd_ii_P0154_debounce_count CAL_obd_ii_P0155 CAL_obd_ii_P0155_debounce_count CAL_obd_ii_P0157 CAL_obd_ii_P0157_fail_count CAL_obd_ii_P0158 CAL_obd_ii_P0158_fail_count CAL_obd_ii_P0159 CAL_obd_ii_P0159_debounce_count CAL_obd_ii_P0160 CAL_obd_ii_P0160_debounce_count CAL_obd_ii_P0161 CAL_obd_ii_P0161_debounce_count CAL_obd_ii_P0171 CAL_obd_ii_P0171_P0172_trim_zone_time_min CAL_obd_ii_P0171_debounce_count CAL_obd_ii_P0171_learn_time_threshold CAL_obd_ii_P0171_ltft_limit CAL_obd_ii_P0172 CAL_obd_ii_P0172_debounce_count CAL_obd_ii_P0172_learn_time_threshold CAL_obd_ii_P0172_ltft_limit CAL_obd_ii_P0174 CAL_obd_ii_P0174_debounce_count CAL_obd_ii_P0175 CAL_obd_ii_P0175_debounce_count CAL_obd_ii_P0191 CAL_obd_ii_P0191_cyl_cut_settle_count CAL_obd_ii_P0191_dual_sensor_agree_count CAL_obd_ii_P0191_dual_sensor_delta_max CAL_obd_ii_P0191_flow_min CAL_obd_ii_P0191_maf_min CAL_obd_ii_P0191_pid_correction_limit CAL_obd_ii_P0191_pid_correction_span_min CAL_obd_ii_P0191_pressure_span_min CAL_obd_ii_P0191_stuck_check_count_dfco CAL_obd_ii_P0191_stuck_check_count_fueling CAL_obd_ii_P0191_trim_check_count CAL_obd_ii_P0192 CAL_obd_ii_P0192_debounce_count CAL_obd_ii_P0193 CAL_obd_ii_P0193_debounce_count CAL_obd_ii_P0222 CAL_obd_ii_P0222_debounce_count CAL_obd_ii_P0223 CAL_obd_ii_P0223_debounce_count CAL_obd_ii_P023B CAL_obd_ii_P023B_debounce_count CAL_obd_ii_P023C CAL_obd_ii_P023C_debounce_count CAL_obd_ii_P025C CAL_obd_ii_P025D CAL_obd_ii_P0261 CAL_obd_ii_P0261_debounce_count CAL_obd_ii_P0262 CAL_obd_ii_P0262_debounce_count CAL_obd_ii_P0264 CAL_obd_ii_P0264_debounce_count CAL_obd_ii_P0265 CAL_obd_ii_P0265_debounce_count CAL_obd_ii_P0267 CAL_obd_ii_P0267_debounce_count CAL_obd_ii_P0268 CAL_obd_ii_P0268_debounce_count CAL_obd_ii_P0270 CAL_obd_ii_P0270_debounce_count CAL_obd_ii_P0271 CAL_obd_ii_P0271_debounce_count CAL_obd_ii_P0273 CAL_obd_ii_P0273_debounce_count CAL_obd_ii_P0274 CAL_obd_ii_P0274_debounce_count CAL_obd_ii_P0276 CAL_obd_ii_P0276_debounce_count CAL_obd_ii_P0277 CAL_obd_ii_P0277_debounce_count CAL_obd_ii_P0300 CAL_obd_ii_P0300_debounce_count CAL_obd_ii_P0301 CAL_obd_ii_P0301_debounce_count CAL_obd_ii_P0302 CAL_obd_ii_P0302_debounce_count CAL_obd_ii_P0303 CAL_obd_ii_P0303_debounce_count CAL_obd_ii_P0304 CAL_obd_ii_P0304_debounce_count CAL_obd_ii_P0305 CAL_obd_ii_P0305_debounce_count CAL_obd_ii_P0306 CAL_obd_ii_P0306_debounce_count CAL_obd_ii_P0327 CAL_obd_ii_P0327_debounce_count CAL_obd_ii_P0328 CAL_obd_ii_P0328_debounce_count CAL_obd_ii_P0332 CAL_obd_ii_P0332_debounce_count CAL_obd_ii_P0333 CAL_obd_ii_P0333_debounce_count CAL_obd_ii_P0335 CAL_obd_ii_P0335_debounce_count CAL_obd_ii_P0341 CAL_obd_ii_P0341_debounce_count CAL_obd_ii_P0346 CAL_obd_ii_P0346_debounce_count CAL_obd_ii_P0351 CAL_obd_ii_P0351_debounce_count CAL_obd_ii_P0352 CAL_obd_ii_P0352_debounce_count CAL_obd_ii_P0353 CAL_obd_ii_P0353_debounce_count CAL_obd_ii_P0354 CAL_obd_ii_P0354_debounce_count CAL_obd_ii_P0355 CAL_obd_ii_P0355_debounce_count CAL_obd_ii_P0356 CAL_obd_ii_P0356_debounce_count CAL_obd_ii_P0366 CAL_obd_ii_P0366_debounce_count CAL_obd_ii_P0391 CAL_obd_ii_P0391_debounce_count CAL_obd_ii_P0420 CAL_obd_ii_P0420_car_speed_max CAL_obd_ii_P0420_car_speed_min CAL_obd_ii_P0420_debounce_count CAL_obd_ii_P0420_maf_max CAL_obd_ii_P0420_maf_min CAL_obd_ii_P0430 CAL_obd_ii_P0430_debounce_count CAL_obd_ii_P0441 CAL_obd_ii_P0441_fail_count CAL_obd_ii_P0441_runtime_min CAL_obd_ii_P0442 CAL_obd_ii_P0442_debounce_count CAL_obd_ii_P0444 CAL_obd_ii_P0444_debounce_count CAL_obd_ii_P0445 CAL_obd_ii_P0445_debounce_count CAL_obd_ii_P0446 CAL_obd_ii_P0446_fail_count CAL_obd_ii_P0447 CAL_obd_ii_P0447_debounce_count CAL_obd_ii_P0448 CAL_obd_ii_P0448_debounce_count CAL_obd_ii_P0451 CAL_obd_ii_P0451_debounce_count CAL_obd_ii_P0451_fail_debounce_count CAL_obd_ii_P0451_pressure_swing_min CAL_obd_ii_P0452 CAL_obd_ii_P0452_debounce_count CAL_obd_ii_P0453 CAL_obd_ii_P0453_debounce_count CAL_obd_ii_P0455 CAL_obd_ii_P0455_debounce_count CAL_obd_ii_P0456 CAL_obd_ii_P0456_debounce_count CAL_obd_ii_P0461 CAL_obd_ii_P0461_debounce_count CAL_obd_ii_P0462 CAL_obd_ii_P0462_debounce_count CAL_obd_ii_P0463 CAL_obd_ii_P0463_debounce_count CAL_obd_ii_P0480 CAL_obd_ii_P0480_debounce_count CAL_obd_ii_P0482 CAL_obd_ii_P0482_debounce_count CAL_obd_ii_P0500 CAL_obd_ii_P0500_car_speed_min CAL_obd_ii_P0500_debounce_count CAL_obd_ii_P0500_test_time CAL_obd_ii_P0506 CAL_obd_ii_P0506_debounce_count CAL_obd_ii_P0507 CAL_obd_ii_P0507_debounce_count CAL_obd_ii_P050A CAL_obd_ii_P050A_debounce_count CAL_obd_ii_P050A_idle_error_high CAL_obd_ii_P050A_idle_error_low CAL_obd_ii_P050B CAL_obd_ii_P050B_maturing_limit CAL_obd_ii_P0522 CAL_obd_ii_P0522_debounce_count CAL_obd_ii_P0523 CAL_obd_ii_P0523_debounce_count CAL_obd_ii_P0524 CAL_obd_ii_P0537 CAL_obd_ii_P0537_debounce_count CAL_obd_ii_P0538 CAL_obd_ii_P0538_debounce_count CAL_obd_ii_P0562 CAL_obd_ii_P0562_debounce_count CAL_obd_ii_P0562_sample_count CAL_obd_ii_P0563 CAL_obd_ii_P0563_debounce_count CAL_obd_ii_P0563_sample_count CAL_obd_ii_P0564 CAL_obd_ii_P0564_debounce_count CAL_obd_ii_P0571 CAL_obd_ii_P0571_brake_check_min_speed CAL_obd_ii_P0571_debounce_count CAL_obd_ii_P0571_switch_mismatch_time CAL_obd_ii_P0578 CAL_obd_ii_P0578_fail_count CAL_obd_ii_P0579 CAL_obd_ii_P0579_fail_count CAL_obd_ii_P0579_stuck_timeout CAL_obd_ii_P0579_switch_changes_max CAL_obd_ii_P0601 CAL_obd_ii_P0606 CAL_obd_ii_P0610 CAL_obd_ii_P0616 CAL_obd_ii_P0616_debounce_count CAL_obd_ii_P0617 CAL_obd_ii_P0617_debounce_count CAL_obd_ii_P0627 CAL_obd_ii_P0628_debounce_count CAL_obd_ii_P0629_debounce_count CAL_obd_ii_P0630 CAL_obd_ii_P0638 CAL_obd_ii_P0646 CAL_obd_ii_P0646_debounce_count CAL_obd_ii_P0647 CAL_obd_ii_P0647_debounce_count CAL_obd_ii_P0661_debounce_count CAL_obd_ii_P0662_debounce_count CAL_obd_ii_P0685 CAL_obd_ii_P0685_debounce_count CAL_obd_ii_P0685_voltage_delta CAL_obd_ii_P0700 CAL_obd_ii_P0712 CAL_obd_ii_P0712_debounce_count CAL_obd_ii_P0713 CAL_obd_ii_P0713_debounce_count CAL_obd_ii_P0806 CAL_obd_ii_P0806_clutch_span_min CAL_obd_ii_P0806_clutch_voltage_max CAL_obd_ii_P0806_debounce_count CAL_obd_ii_P0806_gear_changes_min CAL_obd_ii_P0807 CAL_obd_ii_P0807_debounce_count CAL_obd_ii_P0808 CAL_obd_ii_P0808_debounce_count CAL_obd_ii_P0826 CAL_obd_ii_P0826_debounce_count CAL_obd_ii_P0827 CAL_obd_ii_P0827_debounce_count CAL_obd_ii_P0828 CAL_obd_ii_P0828_debounce_count CAL_obd_ii_P0897 CAL_obd_ii_P0897_debounce CAL_obd_ii_P0897_debounce_count CAL_obd_ii_P1104 CAL_obd_ii_P1104_debounce_count CAL_obd_ii_P1106 CAL_obd_ii_P1106_debounce_count CAL_obd_ii_P1107 CAL_obd_ii_P1107_debounce_count CAL_obd_ii_P1108 CAL_obd_ii_P1108_debounce_count CAL_obd_ii_P1109 CAL_obd_ii_P1109_high_load_phase_count CAL_obd_ii_P1109_high_load_phase_dwell CAL_obd_ii_P1109_high_load_tps_min CAL_obd_ii_P1109_idle_phase_count CAL_obd_ii_P1109_idle_phase_dwell CAL_obd_ii_P1109_load_max CAL_obd_ii_P1109_load_model_tol CAL_obd_ii_P1109_map_agree_count CAL_obd_ii_P1109_map_delta_max CAL_obd_ii_P1109_map_model_tol CAL_obd_ii_P1109_map_voltage_span_min CAL_obd_ii_P1109_model_agree_count CAL_obd_ii_P1109_pass_period CAL_obd_ii_P1109_rpm_max CAL_obd_ii_P1109_steady_settle CAL_obd_ii_P1109_tps_rate_max CAL_obd_ii_P1109_use_map_model CAL_obd_ii_P1113_debounce_count CAL_obd_ii_P123B CAL_obd_ii_P123C CAL_obd_ii_P1301 CAL_obd_ii_P1301_debounce_count CAL_obd_ii_P1302 CAL_obd_ii_P1302_debounce_count CAL_obd_ii_P1562 CAL_obd_ii_P1562_debounce_count CAL_obd_ii_P1809 CAL_obd_ii_P1809_debounce_count CAL_obd_ii_P2100 CAL_obd_ii_P2100_debounce_count CAL_obd_ii_P2102 CAL_obd_ii_P2102_debounce_count CAL_obd_ii_P2103 CAL_obd_ii_P2103_debounce_count CAL_obd_ii_P2104 CAL_obd_ii_P2104_debounce_count CAL_obd_ii_P2105 CAL_obd_ii_P2105_debounce_count CAL_obd_ii_P2106 CAL_obd_ii_P2106_debounce_count CAL_obd_ii_P2107 CAL_obd_ii_P2107_debounce_count CAL_obd_ii_P2108 CAL_obd_ii_P2108_debounce_count CAL_obd_ii_P2119 CAL_obd_ii_P2119_debounce_count CAL_obd_ii_P2122 CAL_obd_ii_P2122_debounce_count CAL_obd_ii_P2123 CAL_obd_ii_P2123_debounce_count CAL_obd_ii_P2127 CAL_obd_ii_P2127_debounce_count CAL_obd_ii_P2128 CAL_obd_ii_P2128_debounce_count CAL_obd_ii_P2135 CAL_obd_ii_P2135_debounce_count CAL_obd_ii_P2138 CAL_obd_ii_P2138_debounce_count CAL_obd_ii_P2170 CAL_obd_ii_P2170_pass_counter_max CAL_obd_ii_P2171 CAL_obd_ii_P2171_debounce_count CAL_obd_ii_P2173 CAL_obd_ii_P2173_fail_count CAL_obd_ii_P2173_load_difference_max CAL_obd_ii_P2191 CAL_obd_ii_P2191_debounce_count CAL_obd_ii_P2191_lean_confirm_time CAL_obd_ii_P2192_rich_confirm_time CAL_obd_ii_P2193 CAL_obd_ii_P2193_debounce_count CAL_obd_ii_P219A CAL_obd_ii_P219A_coolant_min CAL_obd_ii_P219A_imbalance_window_count CAL_obd_ii_P219A_load_max CAL_obd_ii_P219A_load_min CAL_obd_ii_P219A_maf_max CAL_obd_ii_P219A_maf_min CAL_obd_ii_P219A_rpm_max CAL_obd_ii_P219A_rpm_min CAL_obd_ii_P219B CAL_obd_ii_P2336 CAL_obd_ii_P2336_maturing_limit CAL_obd_ii_P2337 CAL_obd_ii_P2337_maturing_limit CAL_obd_ii_P2338 CAL_obd_ii_P2338_maturing_limit CAL_obd_ii_P2339 CAL_obd_ii_P2339_maturing_limit CAL_obd_ii_P2340 CAL_obd_ii_P2340_maturing_limit CAL_obd_ii_P2341 CAL_obd_ii_P2341_maturing_limit CAL_obd_ii_P2602 CAL_obd_ii_P2602_debounce_count CAL_obd_ii_P2603 CAL_obd_ii_P2603_debounce_count CAL_obd_ii_P2612 CAL_obd_ii_P2612_debounce_count CAL_obd_ii_P2613 CAL_obd_ii_P2613_debounce_count CAL_obd_ii_P2754 CAL_obd_ii_P2755 CAL_obd_ii_P2797 CAL_obd_ii_P2797_debounce_count CAL_obd_ii_U0101 CAL_obd_ii_U0101_pass_counter_max CAL_obd_ii_U0109 CAL_obd_ii_U0122 CAL_obd_ii_U0122_pass_counter_max CAL_obd_ii_U0123 CAL_obd_ii_U0123_debounce_count CAL_obd_ii_U0127_debounce_count CAL_obd_ii_U0141 CAL_obd_ii_U0155 CAL_obd_ii_U0302 CAL_obd_ii_U0302_debounce_count CAL_obd_ii_U0316 CAL_obd_ii_U0316_debounce_count CAL_obd_ii_U0416 CAL_obd_ii_U0416_debounce_count CAL_obd_ii_U0513 CAL_obd_ii_U0513_debounce_count CAL_obd_ii_ac_load_diag_rpm_min CAL_obd_ii_ac_load_diag_tolerance_pct CAL_obd_ii_accel_pedal_correlation_max_diff CAL_obd_ii_brake_pedal_conflict_count CAL_obd_ii_cac_temp_agreement_tol CAL_obd_ii_cat_check_o2_rich_time_max CAL_obd_ii_cat_check_tps_rate_max CAL_obd_ii_cat_check_transient_blackout CAL_obd_ii_cat_cold_start_coolant_max CAL_obd_ii_cat_cold_start_coolant_min CAL_obd_ii_cat_efficiency_iat_min CAL_obd_ii_cat_mon_post_dfco_holdoff_prescaler CAL_obd_ii_cat_monitor_baro_min CAL_obd_ii_cat_monitor_coolant_min_above_iat CAL_obd_ii_cat_monitor_ect_min CAL_obd_ii_cat_monitor_iat_max CAL_obd_ii_cat_monitor_iat_min CAL_obd_ii_cat_monitor_init_counter_2 CAL_obd_ii_cat_monitor_low_speed_max CAL_obd_ii_cat_monitor_maf_min CAL_obd_ii_cat_monitor_min_engine_runtime CAL_obd_ii_cat_monitor_run_time_min CAL_obd_ii_cat_monitor_runtime_min CAL_obd_ii_cat_monitor_speed_min CAL_obd_ii_cat_monitor_stable_time CAL_obd_ii_cat_monitor_threshold_ips CAL_obd_ii_cat_monitor_threshold_ips_X_maf_flow CAL_obd_ii_cat_monitor_threshold_manual CAL_obd_ii_cat_monitor_threshold_manual_X_maf_flow CAL_obd_ii_cat_monitor_window_time CAL_obd_ii_cat_o2_monitor_iat_min CAL_obd_ii_cat_precat_o2_lean_thresh CAL_obd_ii_cat_precat_o2_rich_thresh CAL_obd_ii_cat_switch_ratio_fail_threshold CAL_obd_ii_cat_unknown3 CAL_obd_ii_cold_start_ambient_high_margin CAL_obd_ii_cold_start_ambient_low_margin CAL_obd_ii_cold_start_coolant_agree_tol CAL_obd_ii_cold_start_coolant_high_margin CAL_obd_ii_cold_start_coolant_low_margin CAL_obd_ii_cold_start_iat_drop_max CAL_obd_ii_cold_start_iat_high_margin CAL_obd_ii_cold_start_iat_low_margin CAL_obd_ii_cold_start_low_flow_count CAL_obd_ii_cold_start_low_flow_maf_max CAL_obd_ii_cold_start_mat_high_margin CAL_obd_ii_cold_start_mat_low_margin CAL_obd_ii_commanded_evap_purge_limit CAL_obd_ii_commanded_evap_purge_limit_0 CAL_obd_ii_commanded_evap_purge_max CAL_obd_ii_commanded_evap_purge_min CAL_obd_ii_commanded_evap_purge_threshold CAL_obd_ii_common_tests_available CAL_obd_ii_common_tests_complete CAL_obd_ii_coolant_rationality_count CAL_obd_ii_coolant_rationality_delta_threshold CAL_obd_ii_coolant_rationality_holdoff_time CAL_obd_ii_coolant_rationality_sample_count CAL_obd_ii_coolant_warmup_thresholds CAL_obd_ii_countdown_unknown CAL_obd_ii_crank_cam_error_count_max CAL_obd_ii_diag_unknown CAL_obd_ii_drive_cycle_car_speed_min CAL_obd_ii_drive_cycle_idle_time CAL_obd_ii_drive_cycle_runtime CAL_obd_ii_dtc_clear_warmup_cycles CAL_obd_ii_engine_speed_3_threshold_1 CAL_obd_ii_evap_entry_settle_delay CAL_obd_ii_evap_fuel_level_noise_count_limit CAL_obd_ii_evap_fuel_level_noise_threshold CAL_obd_ii_evap_monitor_settle_count CAL_obd_ii_evap_pressure_noise_count_limit CAL_obd_ii_evap_pressure_noise_threshold CAL_obd_ii_evap_purge_settle_debounce CAL_obd_ii_evap_refuel_level_rise_threshold CAL_obd_ii_evap_stability_window_samples CAL_obd_ii_evap_vapor_pressure_limit CAL_obd_ii_fuel_learn_eng_speed_delta_max CAL_obd_ii_fuel_learn_inhibit_holdoff_ticks CAL_obd_ii_fuel_learn_max_load_delta CAL_obd_ii_fuel_pressure_high_debounce CAL_obd_ii_fuel_pressure_high_threshold CAL_obd_ii_fuel_pressure_low_debounce CAL_obd_ii_fuel_pressure_low_threshold CAL_obd_ii_fuel_pressure_sensor_voltage_high CAL_obd_ii_fuel_pressure_sensor_voltage_low CAL_obd_ii_fuel_pump_monitor_coolant_min CAL_obd_ii_fuel_pump_monitor_fuel_level_min CAL_obd_ii_fuel_pump_monitor_inj_flow_min CAL_obd_ii_fuel_pump_monitor_runtime_min CAL_obd_ii_fuel_trim_zone3_time_min CAL_obd_ii_fuel_type CAL_obd_ii_gd_speed_min CAL_obd_ii_gd_speed_time CAL_obd_ii_high_load_monitor_afr_max CAL_obd_ii_high_load_monitor_load_min CAL_obd_ii_iat_activity_min_delta CAL_obd_ii_idle_air_output_limit CAL_obd_ii_idle_air_output_threshold CAL_obd_ii_idle_error_fail_count CAL_obd_ii_idle_learn_limit CAL_obd_ii_knock_monitor_sample_count CAL_obd_ii_knock_no_activity_count CAL_obd_ii_load_model_diff_filter_alpha CAL_obd_ii_maf_adc_high_limit CAL_obd_ii_maf_adc_low_limit CAL_obd_ii_map_baro_engine_off_fail_count CAL_obd_ii_map_baro_engine_off_pass_count CAL_obd_ii_map_baro_engine_off_tol CAL_obd_ii_map_sensor_voltage_high CAL_obd_ii_map_sensor_voltage_low CAL_obd_ii_mat_ambient_heatsoak_delta CAL_obd_ii_mode06_o2_switch_time_max CAL_obd_ii_mode06_o2_switch_time_min CAL_obd_ii_mode08_evap_test_duration CAL_obd_ii_mode2f_coil_test_interval CAL_obd_ii_mode2f_coil_test_pulse_count CAL_obd_ii_mode2f_injector_test_duration CAL_obd_ii_mode2f_injector_test_interval CAL_obd_ii_mode2f_injector_test_pulse CAL_obd_ii_mode2f_timeout CAL_obd_ii_monitor_coolant_min CAL_obd_ii_monitor_debounce_cycles CAL_obd_ii_monitor_rpm_delta_max CAL_obd_ii_monitor_rpm_min CAL_obd_ii_monitor_tps_min CAL_obd_ii_monitors_completed_min CAL_obd_ii_o2_activity_rate_inband CAL_obd_ii_o2_activity_rate_outband CAL_obd_ii_o2_flatline_band CAL_obd_ii_o2_imbalance_accum_cap CAL_obd_ii_o2_imbalance_sample_count CAL_obd_ii_o2_imbalance_sample_period CAL_obd_ii_o2_imbalance_sample_total CAL_obd_ii_o2_imbalance_threshold CAL_obd_ii_o2_l2r_time_max_asym CAL_obd_ii_o2_lean_period_excess_max CAL_obd_ii_o2_lean_time_baseline CAL_obd_ii_o2_lean_time_baseline_X_maf CAL_obd_ii_o2_min_voltage_init CAL_obd_ii_o2_period_consistency_tol CAL_obd_ii_o2_period_excess_max CAL_obd_ii_o2_postcat_activity_min CAL_obd_ii_o2_precat_activity_window CAL_obd_ii_o2_precat_diag_init_counter CAL_obd_ii_o2_precat_diag_reset_counter CAL_obd_ii_o2_precat_diag_timer CAL_obd_ii_o2_r2l_time_max_asym CAL_obd_ii_o2_response_alphaN_blackout CAL_obd_ii_o2_response_car_speed_max CAL_obd_ii_o2_response_car_speed_min CAL_obd_ii_o2_response_load_stability_max CAL_obd_ii_o2_rich_period_excess_max CAL_obd_ii_o2_rich_time_baseline CAL_obd_ii_o2_rich_time_baseline_X_maf CAL_obd_ii_o2_sensor1_voltage_limit CAL_obd_ii_o2_sensor1_voltage_threshold CAL_obd_ii_o2_sensor2_voltage_limit CAL_obd_ii_o2_sensor2_voltage_threshold CAL_obd_ii_o2_sensors_present CAL_obd_ii_o2_slow_response_arm_dwell CAL_obd_ii_o2_slow_response_limit_lean_to_rich CAL_obd_ii_o2_slow_response_limit_rich_to_lean CAL_obd_ii_o2_slow_response_maf_limit_unknown CAL_obd_ii_o2_slow_response_maf_limit_unknown2 CAL_obd_ii_o2_slow_response_runtime_limit_unknown CAL_obd_ii_o2_slow_response_sample_count CAL_obd_ii_o2_switch_time_min CAL_obd_ii_o2_switch_time_threshold CAL_obd_ii_o2_tps_transient_settle_ticks CAL_obd_ii_o2_tps_transient_threshold CAL_obd_ii_o2_transition_count CAL_obd_ii_oil_pressure_sensor_voltage_high CAL_obd_ii_oil_pressure_switch_low_voltage CAL_obd_ii_paddle_shift_voltage_stable_time CAL_obd_ii_postcat_o2_mean_filter_gain CAL_obd_ii_postcat_o2_switch_band_lean CAL_obd_ii_postcat_o2_switch_band_rich CAL_obd_ii_readiness_bit3_enable CAL_obd_ii_runtime_since_start_threshold_unknown CAL_obd_ii_similar_cond_debounce_reload CAL_obd_ii_similar_cond_load_tol CAL_obd_ii_similar_cond_load_window CAL_obd_ii_similar_cond_rpm_tol CAL_obd_ii_speed_sensor_monitor_rpm_min CAL_obd_ii_standards_supported CAL_obd_ii_switch_voltage_debounce CAL_obd_ii_temp_sensor_soak_time CAL_obd_ii_thermostat_monitor_runtime_min CAL_obd_ii_thermostat_monitor_time CAL_obd_ii_thermostat_monitor_time_X_start_coolant CAL_obd_ii_trans_fluid_pump_time_min CAL_obd_ii_trans_fluid_speed_window CAL_obd_ii_trans_fluid_temp_high CAL_obd_ii_trans_fluid_temp_window CAL_obd_ii_vvt_cam_error_limit CAL_obd_ii_vvt_error_fail_count CAL_obd_ii_vvt_monitor_coolant_min CAL_obd_ii_vvt_monitor_min_runtime CAL_obd_ii_vvt_ok_pass_count CAL_obd_ii_wheel_speed_correlation_rpm_max /end REF_CHARACTERISTIC
/end GROUP
/begin GROUP G_Driveline "Transmission and driveline" ROOT
 /begin SUB_GROUP G_Driveline_clutch G_Driveline_gsi G_Driveline_ips G_Driveline_trans /end SUB_GROUP
/end GROUP
/begin GROUP G_Driveline_clutch "clutch"
 /begin REF_CHARACTERISTIC CAL_clutch_confidence_decrement CAL_clutch_confidence_increment CAL_clutch_pos_voltage_threshold CAL_clutch_sensor_confidence_max CAL_clutch_variance_threshold /end REF_CHARACTERISTIC
/end GROUP
/begin GROUP G_Driveline_gsi "gsi" /begin REF_CHARACTERISTIC CAL_gsi_downshift_idle_margin /end REF_CHARACTERISTIC /end GROUP
/end MODULE
/end PROJECT
