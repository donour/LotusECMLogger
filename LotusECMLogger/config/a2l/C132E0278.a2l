ASAP2_VERSION 1 61
/begin PROJECT C132E0278 "Lotus T6 C132E0278"
/begin HEADER "" VERSION "generated v1" /end HEADER
/begin MODULE C132E0278 ""
/begin MOD_COMMON "" BYTE_ORDER MSB_FIRST ALIGNMENT_BYTE 1 ALIGNMENT_WORD 2 ALIGNMENT_LONG 4 /end MOD_COMMON
/begin RECORD_LAYOUT RL_AXIS_SWORD AXIS_PTS_X 1 SWORD INDEX_INCR DIRECT /end RECORD_LAYOUT
/begin COMPU_METHOD CM_i16_factor_1_20 "i16_factor_1/20" RAT_FUNC "%8.0" "%" COEFFS 0 1 0 0 0 5 /end COMPU_METHOD
/begin COMPU_METHOD CM_i16_flow_400mg_s "i16_flow_400mg/s" RAT_FUNC "%8.0" "mg/s" COEFFS 0 1 0 0 0 400 /end COMPU_METHOD
/begin COMPU_METHOD CM_i16_pressure_mbar "i16_pressure_mbar" RAT_FUNC "%8.0" "mbar" COEFFS 0 1 0 0 0 1 /end COMPU_METHOD
/begin COMPU_METHOD CM_u16_afr_1_100 "u16_afr_1/100" RAT_FUNC "%10.2" "AFR" COEFFS 0 1 0 0 0 0.01 /end COMPU_METHOD
/begin COMPU_METHOD CM_u16_distance_10cm "u16_distance_10cm" RAT_FUNC "%8.0" "cm" COEFFS 0 1 0 0 0 10 /end COMPU_METHOD
/begin COMPU_METHOD CM_u16_distance_km "u16_distance_km" RAT_FUNC "%8.0" "km" COEFFS 0 1 0 0 0 1 /end COMPU_METHOD
/begin COMPU_METHOD CM_u16_factor_1_1000 "u16_factor_1/1000" RAT_FUNC "%9.1" "%" COEFFS 0 1 0 0 0 0.1 /end COMPU_METHOD
/begin COMPU_METHOD CM_u16_factor_1_10000 "u16_factor_1/10000" RAT_FUNC "%10.2" "%" COEFFS 0 1 0 0 0 0.01 /end COMPU_METHOD
/begin COMPU_METHOD CM_u16_factor_1_1023 "u16_factor_1/1023" RAT_FUNC "%12.4" "%" COEFFS 0 1 0 0 0 0.0977517106549365 /end COMPU_METHOD
/begin COMPU_METHOD CM_u16_flow_10mg_s "u16_flow_10mg/s" RAT_FUNC "%8.0" "mg/s" COEFFS 0 1 0 0 0 10 /end COMPU_METHOD
/begin COMPU_METHOD CM_u16_flow_mg_s "u16_flow_mg/s" RAT_FUNC "%8.0" "mg/s" COEFFS 0 1 0 0 0 1 /end COMPU_METHOD
/begin COMPU_METHOD CM_u16_mass_10ug "u16_mass_10ug" RAT_FUNC "%8.0" "ug" COEFFS 0 1 0 0 0 10 /end COMPU_METHOD
/begin COMPU_METHOD CM_u16_rspeed_1_4rpm "u16_rspeed_1/4rpm" RAT_FUNC "%10.2" "rpm" COEFFS 0 1 0 0 0 0.25 /end COMPU_METHOD
/begin COMPU_METHOD CM_u16_voltage_5_1023v "u16_voltage_5/1023v" RAT_FUNC "%12.4" "V" COEFFS 0 1 0 0 0 0.00488758553274682 /end COMPU_METHOD
/begin COMPU_METHOD CM_u32_rspeed_1024rpm "u32_rspeed_1024rpm" RAT_FUNC "%8.0" "rpm" COEFFS 0 1 0 0 0 1024 /end COMPU_METHOD
/begin COMPU_METHOD CM_u32_time_100ns "u32_time_100ns" RAT_FUNC "%8.0" "ns" COEFFS 0 1 0 0 0 100 /end COMPU_METHOD
/begin COMPU_METHOD CM_u8_accel_1_100g "u8_accel_1/100g" RAT_FUNC "%10.2" "g" COEFFS 0 1 0 0 0 0.01 /end COMPU_METHOD
/begin COMPU_METHOD CM_u8_angle_1_4deg "u8_angle_1/4deg" RAT_FUNC "%10.2" "deg" COEFFS 0 1 0 0 0 0.25 /end COMPU_METHOD
/begin COMPU_METHOD CM_u8_factor_1_100 "u8_factor_1/100" RAT_FUNC "%8.0" "%" COEFFS 0 1 0 0 0 1 /end COMPU_METHOD
/begin COMPU_METHOD CM_u8_factor_1_128 "u8_factor_1/128" RAT_FUNC "%12.4" "%" COEFFS 0 1 0 0 0 0.78125 /end COMPU_METHOD
/begin COMPU_METHOD CM_u8_factor_1_16 "u8_factor_1/16" RAT_FUNC "%10.2" "%" COEFFS 0 1 0 0 0 6.25 /end COMPU_METHOD
/begin COMPU_METHOD CM_u8_factor_1_200 "u8_factor_1/200" RAT_FUNC "%9.1" "%" COEFFS 0 1 0 0 0 0.5 /end COMPU_METHOD
/begin COMPU_METHOD CM_u8_factor_1_25 "u8_factor_1/25" RAT_FUNC "%8.0" "%" COEFFS 0 1 0 0 0 4 /end COMPU_METHOD
/begin COMPU_METHOD CM_u8_factor_1_255 "u8_factor_1/255" RAT_FUNC "%12.4" "%" COEFFS 0 1 0 0 0 0.392156862745098 /end COMPU_METHOD
/begin COMPU_METHOD CM_u8_factor_1_256 "u8_factor_1/256" RAT_FUNC "%12.4" "%" COEFFS 0 1 0 0 0 0.390625 /end COMPU_METHOD
/begin COMPU_METHOD CM_u8_factor_1_64 "u8_factor_1/64" RAT_FUNC "%12.4" "%" COEFFS 0 1 0 0 0 1.5625 /end COMPU_METHOD
/begin COMPU_METHOD CM_u8_flow_100mg_s "u8_flow_100mg/s" RAT_FUNC "%8.0" "mg/s" COEFFS 0 1 0 0 0 100 /end COMPU_METHOD
/begin COMPU_METHOD CM_u8_load_1173mg_255stroke "u8_load_1173mg/255stroke" RAT_FUNC "%9.1" "mg/stroke" COEFFS 0 1 0 0 0 4.6 /end COMPU_METHOD
/begin COMPU_METHOD CM_u8_load_4mg_stroke "u8_load_4mg/stroke" RAT_FUNC "%8.0" "mg/stroke" COEFFS 0 1 0 0 0 4 /end COMPU_METHOD
/begin COMPU_METHOD CM_u8_load_mg_stroke "u8_load_mg/stroke" RAT_FUNC "%8.0" "mg/stroke" COEFFS 0 1 0 0 0 1 /end COMPU_METHOD
/begin COMPU_METHOD CM_u8_pressure_50mbar "u8_pressure_50mbar" RAT_FUNC "%8.0" "mbar" COEFFS 0 1 0 0 0 50 /end COMPU_METHOD
/begin COMPU_METHOD CM_u8_rspeed_4rpm "u8_rspeed_4rpm" RAT_FUNC "%8.0" "rpm" COEFFS 0 1 0 0 0 4 /end COMPU_METHOD
/begin COMPU_METHOD CM_u8_rspeed_rpm "u8_rspeed_rpm" RAT_FUNC "%8.0" "rpm" COEFFS 0 1 0 0 0 1 /end COMPU_METHOD
/begin COMPU_METHOD CM_u8_speed_1_100kph "u8_speed_1/100kph" RAT_FUNC "%10.2" "km/h" COEFFS 0 1 0 0 0 0.01 /end COMPU_METHOD
/begin COMPU_METHOD CM_u8_speed_kph "u8_speed_kph" RAT_FUNC "%8.0" "km/h" COEFFS 0 1 0 0 0 1 /end COMPU_METHOD
/begin COMPU_METHOD CM_u8_temp_5_8_40c "u8_temp_5/8-40c" RAT_FUNC "%11.3" "°C" COEFFS 0 1 40 0 0 0.625 /end COMPU_METHOD
/begin COMPU_METHOD CM_u8_temp__40c "u8_temp_-40c" RAT_FUNC "%8.0" "°C" COEFFS 0 1 40 0 0 1 /end COMPU_METHOD
/begin COMPU_METHOD CM_u8_time_100ms "u8_time_100ms" RAT_FUNC "%8.0" "ms" COEFFS 0 1 0 0 0 100 /end COMPU_METHOD
/begin COMPU_METHOD CM_u8_time_20ms "u8_time_20ms" RAT_FUNC "%8.0" "ms" COEFFS 0 1 0 0 0 20 /end COMPU_METHOD
/begin COMPU_METHOD CM_u8_time_5ms "u8_time_5ms" RAT_FUNC "%8.0" "ms" COEFFS 0 1 0 0 0 5 /end COMPU_METHOD
/begin COMPU_METHOD CM_u8_time_ms "u8_time_ms" RAT_FUNC "%8.0" "ms" COEFFS 0 1 0 0 0 1 /end COMPU_METHOD
/begin COMPU_METHOD CM_u8_time_s "u8_time_s" RAT_FUNC "%8.0" "s" COEFFS 0 1 0 0 0 1 /end COMPU_METHOD
/begin COMPU_METHOD CM_u8_time_us "u8_time_us" RAT_FUNC "%8.0" "us" COEFFS 0 1 0 0 0 1 /end COMPU_METHOD
/begin COMPU_METHOD CM_u8_torque_nm "u8_torque_nm" RAT_FUNC "%8.0" "Nm" COEFFS 0 1 0 0 0 1 /end COMPU_METHOD
/begin COMPU_METHOD CM_u8_volume_1_10gallon "u8_volume_1/10gallon" RAT_FUNC "%9.1" "gallon" COEFFS 0 1 0 0 0 0.1 /end COMPU_METHOD
/begin MEASUREMENT coilpack_failure_flags "Per-cylinder coil failure bits (bit n = cylinder n+1)." UWORD NO_COMPU_METHOD 0 0 0 65535 ECU_ADDRESS 0x400019A2 /end MEASUREMENT
/begin MEASUREMENT inj_bank_balance_ratio "Bank balance CAL_inj_bank_balance + test trim, clamped 170..230 (val/200): bank2 flow x val/200, bank1 x (400-val)/200." UBYTE CM_u8_factor_1_200 0 0 0 127.5 ECU_ADDRESS 0x400019A4 /end MEASUREMENT
/begin MEASUREMENT revlimit_fuelcut_timer_5ms "Time in rev-limit fuel cut (injection_flags&8), +1 per 200 Hz tick. Was u16_time_100ms_400019a6." UWORD CM_u8_time_5ms 0 0 0 327675 ECU_ADDRESS 0x400019A6 /end MEASUREMENT
/begin MEASUREMENT revlimit_fuelcut_count "Rev-limit fuel-cut events (cleared once rpm drops CAL_revlimit_release_rpm_delta*10 below target)." UBYTE NO_COMPU_METHOD 0 0 0 255 ECU_ADDRESS 0x400019A8 /end MEASUREMENT
/begin MEASUREMENT evap_purge_fuel_fraction_b1 "Bank-1 evap purge fuel / required fuel (val/255; 255 = all). Was mass_ratio_b1_prev." UBYTE CM_u8_factor_1_255 0 0 0 100 ECU_ADDRESS 0x400019A9 /end MEASUREMENT
/begin MEASUREMENT evap_purge_fuel_fraction_b2 "Bank-2 evap purge fuel / required fuel (val/255). Was mass_ratio_b2_prev." UBYTE CM_u8_factor_1_255 0 0 0 100 ECU_ADDRESS 0x400019AA /end MEASUREMENT
/begin MEASUREMENT cranking_load_weight "CAL_inj_cranking_enrichment_load[load] (val/25; stock 25 = 1.0): weights maf_accum_load_weighted_g. Was cranking_enrichment_load." UBYTE CM_u8_factor_1_25 0 0 0 1020 ECU_ADDRESS 0x400019AB /end MEASUREMENT
/begin MEASUREMENT inj_flow_rate "Injector flow rate (mg/s)." UWORD CM_u16_flow_mg_s 0 0 0 65535 ECU_ADDRESS 0x400019AC /end MEASUREMENT
/begin MEASUREMENT fuel_pressure_manifold_relative "Fuel pressure manifold relative (mbar)." UWORD CM_i16_pressure_mbar 0 0 0 65535 ECU_ADDRESS 0x400019AE /end MEASUREMENT
/begin MEASUREMENT rev_limit_active_time_divider "Rev limit active time divider (ms = val*5)." UBYTE CM_u8_time_5ms 0 0 0 1275 ECU_ADDRESS 0x400019B0 /end MEASUREMENT
/begin MEASUREMENT closedloop_entry_delay_timer "Closedloop entry delay timer (ms = val*5)." UWORD CM_u8_time_5ms 0 0 0 327675 ECU_ADDRESS 0x400019B2 /end MEASUREMENT
/begin MEASUREMENT inj_flow_rate_b1 "Injector flow rate bank 1 (mg/s)." UWORD CM_u16_flow_mg_s 0 0 0 65535 ECU_ADDRESS 0x400019B4 /end MEASUREMENT
/begin MEASUREMENT inj_flow_rate_b2 "Injector flow rate bank 2 (mg/s)." UWORD CM_u16_flow_mg_s 0 0 0 65535 ECU_ADDRESS 0x400019B6 /end MEASUREMENT
/begin MEASUREMENT cranking_enrichment_soak_factor "CAL_inj_cranking_enrichment_soak_time[engine off time] (val/255). Was inj_cranking_enrichment_soak_time_X_engine_off_time." UBYTE CM_u8_factor_1_255 0 0 0 100 ECU_ADDRESS 0x400019B8 /end MEASUREMENT
/begin MEASUREMENT cranking_enrichment_air_temp "CAL_inj_cranking_enrichment_air_temp[air temp stopped, coolant stopped] (val/255)." UBYTE CM_u8_factor_1_255 0 0 0 100 ECU_ADDRESS 0x400019B9 /end MEASUREMENT
/begin MEASUREMENT cranking_enrichment_mass_accum "CAL_inj_cranking_enrichment_mass_accum[maf_accum_load_weighted_g] (val/255)." UBYTE CM_u8_factor_1_255 0 0 0 100 ECU_ADDRESS 0x400019BA /end MEASUREMENT
/begin MEASUREMENT inj_pw_max_allowed "Injector pw maximum allowed (µs)." ULONG CM_u8_time_us 0 0 0 4294967295 ECU_ADDRESS 0x400019BC /end MEASUREMENT
/begin MEASUREMENT inj_deadtime_comp_iat "Dead-time air-temp multiplier CAL_inj_deadtime_comp_iat (val/100)." UBYTE CM_u8_factor_1_100 0 0 0 255 ECU_ADDRESS 0x400019C0 /end MEASUREMENT
/begin MEASUREMENT inj_coldstart_enrichment_factor "Cold-start pulse cap factor CAL_inj_coldstart_enrichment, min 24 (val/16 of inj_pw_from_mass)." UBYTE CM_u8_factor_1_16 0 0 0 1593.75 ECU_ADDRESS 0x400019C1 /end MEASUREMENT
/begin MEASUREMENT inj_pw_coldstart_limit_b1 "Injector pw coldstart limit bank 1 (µs)." ULONG CM_u8_time_us 0 0 0 4294967295 ECU_ADDRESS 0x400019C4 /end MEASUREMENT
/begin MEASUREMENT inj_pw_coldstart_limit_b2 "Injector pw coldstart limit bank 2 (µs)." ULONG CM_u8_time_us 0 0 0 4294967295 ECU_ADDRESS 0x400019C8 /end MEASUREMENT
/begin MEASUREMENT inj_pw_b1_base "Bank-1 pulse with all enrichments, tip-in/out and DFCO recovery, before the cold-start cap (us). Was inj_pw_b1_pretrims." ULONG CM_u8_time_us 0 0 0 4294967295 ECU_ADDRESS 0x400019CC /end MEASUREMENT
/begin MEASUREMENT inj_pw_b2_base "Bank-2 pulse with all enrichments, before the cold-start cap (us). Was inj_pw_b2_pretrims." ULONG CM_u8_time_us 0 0 0 4294967295 ECU_ADDRESS 0x400019D0 /end MEASUREMENT
/begin MEASUREMENT closedloop_entry_delay "Closed-loop entry hold (cruise or power-enrich CAL), compared as <<2 to the 5 ms timer. Was closedloop_entry_delay_steps." UBYTE CM_u8_time_20ms 0 0 0 5100 ECU_ADDRESS 0x400019D4 /end MEASUREMENT
/begin MEASUREMENT afr_target_base "CAL_inj_afr_base*5 + 500 + test trim (AFR = val/100). Was afr_target." UWORD CM_u16_afr_1_100 0 0 0 655.35 ECU_ADDRESS 0x400019D6 /end MEASUREMENT
/begin MEASUREMENT inj_power_enrich_load_threshold "CAL_inj_accel_enrichment_load_threshold[rpm], compared with load_pct (val/100)." UBYTE CM_u8_factor_1_100 0 0 0 255 ECU_ADDRESS 0x400019D8 /end MEASUREMENT
/begin MEASUREMENT inj_pulse_time_max_window "Injector pulse time maximum window (µs)." ULONG CM_u8_time_us 0 0 0 4294967295 ECU_ADDRESS 0x400019DC /end MEASUREMENT
/begin MEASUREMENT fuel_pressure_rel_50mbar "Rail-to-manifold fuel pressure (mbar = val*50); dead-time axis." UBYTE CM_u8_pressure_50mbar 0 0 0 12750 ECU_ADDRESS 0x400019E0 /end MEASUREMENT
/begin MEASUREMENT etpu_ch3_period_us "eTPU ch3 measured period / 10 (us); 0xffff if none or too long." UWORD CM_u8_time_us 0 0 0 65535 ECU_ADDRESS 0x400019E8 /end MEASUREMENT
/begin MEASUREMENT etpu_param_alloc_ptr "Next free eTPU parameter-RAM address (etpu_param_alloc)." ULONG NO_COMPU_METHOD 0 0 0 4294967295 ECU_ADDRESS 0x400019EC /end MEASUREMENT
/begin MEASUREMENT eTPU_base_unknown "eTPU shared data memory base (0xc3fcc000)." ULONG NO_COMPU_METHOD 0 0 0 4294967295 ECU_ADDRESS 0x400019F0 /end MEASUREMENT
/begin MEASUREMENT etpu_param_ram_end "End of eTPU parameter RAM (0xc3fc89fc)." ULONG NO_COMPU_METHOD 0 0 0 4294967295 ECU_ADDRESS 0x400019F4 /end MEASUREMENT
/begin MEASUREMENT etpu_param_ram_base "eTPU parameter RAM base used for channel parameter access." ULONG NO_COMPU_METHOD 0 0 0 4294967295 ECU_ADDRESS 0x400019F8 /end MEASUREMENT
/begin MEASUREMENT etpu_code_ram_base "eTPU code RAM base (0xc3fd0000); microcode copied here by etpu_init." ULONG NO_COMPU_METHOD 0 0 0 4294967295 ECU_ADDRESS 0x400019FC /end MEASUREMENT
/begin MEASUREMENT etpu_mcr_addr "Etpu MCR addr (pointer)." ULONG NO_COMPU_METHOD 0 0 0 4294967295 ECU_ADDRESS 0x40001A00 /end MEASUREMENT
/begin MEASUREMENT timer_unused_40001a04 "Decremented at 200 Hz but never loaded or read elsewhere." UWORD CM_u8_time_5ms 0 0 0 327675 ECU_ADDRESS 0x40001A04 /end MEASUREMENT
/begin MEASUREMENT etpu_ch3_frequency_hz "eTPU ch3 measured frequency = 1e7 / period (Hz); 0 if none." ULONG NO_COMPU_METHOD 0 0 0 4294967295 ECU_ADDRESS 0x40001A08 /end MEASUREMENT
/begin MEASUREMENT etpu_ch3_read_a "eTPU ch3 batch read output a." ULONG NO_COMPU_METHOD 0 0 0 4294967295 ECU_ADDRESS 0x40001A0C /end MEASUREMENT
/begin MEASUREMENT etpu_ch3_period "eTPU ch3 measured period (TCR1, 0.1 us)." ULONG CM_u32_time_100ns 0 0 0 429496729500 ECU_ADDRESS 0x40001A10 /end MEASUREMENT
/begin MEASUREMENT etpu_ch3_read_g "eTPU ch3 batch read output g." ULONG NO_COMPU_METHOD 0 0 0 4294967295 ECU_ADDRESS 0x40001A14 /end MEASUREMENT
/begin MEASUREMENT etpu_ch3_read_f "eTPU ch3 batch read output f." ULONG NO_COMPU_METHOD 0 0 0 4294967295 ECU_ADDRESS 0x40001A18 /end MEASUREMENT
/begin MEASUREMENT etpu_ch3_read_e "eTPU ch3 batch read output e." ULONG NO_COMPU_METHOD 0 0 0 4294967295 ECU_ADDRESS 0x40001A1C /end MEASUREMENT
/begin MEASUREMENT etpu_ch3_read_d "eTPU ch3 batch read output d." ULONG NO_COMPU_METHOD 0 0 0 4294967295 ECU_ADDRESS 0x40001A20 /end MEASUREMENT
/begin MEASUREMENT etpu_ch3_read_status "eTPU ch3 batch read status (0 = valid)." UBYTE NO_COMPU_METHOD 0 0 0 255 ECU_ADDRESS 0x40001A24 /end MEASUREMENT
/begin MEASUREMENT timer_main_start2 "undefined4" ULONG NO_COMPU_METHOD 0 0 0 4294967295 ECU_ADDRESS 0x40001A2C /end MEASUREMENT
/begin MEASUREMENT lea_init_stamp_lo "LEA init stamp low word (0x1795)." UWORD NO_COMPU_METHOD 0 0 0 65535 ECU_ADDRESS 0x40001A30 /end MEASUREMENT
/begin MEASUREMENT lea_init_stamp_hi "LEA init stamp high word (0xd98)." UWORD NO_COMPU_METHOD 0 0 0 65535 ECU_ADDRESS 0x40001A32 /end MEASUREMENT
/begin MEASUREMENT lea_init_status_flags "LEA / EEPROM load status bits (bit0 loaded, bit14/15 stamp state)." ULONG NO_COMPU_METHOD 0 0 0 4294967295 ECU_ADDRESS 0x40001A34 /end MEASUREMENT
/begin MEASUREMENT diag_lea_reset_trigger "Diagnostic LEA reset trigger: write 0x5352 (\\SR\\) to reset learned values; set to 0x4b4f (\\OK\\) when done." UWORD NO_COMPU_METHOD 0 0 0 65535 ECU_ADDRESS 0x40001A38 /end MEASUREMENT
/begin MEASUREMENT flash_lock_state "GetLock result blkLockState (bit set = block locked); written back without the target blocks via SetLock to unlock them." ULONG NO_COMPU_METHOD 0 0 0 4294967295 ECU_ADDRESS 0x40001A40 /end MEASUREMENT
/begin MEASUREMENT flash_lock_enabled "GetLock result blkLockEnabled (lock register writable)." ULONG NO_COMPU_METHOD 0 0 0 4294967295 ECU_ADDRESS 0x40001A44 /end MEASUREMENT
/begin MEASUREMENT flash_verify_fail_source "ProgramVerify failSource (source data at the first mismatch)." ULONG NO_COMPU_METHOD 0 0 0 4294967295 ECU_ADDRESS 0x40001A48 /end MEASUREMENT
/begin MEASUREMENT flash_fail_data "BlankCheck / ProgramVerify failData (flash contents at the first failure)." ULONG NO_COMPU_METHOD 0 0 0 4294967295 ECU_ADDRESS 0x40001A50 /end MEASUREMENT
/begin MEASUREMENT flash_fail_address "BlankCheck / ProgramVerify failAddress (first failing address)." ULONG NO_COMPU_METHOD 0 0 0 4294967295 ECU_ADDRESS 0x40001A58 /end MEASUREMENT
/begin MEASUREMENT flash_program_source "flash_write: RAM source address of the data being programmed." ULONG NO_COMPU_METHOD 0 0 0 4294967295 ECU_ADDRESS 0x40001A5C /end MEASUREMENT
/begin MEASUREMENT flash_op_size "Bytes to program/verify (flash_write) or blank-check after erase (flash_erase); 0 = skip the erase." ULONG NO_COMPU_METHOD 0 0 0 4294967295 ECU_ADDRESS 0x40001A60 /end MEASUREMENT
/begin MEASUREMENT flash_op_dest "Flash address to program/verify or to start the post-erase blank check." ULONG NO_COMPU_METHOD 0 0 0 4294967295 ECU_ADDRESS 0x40001A64 /end MEASUREMENT
/begin MEASUREMENT flash_erase_high_blocks "FlashErase highEnabledBlocks mask (flash_erase arg 1); unlocked via lock index 6. Was flash_saved_sll_slms_mask." ULONG NO_COMPU_METHOD 0 0 0 4294967295 ECU_ADDRESS 0x40001A68 /end MEASUREMENT
/begin MEASUREMENT flash_erase_mid_blocks "FlashErase midEnabledBlocks mask (flash_erase arg 2); unlocked via lock indices 4/5. Was flash_saved_lml_hbl_hi_mask." ULONG NO_COMPU_METHOD 0 0 0 4294967295 ECU_ADDRESS 0x40001A6C /end MEASUREMENT
/begin MEASUREMENT flash_erase_low_blocks "FlashErase lowEnabledBlocks mask (flash_erase seg): 4 = 48 KB @ +0x10000, 8 = 16 KB @ +0x1C000, 0x10 = 64 KB @ +0x20000; unlocked via lock indices 2/3. Was flash_saved_lml_hbl_lo_mask." ULONG NO_COMPU_METHOD 0 0 0 4294967295 ECU_ADDRESS 0x40001A70 /end MEASUREMENT
/begin MEASUREMENT flash_erase_shadow_flag "FlashErase shadowFlag (always 0 = main array)." ULONG NO_COMPU_METHOD 0 0 0 4294967295 ECU_ADDRESS 0x40001A74 /end MEASUREMENT
/begin MEASUREMENT cooling_system_flags "Cooling system state bits (pumps/fans)." ULONG NO_COMPU_METHOD 0 0 0 4294967295 ECU_ADDRESS 0x40001A78 /end MEASUREMENT
/begin MEASUREMENT new_gear_detected_flags "bit0 = new gear detected (resets current_gear_time)." UWORD NO_COMPU_METHOD 0 0 0 65535 ECU_ADDRESS 0x40001A7C /end MEASUREMENT
/begin MEASUREMENT car_current_gear "Car current gear (enumerated state)." UBYTE NO_COMPU_METHOD 0 0 0 255 ECU_ADDRESS 0x40001A7E /end MEASUREMENT
/begin MEASUREMENT fuel_level_pct "Fuel level % for the cluster (0xff = invalid)." UBYTE NO_COMPU_METHOD 0 0 0 255 ECU_ADDRESS 0x40001A7F /end MEASUREMENT
/begin MEASUREMENT accessory_relay_bit6_state "obd_ii_relay_status bit6 as a 0/0xff flag (read_accessory_states)." UBYTE NO_COMPU_METHOD 0 0 0 255 ECU_ADDRESS 0x40001A82 /end MEASUREMENT
/begin MEASUREMENT recirc_pump_state "Coolant recirculation pump on (read_accessory_states); reported in mode 22. Was recirculation_pump_state_____or_acis." UBYTE NO_COMPU_METHOD 0 0 0 255 ECU_ADDRESS 0x40001A83 /end MEASUREMENT
/begin MEASUREMENT accessory_input_state "Accessory input == 1 (read_accessory_states)." UBYTE NO_COMPU_METHOD 0 0 0 255 ECU_ADDRESS 0x40001A84 /end MEASUREMENT
/begin MEASUREMENT ign_voltage_above_threshold "Ignition voltage above threshold (boolean flag)." UBYTE NO_COMPU_METHOD 0 0 0 255 ECU_ADDRESS 0x40001A85 /end MEASUREMENT
/begin MEASUREMENT rev_per_km "Engine revs per km (obd_ii_engine_speed/4*1000/car_speed_x100), matched against gear_lookup bands." ULONG NO_COMPU_METHOD 0 0 0 4294967295 ECU_ADDRESS 0x40001A88 /end MEASUREMENT
/begin MEASUREMENT o2_sensor1_heater_enable_state "O2 sensor1 heater enable state (boolean flag)." UBYTE NO_COMPU_METHOD 0 0 0 255 ECU_ADDRESS 0x40001A8C /end MEASUREMENT
/begin MEASUREMENT o2_sensor2_heater_enable_state "O2 sensor2 heater enable state (boolean flag)." UBYTE NO_COMPU_METHOD 0 0 0 255 ECU_ADDRESS 0x40001A8D /end MEASUREMENT
/begin MEASUREMENT o2_sensor5_heater_enable_state "O2 sensor5 heater enable state (boolean flag)." UBYTE NO_COMPU_METHOD 0 0 0 255 ECU_ADDRESS 0x40001A8E /end MEASUREMENT
/begin MEASUREMENT o2_sensor6_heater_enable_state "O2 sensor6 heater enable state (boolean flag)." UBYTE NO_COMPU_METHOD 0 0 0 255 ECU_ADDRESS 0x40001A8F /end MEASUREMENT
/begin MEASUREMENT exhaust_flap_state "Exhaust flap state (boolean flag)." UBYTE NO_COMPU_METHOD 0 0 0 255 ECU_ADDRESS 0x40001A90 /end MEASUREMENT
/begin MEASUREMENT car_speed_u8 "Car speed (km/h)." UBYTE CM_u8_speed_kph 0 0 0 255 ECU_ADDRESS 0x40001A91 /end MEASUREMENT
/begin MEASUREMENT car_speed_x100 "Car speed x100 (km/h = val/100)." UWORD CM_u8_speed_1_100kph 0 0 0 655.35 ECU_ADDRESS 0x40001A92 /end MEASUREMENT
/begin MEASUREMENT wheel_speeds "Wheel speeds (structure)." ULONG NO_COMPU_METHOD 0 0 0 4294967295 ECU_ADDRESS 0x40001A94 /end MEASUREMENT
/begin MEASUREMENT brake_switch "uint8_t" UBYTE NO_COMPU_METHOD 0 0 0 255 ECU_ADDRESS 0x40001A9C /end MEASUREMENT
/begin MEASUREMENT clutch_pos_sensor "uint8_t" UBYTE NO_COMPU_METHOD 0 0 0 255 ECU_ADDRESS 0x40001A9D /end MEASUREMENT
/begin MEASUREMENT cluster_lamp_test_state "Bulb check: 0 done, 1 running, 2 ignition off (re-arm)." UBYTE NO_COMPU_METHOD 0 0 0 255 ECU_ADDRESS 0x40001AB6 /end MEASUREMENT
/begin MEASUREMENT roughness_flags "uint16_t" UWORD NO_COMPU_METHOD 0 0 0 65535 ECU_ADDRESS 0x40001AB8 /end MEASUREMENT
/begin MEASUREMENT ign_comp_roughness_request "Roughness controller spark request from engine_roughness_200hz, clipped to CAL_roughness_ign_adv_max/min (deg = val/4). Was ign_adv_from_roughness_detection." SWORD CM_u8_angle_1_4deg 0 0 -8192 8191.75 ECU_ADDRESS 0x40001ABA /end MEASUREMENT
/begin MEASUREMENT roughness_cycle_mean "Mean roughness period-delta over the captured cycles (x2/count)." UWORD NO_COMPU_METHOD 0 0 0 65535 ECU_ADDRESS 0x40001ABC /end MEASUREMENT
/begin MEASUREMENT roughness_peak_valley_delta "Peak - valley captured engine speed (roughness), vs CAL_roughness_unknown6." UWORD NO_COMPU_METHOD 0 0 0 65535 ECU_ADDRESS 0x40001ABE /end MEASUREMENT
/begin MEASUREMENT accel_front_wheels "Front-wheel acceleration (filtered d(speed)/dt)." SWORD NO_COMPU_METHOD 0 0 -32768 32767 ECU_ADDRESS 0x40001AC0 /end MEASUREMENT
/begin MEASUREMENT radiator_fan_duty_cycle_target "Radiator fan duty cycle target (% = val*100/255)." UBYTE CM_u8_factor_1_255 0 0 0 100 ECU_ADDRESS 0x40001AC2 /end MEASUREMENT
/begin MEASUREMENT cac_pump_dutycycle "Charge-air-cooler pump dutycycle (val/255)." UBYTE CM_u8_factor_1_255 0 0 0 100 ECU_ADDRESS 0x40001AC3 /end MEASUREMENT
/begin MEASUREMENT cac_pwm_output "Charge-cooler pump PWM duty (0..255; output = (255-val)/255)." UBYTE NO_COMPU_METHOD 0 0 0 255 ECU_ADDRESS 0x40001AC4 /end MEASUREMENT
/begin MEASUREMENT fuel_usage_reset "Fuel usage reset (boolean flag)." UBYTE NO_COMPU_METHOD 0 0 0 255 ECU_ADDRESS 0x40001AC5 /end MEASUREMENT
/begin MEASUREMENT cluster_fuel_mileage_update_timer "Countdown between cluster fuel-economy updates (CAL_cluster_fuel_mileage_update_timer)." UBYTE CM_u8_time_100ms 0 0 0 25500 ECU_ADDRESS 0x40001AC6 /end MEASUREMENT
/begin MEASUREMENT fuel_range_smoothing_timer "Countdown between fuel range smoothing steps (CAL_cluster_fuel_range_smoothing_interval). Was fuel_usage_timer1." UBYTE CM_u8_time_100ms 0 0 0 25500 ECU_ADDRESS 0x40001AC7 /end MEASUREMENT
/begin MEASUREMENT cluster_shiftlight_rpm_offset "Shift-light rpm offset per gear (x4 rpm below revlimit_hard)." UWORD NO_COMPU_METHOD 0 0 0 65535 ECU_ADDRESS 0x40001AC8 /end MEASUREMENT
/begin MEASUREMENT coolant_fan_afterrun_time "Coolant fant afterrun time (s)." UWORD CM_u8_time_s 0 0 0 65535 ECU_ADDRESS 0x40001ACA /end MEASUREMENT
/begin MEASUREMENT cluster_shift_light_state "Cluster shift light state." UBYTE NO_COMPU_METHOD 0 0 0 255 ECU_ADDRESS 0x40001ACC /end MEASUREMENT
/begin MEASUREMENT oil_pressure_warning_light_timer "Oil pressure warning light debounce (reload 5)." UBYTE CM_u8_time_100ms 0 0 0 25500 ECU_ADDRESS 0x40001ACD /end MEASUREMENT
/begin MEASUREMENT oil_pressure_expected_x16 "Expected oil pressure threshold <<4 for the cluster lamp." UWORD NO_COMPU_METHOD 0 0 0 65535 ECU_ADDRESS 0x40001ACE /end MEASUREMENT
/begin MEASUREMENT dash_data_CAN400 "Dash data CAN400 (structure)." ULONG NO_COMPU_METHOD 0 0 0 4294967295 ECU_ADDRESS 0x40001AD0 /end MEASUREMENT
/begin MEASUREMENT cluster_indicator_flags "Cluster indicator bits (bits5-7 shift lights, ...)." UBYTE NO_COMPU_METHOD 0 0 0 255 ECU_ADDRESS 0x40001AD8 /end MEASUREMENT
/begin MEASUREMENT cluster_flags "Cluster flag bits." UBYTE NO_COMPU_METHOD 0 0 0 255 ECU_ADDRESS 0x40001AD9 /end MEASUREMENT
/begin MEASUREMENT shutdown_eeprom_saved "Shutdown eeprom saved (boolean flag)." UBYTE NO_COMPU_METHOD 0 0 0 255 ECU_ADDRESS 0x40001ADA /end MEASUREMENT
/begin MEASUREMENT exhaust_flap_output_initialized "Exhaust flap output initialized (boolean flag)." UBYTE NO_COMPU_METHOD 0 0 0 255 ECU_ADDRESS 0x40001ADB /end MEASUREMENT
/begin MEASUREMENT exhaust_flap_flags "Exhaust flap state machine bits." UBYTE NO_COMPU_METHOD 0 0 0 255 ECU_ADDRESS 0x40001ADC /end MEASUREMENT
/begin MEASUREMENT nonabs_wheelspeed_filter_q8 "Non-ABS wheel-speed IIR accumulator (<<8, CAL_wheel_speed_smoothing). Was nonabs_wheelspeed." ULONG NO_COMPU_METHOD 0 0 0 4294967295 ECU_ADDRESS 0x40001AE0 /end MEASUREMENT
/begin MEASUREMENT cooling_recirc_pump_stopped_timer "Countdown at idle/stationary (reload CAL_cooling_recirc_pump_stopped_dwell*4); non-zero keeps the recirc pump logic active." UWORD CM_u8_time_100ms 0 0 0 6553500 ECU_ADDRESS 0x40001AE4 /end MEASUREMENT
/begin MEASUREMENT trans_pump_run_on_timer "Trans cooler pump run-on after the request drops (reload 10 = 1 s)." UBYTE CM_u8_time_100ms 0 0 0 25500 ECU_ADDRESS 0x40001AE6 /end MEASUREMENT
/begin MEASUREMENT recirc_pump_afterrun_started "Recirc pump afterrun started (boolean flag)." UBYTE NO_COMPU_METHOD 0 0 0 255 ECU_ADDRESS 0x40001AE7 /end MEASUREMENT
/begin MEASUREMENT fan_coolant_fall_delta "Coolant temperature fan sample drop amount (°C = val*5/8−40)." UBYTE CM_u8_temp_5_8_40c 0 0 -40 119.375 ECU_ADDRESS 0x40001AE8 /end MEASUREMENT
/begin MEASUREMENT fan_coolant_fall_check_timer "Countdown between coolant-fall samples (CAL_cooling_fan_inhibit_resample_period_100ms)." UBYTE CM_u8_time_100ms 0 0 0 25500 ECU_ADDRESS 0x40001AE9 /end MEASUREMENT
/begin MEASUREMENT fan_inhibit_coolant_falling "Fan engine bay inhibit (boolean flag)." UBYTE NO_COMPU_METHOD 0 0 0 255 ECU_ADDRESS 0x40001AEA /end MEASUREMENT
/begin MEASUREMENT fan_coolant_fall_check_prev_temp "Coolant temperature sample for fan control (°C = val*5/8−40)." UBYTE CM_u8_temp_5_8_40c 0 0 -40 119.375 ECU_ADDRESS 0x40001AEB /end MEASUREMENT
/begin MEASUREMENT ips_cooling "IPS cooling (boolean flag)." UBYTE NO_COMPU_METHOD 0 0 0 255 ECU_ADDRESS 0x40001AEC /end MEASUREMENT
/begin MEASUREMENT temp_engine_air_cooling_control "Temperature engine air cooling control (°C = val*5/8−40)." UBYTE CM_u8_temp_5_8_40c 0 0 -40 119.375 ECU_ADDRESS 0x40001AED /end MEASUREMENT
/begin MEASUREMENT roughness_rpm_prev "Previous obd_ii_engine_speed sample for roughness direction tracking." UWORD CM_u16_rspeed_1_4rpm 0 0 0 16383.75 ECU_ADDRESS 0x40001AEE /end MEASUREMENT
/begin MEASUREMENT roughness_edge_count "Samples since the last direction change (vs CAL_roughness_min_edge_count)." UBYTE NO_COMPU_METHOD 0 0 0 255 ECU_ADDRESS 0x40001AF0 /end MEASUREMENT
/begin MEASUREMENT roughness_direction_count "Consecutive samples in the same direction (vs CAL_roughness_direction_count_threshold)." UBYTE NO_COMPU_METHOD 0 0 0 255 ECU_ADDRESS 0x40001AF1 /end MEASUREMENT
/begin MEASUREMENT roughness_valley_rpm "Engine speed at the last valley." UWORD CM_u16_rspeed_1_4rpm 0 0 0 16383.75 ECU_ADDRESS 0x40001AF2 /end MEASUREMENT
/begin MEASUREMENT roughness_valley_period "Period count at the last valley." UWORD NO_COMPU_METHOD 0 0 0 65535 ECU_ADDRESS 0x40001AF4 /end MEASUREMENT
/begin MEASUREMENT roughness_peak_rpm "Engine speed at the last peak." UWORD CM_u16_rspeed_1_4rpm 0 0 0 16383.75 ECU_ADDRESS 0x40001AF6 /end MEASUREMENT
/begin MEASUREMENT roughness_cycle_period "Samples in the current half-cycle." UWORD NO_COMPU_METHOD 0 0 0 65535 ECU_ADDRESS 0x40001AF8 /end MEASUREMENT
/begin MEASUREMENT roughness_rise_count "Samples spent rising (saturating)." UWORD NO_COMPU_METHOD 0 0 0 65535 ECU_ADDRESS 0x40001AFA /end MEASUREMENT
/begin MEASUREMENT roughness_fall_count "Samples spent falling (saturating); |rise-fall| tests symmetry." UWORD NO_COMPU_METHOD 0 0 0 65535 ECU_ADDRESS 0x40001AFC /end MEASUREMENT
/begin MEASUREMENT roughness_delta_rpm_filtered "Filtered rpm delta (CAL_roughness_delta_rpm_smoothing_factor/100); ign_comp_roughness_request = -this*CAL/1000." SWORD NO_COMPU_METHOD 0 0 -32768 32767 ECU_ADDRESS 0x40001AFE /end MEASUREMENT
/begin MEASUREMENT engine_speed_tach "Engine speed tach (RPM = val/4)." UWORD CM_u16_rspeed_1_4rpm 0 0 0 16383.75 ECU_ADDRESS 0x40001B00 /end MEASUREMENT
/begin MEASUREMENT recirc_pump_override_state "Recirc pump test override (0 normal, 1 forced)." UBYTE NO_COMPU_METHOD 0 0 0 255 ECU_ADDRESS 0x40001B02 /end MEASUREMENT
/begin MEASUREMENT trans_pump_override_state "Trans pump test override (0 normal, 1 forced)." UBYTE NO_COMPU_METHOD 0 0 0 255 ECU_ADDRESS 0x40001B03 /end MEASUREMENT
/begin MEASUREMENT trans_pump_enable_request "Transmission pump enable request (boolean flag)." UBYTE NO_COMPU_METHOD 0 0 0 255 ECU_ADDRESS 0x40001B04 /end MEASUREMENT
/begin MEASUREMENT radiator_fan_pwm_initialized "Radiator fan PWM initialized (boolean flag)." UBYTE NO_COMPU_METHOD 0 0 0 255 ECU_ADDRESS 0x40001B05 /end MEASUREMENT
/begin MEASUREMENT radiator_fan_dc_coolant_based "Radiator fan duty cycle coolant based (% = val*100/255)." UBYTE CM_u8_factor_1_255 0 0 0 100 ECU_ADDRESS 0x40001B06 /end MEASUREMENT
/begin MEASUREMENT radiator_fan_dc_airtemp_based "Radiator fan duty cycle airtemp based (% = val*100/255)." UBYTE CM_u8_factor_1_255 0 0 0 100 ECU_ADDRESS 0x40001B07 /end MEASUREMENT
/begin MEASUREMENT radiator_fan_dc_hotstart "Radiator fan duty cycle hotstart (% = val*100/255)." UBYTE CM_u8_factor_1_255 0 0 0 100 ECU_ADDRESS 0x40001B08 /end MEASUREMENT
/begin MEASUREMENT radiator_fan_pwm_output "Lookup result of CAL_cooling_fan_scaling." UBYTE NO_COMPU_METHOD 0 0 0 255 ECU_ADDRESS 0x40001B09 /end MEASUREMENT
/begin MEASUREMENT engine_bay_fan_override_state "Engine-bay fan test override (0 normal, 1 forced)." UBYTE NO_COMPU_METHOD 0 0 0 255 ECU_ADDRESS 0x40001B0A /end MEASUREMENT
/begin MEASUREMENT cac_pwm_output_last "uint8_t" UBYTE NO_COMPU_METHOD 0 0 0 255 ECU_ADDRESS 0x40001B0B /end MEASUREMENT
/begin MEASUREMENT cac_pump_pwm_initialized "Charge-air-cooler pump PWM initialized (boolean flag)." UBYTE NO_COMPU_METHOD 0 0 0 255 ECU_ADDRESS 0x40001B0C /end MEASUREMENT
/begin MEASUREMENT cac_warmup_timer "Charge-cooler pump warm-up countdown (30 = 3 s)." UBYTE CM_u8_time_100ms 0 0 0 25500 ECU_ADDRESS 0x40001B0D /end MEASUREMENT
/begin MEASUREMENT pwm_b3_latched_on "Software PWM 0xB3 output latched on once the engine has run." UBYTE NO_COMPU_METHOD 0 0 0 255 ECU_ADDRESS 0x40001B0E /end MEASUREMENT
/begin MEASUREMENT pwm_b3_phase "Software PWM 0xB3 phase counter (0..39)." UBYTE NO_COMPU_METHOD 0 0 0 255 ECU_ADDRESS 0x40001B0F /end MEASUREMENT
/begin MEASUREMENT pwm_b3_duty_pct "Software PWM 0xB3 duty (%), latched at the start of each 40-step period." UBYTE NO_COMPU_METHOD 0 0 0 255 ECU_ADDRESS 0x40001B10 /end MEASUREMENT
/begin MEASUREMENT exhaust_flap_state_40001B11 "Exhaust flap state (0 closed, 1, 2 open)." UBYTE NO_COMPU_METHOD 0 0 0 255 ECU_ADDRESS 0x40001B11 /end MEASUREMENT
/begin MEASUREMENT roughness_period_sum "Sum of captured peak+valley periods (roughness_cycle_mean numerator)." UWORD NO_COMPU_METHOD 0 0 0 65535 ECU_ADDRESS 0x40001B12 /end MEASUREMENT
/begin MEASUREMENT wheelspeed_front_delta_accum "Front-wheel speed delta IIR accumulator." SWORD NO_COMPU_METHOD 0 0 -32768 32767 ECU_ADDRESS 0x40001B14 /end MEASUREMENT
/begin MEASUREMENT wheel_speed_front_delta "Front-wheel average speed delta since the last sample." SWORD NO_COMPU_METHOD 0 0 -32768 32767 ECU_ADDRESS 0x40001B16 /end MEASUREMENT
/begin MEASUREMENT wheelspeed_update_timer "Wheelspeed update timer (ms = val*5)." UBYTE CM_u8_time_5ms 0 0 0 1275 ECU_ADDRESS 0x40001B18 /end MEASUREMENT
/begin MEASUREMENT wheelspeed_front_average "Front-wheel average speed." UWORD NO_COMPU_METHOD 0 0 0 65535 ECU_ADDRESS 0x40001B1A /end MEASUREMENT
/begin MEASUREMENT wheelspeed_front_avg_prev "Previous front-wheel average speed." UWORD NO_COMPU_METHOD 0 0 0 65535 ECU_ADDRESS 0x40001B1C /end MEASUREMENT
/begin MEASUREMENT engine_speed_pps_target "Engine-speed reference target (idle target x4 or pedal-based)." UWORD CM_u16_rspeed_1_4rpm 0 0 0 16383.75 ECU_ADDRESS 0x40001B1E /end MEASUREMENT
/begin MEASUREMENT engine_speed_reference_x256 "Engine speed reference x256 (RPM = val*1024)." ULONG CM_u32_rspeed_1024rpm 0 0 0 4398046510080 ECU_ADDRESS 0x40001B20 /end MEASUREMENT
/begin MEASUREMENT engine_speed_decel_limiter_active "Engine speed decel limiter active (boolean flag)." UBYTE NO_COMPU_METHOD 0 0 0 255 ECU_ADDRESS 0x40001B24 /end MEASUREMENT
/begin MEASUREMENT idle_underspeed_latch "Idle underspeed latch (boolean flag)." UBYTE NO_COMPU_METHOD 0 0 0 255 ECU_ADDRESS 0x40001B25 /end MEASUREMENT
/begin MEASUREMENT engine_speed_reference_prev_x256 "Previous engine_speed_reference_x256." ULONG NO_COMPU_METHOD 0 0 0 4294967295 ECU_ADDRESS 0x40001B28 /end MEASUREMENT
/begin MEASUREMENT engine_speed_target_ramp_up_gain "Engine-speed reference ramp-up gain (/0xa00)." UBYTE NO_COMPU_METHOD 0 0 0 255 ECU_ADDRESS 0x40001B2C /end MEASUREMENT
/begin MEASUREMENT fuel_economy_factor "Cluster fuel-economy factor (x100), stepped toward the computed value." UWORD NO_COMPU_METHOD 0 0 0 65535 ECU_ADDRESS 0x40001B2E /end MEASUREMENT
/begin MEASUREMENT cluster_range_to_empty_calculated "Cluster range to empty calculated (km)." UWORD CM_u16_distance_km 0 0 0 65535 ECU_ADDRESS 0x40001B30 /end MEASUREMENT
/begin MEASUREMENT fuel_level_prev "Fuel level prev (gal = val/10)." UBYTE CM_u8_volume_1_10gallon 0 0 0 25.5 ECU_ADDRESS 0x40001B32 /end MEASUREMENT
/begin MEASUREMENT fuel_range_remaining "Fuel range remaining." UWORD NO_COMPU_METHOD 0 0 0 65535 ECU_ADDRESS 0x40001B34 /end MEASUREMENT
/begin MEASUREMENT fuel_economy_avg "Fuel economy avg." UWORD NO_COMPU_METHOD 0 0 0 65535 ECU_ADDRESS 0x40001B36 /end MEASUREMENT
/begin MEASUREMENT fuel_economy_instantaneous "Fuel economy instantaneous." UWORD NO_COMPU_METHOD 0 0 0 65535 ECU_ADDRESS 0x40001B38 /end MEASUREMENT
/begin MEASUREMENT ips_shift_light_flags "IPS shift-light bits from CAN 0x250 byte 3." UBYTE NO_COMPU_METHOD 0 0 0 255 ECU_ADDRESS 0x40001B3A /end MEASUREMENT
/begin MEASUREMENT paddle_shift_sensor_raw "Paddle-shift sensor raw ADC (10-bit)." UWORD NO_COMPU_METHOD 0 0 0 65535 ECU_ADDRESS 0x40001B3C /end MEASUREMENT
/begin MEASUREMENT paddle_shift_flags "uint8_t" UBYTE NO_COMPU_METHOD 0 0 0 255 ECU_ADDRESS 0x40001B3E /end MEASUREMENT
/begin MEASUREMENT inj_dfco_recovery_enrichment "Injector decel fuel cut-off recovery enrichment (µs)." ULONG CM_u8_time_us 0 0 0 4294967295 ECU_ADDRESS 0x40001B40 /end MEASUREMENT
/begin MEASUREMENT inj_tip_adj_enrichment "Injector tip adj enrichment (µs)." ULONG CM_u8_time_us 0 0 0 4294967295 ECU_ADDRESS 0x40001B44 /end MEASUREMENT
/begin MEASUREMENT inj_tip_adj_enleanment "Injector tip adj enleanment (µs)." ULONG CM_u8_time_us 0 0 0 4294967295 ECU_ADDRESS 0x40001B48 /end MEASUREMENT
/begin MEASUREMENT inj_flags "bit0 = decel fuel cut (fixed spark, zero fuel usage)." UWORD NO_COMPU_METHOD 0 0 0 65535 ECU_ADDRESS 0x40001B4C /end MEASUREMENT
/begin MEASUREMENT injtip_in_rpm_decay "Tip-in transient magnitude decay step (CAL_injtip_in_rpm_decay[rpm]) (TPS rate units, /1023)." UBYTE CM_u16_factor_1_1023 0 0 0 24.9266862170088 ECU_ADDRESS 0x40001B4E /end MEASUREMENT
/begin MEASUREMENT injtip_out_rpm_decay "Tip-out transient magnitude decay step (TPS rate units, /1023)." UBYTE CM_u16_factor_1_1023 0 0 0 24.9266862170088 ECU_ADDRESS 0x40001B4F /end MEASUREMENT
/begin MEASUREMENT dfco_pedal_ramp_target "DFCO exit ramp target from CAL_injtip_dfco_pedal_ramp_target[pedal]." UBYTE NO_COMPU_METHOD 0 0 0 255 ECU_ADDRESS 0x40001B50 /end MEASUREMENT
/begin MEASUREMENT injtip_in_enrichment_raw "Tip-in enrichment pulse before limits." ULONG CM_u8_time_us 0 0 0 4294967295 ECU_ADDRESS 0x40001B54 /end MEASUREMENT
/begin MEASUREMENT injtip_out_enleanment_raw "Tip-out enleanment pulse before limits." ULONG CM_u8_time_us 0 0 0 4294967295 ECU_ADDRESS 0x40001B58 /end MEASUREMENT
/begin MEASUREMENT injtip_transient_magnitude "Snapshot of tps_transient_magnitude_decay used by injtip." SWORD NO_COMPU_METHOD 0 0 -32768 32767 ECU_ADDRESS 0x40001B5C /end MEASUREMENT
/begin MEASUREMENT dfco_recovery_enrich_cooldown_timer "DFCO recovery enrichment cooldown countdown." UWORD CM_u8_time_5ms 0 0 0 327675 ECU_ADDRESS 0x40001B5E /end MEASUREMENT
/begin MEASUREMENT inj_post_start_trim "Post-start fuel multiplier offset: pulse x (10000 + val)/10000; decays to 0 in inj_transient_ramp_200hz. Was inj_trim_post_start." SWORD CM_u16_factor_1_10000 0 0 -327.68 327.67 ECU_ADDRESS 0x40001B60 /end MEASUREMENT
/begin MEASUREMENT injtip_in_rpm_scale "Lookup result of CAL_injtip_in_rpm_scale." UBYTE CM_u8_factor_1_128 0 0 0 199.21875 ECU_ADDRESS 0x40001B62 /end MEASUREMENT
/begin MEASUREMENT injtip_in_coolant_scale "Lookup result of CAL_injtip_in_coolant_scale." UBYTE CM_u8_factor_1_64 0 0 0 398.4375 ECU_ADDRESS 0x40001B63 /end MEASUREMENT
/begin MEASUREMENT injtip_out_rpm_scale "Lookup result of CAL_injtip_out_rpm_scale." UBYTE CM_u8_factor_1_128 0 0 0 199.21875 ECU_ADDRESS 0x40001B64 /end MEASUREMENT
/begin MEASUREMENT injtip_out_coolant_scale "Lookup result of CAL_injtip_out_coolant_scale." UBYTE CM_u8_factor_1_64 0 0 0 398.4375 ECU_ADDRESS 0x40001B65 /end MEASUREMENT
/begin MEASUREMENT inj_tip_in_adj_gear_current "Injector tip in adj gear current." SBYTE NO_COMPU_METHOD 0 0 -128 127 ECU_ADDRESS 0x40001B66 /end MEASUREMENT
/begin MEASUREMENT dfco_enable_engine_speed "Decel fuel cut-off enable engine speed (RPM)." UWORD CM_u8_rspeed_rpm 0 0 0 65535 ECU_ADDRESS 0x40001B68 /end MEASUREMENT
/begin MEASUREMENT dfco_disable_rpm_ingear "DFCO re-enable rpm in gear (CAL x10)." UWORD CM_u8_rspeed_rpm 0 0 0 65535 ECU_ADDRESS 0x40001B6A /end MEASUREMENT
/begin MEASUREMENT dfco_disable_rpm_neutral "DFCO re-enable rpm in neutral (CAL x10)." UWORD CM_u8_rspeed_rpm 0 0 0 65535 ECU_ADDRESS 0x40001B6C /end MEASUREMENT
/begin MEASUREMENT injtip_out_load_scale "Lookup result of CAL_injtip_comp_negative_load." UBYTE NO_COMPU_METHOD 0 0 0 255 ECU_ADDRESS 0x40001B6E /end MEASUREMENT
/begin MEASUREMENT injtip_comp_load1 "Lookup result of CAL_injtip_comp_load1." UBYTE NO_COMPU_METHOD 0 0 0 255 ECU_ADDRESS 0x40001B6F /end MEASUREMENT
/begin MEASUREMENT injtip_first_gear_state "Tip-in state machine for first-gear launch (1 -> 2 -> ...)." UBYTE NO_COMPU_METHOD 0 0 0 255 ECU_ADDRESS 0x40001B70 /end MEASUREMENT
/begin MEASUREMENT inj_post_start_trim_decay_step "Post-start trim decay step from CAL_inj_post_start_trim_decay_lean/rich." UBYTE NO_COMPU_METHOD 0 0 0 255 ECU_ADDRESS 0x40001B71 /end MEASUREMENT
/begin MEASUREMENT inj_load_drop "Load drop over the history window (u16_load_mg_stroke_40004d20 history), mg/stroke." SWORD NO_COMPU_METHOD 0 0 -32768 32767 ECU_ADDRESS 0x40001B72 /end MEASUREMENT
/begin MEASUREMENT inj_transient_rate_pct "Transient rate term (lookup - 100), clamped -30..100." SWORD NO_COMPU_METHOD 0 0 -32768 32767 ECU_ADDRESS 0x40001B74 /end MEASUREMENT
/begin MEASUREMENT inj_transient_gain "Transient gain lookup." UBYTE NO_COMPU_METHOD 0 0 0 255 ECU_ADDRESS 0x40001B76 /end MEASUREMENT
/begin MEASUREMENT inj_post_start_10ms_divider "200 Hz divider, reload 2, for the post-start trim decay." UBYTE NO_COMPU_METHOD 0 0 0 255 ECU_ADDRESS 0x40001B77 /end MEASUREMENT
/begin MEASUREMENT inj_transient_20ms_divider "200 Hz divider, reload 4." UBYTE NO_COMPU_METHOD 0 0 0 255 ECU_ADDRESS 0x40001B78 /end MEASUREMENT
/begin MEASUREMENT cyl_fuelcut_sparking_mask "Per-cylinder bits: cylinder fuel-cut but still sparking." UBYTE NO_COMPU_METHOD 0 0 0 255 ECU_ADDRESS 0x40001B79 /end MEASUREMENT
/begin MEASUREMENT ign_per_cyl_fire_enable "Per-cylinder spark enable bits (DFCO / cut patterns)." UBYTE NO_COMPU_METHOD 0 0 0 255 ECU_ADDRESS 0x40001B7A /end MEASUREMENT
/begin MEASUREMENT sensor_adc_maf1 "Sensor ADC maf1 (V = val*5/1023)." UWORD CM_u16_voltage_5_1023v 0 0 0 320.307917888563 ECU_ADDRESS 0x40001B88 /end MEASUREMENT
/begin MEASUREMENT obd_ii_maf_flow "OBD-II: MAF flow (mg/s = val*10)." UWORD CM_u16_flow_10mg_s 0 0 0 655350 ECU_ADDRESS 0x40001B8A /end MEASUREMENT
/begin MEASUREMENT maf_flow "MAF flow (mg/s = val*10)." UWORD CM_u16_flow_10mg_s 0 0 0 655350 ECU_ADDRESS 0x40001B8C /end MEASUREMENT
/begin MEASUREMENT engine_mass_flow_rate_from_map "Engine mass flow rate from MAP (mg/s = val*100)." UWORD CM_u8_flow_100mg_s 0 0 0 6553500 ECU_ADDRESS 0x40001B8E /end MEASUREMENT
/begin MEASUREMENT airflow_rate_from_load "load_computed_alphaN*1e5/engine_speed_period_adj (mg/s = val*10); axis /200 for the fuel-film alpha. Was load_mass_per_time." UWORD CM_u16_flow_10mg_s 0 0 0 655350 ECU_ADDRESS 0x40001B90 /end MEASUREMENT
/begin MEASUREMENT airflow_rate_expected_alphaN "Expected airflow from the alpha-N load (load*1e5/period)." UWORD CM_u16_flow_10mg_s 0 0 0 655350 ECU_ADDRESS 0x40001B92 /end MEASUREMENT
/begin MEASUREMENT manifold_pressure_calculated "Manifold pressure calculated (mbar)." UWORD CM_i16_pressure_mbar 0 0 0 65535 ECU_ADDRESS 0x40001B94 /end MEASUREMENT
/begin MEASUREMENT load_mass_per_stroke_raw "Load mass per stroke (mg/stroke)." ULONG CM_u8_load_mg_stroke 0 0 0 4294967295 ECU_ADDRESS 0x40001B98 /end MEASUREMENT
/begin MEASUREMENT load_selected_raw "Load selected (mg/stroke)." ULONG CM_u8_load_mg_stroke 0 0 0 4294967295 ECU_ADDRESS 0x40001B9C /end MEASUREMENT
/begin MEASUREMENT sensor_adc_maf2 "Sensor ADC maf2 (V = val*5/1023)." UWORD CM_u16_voltage_5_1023v 0 0 0 320.307917888563 ECU_ADDRESS 0x40001BA0 /end MEASUREMENT
/begin MEASUREMENT load_alphaN_learn_cell "Alpha-N trim learn cell: bit15 valid, bits0-14 rpm index (LEA index = val+40)." UWORD NO_COMPU_METHOD 0 0 0 65535 ECU_ADDRESS 0x40001BA2 /end MEASUREMENT
/begin MEASUREMENT load_alphaN_maf_error_correction_cell "Alpha-N MAF-error learn cell: bit15 valid, bits0-14 rpm index (LEA index = val+40)." UWORD NO_COMPU_METHOD 0 0 0 65535 ECU_ADDRESS 0x40001BA4 /end MEASUREMENT
/begin MEASUREMENT load_baro_gain "Load baro gain (efficiency2 lookup x2)." UWORD NO_COMPU_METHOD 0 0 0 65535 ECU_ADDRESS 0x40001BA8 /end MEASUREMENT
/begin MEASUREMENT _ve_for_map_synthesis "u16_factor_1/100" UWORD CM_u8_factor_1_100 0 0 0 65535 ECU_ADDRESS 0x40001BAA /end MEASUREMENT
/begin MEASUREMENT load_maf_vs_alphaN_difference "Load MAF vs alphaN difference (mg/stroke)." UWORD CM_u8_load_mg_stroke 0 0 0 65535 ECU_ADDRESS 0x40001BAC /end MEASUREMENT
/begin MEASUREMENT tps_delta_from_idle "u16_factor_1/1023" UWORD CM_u16_factor_1_1023 0 0 0 6406.15835777126 ECU_ADDRESS 0x40001BAE /end MEASUREMENT
/begin MEASUREMENT load_measured_maf "Load measured MAF (mg/stroke)." ULONG CM_u8_load_mg_stroke 0 0 0 4294967295 ECU_ADDRESS 0x40001BB0 /end MEASUREMENT
/begin MEASUREMENT load_from_speed_density "Load from speed density (mg/stroke)." ULONG CM_u8_load_mg_stroke 0 0 0 4294967295 ECU_ADDRESS 0x40001BB4 /end MEASUREMENT
/begin MEASUREMENT maf_flow_difference "MAF flow difference (mg/s = val*10)." UWORD CM_u16_flow_10mg_s 0 0 0 655350 ECU_ADDRESS 0x40001BB8 /end MEASUREMENT
/begin MEASUREMENT load_computed_alphaN "Load computed alphaN (mg/stroke)." ULONG CM_u8_load_mg_stroke 0 0 0 4294967295 ECU_ADDRESS 0x40001BBC /end MEASUREMENT
/begin MEASUREMENT load_alphaN_expected "u32_load_mg/stroke" ULONG CM_u8_load_mg_stroke 0 0 0 4294967295 ECU_ADDRESS 0x40001BC0 /end MEASUREMENT
/begin MEASUREMENT tps_idle_baseline_learned "u32_factor_1/1023" ULONG CM_u16_factor_1_1023 0 0 0 419840400.293255 ECU_ADDRESS 0x40001BC4 /end MEASUREMENT
/begin MEASUREMENT load_alphaN_calc "Load alphaN calculated (mg/stroke = val*1173)." UWORD CM_u8_load_mg_stroke 0 0 0 65535 ECU_ADDRESS 0x40001BC8 /end MEASUREMENT
/begin MEASUREMENT load_to_tps_mapping "Load to throttle position mapping (val/1023)." UWORD CM_u16_factor_1_1023 0 0 0 6406.15835777126 ECU_ADDRESS 0x40001BCA /end MEASUREMENT
/begin MEASUREMENT maf_vs_alphaN_flow_error "i16_flow_400mg/s" SWORD CM_i16_flow_400mg_s 0 0 -13107200 13106800 ECU_ADDRESS 0x40001BCC /end MEASUREMENT
/begin MEASUREMENT load_alphaN_trim_factor "u16_factor_1/100" UWORD CM_u8_factor_1_100 0 0 0 65535 ECU_ADDRESS 0x40001BCE /end MEASUREMENT
/begin MEASUREMENT load_alphaN_maf_error_correction "u16_factor_1/100" UWORD CM_u8_factor_1_100 0 0 0 65535 ECU_ADDRESS 0x40001BD0 /end MEASUREMENT
/begin MEASUREMENT transient_load_timer "Transient load timer (ms = val*5)." UBYTE CM_u8_time_5ms 0 0 0 1275 ECU_ADDRESS 0x40001BD2 /end MEASUREMENT
/begin MEASUREMENT load_mass_per_stroke "Load mass per stroke (mg/stroke = val*4)." UBYTE CM_u8_load_4mg_stroke 0 0 0 1020 ECU_ADDRESS 0x40001BD3 /end MEASUREMENT
/begin MEASUREMENT load_8bit "Load 1 (mg/stroke = val*1173)." UBYTE CM_u8_load_1173mg_255stroke 0 0 0 1173 ECU_ADDRESS 0x40001BD4 /end MEASUREMENT
/begin MEASUREMENT load_unused1 "Lookup result of CAL_load_unused1." UBYTE NO_COMPU_METHOD 0 0 0 255 ECU_ADDRESS 0x40001BD5 /end MEASUREMENT
/begin MEASUREMENT tps_scaling_factor "Throttle position scaling factor (val/255)." UBYTE CM_u8_factor_1_255 0 0 0 100 ECU_ADDRESS 0x40001BD6 /end MEASUREMENT
/begin MEASUREMENT load_selection_tps_threshold "u8_factor_1/255" UBYTE CM_u8_factor_1_255 0 0 0 100 ECU_ADDRESS 0x40001BD7 /end MEASUREMENT
/begin MEASUREMENT knock_inhibit_tps_max "Knock inhibit throttle position maximum (val/255)." UBYTE CM_u8_factor_1_255 0 0 0 100 ECU_ADDRESS 0x40001BD8 /end MEASUREMENT
/begin MEASUREMENT load_computed_to_measured_ratio "Load computed to measured ratio (val/100)." UBYTE CM_u8_factor_1_100 0 0 0 255 ECU_ADDRESS 0x40001BD9 /end MEASUREMENT
/begin MEASUREMENT tps_idle_to_current_ratio "Throttle position idle to current ratio (val/100)." UBYTE CM_u8_factor_1_100 0 0 0 255 ECU_ADDRESS 0x40001BDA /end MEASUREMENT
/begin MEASUREMENT obd_ii_calc_engine_load "OBD-II: calculated engine load (val/255)." UBYTE CM_u8_factor_1_255 0 0 0 100 ECU_ADDRESS 0x40001BDB /end MEASUREMENT
/begin MEASUREMENT obd_ii_load_abs "OBD-II: load ABS (val/255)." UWORD CM_u8_factor_1_255 0 0 0 25700 ECU_ADDRESS 0x40001BDC /end MEASUREMENT
/begin MEASUREMENT load_pct "Load pct (val/100)." UBYTE CM_u8_factor_1_100 0 0 0 255 ECU_ADDRESS 0x40001BDE /end MEASUREMENT
/begin MEASUREMENT load_source_is_alphaN "Load source is alphaN (boolean flag)." UBYTE NO_COMPU_METHOD 0 0 0 255 ECU_ADDRESS 0x40001BDF /end MEASUREMENT
/begin MEASUREMENT engine_speed_period_adj "Engine speed period adj (µs)." UWORD CM_u8_time_us 0 0 0 65535 ECU_ADDRESS 0x40001BE0 /end MEASUREMENT
/begin MEASUREMENT maf_flow_2 "MAF flow 2 (mg/s = val*10)." UWORD CM_u16_flow_10mg_s 0 0 0 655350 ECU_ADDRESS 0x40001BE2 /end MEASUREMENT
/begin MEASUREMENT load_ref_charge "u8_load_4mg/stroke" UBYTE CM_u8_load_4mg_stroke 0 0 0 1020 ECU_ADDRESS 0x40001BE4 /end MEASUREMENT
/begin MEASUREMENT load_u8_tmp "Load axis value for the LEA alpha-N MAF-error lookup." UBYTE NO_COMPU_METHOD 0 0 0 255 ECU_ADDRESS 0x40001BE5 /end MEASUREMENT
/begin MEASUREMENT load_unknown "Load." ULONG NO_COMPU_METHOD 0 0 0 4294967295 ECU_ADDRESS 0x40001BE8 /end MEASUREMENT
/begin MEASUREMENT ve_for_speed_density "VE for speed density (val/10000)." UWORD CM_u16_factor_1_10000 0 0 0 655.35 ECU_ADDRESS 0x40001BEC /end MEASUREMENT
/begin MEASUREMENT manifold_pressure_ratio_mbar "Manifold pressure ratio mbar (mbar)." UWORD CM_i16_pressure_mbar 0 0 0 65535 ECU_ADDRESS 0x40001BEE /end MEASUREMENT
/begin MEASUREMENT vacuum_mbar "Vacuum mbar (mbar)." UWORD CM_i16_pressure_mbar 0 0 0 65535 ECU_ADDRESS 0x40001BF0 /end MEASUREMENT
/begin MEASUREMENT obd_ii_p0011_health "Debounce health for P0011: reset to CAL_obd_ii_P0011_debounce_count; +1 per pass (to the CAL), -1 per fail event; the DTC fails at 0." UBYTE NO_COMPU_METHOD 0 0 0 255 ECU_ADDRESS 0x40001BF8 /end MEASUREMENT
/begin MEASUREMENT obd_ii_p0012_health "Debounce health for P0012: reset to CAL_obd_ii_P0012_debounce_count; +1 per pass (to the CAL), -1 per fail event; the DTC fails at 0." UBYTE NO_COMPU_METHOD 0 0 0 255 ECU_ADDRESS 0x40001BF9 /end MEASUREMENT
/begin MEASUREMENT obd_ii_p0021_health "Debounce health for P0021: reset to CAL_obd_ii_P0021_debounce_count; +1 per pass (to the CAL), -1 per fail event; the DTC fails at 0." UBYTE NO_COMPU_METHOD 0 0 0 255 ECU_ADDRESS 0x40001BFA /end MEASUREMENT
/begin MEASUREMENT obd_ii_p0022_health "Debounce health for P0022: reset to CAL_obd_ii_P0022_debounce_count; +1 per pass (to the CAL), -1 per fail event; the DTC fails at 0." UBYTE NO_COMPU_METHOD 0 0 0 255 ECU_ADDRESS 0x40001BFB /end MEASUREMENT
/begin MEASUREMENT obd_ii_p0014_health "Debounce health for P0014: reset to CAL_obd_ii_P0014_maturing_limit; +1 per pass (to the CAL), -1 per fail event; the DTC fails at 0." UBYTE NO_COMPU_METHOD 0 0 0 255 ECU_ADDRESS 0x40001BFC /end MEASUREMENT
/begin MEASUREMENT obd_ii_p0015_health "Debounce health for P0015: reset to CAL_obd_ii_P0015_maturing_limit; +1 per pass (to the CAL), -1 per fail event; the DTC fails at 0." UBYTE NO_COMPU_METHOD 0 0 0 255 ECU_ADDRESS 0x40001BFD /end MEASUREMENT
/begin MEASUREMENT obd_ii_p0024_health "Debounce health for P0024: reset to CAL_obd_ii_P0024_maturing_limit; +1 per pass (to the CAL), -1 per fail event; the DTC fails at 0." UBYTE NO_COMPU_METHOD 0 0 0 255 ECU_ADDRESS 0x40001BFE /end MEASUREMENT
/begin MEASUREMENT obd_ii_p0025_health "Debounce health for P0025: reset to CAL_obd_ii_P0025_debounce_count; +1 per pass (to the CAL), -1 per fail event; the DTC fails at 0." UBYTE NO_COMPU_METHOD 0 0 0 255 ECU_ADDRESS 0x40001BFF /end MEASUREMENT
/begin MEASUREMENT obd_ii_p0016_health "Debounce health for P0016: reset to CAL_obd_ii_P0016_debounce_count; +1 per pass (to the CAL), -1 per fail event; the DTC fails at 0." UBYTE NO_COMPU_METHOD 0 0 0 255 ECU_ADDRESS 0x40001C00 /end MEASUREMENT
/begin MEASUREMENT obd_ii_p0017_health "Debounce health for P0017: reset to CAL_obd_ii_P0017_debounce_count; +1 per pass (to the CAL), -1 per fail event; the DTC fails at 0." UBYTE NO_COMPU_METHOD 0 0 0 255 ECU_ADDRESS 0x40001C01 /end MEASUREMENT
/begin MEASUREMENT obd_ii_p0018_health "Debounce health for P0018: reset to CAL_obd_ii_P0018_debounce_count; +1 per pass (to the CAL), -1 per fail event; the DTC fails at 0." UBYTE NO_COMPU_METHOD 0 0 0 255 ECU_ADDRESS 0x40001C02 /end MEASUREMENT
/begin MEASUREMENT obd_ii_p0019_health "Debounce health for P0019: reset to CAL_obd_ii_P0019_debounce_count; +1 per pass (to the CAL), -1 per fail event; the DTC fails at 0." UBYTE NO_COMPU_METHOD 0 0 0 255 ECU_ADDRESS 0x40001C03 /end MEASUREMENT
/begin MEASUREMENT obd_ii_vvt_inlet_b1_over_advanced_count "Consecutive samples with inlet b1 error < -CAL_obd_ii_vvt_cam_error_limit (cam ahead of target); > CAL_obd_ii_vvt_error_fail_count -> P0011 fail event. Also Mode 06 result 1." UBYTE NO_COMPU_METHOD 0 0 0 255 ECU_ADDRESS 0x40001C04 /end MEASUREMENT
/begin MEASUREMENT obd_ii_vvt_exhaust_b1_over_advanced_count "Consecutive samples with exhaust b1 error > limit -> P0014." UBYTE NO_COMPU_METHOD 0 0 0 255 ECU_ADDRESS 0x40001C05 /end MEASUREMENT
/begin MEASUREMENT obd_ii_vvt_inlet_b2_over_advanced_count "Consecutive samples with inlet b2 error < -limit -> P0021. Mode 06 result 3." UBYTE NO_COMPU_METHOD 0 0 0 255 ECU_ADDRESS 0x40001C06 /end MEASUREMENT
/begin MEASUREMENT obd_ii_vvt_exhaust_b2_over_advanced_count "Consecutive samples with exhaust b2 error > limit -> P0024." UBYTE NO_COMPU_METHOD 0 0 0 255 ECU_ADDRESS 0x40001C07 /end MEASUREMENT
/begin MEASUREMENT obd_ii_vvt_inlet_b1_over_retarded_count "Consecutive samples with inlet b1 error > limit (cam behind target) -> P0012. Mode 06 result 2." UBYTE NO_COMPU_METHOD 0 0 0 255 ECU_ADDRESS 0x40001C08 /end MEASUREMENT
/begin MEASUREMENT obd_ii_vvt_exhaust_b1_over_retarded_count "Consecutive samples with exhaust b1 error < -limit -> P0015." UBYTE NO_COMPU_METHOD 0 0 0 255 ECU_ADDRESS 0x40001C09 /end MEASUREMENT
/begin MEASUREMENT obd_ii_vvt_inlet_b2_over_retarded_count "Consecutive samples with inlet b2 error > limit -> P0022. Mode 06 result 4." UBYTE NO_COMPU_METHOD 0 0 0 255 ECU_ADDRESS 0x40001C0A /end MEASUREMENT
/begin MEASUREMENT obd_ii_vvt_exhaust_b2_over_retarded_count "Consecutive samples with exhaust b2 error < -limit -> P0025." UBYTE NO_COMPU_METHOD 0 0 0 255 ECU_ADDRESS 0x40001C0B /end MEASUREMENT
/begin MEASUREMENT obd_ii_vvt_inlet_b1_in_range_count "Consecutive in-range inlet b1 samples; > CAL_obd_ii_vvt_ok_pass_count -> P0011/P0012 pass event." UBYTE NO_COMPU_METHOD 0 0 0 255 ECU_ADDRESS 0x40001C0C /end MEASUREMENT
/begin MEASUREMENT obd_ii_vvt_exhaust_b1_in_range_count "Consecutive in-range exhaust b1 samples -> P0014/P0015 pass event." UBYTE NO_COMPU_METHOD 0 0 0 255 ECU_ADDRESS 0x40001C0D /end MEASUREMENT
/begin MEASUREMENT obd_ii_vvt_inlet_b2_in_range_count "Consecutive in-range inlet b2 samples -> P0021/P0022 pass event." UBYTE NO_COMPU_METHOD 0 0 0 255 ECU_ADDRESS 0x40001C0E /end MEASUREMENT
/begin MEASUREMENT obd_ii_vvt_exhaust_b2_in_range_count "Consecutive in-range exhaust b2 samples -> P0024/P0025 pass event." UBYTE NO_COMPU_METHOD 0 0 0 255 ECU_ADDRESS 0x40001C0F /end MEASUREMENT
/begin MEASUREMENT obd_ii_p0420_health "Debounce health for P0420: reset to its CAL debounce count, decremented on failing samples; DTC fails at 0." UBYTE NO_COMPU_METHOD 0 0 0 255 ECU_ADDRESS 0x40001C10 /end MEASUREMENT
/begin MEASUREMENT obd_ii_p0430_health "Debounce health for P0430: reset to its CAL debounce count, decremented on failing samples; DTC fails at 0." UBYTE NO_COMPU_METHOD 0 0 0 255 ECU_ADDRESS 0x40001C11 /end MEASUREMENT
/begin MEASUREMENT cat_monitor_min_maf_accum_thresh_ "undefined1" UBYTE NO_COMPU_METHOD 0 0 0 255 ECU_ADDRESS 0x40001C12 /end MEASUREMENT
/begin MEASUREMENT obd_ii_cat_precat_sum_b1 "Sum of LEA_cat_o2_accum_b1_precat[] for the efficiency ratio." UWORD NO_COMPU_METHOD 0 0 0 65535 ECU_ADDRESS 0x40001C14 /end MEASUREMENT
/begin MEASUREMENT obd_ii_cat_precat_sum_b2 "Sum of LEA_cat_o2_accum_b2_precat[]." UWORD NO_COMPU_METHOD 0 0 0 65535 ECU_ADDRESS 0x40001C16 /end MEASUREMENT
/begin MEASUREMENT obd_ii_cat_postcat_sum_b1 "Sum of LEA_cat_o2_accum_b1_postcat[]; ratio = post*1000/pre." UWORD NO_COMPU_METHOD 0 0 0 65535 ECU_ADDRESS 0x40001C18 /end MEASUREMENT
/begin MEASUREMENT obd_ii_cat_postcat_sum_b2 "Sum of LEA_cat_o2_accum_b2_postcat[]." UWORD NO_COMPU_METHOD 0 0 0 65535 ECU_ADDRESS 0x40001C1A /end MEASUREMENT
/begin MEASUREMENT obd_ii_cat_post_dfco_holdoff_prescaler "Cat monitor post-DFCO hold-off prescaler countdown (CAL_obd_ii_cat_mon_post_dfco_holdoff_prescaler)." UBYTE NO_COMPU_METHOD 0 0 0 255 ECU_ADDRESS 0x40001C1C /end MEASUREMENT
/begin MEASUREMENT obd_ii_cat_dfco_time_max "Longest DFCO seen (dfco_active_time_5ms max); non-zero blocks the cat monitor until it decays." UWORD CM_u8_time_5ms 0 0 0 327675 ECU_ADDRESS 0x40001C1E /end MEASUREMENT
/begin MEASUREMENT obd_ii_cat_tps_settle_timer "Settle countdown after a TPS transient (CAL_obd_ii_o2_tps_transient_settle_ticks)." UWORD NO_COMPU_METHOD 0 0 0 65535 ECU_ADDRESS 0x40001C20 /end MEASUREMENT
/begin MEASUREMENT obd_ii_cat_precat_accum_b1_copy "Snapshot of LEA_cat_o2_accum_b1_precat." ULONG NO_COMPU_METHOD 0 0 0 4294967295 ECU_ADDRESS 0x40001C24 /end MEASUREMENT
/begin MEASUREMENT obd_ii_cat_postcat_accum_b1_copy "Snapshot of LEA_cat_o2_accum_b1_postcat." ULONG NO_COMPU_METHOD 0 0 0 4294967295 ECU_ADDRESS 0x40001C28 /end MEASUREMENT
/begin MEASUREMENT obd_ii_cat_precat_accum_b2_copy "Snapshot of LEA_cat_o2_accum_b2_precat." ULONG NO_COMPU_METHOD 0 0 0 4294967295 ECU_ADDRESS 0x40001C2C /end MEASUREMENT
/begin MEASUREMENT obd_ii_cat_postcat_accum_b2_copy "Snapshot of LEA_cat_o2_accum_b2_postcat." ULONG NO_COMPU_METHOD 0 0 0 4294967295 ECU_ADDRESS 0x40001C30 /end MEASUREMENT
/begin MEASUREMENT obd_ii_postcat_o2_mean_b2 "float" ULONG NO_COMPU_METHOD 0 0 0 4294967295 ECU_ADDRESS 0x40001C34 /end MEASUREMENT
/begin MEASUREMENT obd_ii_postcat_o2_mean_b1 "Post-cat O2 bank-1 mean (x0xa00)." ULONG NO_COMPU_METHOD 0 0 0 4294967295 ECU_ADDRESS 0x40001C38 /end MEASUREMENT
/begin MEASUREMENT obd_ii_cat_monitor_count_b2_post "Catalyst monitor count (bank 2, post)." UWORD NO_COMPU_METHOD 0 0 0 65535 ECU_ADDRESS 0x40001C3C /end MEASUREMENT
/begin MEASUREMENT obd_ii_cat_monitor_count_b1_post "Catalyst monitor count (bank 1, post)." UWORD NO_COMPU_METHOD 0 0 0 65535 ECU_ADDRESS 0x40001C3E /end MEASUREMENT
/begin MEASUREMENT obd_ii_p0430_status "P0430 catalyst bank-2 test state bits." UWORD NO_COMPU_METHOD 0 0 0 65535 ECU_ADDRESS 0x40001C40 /end MEASUREMENT
/begin MEASUREMENT obd_ii_p0420_status "P0420 catalyst bank-1 test state bits." UWORD NO_COMPU_METHOD 0 0 0 65535 ECU_ADDRESS 0x40001C42 /end MEASUREMENT
/begin MEASUREMENT obd_ii_o2_precat_sw_bank2 "uint16_t" UWORD NO_COMPU_METHOD 0 0 0 65535 ECU_ADDRESS 0x40001C44 /end MEASUREMENT
/begin MEASUREMENT obd_ii_cat_monitor_count_b1 "uint16_t" UWORD NO_COMPU_METHOD 0 0 0 65535 ECU_ADDRESS 0x40001C46 /end MEASUREMENT
/begin MEASUREMENT obd_ii_cat_monitor_threshold_current "uint16_t" UWORD NO_COMPU_METHOD 0 0 0 65535 ECU_ADDRESS 0x40001C48 /end MEASUREMENT
/begin MEASUREMENT perf_stats_rpm_max_capture "Max engine speed captured during the hold window." UWORD CM_u8_rspeed_rpm 0 0 0 65535 ECU_ADDRESS 0x40001C56 /end MEASUREMENT
/begin MEASUREMENT perf_accel_timer "0-100/0-160 km/h stopwatch (100 ms ticks, saturating 255)." UBYTE NO_COMPU_METHOD 0 0 0 255 ECU_ADDRESS 0x40001C58 /end MEASUREMENT
/begin MEASUREMENT perf_0_100kmh_time "0-100 km/h time of the current run (100 ms)." UBYTE NO_COMPU_METHOD 0 0 0 255 ECU_ADDRESS 0x40001C59 /end MEASUREMENT
/begin MEASUREMENT perf_0_160kmh_time "0-160 km/h time of the current run (100 ms)." UBYTE NO_COMPU_METHOD 0 0 0 255 ECU_ADDRESS 0x40001C5A /end MEASUREMENT
/begin MEASUREMENT perf_accel_run_flags "Perf acceleration run state bits (bit0 armed, bit1 ...)." UBYTE NO_COMPU_METHOD 0 0 0 255 ECU_ADDRESS 0x40001C5B /end MEASUREMENT
/begin MEASUREMENT low_oil_pressure_event_time "Duration of the current low-oil-pressure event (saturating)." UBYTE NO_COMPU_METHOD 0 0 0 255 ECU_ADDRESS 0x40001C5C /end MEASUREMENT
/begin MEASUREMENT high_lat_accel_event_time "Duration of the current high-lateral-accel event (saturating)." UBYTE NO_COMPU_METHOD 0 0 0 255 ECU_ADDRESS 0x40001C5D /end MEASUREMENT
/begin MEASUREMENT low_oil_pressure_event_lat_accel_peak "Peak |lat_accel| tracker for the current low-oil-pressure event (g = val/100)." SWORD CM_u8_accel_1_100g 0 0 -327.68 327.67 ECU_ADDRESS 0x40001C5E /end MEASUREMENT
/begin MEASUREMENT perf_event_lat_accel_peak "Peak |lat_accel| tracker for the current perf event (g = val/100)." SWORD CM_u8_accel_1_100g 0 0 -327.68 327.67 ECU_ADDRESS 0x40001C60 /end MEASUREMENT
/begin MEASUREMENT obd_ii_similar_cond_met_mask "Bit per similar-conditions slot whose test point has been met." UBYTE NO_COMPU_METHOD 0 0 0 255 ECU_ADDRESS 0x40001C68 /end MEASUREMENT
/begin MEASUREMENT obd_ii_mil_state_flags "MIL state: bit0/1 MIL requested (either -> mode 01 MIL bit), bit2 flash request, bit3 MIL lamp output (toggled every 5 x 100 ms to flash; read by the cluster), bit4 distance-with-MIL counting, bit5 DTC event timer active, bit6 secondary lamp (cluster" UWORD NO_COMPU_METHOD 0 0 0 65535 ECU_ADDRESS 0x40001C6A /end MEASUREMENT
/begin MEASUREMENT ips_tcu_lamp_request "Byte 2 of CAN 0x250 from the IPS TCU: bit0 = request MIL on, bit1 = request the secondary lamp (IPS-coded cars only); zeroed on CAN timeout." UBYTE NO_COMPU_METHOD 0 0 0 255 ECU_ADDRESS 0x40001C6C /end MEASUREMENT
/begin MEASUREMENT obd_ii_engine_coolant_temp "OBD-II: engine coolant temperature (°C = val−40)." UBYTE CM_u8_temp__40c 0 0 -40 215 ECU_ADDRESS 0x40001C6D /end MEASUREMENT
/begin MEASUREMENT obd_ii_dtc_state "DTC processing state machine index (obd_ii_set_dtc_processing)." UBYTE NO_COMPU_METHOD 0 0 0 255 ECU_ADDRESS 0x40001C6E /end MEASUREMENT
/begin MEASUREMENT obd_ii_clear_dtc_request "OBD-II: clear DTC request (boolean flag)." UBYTE NO_COMPU_METHOD 0 0 0 255 ECU_ADDRESS 0x40001C6F /end MEASUREMENT
/begin MEASUREMENT obd_ii_dtc_current_decimal "obd_ii_dtc_unpack(obd_ii_dtc_current_raw): decimal code, e.g. P0171 = 171, U0122 = 30122." UWORD NO_COMPU_METHOD 0 0 0 65535 ECU_ADDRESS 0x40001C70 /end MEASUREMENT
/begin MEASUREMENT obd_ii_dtc_pending_decimal "obd_ii_dtc_unpack(obd_ii_dtc_pending_raw)." UWORD NO_COMPU_METHOD 0 0 0 65535 ECU_ADDRESS 0x40001C72 /end MEASUREMENT
/begin MEASUREMENT engine_has_run "Non-zero once the engine has run this ignition cycle." UBYTE NO_COMPU_METHOD 0 0 0 255 ECU_ADDRESS 0x40001C74 /end MEASUREMENT
/begin MEASUREMENT obd_ii_warmup_ready "uint8_t" UBYTE NO_COMPU_METHOD 0 0 0 255 ECU_ADDRESS 0x40001C75 /end MEASUREMENT
/begin MEASUREMENT obd_ii_dtc_event_timer_100ms "Loaded with CAL_obd_ii_countdown_unknown*10 on DTC set / similar-conditions clear; -1 per 100 ms; obd_ii_update_states acts while non-zero." UWORD CM_u8_time_100ms 0 0 0 6553500 ECU_ADDRESS 0x40001C76 /end MEASUREMENT
/begin MEASUREMENT obd_ii_drive_cycle_complete "1 when the drive-cycle timers below have all expired (runtime, time above speed, idle time); enables DTC aging in mode 01 processing." UBYTE NO_COMPU_METHOD 0 0 0 255 ECU_ADDRESS 0x40001C78 /end MEASUREMENT
/begin MEASUREMENT obd_ii_engine_has_run_latched "engine_has_run latched at mode-01 DTC processing." UBYTE NO_COMPU_METHOD 0 0 0 255 ECU_ADDRESS 0x40001C79 /end MEASUREMENT
/begin MEASUREMENT obd_ii_monitors_completed_this_drive_cycle "OBD-II: monitors completed this drive cycle." UBYTE NO_COMPU_METHOD 0 0 0 255 ECU_ADDRESS 0x40001C7A /end MEASUREMENT
/begin MEASUREMENT obd_ii_dtc_process_first_pass "Set on the first mode-01 DTC processing pass." UBYTE NO_COMPU_METHOD 0 0 0 255 ECU_ADDRESS 0x40001C7B /end MEASUREMENT
/begin MEASUREMENT obd_ii_mil_flash_counter "100 ms ticks in the MIL flash cycle (toggle every 5; 29/30 for the readiness-display pattern at key-on)." UBYTE NO_COMPU_METHOD 0 0 0 255 ECU_ADDRESS 0x40001C7C /end MEASUREMENT
/begin MEASUREMENT obd_ii_dtc_display_divider "Calls between DTC list rotation steps (10)." UBYTE NO_COMPU_METHOD 0 0 0 255 ECU_ADDRESS 0x40001C7E /end MEASUREMENT
/begin MEASUREMENT obd_ii_dtc_current_index "Index into obd_ii_dtc_current[] of the code shown in obd_ii_DTC_current." UBYTE NO_COMPU_METHOD 0 0 0 255 ECU_ADDRESS 0x40001C7F /end MEASUREMENT
/begin MEASUREMENT obd_ii_dtc_confirmed_index "Index into obd_ii_DTC_confirmed[] of the code shown in obd_ii_DTC_confirmed_text." UBYTE NO_COMPU_METHOD 0 0 0 255 ECU_ADDRESS 0x40001C80 /end MEASUREMENT
/begin MEASUREMENT obd_ii_dtc_pending_index "Index into obd_ii_dtc_pending[] of the code shown in obd_ii_DTC_pending." UBYTE NO_COMPU_METHOD 0 0 0 255 ECU_ADDRESS 0x40001C81 /end MEASUREMENT
/begin MEASUREMENT obd_ii_dtc_permanent_index "Index (0..7) into LEA_obd_ii_permanent_dtc[] of the code shown in obd_ii_perm_dtc." UBYTE NO_COMPU_METHOD 0 0 0 255 ECU_ADDRESS 0x40001C82 /end MEASUREMENT
/begin MEASUREMENT obd_ii_distance_since_clear_frac "Sub-km accumulator for obd_ii_distance_since_codes_cleared_km: += car_speed_x100/360 per 100 ms (10 cm units); at 10000 (1 km) the km counter increments." UWORD CM_u16_distance_10cm 0 0 0 655350 ECU_ADDRESS 0x40001C84 /end MEASUREMENT
/begin MEASUREMENT obd_ii_warmup_counted "1 once this drive cycle has been counted in obd_ii_warmups_since_code_cleared." UBYTE NO_COMPU_METHOD 0 0 0 255 ECU_ADDRESS 0x40001C86 /end MEASUREMENT
/begin MEASUREMENT obd_ii_drive_cycle_idle_timer "Countdown of continuous idle time (CAL_obd_ii_drive_cycle_idle_time); reloaded if moving with rpm above the idle target by CAL_obd_ii_monitor_rpm_delta_max." UWORD CM_u8_time_100ms 0 0 0 6553500 ECU_ADDRESS 0x40001C88 /end MEASUREMENT
/begin MEASUREMENT obd_ii_drive_cycle_runtime_timer "Countdown of engine running time (CAL_obd_ii_drive_cycle_runtime)." UWORD CM_u8_time_100ms 0 0 0 6553500 ECU_ADDRESS 0x40001C8A /end MEASUREMENT
/begin MEASUREMENT obd_ii_drive_cycle_speed_timer "Countdown of time at or above CAL_obd_ii_drive_cycle_car_speed_min (CAL_obd_ii_gd_speed_time)." UWORD CM_u8_time_100ms 0 0 0 6553500 ECU_ADDRESS 0x40001C8C /end MEASUREMENT
/begin MEASUREMENT obd_ii_dtc_current_raw "Packed DTC (letter<<14 | BCD) currently shown from the current list." UWORD NO_COMPU_METHOD 0 0 0 65535 ECU_ADDRESS 0x40001C8E /end MEASUREMENT
/begin MEASUREMENT obd_ii_dtc_confirmed_raw "Packed DTC currently shown from the confirmed list." UWORD NO_COMPU_METHOD 0 0 0 65535 ECU_ADDRESS 0x40001C90 /end MEASUREMENT
/begin MEASUREMENT obd_ii_dtc_permanent_raw "Packed DTC currently shown from the permanent list." UWORD NO_COMPU_METHOD 0 0 0 65535 ECU_ADDRESS 0x40001C92 /end MEASUREMENT
/begin MEASUREMENT obd_ii_dtc_pending_raw "Packed DTC currently shown from the pending list." UWORD NO_COMPU_METHOD 0 0 0 65535 ECU_ADDRESS 0x40001C94 /end MEASUREMENT
/begin MEASUREMENT obd_ii_dtc_confirmed_decimal "obd_ii_dtc_unpack(obd_ii_dtc_confirmed_raw)." UWORD NO_COMPU_METHOD 0 0 0 65535 ECU_ADDRESS 0x40001C96 /end MEASUREMENT
/begin MEASUREMENT obd_ii_dtc_permanent_decimal "obd_ii_dtc_unpack(obd_ii_dtc_permanent_raw)." UWORD NO_COMPU_METHOD 0 0 0 65535 ECU_ADDRESS 0x40001C98 /end MEASUREMENT
/begin MEASUREMENT freeze_frame_dtc "DTC being captured into the freeze frame." ULONG NO_COMPU_METHOD 0 0 0 4294967295 ECU_ADDRESS 0x40001CA4 /end MEASUREMENT
/begin MEASUREMENT freeze_frame_dtc_config "Config byte of the DTC being captured into the freeze frame." UBYTE NO_COMPU_METHOD 0 0 0 255 ECU_ADDRESS 0x40001CA8 /end MEASUREMENT
/begin MEASUREMENT o2_sensor_fault_detected "Set to 1 by o2_sensor_fault_detection when a heater/circuit fault is reported." UBYTE NO_COMPU_METHOD 0 0 0 255 ECU_ADDRESS 0x40001CB0 /end MEASUREMENT
/begin MEASUREMENT obd_ii_p0122_health "Health for P0122 (TPS1 low): seeded CAL_obd_ii_P0122_debounce_count, 0 on fail. Was latch_counter_p0122." UBYTE NO_COMPU_METHOD 0 0 0 255 ECU_ADDRESS 0x40001CB8 /end MEASUREMENT
/begin MEASUREMENT obd_ii_p0123_health "Health for P0123 (TPS1 high). Was latch_counter_p0123." UBYTE NO_COMPU_METHOD 0 0 0 255 ECU_ADDRESS 0x40001CB9 /end MEASUREMENT
/begin MEASUREMENT obd_ii_p0222_health "Health for P0222 (TPS2 low). Was latch_counter_p0222." UBYTE NO_COMPU_METHOD 0 0 0 255 ECU_ADDRESS 0x40001CBA /end MEASUREMENT
/begin MEASUREMENT obd_ii_p0223_health "Health for P0223 (TPS2 high). Was latch_counter_p0223." UBYTE NO_COMPU_METHOD 0 0 0 255 ECU_ADDRESS 0x40001CBB /end MEASUREMENT
/begin MEASUREMENT obd_ii_throttle_model_health "Health of the throttle actuator model monitor (obd_ii_throttle_actuator_model_monitor_200hz): seeded/limited by CAL_tps_obd_throttle_monitor_pass_threshold; 0 sets engine_state_failure_flags bit16. Was obd_ii_throttle_monitor_pass_counter." UBYTE NO_COMPU_METHOD 0 0 0 255 ECU_ADDRESS 0x40001CBC /end MEASUREMENT
/begin MEASUREMENT obd_ii_p2119_health "Health for P2119 (throttle body range/performance). Was obd_ii_P2119_not_failed." UBYTE NO_COMPU_METHOD 0 0 0 255 ECU_ADDRESS 0x40001CBD /end MEASUREMENT
/begin MEASUREMENT obd_ii_p2173_health "Health for P2173 (high airflow / load plausibility): +1 per pass window to CAL_obd_ii_P2173_fail_count, -1 per fail window, fails at 0. Was obd_ii_P2173_fail_countdown." UBYTE NO_COMPU_METHOD 0 0 0 255 ECU_ADDRESS 0x40001CBE /end MEASUREMENT
/begin MEASUREMENT obd_ii_p2135_health "Health for P2135 (TPS1/TPS2 correlation). Was obd_ii_P2135_not_failed." UBYTE NO_COMPU_METHOD 0 0 0 255 ECU_ADDRESS 0x40001CBF /end MEASUREMENT
/begin MEASUREMENT obd_ii_p2104_health "Health for P2104 (throttle forced idle: actuator state >= TSL_FAULT or control mode >= severe fault)." UBYTE NO_COMPU_METHOD 0 0 0 255 ECU_ADDRESS 0x40001CC0 /end MEASUREMENT
/begin MEASUREMENT obd_ii_p1104_health "Health for P1104 (ETB / HC08 state mismatch)." UBYTE NO_COMPU_METHOD 0 0 0 255 ECU_ADDRESS 0x40001CC1 /end MEASUREMENT
/begin MEASUREMENT obd_ii_p2105_health "Health for P2105 (throttle forced engine shutdown: TSL_SHUTDOWN)." UBYTE NO_COMPU_METHOD 0 0 0 255 ECU_ADDRESS 0x40001CC2 /end MEASUREMENT
/begin MEASUREMENT obd_ii_p2106_health "Health for P2106 (throttle forced limited power: pedal or TPS degraded)." UBYTE NO_COMPU_METHOD 0 0 0 255 ECU_ADDRESS 0x40001CC3 /end MEASUREMENT
/begin MEASUREMENT obd_ii_p2107_health "Health for P2107 (throttle control module processor, hc08_obd_flags bits 6/7)." UBYTE NO_COMPU_METHOD 0 0 0 255 ECU_ADDRESS 0x40001CC4 /end MEASUREMENT
/begin MEASUREMENT obd_ii_p2100_health "Health for P2100 (ETB motor circuit open, etb_driver_diag_latched bit4)." UBYTE NO_COMPU_METHOD 0 0 0 255 ECU_ADDRESS 0x40001CC5 /end MEASUREMENT
/begin MEASUREMENT obd_ii_p2102_health "Health for P2102 (ETB motor circuit low, bit3)." UBYTE NO_COMPU_METHOD 0 0 0 255 ECU_ADDRESS 0x40001CC6 /end MEASUREMENT
/begin MEASUREMENT obd_ii_p2103_health "Health for P2103 (ETB motor circuit high, bit2)." UBYTE NO_COMPU_METHOD 0 0 0 255 ECU_ADDRESS 0x40001CC7 /end MEASUREMENT
/begin MEASUREMENT obd_ii_p2108_health "Health for P2108 (ETB motor control module performance, bit0)." UBYTE NO_COMPU_METHOD 0 0 0 255 ECU_ADDRESS 0x40001CC8 /end MEASUREMENT
/begin MEASUREMENT etb_module_fault_latched "Set when P2107 fails; blocks normal ETB control in tps_control_1000hz." UBYTE NO_COMPU_METHOD 0 0 0 255 ECU_ADDRESS 0x40001CC9 /end MEASUREMENT
/begin MEASUREMENT obd_ii_throttle_model_fail_ticks "Fail-sample counter of the throttle actuator model monitor; decrements obd_ii_throttle_model_health. Was obd_ii_throttle_monitor_fail_debounce." UWORD NO_COMPU_METHOD 0 0 0 65535 ECU_ADDRESS 0x40001CCA /end MEASUREMENT
/begin MEASUREMENT obd_ii_p2173_debounce_ticks "P2173 window counter (100 ms ticks): +1 per implausible sample, at CAL_obd_ii_P2173_load_difference_max -> health-1; in a pass window counts down to 0 before health+1. Was typed u16_load_mg/stroke." SWORD NO_COMPU_METHOD 0 0 -32768 32767 ECU_ADDRESS 0x40001CCC /end MEASUREMENT
/begin MEASUREMENT obd_ii_p2107_fail_ticks "Consecutive P2107 failing samples; at obd_ii_monitor_debounce_ticks decrements obd_ii_p2107_health." UWORD NO_COMPU_METHOD 0 0 0 65535 ECU_ADDRESS 0x40001CCE /end MEASUREMENT
/begin MEASUREMENT obd_ii_p1106_health "Health for P1106 (left-foot-braking strategy, lfb_state_flags bit3)." UBYTE NO_COMPU_METHOD 0 0 0 255 ECU_ADDRESS 0x40001CD0 /end MEASUREMENT
/begin MEASUREMENT hc08_sf_mode_duration "Time in HC08 safety-fallback mode (hc08_obd_flags bit4), 100 ms; its max is kept in LEA_hc08_sf_mode_max_duration." UWORD CM_u8_time_100ms 0 0 0 6553500 ECU_ADDRESS 0x40001CD2 /end MEASUREMENT
/begin MEASUREMENT obd_ii_p2173_load_delta_min "CAL_load_plausibility_test_delta[rpm, tps]*2: minimum load excess over alpha-N for the sample to count as plausible (mg/stroke)." UWORD CM_u8_load_mg_stroke 0 0 0 65535 ECU_ADDRESS 0x40001CD4 /end MEASUREMENT
/begin MEASUREMENT obd_ii_p2173_maf_load_delta "load_measured_maf - load_alphaN_expected (mg/stroke, signed)." SLONG NO_COMPU_METHOD 0 0 -2147483648 2147483647 ECU_ADDRESS 0x40001CD8 /end MEASUREMENT
/begin MEASUREMENT obd_ii_p2173_sd_load_delta "load_from_speed_density - load_alphaN_expected (mg/stroke, signed)." SLONG NO_COMPU_METHOD 0 0 -2147483648 2147483647 ECU_ADDRESS 0x40001CDC /end MEASUREMENT
/begin MEASUREMENT obd_ii_throttle_model_velocity "Throttle model velocity (obd_ii_throttle_actuator_model_monitor_200hz)." SWORD NO_COMPU_METHOD 0 0 -32768 32767 ECU_ADDRESS 0x40001CE0 /end MEASUREMENT
/begin MEASUREMENT obd_ii_throttle_model_error "Throttle model position error (model - measured)." SWORD NO_COMPU_METHOD 0 0 -32768 32767 ECU_ADDRESS 0x40001CE2 /end MEASUREMENT
/begin MEASUREMENT obd_ii_throttle_monitor_blank_timer "Throttle model monitor blanking countdown (CAL_tps_obd_throttle_monitor_blank_time)." UBYTE NO_COMPU_METHOD 0 0 0 255 ECU_ADDRESS 0x40001CE4 /end MEASUREMENT
/begin MEASUREMENT evap_vent_valve_closed "1 = evap canister vent valve commanded closed (leak test)." UBYTE NO_COMPU_METHOD 0 0 0 255 ECU_ADDRESS 0x40001CE8 /end MEASUREMENT
/begin MEASUREMENT obd_ii_p0441_health "Debounce health for P0441: reset to its CAL debounce count, decremented on failing samples; DTC fails at 0." UBYTE NO_COMPU_METHOD 0 0 0 255 ECU_ADDRESS 0x40001CE9 /end MEASUREMENT
/begin MEASUREMENT obd_ii_p0446_health "Debounce health for P0446: reset to its CAL debounce count, decremented on failing samples; DTC fails at 0." UBYTE NO_COMPU_METHOD 0 0 0 255 ECU_ADDRESS 0x40001CEA /end MEASUREMENT
/begin MEASUREMENT evap_canister_purge_solenoid_timer "Evap purge solenoid test countdown." UBYTE CM_u8_time_100ms 0 0 0 25500 ECU_ADDRESS 0x40001CEB /end MEASUREMENT
/begin MEASUREMENT evap_purge_load_min_selected "Minimum load for the purge-flow test (CAL_evap_purge_min_load or _active)." UBYTE CM_u8_load_4mg_stroke 0 0 0 1020 ECU_ADDRESS 0x40001CEC /end MEASUREMENT
/begin MEASUREMENT evap_purge_flow_state_timer "Evap purge flow test state countdown (decremented in evap_leak_detection_timers_decrement_100ms)." UBYTE CM_u8_time_100ms 0 0 0 25500 ECU_ADDRESS 0x40001CED /end MEASUREMENT
/begin MEASUREMENT evap_purge_flow_test_state "Purge-flow test sub-state (0, 2, 4)." UBYTE NO_COMPU_METHOD 0 0 0 255 ECU_ADDRESS 0x40001CEE /end MEASUREMENT
/begin MEASUREMENT evap_purge_flow_test_result "Purge-flow test result state (0 idle, 1-2 running, 3 pass, 4 abort)." UBYTE NO_COMPU_METHOD 0 0 0 255 ECU_ADDRESS 0x40001CEF /end MEASUREMENT
/begin MEASUREMENT evap_vent_control_timer "Evap vent control test countdown." UBYTE CM_u8_time_100ms 0 0 0 25500 ECU_ADDRESS 0x40001CF0 /end MEASUREMENT
/begin MEASUREMENT evap_purge_stuck_open_test_count "Stuck-open test passes remaining (CAL_evap_purge_stuck_open_test_passes)." UBYTE NO_COMPU_METHOD 0 0 0 255 ECU_ADDRESS 0x40001CF1 /end MEASUREMENT
/begin MEASUREMENT obd_ii_p0335_health "Debounce health for P0335: reset to its CAL debounce count, decremented on failing samples; DTC fails at 0." UBYTE NO_COMPU_METHOD 0 0 0 255 ECU_ADDRESS 0x40001CF8 /end MEASUREMENT
/begin MEASUREMENT obd_ii_p0341_health "Debounce health for P0341: reset to CAL_obd_ii_P0341_debounce_count; +1 per pass (to the CAL), -1 per fail event; the DTC fails at 0." UBYTE NO_COMPU_METHOD 0 0 0 255 ECU_ADDRESS 0x40001CF9 /end MEASUREMENT
/begin MEASUREMENT obd_ii_p0346_health "Debounce health for P0346: reset to CAL_obd_ii_P0346_debounce_count; +1 per pass (to the CAL), -1 per fail event; the DTC fails at 0." UBYTE NO_COMPU_METHOD 0 0 0 255 ECU_ADDRESS 0x40001CFA /end MEASUREMENT
/begin MEASUREMENT obd_ii_p0366_health "Debounce health for P0366: reset to CAL_obd_ii_P0366_debounce_count; +1 per pass (to the CAL), -1 per fail event; the DTC fails at 0." UBYTE NO_COMPU_METHOD 0 0 0 255 ECU_ADDRESS 0x40001CFB /end MEASUREMENT
/begin MEASUREMENT obd_ii_p0391_health "Debounce health for P0391: reset to CAL_obd_ii_P0391_debounce_count; +1 per pass (to the CAL), -1 per fail event; the DTC fails at 0." UBYTE NO_COMPU_METHOD 0 0 0 255 ECU_ADDRESS 0x40001CFC /end MEASUREMENT
/begin MEASUREMENT obd_ii_p0500_health "Debounce health for P0500: reset to CAL_obd_ii_P0500_debounce_count; +1 per passing sample (to the CAL), -1 per obd_ii_monitor_debounce_ticks failing samples; the DTC fails when it reaches 0." UBYTE NO_COMPU_METHOD 0 0 0 255 ECU_ADDRESS 0x40001CFD /end MEASUREMENT
/begin MEASUREMENT vss_monitor_flags "Vehicle-speed-sensor monitor state bits (P0500). Was car_speed_flags_unknown." UBYTE NO_COMPU_METHOD 0 0 0 255 ECU_ADDRESS 0x40001CFE /end MEASUREMENT
/begin MEASUREMENT obd_ii_p0500_test_timer "P0500 test window countdown (CAL_obd_ii_P0500_test_time)." UWORD CM_u8_time_100ms 0 0 0 6553500 ECU_ADDRESS 0x40001D00 /end MEASUREMENT
/begin MEASUREMENT obd_ii_p0500_debounce_ticks "P0500 up/down debounce ticks (reload CAL_obd_ii_monitor_debounce_cycles)." UWORD NO_COMPU_METHOD 0 0 0 65535 ECU_ADDRESS 0x40001D02 /end MEASUREMENT
/begin MEASUREMENT vss_monitor_speed_max "Maximum car_speed_u8 seen by the P0500 monitor." UBYTE CM_u8_speed_kph 0 0 0 255 ECU_ADDRESS 0x40001D04 /end MEASUREMENT
/begin MEASUREMENT cl_state_flags_bank1 "uint16_t" UWORD NO_COMPU_METHOD 0 0 0 65535 ECU_ADDRESS 0x40001D08 /end MEASUREMENT
/begin MEASUREMENT cl_state_flags_bank2 "uint16_t" UWORD NO_COMPU_METHOD 0 0 0 65535 ECU_ADDRESS 0x40001D0A /end MEASUREMENT
/begin MEASUREMENT stft_bank1 "Short-term fuel trim bank1 (val/20)." SWORD CM_i16_factor_1_20 0 0 -163840 163835 ECU_ADDRESS 0x40001D0C /end MEASUREMENT
/begin MEASUREMENT stft_bank2 "Short-term fuel trim bank2 (val/20)." SWORD CM_i16_factor_1_20 0 0 -163840 163835 ECU_ADDRESS 0x40001D0E /end MEASUREMENT
/begin MEASUREMENT cl_status_bank1 "Closed-loop status bank1." UWORD NO_COMPU_METHOD 0 0 0 65535 ECU_ADDRESS 0x40001D10 /end MEASUREMENT
/begin MEASUREMENT cl_status_bank2 "Closed-loop status bank2." UWORD NO_COMPU_METHOD 0 0 0 65535 ECU_ADDRESS 0x40001D12 /end MEASUREMENT
/begin MEASUREMENT stft_filtered_bank1 "Bank-1 STFT low-pass filtered (fuel learn)." SWORD NO_COMPU_METHOD 0 0 -32768 32767 ECU_ADDRESS 0x40001D14 /end MEASUREMENT
/begin MEASUREMENT stft_filtered_bank2 "Bank-2 STFT low-pass filtered (fuel learn)." SWORD NO_COMPU_METHOD 0 0 -32768 32767 ECU_ADDRESS 0x40001D16 /end MEASUREMENT
/begin MEASUREMENT ltft_bank1 "Long-term fuel trim bank1 (% = val/10)." SWORD CM_u16_factor_1_1000 0 0 -3276.8 3276.7 ECU_ADDRESS 0x40001D18 /end MEASUREMENT
/begin MEASUREMENT ltft_bank2 "Long-term fuel trim bank2 (% = val/10)." SWORD CM_u16_factor_1_1000 0 0 -3276.8 3276.7 ECU_ADDRESS 0x40001D1A /end MEASUREMENT
/begin MEASUREMENT fuel_learn_timer "Fuel learn timer (ms = val*100)." UWORD CM_u8_time_100ms 0 0 0 6553500 ECU_ADDRESS 0x40001D1C /end MEASUREMENT
/begin MEASUREMENT obd_ii_fuel_trim_offidle_time_bank1 "Bank-1 time in the off-idle fuel-trim zone (P0171/P0172)." UWORD CM_u8_time_100ms 0 0 0 6553500 ECU_ADDRESS 0x40001D1E /end MEASUREMENT
/begin MEASUREMENT obd_ii_fuel_trim_offidle_time_bank2 "Bank-2 time in the off-idle fuel-trim zone." UWORD CM_u8_time_100ms 0 0 0 6553500 ECU_ADDRESS 0x40001D20 /end MEASUREMENT
/begin MEASUREMENT obd_ii_fuel_trim_idle_time_bank1 "Bank-1 time in the idle fuel-trim zone." UWORD CM_u8_time_100ms 0 0 0 6553500 ECU_ADDRESS 0x40001D22 /end MEASUREMENT
/begin MEASUREMENT obd_ii_fuel_trim_idle_time_bank2 "Bank-2 time in the idle fuel-trim zone." UWORD CM_u8_time_100ms 0 0 0 6553500 ECU_ADDRESS 0x40001D24 /end MEASUREMENT
/begin MEASUREMENT obd_ii_fuel_trim_zone3_time_bank1 "Bank-1 time in fuel-trim zone 3." UWORD CM_u8_time_100ms 0 0 0 6553500 ECU_ADDRESS 0x40001D26 /end MEASUREMENT
/begin MEASUREMENT obd_ii_fuel_trim_zone3_time_bank2 "Bank-2 time in fuel-trim zone 3." UWORD CM_u8_time_100ms 0 0 0 6553500 ECU_ADDRESS 0x40001D28 /end MEASUREMENT
/begin MEASUREMENT cl_proportional_gain_lean "Closed-loop proportional step applied on a lean O2 switch." UWORD NO_COMPU_METHOD 0 0 0 65535 ECU_ADDRESS 0x40001D2A /end MEASUREMENT
/begin MEASUREMENT cl_proportional_gain_rich "Closed-loop proportional step applied on a rich O2 switch." UWORD NO_COMPU_METHOD 0 0 0 65535 ECU_ADDRESS 0x40001D2C /end MEASUREMENT
/begin MEASUREMENT cl_jump_lean "Closed-loop integral gain (val/20)." SWORD CM_i16_factor_1_20 0 0 -163840 163835 ECU_ADDRESS 0x40001D2E /end MEASUREMENT
/begin MEASUREMENT cl_jump_rich "Closed-loop derivative gain (val/20)." SWORD CM_i16_factor_1_20 0 0 -163840 163835 ECU_ADDRESS 0x40001D30 /end MEASUREMENT
/begin MEASUREMENT closedloop_activate_time "Closedloop activate time (ms = val*5)." UWORD CM_u8_time_5ms 0 0 0 327675 ECU_ADDRESS 0x40001D32 /end MEASUREMENT
/begin MEASUREMENT stft_ramp_rate_bank1 "Bank-1 STFT ramp rate per step." SWORD NO_COMPU_METHOD 0 0 -32768 32767 ECU_ADDRESS 0x40001D34 /end MEASUREMENT
/begin MEASUREMENT stft_ramp_rate_bank2 "Bank-2 STFT ramp rate per step." SWORD NO_COMPU_METHOD 0 0 -32768 32767 ECU_ADDRESS 0x40001D36 /end MEASUREMENT
/begin MEASUREMENT closed_loop_active_bank1 "bool" UBYTE NO_COMPU_METHOD 0 0 0 255 ECU_ADDRESS 0x40001D38 /end MEASUREMENT
/begin MEASUREMENT closed_loop_active_bank2 "bool" UBYTE NO_COMPU_METHOD 0 0 0 255 ECU_ADDRESS 0x40001D39 /end MEASUREMENT
/begin MEASUREMENT stft_ramp_timer_bank1 "Bank-1 STFT ramp interval countdown (200 Hz)." SWORD NO_COMPU_METHOD 0 0 -32768 32767 ECU_ADDRESS 0x40001D3A /end MEASUREMENT
/begin MEASUREMENT o2_switch_counter_bank1 "O2 switch counter bank1." UWORD NO_COMPU_METHOD 0 0 0 65535 ECU_ADDRESS 0x40001D3C /end MEASUREMENT
/begin MEASUREMENT stft_ramp_timer_bank2 "Bank-2 STFT ramp interval countdown (200 Hz)." SWORD NO_COMPU_METHOD 0 0 -32768 32767 ECU_ADDRESS 0x40001D3E /end MEASUREMENT
/begin MEASUREMENT o2_switch_counter_bank2 "O2 switch counter bank2." UWORD NO_COMPU_METHOD 0 0 0 65535 ECU_ADDRESS 0x40001D40 /end MEASUREMENT
/begin MEASUREMENT stft_filter_q8_bank1 "Bank-1 STFT IIR accumulator (<<8). Was stft_filter_accum_bank1." SLONG NO_COMPU_METHOD 0 0 -2147483648 2147483647 ECU_ADDRESS 0x40001D44 /end MEASUREMENT
/begin MEASUREMENT stft_filter_q8_bank2 "Bank-2 STFT IIR accumulator (<<8). Was stft_filter_accum_bank2." SLONG NO_COMPU_METHOD 0 0 -2147483648 2147483647 ECU_ADDRESS 0x40001D48 /end MEASUREMENT
/begin MEASUREMENT o2_threshold_lean "Pre-cat O2 lean switch threshold (CAL_closedloop_o2_sensor_threshold_lean)." UWORD CM_u16_voltage_5_1023v 0 0 0 320.307917888563 ECU_ADDRESS 0x40001D4C /end MEASUREMENT
/begin MEASUREMENT o2_threshold_rich "Pre-cat O2 rich switch threshold (CAL_closedloop_o2_sensor_threshold_rich)." UWORD CM_u16_voltage_5_1023v 0 0 0 320.307917888563 ECU_ADDRESS 0x40001D4E /end MEASUREMENT
/begin MEASUREMENT fuel_learn_step_timer_bank1 "Bank-1 fuel-learn step countdown (CAL_inj_fuel_learn_step_period + zone delay)." UBYTE CM_u8_time_100ms 0 0 0 25500 ECU_ADDRESS 0x40001D50 /end MEASUREMENT
/begin MEASUREMENT fuel_learn_step_timer_bank2 "Bank-2 fuel-learn step countdown." UBYTE CM_u8_time_100ms 0 0 0 25500 ECU_ADDRESS 0x40001D51 /end MEASUREMENT
/begin MEASUREMENT fuel_learning_zone "uint8_t" UBYTE NO_COMPU_METHOD 0 0 0 255 ECU_ADDRESS 0x40001D52 /end MEASUREMENT
/begin MEASUREMENT cl_cross_bank_check_enabled "Closed-loop cross-bank check countdown." UBYTE NO_COMPU_METHOD 0 0 0 255 ECU_ADDRESS 0x40001D53 /end MEASUREMENT
/begin MEASUREMENT cl_cross_bank_fault "Closed-loop cross-bank fault bits." UWORD NO_COMPU_METHOD 0 0 0 65535 ECU_ADDRESS 0x40001D54 /end MEASUREMENT
/begin MEASUREMENT o2_switch_count_threshold "O2 switch count threshold (CAL x5)." UWORD NO_COMPU_METHOD 0 0 0 65535 ECU_ADDRESS 0x40001D56 /end MEASUREMENT
/begin MEASUREMENT stft_at_o2_rich_switch_bank1 "Bank-1 STFT at the last rich O2 switch." SWORD NO_COMPU_METHOD 0 0 -32768 32767 ECU_ADDRESS 0x40001D58 /end MEASUREMENT
/begin MEASUREMENT stft_at_o2_rich_switch_bank2 "Bank-2 STFT at the last rich O2 switch." SWORD NO_COMPU_METHOD 0 0 -32768 32767 ECU_ADDRESS 0x40001D5A /end MEASUREMENT
/begin MEASUREMENT stft_bank_sync_hold_timer_bank1 "Bank-1 STFT bank-sync hold countdown." SWORD NO_COMPU_METHOD 0 0 -32768 32767 ECU_ADDRESS 0x40001D5C /end MEASUREMENT
/begin MEASUREMENT stft_bank_sync_hold_timer_bank2 "Bank-2 STFT bank-sync hold countdown." SWORD NO_COMPU_METHOD 0 0 -32768 32767 ECU_ADDRESS 0x40001D5E /end MEASUREMENT
/begin MEASUREMENT fuel_learn_zone1_delay_bank1 "Bank-1 delay before zone-1 learning (CAL_inj_fuel_learn_zone_step_delay[0])." UBYTE CM_u8_time_100ms 0 0 0 25500 ECU_ADDRESS 0x40001D60 /end MEASUREMENT
/begin MEASUREMENT fuel_learn_zone2_delay_bank1 "Bank-1 delay before zone-2 learning (CAL_inj_fuel_learn_zone_step_delay[1])." UBYTE CM_u8_time_100ms 0 0 0 25500 ECU_ADDRESS 0x40001D61 /end MEASUREMENT
/begin MEASUREMENT fuel_learn_zone3_delay_bank1 "Bank-1 delay before zone-3 learning (CAL_inj_fuel_learn_zone_step_delay[2])." UBYTE CM_u8_time_100ms 0 0 0 25500 ECU_ADDRESS 0x40001D62 /end MEASUREMENT
/begin MEASUREMENT fuel_learn_zone1_delay_bank2 "Bank-2 delay before zone-1 learning." UBYTE CM_u8_time_100ms 0 0 0 25500 ECU_ADDRESS 0x40001D63 /end MEASUREMENT
/begin MEASUREMENT fuel_learn_zone2_delay_bank2 "Bank-2 delay before zone-2 learning." UBYTE CM_u8_time_100ms 0 0 0 25500 ECU_ADDRESS 0x40001D64 /end MEASUREMENT
/begin MEASUREMENT fuel_learn_zone3_delay_bank2 "Bank-2 delay before zone-3 learning." UBYTE CM_u8_time_100ms 0 0 0 25500 ECU_ADDRESS 0x40001D65 /end MEASUREMENT
/begin MEASUREMENT stft_increment_timer_bank1 "Short-term fuel trim increment timer bank1 (ms = val*5)." UBYTE CM_u8_time_5ms 0 0 0 1275 ECU_ADDRESS 0x40001D66 /end MEASUREMENT
/begin MEASUREMENT stft_increment_timer_bank2 "Short-term fuel trim increment timer bank2 (ms = val*5)." UBYTE CM_u8_time_5ms 0 0 0 1275 ECU_ADDRESS 0x40001D67 /end MEASUREMENT
/begin MEASUREMENT obd_ii_p0171_health "Debounce health for P0171: reset to its CAL debounce count, decremented on failing samples; DTC fails at 0." UBYTE NO_COMPU_METHOD 0 0 0 255 ECU_ADDRESS 0x40001D68 /end MEASUREMENT
/begin MEASUREMENT obd_ii_p0172_health "Debounce health for P0172: reset to its CAL debounce count, decremented on failing samples; DTC fails at 0." UBYTE NO_COMPU_METHOD 0 0 0 255 ECU_ADDRESS 0x40001D69 /end MEASUREMENT
/begin MEASUREMENT obd_ii_p0174_health "Debounce health for P0174: reset to its CAL debounce count, decremented on failing samples; DTC fails at 0." UBYTE NO_COMPU_METHOD 0 0 0 255 ECU_ADDRESS 0x40001D6A /end MEASUREMENT
/begin MEASUREMENT obd_ii_p0175_health "Debounce health for P0175: reset to its CAL debounce count, decremented on failing samples; DTC fails at 0." UBYTE NO_COMPU_METHOD 0 0 0 255 ECU_ADDRESS 0x40001D6B /end MEASUREMENT
/begin MEASUREMENT obd_ii_p2191_health "Debounce health for P2191: reset to its CAL debounce count, decremented on failing samples; DTC fails at 0." UBYTE NO_COMPU_METHOD 0 0 0 255 ECU_ADDRESS 0x40001D6C /end MEASUREMENT
/begin MEASUREMENT obd_ii_p2193_health "Debounce health for P2193: reset to its CAL debounce count, decremented on failing samples; DTC fails at 0." UBYTE NO_COMPU_METHOD 0 0 0 255 ECU_ADDRESS 0x40001D6D /end MEASUREMENT
/begin MEASUREMENT fuel_trim_monitor_ready_flags "Fuel-trim monitor zone completion bits (0x3f = all zones done)." UBYTE NO_COMPU_METHOD 0 0 0 255 ECU_ADDRESS 0x40001D6E /end MEASUREMENT
/begin MEASUREMENT o2_imbalance_afr_delta "|AFR(now) - AFR(previous sample)| from the pre-cat O2 (imbalance monitor)." UWORD CM_u16_afr_1_100 0 0 0 655.35 ECU_ADDRESS 0x40001D70 /end MEASUREMENT
/begin MEASUREMENT o2_imbalance_afr_now "AFR from CAL_sensor_o2_afr_diag_scaling at the current O2 voltage." UWORD CM_u16_afr_1_100 0 0 0 655.35 ECU_ADDRESS 0x40001D72 /end MEASUREMENT
/begin MEASUREMENT o2_imbalance_afr_prev "AFR at the previous O2 voltage." UWORD CM_u16_afr_1_100 0 0 0 655.35 ECU_ADDRESS 0x40001D74 /end MEASUREMENT
/begin MEASUREMENT obd_ii_o2_imbalance_sample_timer "O2 imbalance sample period countdown (CAL_obd_ii_o2_imbalance_sample_period)." UBYTE CM_u8_time_ms 0 0 0 255 ECU_ADDRESS 0x40001D76 /end MEASUREMENT
/begin MEASUREMENT obd_ii_fuel_learn_inhibit_holdoff "Fuel-trim learn inhibit hold-off (CAL_obd_ii_fuel_learn_inhibit_holdoff_ticks); fuel-trim monitors wait for 0." UWORD CM_u8_time_ms 0 0 0 65535 ECU_ADDRESS 0x40001D78 /end MEASUREMENT
/begin MEASUREMENT o2_imbalance_fail_windows_b2 "Bank-2 windows above CAL_obd_ii_o2_imbalance_threshold (P219B)." UBYTE NO_COMPU_METHOD 0 0 0 255 ECU_ADDRESS 0x40001D7A /end MEASUREMENT
/begin MEASUREMENT o2_imbalance_ok_windows_b2 "Bank-2 windows below the threshold." UBYTE NO_COMPU_METHOD 0 0 0 255 ECU_ADDRESS 0x40001D7B /end MEASUREMENT
/begin MEASUREMENT o2_imbalance_metric_b2 "Bank-2 imbalance metric per window (sum*1000/samples); Mode 06 fuel-trim result 2." UWORD NO_COMPU_METHOD 0 0 0 65535 ECU_ADDRESS 0x40001D7C /end MEASUREMENT
/begin MEASUREMENT o2_imbalance_samples_b2 "Bank-2 samples in the current window (to CAL_obd_ii_o2_imbalance_sample_total)." UWORD NO_COMPU_METHOD 0 0 0 65535 ECU_ADDRESS 0x40001D7E /end MEASUREMENT
/begin MEASUREMENT o2_imbalance_sum_b2 "Bank-2 sum of |dAFR| in the current window." ULONG NO_COMPU_METHOD 0 0 0 4294967295 ECU_ADDRESS 0x40001D80 /end MEASUREMENT
/begin MEASUREMENT o2_imbalance_volt_last_b2 "Bank-2 previous pre-cat O2 voltage (ADC ch 0x17)." UWORD CM_u16_voltage_5_1023v 0 0 0 320.307917888563 ECU_ADDRESS 0x40001D84 /end MEASUREMENT
/begin MEASUREMENT o2_imbalance_fail_windows_b1 "Bank-1 windows above CAL_obd_ii_o2_imbalance_threshold (P219A)." UBYTE NO_COMPU_METHOD 0 0 0 255 ECU_ADDRESS 0x40001D86 /end MEASUREMENT
/begin MEASUREMENT o2_imbalance_ok_windows_b1 "Bank-1 windows below the threshold." UBYTE NO_COMPU_METHOD 0 0 0 255 ECU_ADDRESS 0x40001D87 /end MEASUREMENT
/begin MEASUREMENT o2_imbalance_metric_b1 "Bank-1 imbalance metric per window; Mode 06 fuel-trim result 1." UWORD NO_COMPU_METHOD 0 0 0 65535 ECU_ADDRESS 0x40001D88 /end MEASUREMENT
/begin MEASUREMENT o2_imbalance_samples_b1 "Bank-1 samples in the current window." UWORD NO_COMPU_METHOD 0 0 0 65535 ECU_ADDRESS 0x40001D8A /end MEASUREMENT
/begin MEASUREMENT o2_imbalance_sum_b1 "Bank-1 sum of |dAFR| in the current window." ULONG NO_COMPU_METHOD 0 0 0 4294967295 ECU_ADDRESS 0x40001D8C /end MEASUREMENT
/begin MEASUREMENT o2_imbalance_volt_last_b1 "Bank-1 previous pre-cat O2 voltage (ADC ch 0x16)." UWORD CM_u16_voltage_5_1023v 0 0 0 320.307917888563 ECU_ADDRESS 0x40001D90 /end MEASUREMENT
/begin MEASUREMENT obd_ii_p2192_rich_timer_a "P2192 rich confirmation countdown (CAL_obd_ii_P2192_rich_confirm_time)." UBYTE CM_u8_time_100ms 0 0 0 25500 ECU_ADDRESS 0x40001D92 /end MEASUREMENT
/begin MEASUREMENT obd_ii_p2192_rich_timer_b "P2192 rich confirmation countdown (second sensor)." UBYTE CM_u8_time_100ms 0 0 0 25500 ECU_ADDRESS 0x40001D93 /end MEASUREMENT
/begin MEASUREMENT obd_ii_p2191_lean_timer_a "P2191 lean confirmation countdown (CAL_obd_ii_P2191_lean_confirm_time)." UBYTE CM_u8_time_100ms 0 0 0 25500 ECU_ADDRESS 0x40001D94 /end MEASUREMENT
/begin MEASUREMENT obd_ii_p2191_lean_timer_b "P2191 lean confirmation countdown (second sensor)." UBYTE CM_u8_time_100ms 0 0 0 25500 ECU_ADDRESS 0x40001D95 /end MEASUREMENT
/begin MEASUREMENT o2_imbalance_status_b2 "Bank-2 imbalance monitor bits: bit0 enabled, bit1 window done, bit2 fail, bit3 pass." UBYTE NO_COMPU_METHOD 0 0 0 255 ECU_ADDRESS 0x40001D96 /end MEASUREMENT
/begin MEASUREMENT o2_imbalance_status_b1 "Bank-1 imbalance monitor bits: bit0 enabled, bit1 window done, bit2 fail, bit3 pass." UBYTE NO_COMPU_METHOD 0 0 0 255 ECU_ADDRESS 0x40001D97 /end MEASUREMENT
/begin MEASUREMENT throttle_actuator_init_status "Cleared in throttle_actuator_init." UWORD NO_COMPU_METHOD 0 0 0 65535 ECU_ADDRESS 0x40001D98 /end MEASUREMENT
/begin MEASUREMENT hc08_remote_comm_fault_count "HC08 remote communication fault count (hc08_obd_flags bit7), saturating." UWORD NO_COMPU_METHOD 0 0 0 65535 ECU_ADDRESS 0x40001D9A /end MEASUREMENT
/begin MEASUREMENT hc08_comm_event_count "HC08 communication event count (saturating)." UWORD NO_COMPU_METHOD 0 0 0 65535 ECU_ADDRESS 0x40001D9C /end MEASUREMENT
/begin MEASUREMENT throttle_monitor5_max_ticks "u16_count" UWORD NO_COMPU_METHOD 0 0 0 65535 ECU_ADDRESS 0x40001D9E /end MEASUREMENT
/begin MEASUREMENT throttle_uptime_max_ticks "u16_count" UWORD NO_COMPU_METHOD 0 0 0 65535 ECU_ADDRESS 0x40001DA0 /end MEASUREMENT
/begin MEASUREMENT timer_unused_40001da2 "Decremented at 200 Hz but never loaded or read elsewhere." UWORD CM_u8_time_5ms 0 0 0 327675 ECU_ADDRESS 0x40001DA2 /end MEASUREMENT
/begin MEASUREMENT hc08_send_timer "Hc08 send timer (ms = val*5)." UWORD CM_u8_time_5ms 0 0 0 327675 ECU_ADDRESS 0x40001DA4 /end MEASUREMENT
/begin MEASUREMENT throttle_control_mode "Throttle control mode (enumerated state)." UBYTE NO_COMPU_METHOD 0 0 0 255 ECU_ADDRESS 0x40001DA8 /end MEASUREMENT
/begin MEASUREMENT throttle_control_flags "Throttle control state bits." UBYTE NO_COMPU_METHOD 0 0 0 255 ECU_ADDRESS 0x40001DA9 /end MEASUREMENT
/begin MEASUREMENT tps_commanded_hc08 "u8_factor_1/255" UBYTE CM_u8_factor_1_255 0 0 0 100 ECU_ADDRESS 0x40001DAA /end MEASUREMENT
/begin MEASUREMENT engine_operating_state_flags "uint16_t" UWORD NO_COMPU_METHOD 0 0 0 65535 ECU_ADDRESS 0x40001DB0 /end MEASUREMENT
/begin MEASUREMENT obd_ii_idle_speed_target_total "OBD-II: idle speed target total (RPM)." UWORD CM_u8_rspeed_rpm 0 0 0 65535 ECU_ADDRESS 0x40001DB2 /end MEASUREMENT
/begin MEASUREMENT idle_speed_target_base "Idle target rpm without dashpot / car-speed / pedal adders (idle()); used for rpm-above-idle tests." UWORD CM_u8_rspeed_rpm 0 0 0 65535 ECU_ADDRESS 0x40001DB4 /end MEASUREMENT
/begin MEASUREMENT idle_speed_target_pedal_comp "Idle target incl. idle_comp_accel_pedal_pos*4 (driveaway target)." UWORD CM_u8_rspeed_rpm 0 0 0 65535 ECU_ADDRESS 0x40001DB6 /end MEASUREMENT
/begin MEASUREMENT idle_speed_error_pedal_comp "engine_speed_16bit - idle_speed_target_pedal_comp (RPM, signed). Axis for CAL_ign_comp_idle_error_driveaway. Was idle_speed_error_tps_compensated." SWORD CM_u8_rspeed_rpm 0 0 -32768 32767 ECU_ADDRESS 0x40001DB8 /end MEASUREMENT
/begin MEASUREMENT obd_ii_idle_speed_error "engine_speed_16bit - obd_ii_idle_speed_target_total (RPM, signed)." SWORD CM_u8_rspeed_rpm 0 0 -32768 32767 ECU_ADDRESS 0x40001DBA /end MEASUREMENT
/begin MEASUREMENT obd_ii_idle_air_output "Idle air output: sum of idle airflow terms in 10 mg/s (clamped 5100 = 51 g/s). Was typed 100 mg/s." UWORD CM_u16_flow_10mg_s 0 0 0 655350 ECU_ADDRESS 0x40001DBC /end MEASUREMENT
/begin MEASUREMENT idle_air_control_proportional_term "Idle air PI proportional term (CAL_idle_air_control_proportional[speed error]) (10 mg/s)." SWORD NO_COMPU_METHOD 0 0 -32768 32767 ECU_ADDRESS 0x40001DBE /end MEASUREMENT
/begin MEASUREMENT idle_air_control_integral_term "Idle air PI integral accumulator (>>10 -> 10 mg/s)." SLONG NO_COMPU_METHOD 0 0 -2147483648 2147483647 ECU_ADDRESS 0x40001DC0 /end MEASUREMENT
/begin MEASUREMENT obd_ii_idle_status "Idle state: 0 not idle, 1 just started (low air since start), 2 integral out of range, 3 stable, 4 stable for 30 s. Reported in mode 22." UBYTE NO_COMPU_METHOD 0 0 0 255 ECU_ADDRESS 0x40001DC4 /end MEASUREMENT
/begin MEASUREMENT idle_tps_from_airflow "Idle throttle position computed from the idle airflow target." UWORD CM_u16_factor_1_1023 0 0 0 6406.15835777126 ECU_ADDRESS 0x40001DC6 /end MEASUREMENT
/begin MEASUREMENT idle_tps_minimum "Minimum idle throttle position (lookup x4)." UWORD CM_u16_factor_1_1023 0 0 0 6406.15835777126 ECU_ADDRESS 0x40001DC8 /end MEASUREMENT
/begin MEASUREMENT idle_air_flow_decayed "Peak-hold of idle_air_target_flow (max 51 g/s) decaying by CAL_idle_air_fast_decay_step per period; feeds the idle throttle-area calc (mg/s = val*10)." UWORD CM_u16_flow_10mg_s 0 0 0 655350 ECU_ADDRESS 0x40001DCA /end MEASUREMENT
/begin MEASUREMENT idle_stabilization_timer "Time at idle (engine_operating_state_flags&8), +1 per 100 ms, saturates 255." UBYTE CM_u8_time_100ms 0 0 0 25500 ECU_ADDRESS 0x40001DCC /end MEASUREMENT
/begin MEASUREMENT idle_low_carspeed_timer "500 ms ticks at idle with car speed between CAL_idle_low_car_speed_enter/exit. Was timer_above_min_carspeed." UBYTE NO_COMPU_METHOD 0 0 0 255 ECU_ADDRESS 0x40001DCD /end MEASUREMENT
/begin MEASUREMENT idle_comp_clutch_antistall "Clutch anti-stall idle air adder (CAL_idle_clutch_antistall_comp scaled by speed below threshold)." UWORD CM_u16_flow_10mg_s 0 0 0 655350 ECU_ADDRESS 0x40001DCE /end MEASUREMENT
/begin MEASUREMENT idle_comp_steering "Steering load idle air adder (CAL_idle_comp_steering[|steering angle|])." UWORD CM_u16_flow_10mg_s 0 0 0 655350 ECU_ADDRESS 0x40001DD0 /end MEASUREMENT
/begin MEASUREMENT idle_dashpot_air_adder "Idle air added after a high-rpm transient (CAL_idle_high_rpm_transient_air_comp*10), decays by CAL_idle_high_rpm_transient_air_decay_step (mg/s = val*10)." UWORD CM_u16_flow_10mg_s 0 0 0 655350 ECU_ADDRESS 0x40001DD2 /end MEASUREMENT
/begin MEASUREMENT idle_comp_moving_blend_rpm_high "u16_rspeed_rpm" UWORD CM_u8_rspeed_rpm 0 0 0 65535 ECU_ADDRESS 0x40001DD4 /end MEASUREMENT
/begin MEASUREMENT idle_control_entry_rpm "u16_rspeed_rpm" UWORD CM_u8_rspeed_rpm 0 0 0 65535 ECU_ADDRESS 0x40001DD6 /end MEASUREMENT
/begin MEASUREMENT idle_control_exit_rpm "Idle target + CAL_idle_unknown3*8: above this idle control exits." UWORD CM_u8_rspeed_rpm 0 0 0 65535 ECU_ADDRESS 0x40001DD8 /end MEASUREMENT
/begin MEASUREMENT idle_control_low_rpm "Idle target + CAL_idle_unknown4*8: below this the low-rpm branch runs." UWORD CM_u8_rspeed_rpm 0 0 0 65535 ECU_ADDRESS 0x40001DDA /end MEASUREMENT
/begin MEASUREMENT idle_comp_ecu_voltage "Idle air adder from CAL_idle_comp_ecu_voltage (offset-binary, clamped +-0x500) (10 mg/s)." SWORD NO_COMPU_METHOD 0 0 -32768 32767 ECU_ADDRESS 0x40001DDC /end MEASUREMENT
/begin MEASUREMENT idle_integral_update_timer_ms "1 kHz countdown (reload CAL_idle_integral_update_period) between idle integral updates." UWORD NO_COMPU_METHOD 0 0 0 65535 ECU_ADDRESS 0x40001DDE /end MEASUREMENT
/begin MEASUREMENT idle_air_p_term_raw "CAL_idle_air_control_proportional[speed error] (offset-binary, +-0x500) (10 mg/s)." SWORD NO_COMPU_METHOD 0 0 -32768 32767 ECU_ADDRESS 0x40001DE0 /end MEASUREMENT
/begin MEASUREMENT idle_error_correction "CAL_idle_error_correction_unknown[speed error] (offset-binary, +-0x9f6) (10 mg/s)." SWORD NO_COMPU_METHOD 0 0 -32768 32767 ECU_ADDRESS 0x40001DE2 /end MEASUREMENT
/begin MEASUREMENT idle_comp_carspeed_decaying "Idle compensation carspeed decaying (RPM)." UWORD CM_u8_rspeed_rpm 0 0 0 65535 ECU_ADDRESS 0x40001DE4 /end MEASUREMENT
/begin MEASUREMENT idle_comp_vehicle_speed "Idle air adder from CAL_idle_comp_vehicle_speed_ips/_manual (max 0x9f6)." UWORD CM_u16_flow_10mg_s 0 0 0 655350 ECU_ADDRESS 0x40001DE6 /end MEASUREMENT
/begin MEASUREMENT idle_comp_ac "A/C idle air adder (max 2550)." UWORD CM_u16_flow_10mg_s 0 0 0 655350 ECU_ADDRESS 0x40001DE8 /end MEASUREMENT
/begin MEASUREMENT idle_comp_fan "Fan idle air adder (max 0x9f6)." UWORD CM_u16_flow_10mg_s 0 0 0 655350 ECU_ADDRESS 0x40001DEA /end MEASUREMENT
/begin MEASUREMENT idle_comp_hot_soak "Hot-soak idle air adder from CAL_idle_air_hot_soak_comp[engine-bay fan run time]." UWORD CM_u16_flow_10mg_s 0 0 0 655350 ECU_ADDRESS 0x40001DEC /end MEASUREMENT
/begin MEASUREMENT idle_comp_baro "Idle air adder from CAL_idle_comp_baro2[baro] (offset-binary, +-0x500) (10 mg/s)." SWORD NO_COMPU_METHOD 0 0 -32768 32767 ECU_ADDRESS 0x40001DEE /end MEASUREMENT
/begin MEASUREMENT idle_airflow_expected "Expected idle airflow (max 0x9f6)." UWORD CM_u16_flow_10mg_s 0 0 0 655350 ECU_ADDRESS 0x40001DF0 /end MEASUREMENT
/begin MEASUREMENT idle_air_warmup_factor "Lookup result of CAL_idle_air_warmup_factor_ips." UBYTE CM_u8_factor_1_64 0 0 0 398.4375 ECU_ADDRESS 0x40001DF2 /end MEASUREMENT
/begin MEASUREMENT idle_air_comp_while_moving "u16_flow_100mg/s" UWORD CM_u8_flow_100mg_s 0 0 0 6553500 ECU_ADDRESS 0x40001DF4 /end MEASUREMENT
/begin MEASUREMENT idle_manifold_vacuum "Manifold vacuum used for the idle throttle-area calc (0x3ff when invalid)." UWORD CM_i16_pressure_mbar 0 0 0 65535 ECU_ADDRESS 0x40001DF6 /end MEASUREMENT
/begin MEASUREMENT idle_dashpot_rpm_lift "Idle target rpm lift (dashpot) after a high-rpm transient, decays in idle_airflow_decay_manager (RPM). Was idle_comp_high_rpm_transient." UWORD CM_u8_rspeed_rpm 0 0 0 65535 ECU_ADDRESS 0x40001DF8 /end MEASUREMENT
/begin MEASUREMENT idle_comp_misc_air "Idle air adder (max 0x9f6) summed into obd_ii_idle_air_output." UWORD CM_u16_flow_10mg_s 0 0 0 655350 ECU_ADDRESS 0x40001DFA /end MEASUREMENT
/begin MEASUREMENT idle_air_base "Base idle airflow term (max 0x9f6) summed into obd_ii_idle_air_output." UWORD CM_u16_flow_10mg_s 0 0 0 655350 ECU_ADDRESS 0x40001DFC /end MEASUREMENT
/begin MEASUREMENT idle_comp_failed_cylinder_misfire "Idle compensation failed cylinder misfire (mg/s = val*10)." UWORD CM_u16_flow_10mg_s 0 0 0 655350 ECU_ADDRESS 0x40001DFE /end MEASUREMENT
/begin MEASUREMENT idle_corrected_airflow "Idle airflow corrected for density (max 0x13ec); axis of the idle throttle-area lookup." UWORD CM_u16_flow_10mg_s 0 0 0 655350 ECU_ADDRESS 0x40001E00 /end MEASUREMENT
/begin MEASUREMENT idle_air_low_load_cam_active "bool" UBYTE NO_COMPU_METHOD 0 0 0 255 ECU_ADDRESS 0x40001E02 /end MEASUREMENT
/begin MEASUREMENT idle_air_fast_decay_flag "bool" UBYTE NO_COMPU_METHOD 0 0 0 255 ECU_ADDRESS 0x40001E03 /end MEASUREMENT
/begin MEASUREMENT idle_strategy "Idle strategy (enumerated state)." UBYTE NO_COMPU_METHOD 0 0 0 255 ECU_ADDRESS 0x40001E04 /end MEASUREMENT
/begin MEASUREMENT idle_rolling_target_delta "u16_rspeed_rpm" UWORD CM_u8_rspeed_rpm 0 0 0 65535 ECU_ADDRESS 0x40001E06 /end MEASUREMENT
/begin MEASUREMENT idle_clutch_antistall_inhibit "1 = clutch anti-stall adder inhibited." UBYTE NO_COMPU_METHOD 0 0 0 255 ECU_ADDRESS 0x40001E08 /end MEASUREMENT
/begin MEASUREMENT idle_strategy_prev "idle_strategy at the previous pass (slewed target reset on change)." UBYTE NO_COMPU_METHOD 0 0 0 255 ECU_ADDRESS 0x40001E09 /end MEASUREMENT
/begin MEASUREMENT idle_comp_decay_step_timer "u8_time_ms" UBYTE CM_u8_time_ms 0 0 0 255 ECU_ADDRESS 0x40001E0A /end MEASUREMENT
/begin MEASUREMENT idle_air_decay_step_timer "Countdown (1 kHz) between idle_air_flow_decayed steps: CAL_idle_air_decay_period[flow] or the fast period." UBYTE CM_u8_time_ms 0 0 0 255 ECU_ADDRESS 0x40001E0B /end MEASUREMENT
/begin MEASUREMENT idle_comp_decay_step "Car-speed / dashpot rpm decay step (CAL_idle_carspeed_comp_decay_step[_ac]) (RPM)." UBYTE CM_u8_rspeed_rpm 0 0 0 255 ECU_ADDRESS 0x40001E0C /end MEASUREMENT
/begin MEASUREMENT idle_comp_accel_pedal_pos "Idle compensation accelerator pedal position (RPM = val*4)." UBYTE CM_u8_rspeed_4rpm 0 0 0 1020 ECU_ADDRESS 0x40001E0D /end MEASUREMENT
/begin MEASUREMENT idle_comp_timer_carspeed "Idle compensation timer carspeed (RPM)." UWORD CM_u8_rspeed_rpm 0 0 0 65535 ECU_ADDRESS 0x40001E0E /end MEASUREMENT
/begin MEASUREMENT idle_comp_iat "Idle compensation intake air temp (RPM)." UBYTE CM_u8_rspeed_rpm 0 0 0 255 ECU_ADDRESS 0x40001E10 /end MEASUREMENT
/begin MEASUREMENT idle_rolling_target_delta_slewed "u16_rspeed_rpm" UWORD CM_u8_rspeed_rpm 0 0 0 65535 ECU_ADDRESS 0x40001E12 /end MEASUREMENT
/begin MEASUREMENT idle_comp_car_speed "Idle compensation car speed (RPM)." UWORD CM_u8_rspeed_rpm 0 0 0 65535 ECU_ADDRESS 0x40001E14 /end MEASUREMENT
/begin MEASUREMENT idle_air_target_flow "obd_ii_idle_air_output (+ moving comp) (mg/s = val*10). Was typed 100 mg/s." UWORD CM_u16_flow_10mg_s 0 0 0 655350 ECU_ADDRESS 0x40001E16 /end MEASUREMENT
/begin MEASUREMENT idle_dashpot_rpm_lift_max "CAL_idle_dashpot_rpm_lift_max[rpm]*10 (RPM). Normalises the dashpot spark comp. Was idle_comp_high_rpm_transient_max." UWORD CM_u8_rspeed_rpm 0 0 0 65535 ECU_ADDRESS 0x40001E18 /end MEASUREMENT
/begin MEASUREMENT idle_manifold_pressure_ratio "Manifold pressure ratio term for the idle throttle-area lookup." UWORD CM_i16_pressure_mbar 0 0 0 65535 ECU_ADDRESS 0x40001E1A /end MEASUREMENT
/begin MEASUREMENT idle_tps_requested "Idle throttle position requested (val/1023)." UWORD CM_u16_factor_1_1023 0 0 0 6406.15835777126 ECU_ADDRESS 0x40001E1C /end MEASUREMENT
/begin MEASUREMENT obd_ii_p0506_health "Debounce health for P0506: reset to its CAL debounce count, decremented on failing samples; DTC fails at 0." UBYTE NO_COMPU_METHOD 0 0 0 255 ECU_ADDRESS 0x40001E20 /end MEASUREMENT
/begin MEASUREMENT obd_ii_p0507_health "Debounce health for P0507: reset to its CAL debounce count, decremented on failing samples; DTC fails at 0." UBYTE NO_COMPU_METHOD 0 0 0 255 ECU_ADDRESS 0x40001E21 /end MEASUREMENT
/begin MEASUREMENT obd_ii_p050a_health "Debounce health for P050A: reset to its CAL debounce count, decremented on failing samples; DTC fails at 0." UBYTE NO_COMPU_METHOD 0 0 0 255 ECU_ADDRESS 0x40001E22 /end MEASUREMENT
/begin MEASUREMENT obd_ii_p0506_fail_ticks "Idle speed low failing samples for P0506; at CAL_obd_ii_idle_error_fail_count decrements obd_ii_p0506_health." UBYTE NO_COMPU_METHOD 0 0 0 255 ECU_ADDRESS 0x40001E23 /end MEASUREMENT
/begin MEASUREMENT obd_ii_p0507_fail_ticks "Idle speed high failing samples for P0507; at CAL_obd_ii_idle_error_fail_count decrements obd_ii_p0507_health." UBYTE NO_COMPU_METHOD 0 0 0 255 ECU_ADDRESS 0x40001E24 /end MEASUREMENT
/begin MEASUREMENT obd_ii_p050a_fail_ticks "Idle speed cold-start failing samples for P050A; at CAL_obd_ii_idle_error_fail_count decrements obd_ii_p050a_health." UBYTE NO_COMPU_METHOD 0 0 0 255 ECU_ADDRESS 0x40001E25 /end MEASUREMENT
/begin MEASUREMENT obd_ii_p050a_fail_ticks_2 "Idle speed cold-start (2) failing samples for P050A; at CAL_obd_ii_idle_error_fail_count decrements obd_ii_p050a_health." UBYTE NO_COMPU_METHOD 0 0 0 255 ECU_ADDRESS 0x40001E26 /end MEASUREMENT
/begin MEASUREMENT obd_ii_p0507_fail_ticks_2 "Idle speed high (2) failing samples for P0507; at CAL_obd_ii_idle_error_fail_count decrements obd_ii_p0507_health." UBYTE NO_COMPU_METHOD 0 0 0 255 ECU_ADDRESS 0x40001E27 /end MEASUREMENT
/begin MEASUREMENT knock_ign_retard_octane_sum "Sum of ign_knock_retard_octane[6] (deg = val/4). Was knock_ign_retard_sum." UWORD CM_u8_angle_1_4deg 0 0 0 16383.75 ECU_ADDRESS 0x40001E3E /end MEASUREMENT
/begin MEASUREMENT knock_flags "Knock control state bits." UBYTE NO_COMPU_METHOD 0 0 0 255 ECU_ADDRESS 0x40001E40 /end MEASUREMENT
/begin MEASUREMENT knock_sampling_window_offset "Lookup result of CAL_knock_sampling_window." UBYTE NO_COMPU_METHOD 0 0 0 255 ECU_ADDRESS 0x40001E41 /end MEASUREMENT
/begin MEASUREMENT knock_baseline_update_pending "1 while the knock baseline update for the current cylinder is pending." UBYTE NO_COMPU_METHOD 0 0 0 255 ECU_ADDRESS 0x40001E42 /end MEASUREMENT
/begin MEASUREMENT knock_baseline_sample_counter "Knock baseline sample counter (wraps at 2000)." UWORD NO_COMPU_METHOD 0 0 0 65535 ECU_ADDRESS 0x40001E44 /end MEASUREMENT
/begin MEASUREMENT knock_noise_half_sum "Sum of knock_noise_half_per_cyl." UWORD NO_COMPU_METHOD 0 0 0 65535 ECU_ADDRESS 0x40001E4E /end MEASUREMENT
/begin MEASUREMENT ign_adv_delta_to_knock_safe "Ignition adv delta to knock safe (° = val/4)." SWORD CM_u8_angle_1_4deg 0 0 -8192 8191.75 ECU_ADDRESS 0x40001E50 /end MEASUREMENT
/begin MEASUREMENT knock_inhibit_timer_tps_rate "Knock inhibit timer throttle position rate (ms = val*5)." UBYTE CM_u8_time_5ms 0 0 0 1275 ECU_ADDRESS 0x40001E52 /end MEASUREMENT
/begin MEASUREMENT octane_scaler_current_min "Octane scaler current minimum." UWORD NO_COMPU_METHOD 0 0 0 65535 ECU_ADDRESS 0x40001E54 /end MEASUREMENT
/begin MEASUREMENT knock_trace_cylinder "Cylinder selected for the knock trace buffers." UBYTE NO_COMPU_METHOD 0 0 0 255 ECU_ADDRESS 0x40001E56 /end MEASUREMENT
/begin MEASUREMENT knock_baseline_rpm_index "Row of LEA_knock_baseline_3d = engine_speed_8bit >> 5." UBYTE NO_COMPU_METHOD 0 0 0 255 ECU_ADDRESS 0x40001E57 /end MEASUREMENT
/begin MEASUREMENT knock_baseline_load_index "Column of LEA_knock_baseline_3d = load_mass_per_stroke >> 5." UBYTE NO_COMPU_METHOD 0 0 0 255 ECU_ADDRESS 0x40001E58 /end MEASUREMENT
/begin MEASUREMENT knock_trace_index "Write index (0..10) of the knock trace buffers at 0x40004f7c / 0x40004f94." UBYTE NO_COMPU_METHOD 0 0 0 255 ECU_ADDRESS 0x40001E59 /end MEASUREMENT
/begin MEASUREMENT knock_agc_gain_select_bit1 "bool" UBYTE NO_COMPU_METHOD 0 0 0 255 ECU_ADDRESS 0x40001E5A /end MEASUREMENT
/begin MEASUREMENT knock_agc_gain_select_bit0 "bool" UBYTE NO_COMPU_METHOD 0 0 0 255 ECU_ADDRESS 0x40001E5B /end MEASUREMENT
/begin MEASUREMENT obd_ii_p0455_health "Debounce health for P0455: reset to its CAL debounce count, decremented on failing samples; DTC fails at 0." UBYTE NO_COMPU_METHOD 0 0 0 255 ECU_ADDRESS 0x40001E68 /end MEASUREMENT
/begin MEASUREMENT evap_system_state_flags "Evap system / leak monitor state bits." ULONG NO_COMPU_METHOD 0 0 0 4294967295 ECU_ADDRESS 0x40001E6C /end MEASUREMENT
/begin MEASUREMENT evap_p0441_pressure_delta "Evap pressure change during the P0441 purge-flow test (stored in LEA_obd_ii_evap_P0441_test_result)." SWORD NO_COMPU_METHOD 0 0 -32768 32767 ECU_ADDRESS 0x40001E70 /end MEASUREMENT
/begin MEASUREMENT obd_ii_system_leak_status "Evap leak test state (0..5)." UBYTE NO_COMPU_METHOD 0 0 0 255 ECU_ADDRESS 0x40001E72 /end MEASUREMENT
/begin MEASUREMENT evap_leak_decay "Pressure decay over the leak-test window (P0456/P0442 metric)." SWORD NO_COMPU_METHOD 0 0 -32768 32767 ECU_ADDRESS 0x40001E74 /end MEASUREMENT
/begin MEASUREMENT obd_ii_eval_leak_check_result "Last leak-check result (mode 22)." SWORD NO_COMPU_METHOD 0 0 -32768 32767 ECU_ADDRESS 0x40001E76 /end MEASUREMENT
/begin MEASUREMENT evap_p0456_decay_limit "P0456 decay limit lookup [fuel level, ...]." UBYTE NO_COMPU_METHOD 0 0 0 255 ECU_ADDRESS 0x40001E78 /end MEASUREMENT
/begin MEASUREMENT evap_leak_test_P0442_decay_limit "Lookup result of CAL_evap_leak_test_P0442_decay_limit." UBYTE NO_COMPU_METHOD 0 0 0 255 ECU_ADDRESS 0x40001E79 /end MEASUREMENT
/begin MEASUREMENT evap_leak_pressure_rise "Pressure rise above the vacuum start point." SWORD NO_COMPU_METHOD 0 0 -32768 32767 ECU_ADDRESS 0x40001E7A /end MEASUREMENT
/begin MEASUREMENT evap_leak_purge_duty_limit "Purge duty limit during the leak test (0xff = none)." UBYTE NO_COMPU_METHOD 0 0 0 255 ECU_ADDRESS 0x40001E7C /end MEASUREMENT
/begin MEASUREMENT evap_leak_pressure_max "Maximum evap pressure seen in the leak test." SWORD NO_COMPU_METHOD 0 0 -32768 32767 ECU_ADDRESS 0x40001E7E /end MEASUREMENT
/begin MEASUREMENT evap_leak_pressure_start "Evap pressure at the start of the decay window." SWORD NO_COMPU_METHOD 0 0 -32768 32767 ECU_ADDRESS 0x40001E80 /end MEASUREMENT
/begin MEASUREMENT evap_leak_pre_start_timer "EVAP leak test pre-start delay countdown (CAL_evap_leak_test_pre_start_delay)." UBYTE NO_COMPU_METHOD 0 0 0 255 ECU_ADDRESS 0x40001E82 /end MEASUREMENT
/begin MEASUREMENT evap_leak_purge_settle_timer "EVAP leak test purge settle countdown (CAL_evap_leak_test_purge_settle_delay)." UBYTE NO_COMPU_METHOD 0 0 0 255 ECU_ADDRESS 0x40001E83 /end MEASUREMENT
/begin MEASUREMENT evap_leak_settle_samples "EVAP leak test settle samples left (CAL_evap_leak_test_settle_samples)." UBYTE NO_COMPU_METHOD 0 0 0 255 ECU_ADDRESS 0x40001E84 /end MEASUREMENT
/begin MEASUREMENT evap_leak_stage4_dwell_timer "EVAP leak test stage 4 dwell countdown (CAL_evap_leak_test_stage4_dwell)." UBYTE NO_COMPU_METHOD 0 0 0 255 ECU_ADDRESS 0x40001E85 /end MEASUREMENT
/begin MEASUREMENT evap_leak_samples_left "EVAP leak test samples left (CAL_evap_leak_test_sample_count)." UWORD NO_COMPU_METHOD 0 0 0 65535 ECU_ADDRESS 0x40001E86 /end MEASUREMENT
/begin MEASUREMENT evap_leak_vacuum_target "Vacuum target for the leak test (P0441 delta - offset)." SWORD NO_COMPU_METHOD 0 0 -32768 32767 ECU_ADDRESS 0x40001E88 /end MEASUREMENT
/begin MEASUREMENT evap_leak_monitor_flags "Evap leak monitor state bits." UWORD NO_COMPU_METHOD 0 0 0 65535 ECU_ADDRESS 0x40001E8C /end MEASUREMENT
/begin MEASUREMENT obd_ii_p0456_health "Debounce health for P0456: reset to its CAL debounce count, decremented on failing samples; DTC fails at 0." UBYTE NO_COMPU_METHOD 0 0 0 255 ECU_ADDRESS 0x40001E90 /end MEASUREMENT
/begin MEASUREMENT obd_ii_p0442_health "Debounce health for P0442: reset to its CAL debounce count, decremented on failing samples; DTC fails at 0." UBYTE NO_COMPU_METHOD 0 0 0 255 ECU_ADDRESS 0x40001E91 /end MEASUREMENT
/begin MEASUREMENT evap_leak_idle_dwell_timer "EVAP leak test idle dwell countdown (CAL_evap_leak_test_idle_dwell)." UWORD NO_COMPU_METHOD 0 0 0 65535 ECU_ADDRESS 0x40001E92 /end MEASUREMENT
/begin MEASUREMENT evap_leak_test_delay_timer "EVAP leak test start delay (CAL_evap_leak_test_delay << 4)." UWORD NO_COMPU_METHOD 0 0 0 65535 ECU_ADDRESS 0x40001E94 /end MEASUREMENT
/begin MEASUREMENT evap_leak_purge_duty "Purge duty (evap_purge_duty_hi) latched for the pull-down rate." UBYTE NO_COMPU_METHOD 0 0 0 255 ECU_ADDRESS 0x40001E96 /end MEASUREMENT
/begin MEASUREMENT evap_leak_vacuum_decay_timer "EVAP leak vacuum-decay sample countdown (CAL_evap_leak_vacuum_decay_sample)." UWORD NO_COMPU_METHOD 0 0 0 65535 ECU_ADDRESS 0x40001E98 /end MEASUREMENT
/begin MEASUREMENT evap_leak_pulldown_ticks "Ticks spent pulling vacuum (saturating)." UBYTE NO_COMPU_METHOD 0 0 0 255 ECU_ADDRESS 0x40001E9A /end MEASUREMENT
/begin MEASUREMENT main_diagnostic_flags "Main diagnostic state bits." UWORD NO_COMPU_METHOD 0 0 0 65535 ECU_ADDRESS 0x40001EA0 /end MEASUREMENT
/begin MEASUREMENT obd_ii_p050b_fail_ticks "P050B failing samples (vs CAL_obd_ii_monitor_debounce_cycles). Was p050b_fail_cycle_counter." UWORD NO_COMPU_METHOD 0 0 0 65535 ECU_ADDRESS 0x40001EA2 /end MEASUREMENT
/begin MEASUREMENT obd_ii_p050b_health "Debounce health for P050B: reset to its CAL debounce count, decremented on failing samples; DTC fails at 0." UBYTE NO_COMPU_METHOD 0 0 0 255 ECU_ADDRESS 0x40001EA4 /end MEASUREMENT
/begin MEASUREMENT obd_ii_p2336_noactivity_ticks "Cylinder 1 knock no-activity samples; above CAL_obd_ii_knock_no_activity_count decrements obd_ii_p2336_noactivity_health." UBYTE NO_COMPU_METHOD 0 0 0 255 ECU_ADDRESS 0x40001EA5 /end MEASUREMENT
/begin MEASUREMENT obd_ii_p2336_noactivity_health "Cylinder 1 knock-sensor activity health for P2336 (to CAL_obd_ii_P2336_maturing_limit)." UBYTE NO_COMPU_METHOD 0 0 0 255 ECU_ADDRESS 0x40001EA6 /end MEASUREMENT
/begin MEASUREMENT obd_ii_p2337_noactivity_ticks "Cylinder 2 knock no-activity samples; above CAL_obd_ii_knock_no_activity_count decrements obd_ii_p2337_noactivity_health." UBYTE NO_COMPU_METHOD 0 0 0 255 ECU_ADDRESS 0x40001EA7 /end MEASUREMENT
/begin MEASUREMENT obd_ii_p2337_noactivity_health "Cylinder 2 knock-sensor activity health for P2337 (to CAL_obd_ii_P2337_maturing_limit)." UBYTE NO_COMPU_METHOD 0 0 0 255 ECU_ADDRESS 0x40001EA8 /end MEASUREMENT
/begin MEASUREMENT obd_ii_p2338_noactivity_ticks "Cylinder 3 knock no-activity samples; above CAL_obd_ii_knock_no_activity_count decrements obd_ii_p2338_noactivity_health." UBYTE NO_COMPU_METHOD 0 0 0 255 ECU_ADDRESS 0x40001EA9 /end MEASUREMENT
/begin MEASUREMENT obd_ii_p2338_noactivity_health "Cylinder 3 knock-sensor activity health for P2338 (to CAL_obd_ii_P2338_maturing_limit)." UBYTE NO_COMPU_METHOD 0 0 0 255 ECU_ADDRESS 0x40001EAA /end MEASUREMENT
/begin MEASUREMENT obd_ii_p2339_noactivity_ticks "Cylinder 4 knock no-activity samples; above CAL_obd_ii_knock_no_activity_count decrements obd_ii_p2339_noactivity_health." UBYTE NO_COMPU_METHOD 0 0 0 255 ECU_ADDRESS 0x40001EAB /end MEASUREMENT
/begin MEASUREMENT obd_ii_p2339_noactivity_health "Cylinder 4 knock-sensor activity health for P2339 (to CAL_obd_ii_P2339_maturing_limit)." UBYTE NO_COMPU_METHOD 0 0 0 255 ECU_ADDRESS 0x40001EAC /end MEASUREMENT
/begin MEASUREMENT obd_ii_p2340_noactivity_ticks "Cylinder 5 knock no-activity samples; above CAL_obd_ii_knock_no_activity_count decrements obd_ii_p2340_noactivity_health." UBYTE NO_COMPU_METHOD 0 0 0 255 ECU_ADDRESS 0x40001EAD /end MEASUREMENT
/begin MEASUREMENT obd_ii_p2340_noactivity_health "Cylinder 5 knock-sensor activity health for P2340 (to CAL_obd_ii_P2340_maturing_limit)." UBYTE NO_COMPU_METHOD 0 0 0 255 ECU_ADDRESS 0x40001EAE /end MEASUREMENT
/begin MEASUREMENT obd_ii_p2341_noactivity_ticks "Cylinder 6 knock no-activity samples; above CAL_obd_ii_knock_no_activity_count decrements obd_ii_p2341_noactivity_health." UBYTE NO_COMPU_METHOD 0 0 0 255 ECU_ADDRESS 0x40001EAF /end MEASUREMENT
/begin MEASUREMENT obd_ii_p2341_noactivity_health "Cylinder 6 knock-sensor activity health for P2341 (to CAL_obd_ii_P2341_maturing_limit)." UBYTE NO_COMPU_METHOD 0 0 0 255 ECU_ADDRESS 0x40001EB0 /end MEASUREMENT
/begin MEASUREMENT obd_ii_p2336_threshold_ticks "Cylinder 1 knock-threshold check samples (vs CAL_knock_threshold_obd_ii_check_count)." UBYTE NO_COMPU_METHOD 0 0 0 255 ECU_ADDRESS 0x40001EB1 /end MEASUREMENT
/begin MEASUREMENT obd_ii_p2336_threshold_health "Cylinder 1 knock-threshold health for P2336 (to CAL_obd_ii_P2336_maturing_limit). Was obd_ii_knock_monitor_counters." UBYTE NO_COMPU_METHOD 0 0 0 255 ECU_ADDRESS 0x40001EB2 /end MEASUREMENT
/begin MEASUREMENT obd_ii_p2337_threshold_ticks "Cylinder 2 knock-threshold check samples (vs CAL_knock_threshold_obd_ii_check_count)." UBYTE NO_COMPU_METHOD 0 0 0 255 ECU_ADDRESS 0x40001EB3 /end MEASUREMENT
/begin MEASUREMENT obd_ii_p2337_threshold_health "Cylinder 2 knock-threshold health for P2337 (to CAL_obd_ii_P2337_maturing_limit)." UBYTE NO_COMPU_METHOD 0 0 0 255 ECU_ADDRESS 0x40001EB4 /end MEASUREMENT
/begin MEASUREMENT obd_ii_p2338_threshold_ticks "Cylinder 3 knock-threshold check samples (vs CAL_knock_threshold_obd_ii_check_count)." UBYTE NO_COMPU_METHOD 0 0 0 255 ECU_ADDRESS 0x40001EB5 /end MEASUREMENT
/begin MEASUREMENT obd_ii_p2338_threshold_health "Cylinder 3 knock-threshold health for P2338 (to CAL_obd_ii_P2338_maturing_limit)." UBYTE NO_COMPU_METHOD 0 0 0 255 ECU_ADDRESS 0x40001EB6 /end MEASUREMENT
/begin MEASUREMENT obd_ii_p2339_threshold_ticks "Cylinder 4 knock-threshold check samples (vs CAL_knock_threshold_obd_ii_check_count)." UBYTE NO_COMPU_METHOD 0 0 0 255 ECU_ADDRESS 0x40001EB7 /end MEASUREMENT
/begin MEASUREMENT obd_ii_p2339_threshold_health "Cylinder 4 knock-threshold health for P2339 (to CAL_obd_ii_P2339_maturing_limit)." UBYTE NO_COMPU_METHOD 0 0 0 255 ECU_ADDRESS 0x40001EB8 /end MEASUREMENT
/begin MEASUREMENT obd_ii_p2340_threshold_ticks "Cylinder 5 knock-threshold check samples (vs CAL_knock_threshold_obd_ii_check_count)." UBYTE NO_COMPU_METHOD 0 0 0 255 ECU_ADDRESS 0x40001EB9 /end MEASUREMENT
/begin MEASUREMENT obd_ii_p2340_threshold_health "Cylinder 5 knock-threshold health for P2340 (to CAL_obd_ii_P2340_maturing_limit)." UBYTE NO_COMPU_METHOD 0 0 0 255 ECU_ADDRESS 0x40001EBA /end MEASUREMENT
/begin MEASUREMENT obd_ii_p2341_threshold_ticks "Cylinder 6 knock-threshold check samples (vs CAL_knock_threshold_obd_ii_check_count)." UBYTE NO_COMPU_METHOD 0 0 0 255 ECU_ADDRESS 0x40001EBB /end MEASUREMENT
/begin MEASUREMENT obd_ii_p2341_threshold_health "Cylinder 6 knock-threshold health for P2341 (to CAL_obd_ii_P2341_maturing_limit)." UBYTE NO_COMPU_METHOD 0 0 0 255 ECU_ADDRESS 0x40001EBC /end MEASUREMENT
/begin MEASUREMENT obd_ii_coding_check_count "Module coding / VIN monitor sample count (to 8)." UBYTE NO_COMPU_METHOD 0 0 0 255 ECU_ADDRESS 0x40001EBD /end MEASUREMENT
/begin MEASUREMENT obd_ii_knock_monitor_samples "Knock monitor samples (vs CAL_obd_ii_knock_monitor_sample_count), saturating." UWORD NO_COMPU_METHOD 0 0 0 65535 ECU_ADDRESS 0x40001EBE /end MEASUREMENT
/begin MEASUREMENT obd_ii_p0300_health "Debounce health for P0300: reset to its CAL debounce count, decremented on failing samples; DTC fails at 0." UBYTE NO_COMPU_METHOD 0 0 0 255 ECU_ADDRESS 0x40001EC0 /end MEASUREMENT
/begin MEASUREMENT obd_ii_p0301_health "Debounce health for P0301: reset to its CAL debounce count, decremented on failing samples; DTC fails at 0." UBYTE NO_COMPU_METHOD 0 0 0 255 ECU_ADDRESS 0x40001EC1 /end MEASUREMENT
/begin MEASUREMENT obd_ii_p0302_health "Debounce health for P0302: reset to its CAL debounce count, decremented on failing samples; DTC fails at 0." UBYTE NO_COMPU_METHOD 0 0 0 255 ECU_ADDRESS 0x40001EC2 /end MEASUREMENT
/begin MEASUREMENT obd_ii_p0303_health "Debounce health for P0303: reset to its CAL debounce count, decremented on failing samples; DTC fails at 0." UBYTE NO_COMPU_METHOD 0 0 0 255 ECU_ADDRESS 0x40001EC3 /end MEASUREMENT
/begin MEASUREMENT obd_ii_p0304_health "Debounce health for P0304: reset to its CAL debounce count, decremented on failing samples; DTC fails at 0." UBYTE NO_COMPU_METHOD 0 0 0 255 ECU_ADDRESS 0x40001EC4 /end MEASUREMENT
/begin MEASUREMENT obd_ii_p0305_health "Debounce health for P0305: reset to its CAL debounce count, decremented on failing samples; DTC fails at 0." UBYTE NO_COMPU_METHOD 0 0 0 255 ECU_ADDRESS 0x40001EC5 /end MEASUREMENT
/begin MEASUREMENT obd_ii_p0306_health "Debounce health for P0306: reset to its CAL debounce count, decremented on failing samples; DTC fails at 0." UBYTE NO_COMPU_METHOD 0 0 0 255 ECU_ADDRESS 0x40001EC6 /end MEASUREMENT
/begin MEASUREMENT obd_ii_p1301_health "Debounce health for P1301: reset to its CAL debounce count, decremented on failing samples; DTC fails at 0." UBYTE NO_COMPU_METHOD 0 0 0 255 ECU_ADDRESS 0x40001EC7 /end MEASUREMENT
/begin MEASUREMENT obd_ii_p1302_health "Debounce health for P1302: reset to its CAL debounce count, decremented on failing samples; DTC fails at 0." UBYTE NO_COMPU_METHOD 0 0 0 255 ECU_ADDRESS 0x40001EC8 /end MEASUREMENT
/begin MEASUREMENT misfire_threshold_current_window "Misfire cat-damage threshold for the current window (misfire_cat_damage_limit x2)." UWORD NO_COMPU_METHOD 0 0 0 65535 ECU_ADDRESS 0x40001ECA /end MEASUREMENT
/begin MEASUREMENT obd_ii_misfire_code_state "Misfire DTC evaluation state (obd_ii_set_misfire_codes)." UBYTE NO_COMPU_METHOD 0 0 0 255 ECU_ADDRESS 0x40001ECC /end MEASUREMENT
/begin MEASUREMENT misfire_min_torque_threshold "Lookup result of CAL_misfire_detect_torque_threshold." UBYTE CM_u8_torque_nm 0 0 0 255 ECU_ADDRESS 0x40001ECD /end MEASUREMENT
/begin MEASUREMENT misfire_rough_road_hold_timer "Rough-road hold countdown (CAL_misfire_rough_road_hold); misfire counting suspended while non-zero." UWORD CM_u8_time_5ms 0 0 0 327675 ECU_ADDRESS 0x40001ECE /end MEASUREMENT
/begin MEASUREMENT misfire_p1302_pass_holdoff_timer "TPS-rate misfire inhibit hold (CAL_misfire_inhibit_tps_rate_hold)." UWORD CM_u8_time_5ms 0 0 0 327675 ECU_ADDRESS 0x40001ED0 /end MEASUREMENT
/begin MEASUREMENT misfire_cyl_detect_divider "Per-cylinder misfire detection divider (reload 3)." UBYTE NO_COMPU_METHOD 0 0 0 255 ECU_ADDRESS 0x40001ED2 /end MEASUREMENT
/begin MEASUREMENT misfire_window_15s_counter "200 Hz counter to 3000 (15 s)." UWORD NO_COMPU_METHOD 0 0 0 65535 ECU_ADDRESS 0x40001ED4 /end MEASUREMENT
/begin MEASUREMENT misfire_window_3s_counter "200 Hz counter to 600 (3 s)." UWORD NO_COMPU_METHOD 0 0 0 65535 ECU_ADDRESS 0x40001ED6 /end MEASUREMENT
/begin MEASUREMENT misfire_detect_cyl_index "Cylinder index being processed by misfire_detect_per_cylinder_200hz (catches up to last_fired_cylinder)." UBYTE NO_COMPU_METHOD 0 0 0 255 ECU_ADDRESS 0x40001ED8 /end MEASUREMENT
/begin MEASUREMENT misfire_trim_ptr "Pointer to the current cylinder LEA_misfire_trim_cylN table." ULONG NO_COMPU_METHOD 0 0 0 4294967295 ECU_ADDRESS 0x40001EE4 /end MEASUREMENT
/begin MEASUREMENT misfire_wheel_speed_deviation "LF wheel speed - filtered (rough-road detection)." SLONG NO_COMPU_METHOD 0 0 -2147483648 2147483647 ECU_ADDRESS 0x40001EE8 /end MEASUREMENT
/begin MEASUREMENT misfire_wheel_speed_dev_rf "RF wheel speed - filtered (rough-road detection)." SLONG NO_COMPU_METHOD 0 0 -2147483648 2147483647 ECU_ADDRESS 0x40001EEC /end MEASUREMENT
/begin MEASUREMENT misfire_wheel_speed_dev_lr "LR wheel speed - filtered." SLONG NO_COMPU_METHOD 0 0 -2147483648 2147483647 ECU_ADDRESS 0x40001EF0 /end MEASUREMENT
/begin MEASUREMENT misfire_wheel_speed_dev_rr "RR wheel speed - filtered." SLONG NO_COMPU_METHOD 0 0 -2147483648 2147483647 ECU_ADDRESS 0x40001EF4 /end MEASUREMENT
/begin MEASUREMENT misfire_wheel_speed_filter_q8_lf "LF wheel speed IIR accumulator (<<8, CAL_wheel_speed_smoothing). Was misfire_wheel_speed_filt_x256." ULONG NO_COMPU_METHOD 0 0 0 4294967295 ECU_ADDRESS 0x40001EF8 /end MEASUREMENT
/begin MEASUREMENT misfire_wheel_speed_filter_q8_rf "RF wheel speed IIR accumulator (<<8)." ULONG NO_COMPU_METHOD 0 0 0 4294967295 ECU_ADDRESS 0x40001EFC /end MEASUREMENT
/begin MEASUREMENT misfire_wheel_speed_filter_q8_lr "LR wheel speed IIR accumulator (<<8)." ULONG NO_COMPU_METHOD 0 0 0 4294967295 ECU_ADDRESS 0x40001F00 /end MEASUREMENT
/begin MEASUREMENT misfire_wheel_speed_filter_q8_rr "RR wheel speed IIR accumulator (<<8)." ULONG NO_COMPU_METHOD 0 0 0 4294967295 ECU_ADDRESS 0x40001F04 /end MEASUREMENT
/begin MEASUREMENT misfire_wheel_speed_filt "LF wheel speed, filtered (rough-road detection)." ULONG NO_COMPU_METHOD 0 0 0 4294967295 ECU_ADDRESS 0x40001F08 /end MEASUREMENT
/begin MEASUREMENT misfire_wheel_speed_filt_rf "RF wheel speed, filtered." ULONG NO_COMPU_METHOD 0 0 0 4294967295 ECU_ADDRESS 0x40001F0C /end MEASUREMENT
/begin MEASUREMENT misfire_wheel_speed_filt_lr "LR wheel speed, filtered." ULONG NO_COMPU_METHOD 0 0 0 4294967295 ECU_ADDRESS 0x40001F10 /end MEASUREMENT
/begin MEASUREMENT misfire_wheel_speed_filt_rr "RR wheel speed, filtered." ULONG NO_COMPU_METHOD 0 0 0 4294967295 ECU_ADDRESS 0x40001F14 /end MEASUREMENT
/begin MEASUREMENT misfire_emissions_count "Misfires in the emissions window /3 (obd_ii_max_misfire_results_emissions source)." UWORD NO_COMPU_METHOD 0 0 0 65535 ECU_ADDRESS 0x40001F1C /end MEASUREMENT
/begin MEASUREMENT misfire_last_sampled_cyl "Last cylinder index sampled by misfire_record_segment_period." UBYTE NO_COMPU_METHOD 0 0 0 255 ECU_ADDRESS 0x40001F1E /end MEASUREMENT
/begin MEASUREMENT failed_ignition_cyl_count "uint8_t" UBYTE NO_COMPU_METHOD 0 0 0 255 ECU_ADDRESS 0x40001F24 /end MEASUREMENT
/begin MEASUREMENT misfire_enable_hold_timer "Misfire enable-condition hold (CAL_misfire_enable_conditions_hold)." UWORD CM_u8_time_5ms 0 0 0 327675 ECU_ADDRESS 0x40001F26 /end MEASUREMENT
/begin MEASUREMENT misfire_sensitivity "short" SWORD NO_COMPU_METHOD 0 0 -32768 32767 ECU_ADDRESS 0x40001F2C /end MEASUREMENT
/begin MEASUREMENT misfire_rpm_load_threshold_scaled "short" SWORD NO_COMPU_METHOD 0 0 -32768 32767 ECU_ADDRESS 0x40001F2E /end MEASUREMENT
/begin MEASUREMENT obd_ii_max_misfire_results_emissions "u16_count" UWORD NO_COMPU_METHOD 0 0 0 65535 ECU_ADDRESS 0x40001F34 /end MEASUREMENT
/begin MEASUREMENT misfire_emissions_limit "Misfire emissions limit (CAL_misfire_emissions_limit); x10 in Mode 06." UBYTE NO_COMPU_METHOD 0 0 0 255 ECU_ADDRESS 0x40001F36 /end MEASUREMENT
/begin MEASUREMENT misfire_condition_flags "uint32_t" ULONG NO_COMPU_METHOD 0 0 0 4294967295 ECU_ADDRESS 0x40001F38 /end MEASUREMENT
/begin MEASUREMENT obd_ii_mode22_supported_pids_120_40 "Mode 22 supported-PID bitmap byte (0xff)." UBYTE NO_COMPU_METHOD 0 0 0 255 ECU_ADDRESS 0x40001F60 /end MEASUREMENT
/begin MEASUREMENT obd_ii_mode22_supported_pids_byte1 "Mode 22 supported-PID bitmap byte (set in obd_ii_set_mode22_supported_pids)." UBYTE NO_COMPU_METHOD 0 0 0 255 ECU_ADDRESS 0x40001F61 /end MEASUREMENT
/begin MEASUREMENT obd_ii_mode22_supported_pids_byte2 "Mode 22 supported-PID bitmap byte (set in obd_ii_set_mode22_supported_pids)." UBYTE NO_COMPU_METHOD 0 0 0 255 ECU_ADDRESS 0x40001F62 /end MEASUREMENT
/begin MEASUREMENT obd_ii_mode22_supported_pids_byte3 "Mode 22 supported-PID bitmap byte (set in obd_ii_set_mode22_supported_pids)." UBYTE NO_COMPU_METHOD 0 0 0 255 ECU_ADDRESS 0x40001F63 /end MEASUREMENT
/begin MEASUREMENT obd_ii_mode22_supported_pids_byte4 "Mode 22 supported-PID bitmap byte (set in obd_ii_set_mode22_supported_pids)." UBYTE NO_COMPU_METHOD 0 0 0 255 ECU_ADDRESS 0x40001F64 /end MEASUREMENT
/begin MEASUREMENT obd_ii_mode22_supported_pids_byte5 "Mode 22 supported-PID bitmap byte (set in obd_ii_set_mode22_supported_pids)." UBYTE NO_COMPU_METHOD 0 0 0 255 ECU_ADDRESS 0x40001F65 /end MEASUREMENT
/begin MEASUREMENT obd_ii_mode22_supported_pids_byte6 "Mode 22 supported-PID bitmap byte (set in obd_ii_set_mode22_supported_pids)." UBYTE NO_COMPU_METHOD 0 0 0 255 ECU_ADDRESS 0x40001F66 /end MEASUREMENT
/begin MEASUREMENT obd_ii_mode22_supported_pids_byte7 "Mode 22 supported-PID bitmap byte (set in obd_ii_set_mode22_supported_pids)." UBYTE NO_COMPU_METHOD 0 0 0 255 ECU_ADDRESS 0x40001F67 /end MEASUREMENT
/begin MEASUREMENT obd_ii_mode06_supported_mid_0_0 "Mode 06 supported-MID bitmap group 0 byte 0 (obd_ii_set_mode06_supported_pids)." UBYTE NO_COMPU_METHOD 0 0 0 255 ECU_ADDRESS 0x40001F70 /end MEASUREMENT
/begin MEASUREMENT obd_ii_mode06_supported_mid_0_1 "Mode 06 supported-MID bitmap group 0 byte 1 (obd_ii_set_mode06_supported_pids)." UBYTE NO_COMPU_METHOD 0 0 0 255 ECU_ADDRESS 0x40001F71 /end MEASUREMENT
/begin MEASUREMENT obd_ii_mode06_supported_mid_0_2 "Mode 06 supported-MID bitmap group 0 byte 2 (obd_ii_set_mode06_supported_pids)." UBYTE NO_COMPU_METHOD 0 0 0 255 ECU_ADDRESS 0x40001F72 /end MEASUREMENT
/begin MEASUREMENT obd_ii_mode06_supported_mid_0_3 "Mode 06 supported-MID bitmap group 0 byte 3 (obd_ii_set_mode06_supported_pids)." UBYTE NO_COMPU_METHOD 0 0 0 255 ECU_ADDRESS 0x40001F73 /end MEASUREMENT
/begin MEASUREMENT obd_ii_mode06_supported_mid_1_0 "Mode 06 supported-MID bitmap group 1 byte 0 (obd_ii_set_mode06_supported_pids)." UBYTE NO_COMPU_METHOD 0 0 0 255 ECU_ADDRESS 0x40001F74 /end MEASUREMENT
/begin MEASUREMENT obd_ii_mode06_supported_mid_1_1 "Mode 06 supported-MID bitmap group 1 byte 1 (obd_ii_set_mode06_supported_pids)." UBYTE NO_COMPU_METHOD 0 0 0 255 ECU_ADDRESS 0x40001F75 /end MEASUREMENT
/begin MEASUREMENT obd_ii_mode06_supported_mid_1_2 "Mode 06 supported-MID bitmap group 1 byte 2 (obd_ii_set_mode06_supported_pids)." UBYTE NO_COMPU_METHOD 0 0 0 255 ECU_ADDRESS 0x40001F76 /end MEASUREMENT
/begin MEASUREMENT obd_ii_mode06_supported_mid_1_3 "Mode 06 supported-MID bitmap group 1 byte 3 (obd_ii_set_mode06_supported_pids)." UBYTE NO_COMPU_METHOD 0 0 0 255 ECU_ADDRESS 0x40001F77 /end MEASUREMENT
/begin MEASUREMENT obd_ii_mode06_supported_mid_2_0 "Mode 06 supported-MID bitmap group 2 byte 0 (obd_ii_set_mode06_supported_pids)." UBYTE NO_COMPU_METHOD 0 0 0 255 ECU_ADDRESS 0x40001F78 /end MEASUREMENT
/begin MEASUREMENT obd_ii_mode06_supported_mid_2_1 "Mode 06 supported-MID bitmap group 2 byte 1 (obd_ii_set_mode06_supported_pids)." UBYTE NO_COMPU_METHOD 0 0 0 255 ECU_ADDRESS 0x40001F79 /end MEASUREMENT
/begin MEASUREMENT obd_ii_mode06_supported_mid_2_2 "Mode 06 supported-MID bitmap group 2 byte 2 (obd_ii_set_mode06_supported_pids)." UBYTE NO_COMPU_METHOD 0 0 0 255 ECU_ADDRESS 0x40001F7A /end MEASUREMENT
/begin MEASUREMENT obd_ii_mode06_supported_mid_2_3 "Mode 06 supported-MID bitmap group 2 byte 3 (obd_ii_set_mode06_supported_pids)." UBYTE NO_COMPU_METHOD 0 0 0 255 ECU_ADDRESS 0x40001F7B /end MEASUREMENT
/begin MEASUREMENT obd_ii_mode06_supported_mid_3_0 "Mode 06 supported-MID bitmap group 3 byte 0 (obd_ii_set_mode06_supported_pids)." UBYTE NO_COMPU_METHOD 0 0 0 255 ECU_ADDRESS 0x40001F7C /end MEASUREMENT
/begin MEASUREMENT obd_ii_mode06_supported_mid_3_1 "Mode 06 supported-MID bitmap group 3 byte 1 (obd_ii_set_mode06_supported_pids)." UBYTE NO_COMPU_METHOD 0 0 0 255 ECU_ADDRESS 0x40001F7D /end MEASUREMENT
/begin MEASUREMENT obd_ii_mode06_supported_mid_3_2 "Mode 06 supported-MID bitmap group 3 byte 2 (obd_ii_set_mode06_supported_pids)." UBYTE NO_COMPU_METHOD 0 0 0 255 ECU_ADDRESS 0x40001F7E /end MEASUREMENT
/begin MEASUREMENT obd_ii_mode06_supported_mid_3_3 "Mode 06 supported-MID bitmap group 3 byte 3 (obd_ii_set_mode06_supported_pids)." UBYTE NO_COMPU_METHOD 0 0 0 255 ECU_ADDRESS 0x40001F7F /end MEASUREMENT
/begin MEASUREMENT obd_ii_mode06_supported_mid_4_0 "Mode 06 supported-MID bitmap group 4 byte 0 (obd_ii_set_mode06_supported_pids)." UBYTE NO_COMPU_METHOD 0 0 0 255 ECU_ADDRESS 0x40001F80 /end MEASUREMENT
/begin MEASUREMENT obd_ii_mode06_supported_mid_4_1 "Mode 06 supported-MID bitmap group 4 byte 1 (obd_ii_set_mode06_supported_pids)." UBYTE NO_COMPU_METHOD 0 0 0 255 ECU_ADDRESS 0x40001F81 /end MEASUREMENT
/begin MEASUREMENT obd_ii_mode06_supported_mid_4_2 "Mode 06 supported-MID bitmap group 4 byte 2 (obd_ii_set_mode06_supported_pids)." UBYTE NO_COMPU_METHOD 0 0 0 255 ECU_ADDRESS 0x40001F82 /end MEASUREMENT
/begin MEASUREMENT obd_ii_mode06_supported_mid_4_3 "Mode 06 supported-MID bitmap group 4 byte 3 (obd_ii_set_mode06_supported_pids)." UBYTE NO_COMPU_METHOD 0 0 0 255 ECU_ADDRESS 0x40001F83 /end MEASUREMENT
/begin MEASUREMENT obd_ii_mode06_supported_mid_5_0 "Mode 06 supported-MID bitmap group 5 byte 0 (obd_ii_set_mode06_supported_pids)." UBYTE NO_COMPU_METHOD 0 0 0 255 ECU_ADDRESS 0x40001F84 /end MEASUREMENT
/begin MEASUREMENT obd_ii_mode06_supported_mid_5_1 "Mode 06 supported-MID bitmap group 5 byte 1 (obd_ii_set_mode06_supported_pids)." UBYTE NO_COMPU_METHOD 0 0 0 255 ECU_ADDRESS 0x40001F85 /end MEASUREMENT
/begin MEASUREMENT obd_ii_mode06_supported_mid_5_2 "Mode 06 supported-MID bitmap group 5 byte 2 (obd_ii_set_mode06_supported_pids)." UBYTE NO_COMPU_METHOD 0 0 0 255 ECU_ADDRESS 0x40001F86 /end MEASUREMENT
/begin MEASUREMENT obd_ii_mode06_supported_mid_5_3 "Mode 06 supported-MID bitmap group 5 byte 3 (obd_ii_set_mode06_supported_pids)." UBYTE NO_COMPU_METHOD 0 0 0 255 ECU_ADDRESS 0x40001F87 /end MEASUREMENT
/begin MEASUREMENT obd_ii_DTC_pending_count "Number of pending DTCs (mode 07), max 127." UBYTE NO_COMPU_METHOD 0 0 0 255 ECU_ADDRESS 0x40001F88 /end MEASUREMENT
/begin MEASUREMENT obd_ii_mode08_active_test_mask "Mode 08 active test (non-zero = evap test running)." UBYTE NO_COMPU_METHOD 0 0 0 255 ECU_ADDRESS 0x40001F90 /end MEASUREMENT
/begin MEASUREMENT obd_ii_mode08_evap_test_timer "Mode 08 evap test countdown (CAL_obd_ii_mode08_evap_test_duration)." UWORD CM_u8_time_5ms 0 0 0 327675 ECU_ADDRESS 0x40001F96 /end MEASUREMENT
/begin MEASUREMENT obd_ii_DTC_confirmed_count "Number of confirmed DTCs, max 127." UBYTE NO_COMPU_METHOD 0 0 0 255 ECU_ADDRESS 0x40001F98 /end MEASUREMENT
/begin MEASUREMENT obd_ii_mode13_requested "OBD-II: mode13 requested (boolean flag)." UBYTE NO_COMPU_METHOD 0 0 0 255 ECU_ADDRESS 0x40001F99 /end MEASUREMENT
/begin MEASUREMENT calibration_verification_number "Calibration verification number computed at start-up (compared with CAL_ecu_cvn; reported in mode 09)." UWORD NO_COMPU_METHOD 0 0 0 65535 ECU_ADDRESS 0x40001FA0 /end MEASUREMENT
/begin MEASUREMENT obd_ii_p0140_health "Debounce health for P0140: reset to its CAL debounce count, decremented on failing samples; DTC fails at 0." UBYTE NO_COMPU_METHOD 0 0 0 255 ECU_ADDRESS 0x40001FA8 /end MEASUREMENT
/begin MEASUREMENT obd_ii_p0160_health "Debounce health for P0160: reset to its CAL debounce count, decremented on failing samples; DTC fails at 0." UBYTE NO_COMPU_METHOD 0 0 0 255 ECU_ADDRESS 0x40001FA9 /end MEASUREMENT
/begin MEASUREMENT obd_ii_o2_precat_activity_count_b1 "Bank-1 pre-cat O2 activity samples (to CAL_obd_ii_o2_precat_activity_window)." UWORD NO_COMPU_METHOD 0 0 0 65535 ECU_ADDRESS 0x40001FAA /end MEASUREMENT
/begin MEASUREMENT obd_ii_o2_precat_activity_count_b2 "Bank-2 pre-cat O2 activity samples." UWORD NO_COMPU_METHOD 0 0 0 65535 ECU_ADDRESS 0x40001FAC /end MEASUREMENT
/begin MEASUREMENT obd_ii_o2_postcat_activity_count_b1 "Bank-1 post-cat O2 activity samples (vs CAL_obd_ii_o2_postcat_activity_min)." UWORD NO_COMPU_METHOD 0 0 0 65535 ECU_ADDRESS 0x40001FAE /end MEASUREMENT
/begin MEASUREMENT obd_ii_o2_postcat_activity_count_b2 "Bank-2 post-cat O2 activity samples." UWORD NO_COMPU_METHOD 0 0 0 65535 ECU_ADDRESS 0x40001FB0 /end MEASUREMENT
/begin MEASUREMENT obd_ii_o2_slow_response_holdoff "Countdown blocking the O2 slow-response test (decremented while not in alpha-N)." UBYTE NO_COMPU_METHOD 0 0 0 255 ECU_ADDRESS 0x40001FB2 /end MEASUREMENT
/begin MEASUREMENT obd_ii_o2_noact_ref_b1_pre "Bank-1 pre-cat O2 no-activity reference (obd_ii_o2_no_activity_monitor)." UWORD NO_COMPU_METHOD 0 0 0 65535 ECU_ADDRESS 0x40001FB4 /end MEASUREMENT
/begin MEASUREMENT obd_ii_o2_noact_ref_b1_post "Bank-1 post-cat O2 no-activity reference." UWORD NO_COMPU_METHOD 0 0 0 65535 ECU_ADDRESS 0x40001FB6 /end MEASUREMENT
/begin MEASUREMENT obd_ii_o2_noact_ref_b2_pre "Bank-2 pre-cat O2 no-activity reference." UWORD NO_COMPU_METHOD 0 0 0 65535 ECU_ADDRESS 0x40001FB8 /end MEASUREMENT
/begin MEASUREMENT obd_ii_o2_noact_ref_b2_post "Bank-2 post-cat O2 no-activity reference." UWORD NO_COMPU_METHOD 0 0 0 65535 ECU_ADDRESS 0x40001FBA /end MEASUREMENT
/begin MEASUREMENT obd_ii_o2_noact_count_b1 "Bank-1 O2 activity rate counter." UBYTE NO_COMPU_METHOD 0 0 0 255 ECU_ADDRESS 0x40001FBC /end MEASUREMENT
/begin MEASUREMENT obd_ii_o2_noact_count_b2 "Bank-2 O2 activity rate counter." UBYTE NO_COMPU_METHOD 0 0 0 255 ECU_ADDRESS 0x40001FBD /end MEASUREMENT
/begin MEASUREMENT obd_ii_p0134_fail_ticks "P0134 (B1S1 no activity) failing samples; at CAL_obd_ii_monitor_debounce_cycles decrements obd_ii_p0134_health." UBYTE NO_COMPU_METHOD 0 0 0 255 ECU_ADDRESS 0x40001FBE /end MEASUREMENT
/begin MEASUREMENT obd_ii_p0154_fail_ticks "P0154 (B2S1 no activity) failing samples." UBYTE NO_COMPU_METHOD 0 0 0 255 ECU_ADDRESS 0x40001FBF /end MEASUREMENT
/begin MEASUREMENT obd_ii_p0140_fail_ticks "P0140 (B1S2 no activity) failing samples." UBYTE NO_COMPU_METHOD 0 0 0 255 ECU_ADDRESS 0x40001FC0 /end MEASUREMENT
/begin MEASUREMENT obd_ii_p0160_fail_ticks "P0160 (B2S2 no activity) failing samples." UBYTE NO_COMPU_METHOD 0 0 0 255 ECU_ADDRESS 0x40001FC1 /end MEASUREMENT
/begin MEASUREMENT o2_activity_lean_duration_b1 "Bank-1 pre-cat O2 current lean duration (obd_ii_o2_transition_activity_counter)." UBYTE NO_COMPU_METHOD 0 0 0 255 ECU_ADDRESS 0x40001FC2 /end MEASUREMENT
/begin MEASUREMENT o2_activity_lean_duration_b2 "Bank-2 pre-cat O2 current lean duration." UBYTE NO_COMPU_METHOD 0 0 0 255 ECU_ADDRESS 0x40001FC3 /end MEASUREMENT
/begin MEASUREMENT o2_activity_rich_duration_b1 "Bank-1 pre-cat O2 current rich duration." UBYTE NO_COMPU_METHOD 0 0 0 255 ECU_ADDRESS 0x40001FC4 /end MEASUREMENT
/begin MEASUREMENT o2_activity_rich_duration_b2 "Bank-2 pre-cat O2 current rich duration." UBYTE NO_COMPU_METHOD 0 0 0 255 ECU_ADDRESS 0x40001FC5 /end MEASUREMENT
/begin MEASUREMENT obd_ii_cat_o2_rich_time_b1 "Catalyst check: time post-cat O2 held rich, bank 1 (vs CAL_obd_ii_cat_check_o2_rich_time_max*5)." UWORD NO_COMPU_METHOD 0 0 0 65535 ECU_ADDRESS 0x40001FC6 /end MEASUREMENT
/begin MEASUREMENT obd_ii_cat_o2_rich_time_b2 "Catalyst check: time post-cat O2 held rich, bank 2." UWORD NO_COMPU_METHOD 0 0 0 65535 ECU_ADDRESS 0x40001FC8 /end MEASUREMENT
/begin MEASUREMENT obd_ii_o2_noact_status_b1 "Bank-1 O2 no-activity monitor state bits." UBYTE NO_COMPU_METHOD 0 0 0 255 ECU_ADDRESS 0x40001FCA /end MEASUREMENT
/begin MEASUREMENT obd_ii_o2_noact_status_b2 "Bank-2 O2 no-activity monitor state bits." UBYTE NO_COMPU_METHOD 0 0 0 255 ECU_ADDRESS 0x40001FCB /end MEASUREMENT
/begin MEASUREMENT o2_leanrich_flags_b1 "Bank-1 pre-cat O2 lean/rich state bits (o2_leanrich_detect: bit1 rich, bit2 lean, bit6/7 edges). Was o2_sensor_1_leanrich." UBYTE NO_COMPU_METHOD 0 0 0 255 ECU_ADDRESS 0x40001FCC /end MEASUREMENT
/begin MEASUREMENT o2_leanrich_flags_b2 "Bank-2 pre-cat O2 lean/rich state bits." UBYTE NO_COMPU_METHOD 0 0 0 255 ECU_ADDRESS 0x40001FCD /end MEASUREMENT
/begin MEASUREMENT o2_switch_rich_duration_accum_b1 "Bank-1 sum of rich durations (obd_ii_o2_switching_counter); /count -> LEA_obd_ii_o2_b1_period_avg2." SLONG NO_COMPU_METHOD 0 0 -2147483648 2147483647 ECU_ADDRESS 0x40001FD0 /end MEASUREMENT
/begin MEASUREMENT o2_switch_lean_duration_accum_b1 "Bank-1 sum of lean durations; /count -> LEA_obd_ii_o2_b1_period_avg1." SLONG NO_COMPU_METHOD 0 0 -2147483648 2147483647 ECU_ADDRESS 0x40001FD4 /end MEASUREMENT
/begin MEASUREMENT o2_switch_rich_duration_accum_b2 "Bank-2 sum of rich durations." SLONG NO_COMPU_METHOD 0 0 -2147483648 2147483647 ECU_ADDRESS 0x40001FD8 /end MEASUREMENT
/begin MEASUREMENT o2_switch_lean_duration_accum_b2 "Bank-2 sum of lean durations." SLONG NO_COMPU_METHOD 0 0 -2147483648 2147483647 ECU_ADDRESS 0x40001FDC /end MEASUREMENT
/begin MEASUREMENT o2_switch_rich_count_b1 "Bank-1 rich transitions counted." UBYTE NO_COMPU_METHOD 0 0 0 255 ECU_ADDRESS 0x40001FE0 /end MEASUREMENT
/begin MEASUREMENT o2_switch_lean_count_b1 "Bank-1 lean transitions counted." UBYTE NO_COMPU_METHOD 0 0 0 255 ECU_ADDRESS 0x40001FE1 /end MEASUREMENT
/begin MEASUREMENT o2_switch_rich_count_b2 "Bank-2 rich transitions counted." UBYTE NO_COMPU_METHOD 0 0 0 255 ECU_ADDRESS 0x40001FE2 /end MEASUREMENT
/begin MEASUREMENT o2_switch_lean_count_b2 "Bank-2 lean transitions counted." UBYTE NO_COMPU_METHOD 0 0 0 255 ECU_ADDRESS 0x40001FE3 /end MEASUREMENT
/begin MEASUREMENT o2_switch_lean_duration_cur_b1 "Bank-1 current lean duration." UWORD CM_u8_time_5ms 0 0 0 327675 ECU_ADDRESS 0x40001FE4 /end MEASUREMENT
/begin MEASUREMENT o2_switch_rich_duration_cur_b1 "Bank-1 current rich duration." UWORD CM_u8_time_5ms 0 0 0 327675 ECU_ADDRESS 0x40001FE6 /end MEASUREMENT
/begin MEASUREMENT o2_switch_lean_duration_cur_b2 "Bank-2 current lean duration." UWORD CM_u8_time_5ms 0 0 0 327675 ECU_ADDRESS 0x40001FE8 /end MEASUREMENT
/begin MEASUREMENT o2_switch_rich_duration_cur_b2 "Bank-2 current rich duration." UWORD CM_u8_time_5ms 0 0 0 327675 ECU_ADDRESS 0x40001FEA /end MEASUREMENT
/begin MEASUREMENT obd_ii_cat_transient_blackout "Catalyst check transient blackout countdown (CAL_obd_ii_cat_check_transient_blackout)." UWORD NO_COMPU_METHOD 0 0 0 65535 ECU_ADDRESS 0x40001FEC /end MEASUREMENT
/begin MEASUREMENT o2_switch_delay_timer_b1 "Bank-1 O2 switching monitor start delay (CAL_obd_ii_o2_precat_diag_reset_counter)." SWORD NO_COMPU_METHOD 0 0 -32768 32767 ECU_ADDRESS 0x40001FEE /end MEASUREMENT
/begin MEASUREMENT o2_switch_delay_timer_b2 "Bank-2 O2 switching monitor start delay." SWORD NO_COMPU_METHOD 0 0 -32768 32767 ECU_ADDRESS 0x40001FF0 /end MEASUREMENT
/begin MEASUREMENT obd_ii_cat_20ms_divider "Catalyst monitor divider (reload 4)." UBYTE NO_COMPU_METHOD 0 0 0 255 ECU_ADDRESS 0x40001FF2 /end MEASUREMENT
/begin MEASUREMENT obd_ii_cat_load_delta "Load change over the catalyst window (mg/stroke); stability check for the O2 response tests." SLONG NO_COMPU_METHOD 0 0 -2147483648 2147483647 ECU_ADDRESS 0x40001FF4 /end MEASUREMENT
/begin MEASUREMENT o2_slow_response_arm_timer_b2 "O2 slow-response arm dwell countdown (CAL_obd_ii_o2_slow_response_arm_dwell)." UWORD NO_COMPU_METHOD 0 0 0 65535 ECU_ADDRESS 0x40001FF8 /end MEASUREMENT
/begin MEASUREMENT o2_slow_response_arm_timer_b1 "O2 slow-response arm dwell countdown." UWORD NO_COMPU_METHOD 0 0 0 65535 ECU_ADDRESS 0x40001FFA /end MEASUREMENT
/begin MEASUREMENT o2_slow_response_state_b2_a "O2 slow-response test state (0/1)." UBYTE NO_COMPU_METHOD 0 0 0 255 ECU_ADDRESS 0x40001FFC /end MEASUREMENT
/begin MEASUREMENT o2_slow_response_state_b1_a "O2 slow-response test state (0/1)." UBYTE NO_COMPU_METHOD 0 0 0 255 ECU_ADDRESS 0x40001FFD /end MEASUREMENT
/begin MEASUREMENT o2_slow_response_state_b2_b "O2 slow-response test state (0/1)." UBYTE NO_COMPU_METHOD 0 0 0 255 ECU_ADDRESS 0x40001FFE /end MEASUREMENT
/begin MEASUREMENT o2_slow_response_state_b1_b "O2 slow-response test state (0/1)." UBYTE NO_COMPU_METHOD 0 0 0 255 ECU_ADDRESS 0x40001FFF /end MEASUREMENT
/begin MEASUREMENT o2_slow_response_runtime_s "runtime_since_start / 200 (s) snapshot." SWORD NO_COMPU_METHOD 0 0 -32768 32767 ECU_ADDRESS 0x40002000 /end MEASUREMENT
/begin MEASUREMENT o2_slow_response_timer_b2_a "Countdown loaded from CAL_cat_check_unknown4." UWORD NO_COMPU_METHOD 0 0 0 65535 ECU_ADDRESS 0x40002002 /end MEASUREMENT
/begin MEASUREMENT o2_slow_response_timer_b1_a "Countdown loaded from CAL_cat_check_unknown4." UWORD NO_COMPU_METHOD 0 0 0 65535 ECU_ADDRESS 0x40002004 /end MEASUREMENT
/begin MEASUREMENT o2_slow_response_timer_b2_b "Countdown loaded from CAL_obd_ii_o2_min_voltage_init." UWORD NO_COMPU_METHOD 0 0 0 65535 ECU_ADDRESS 0x40002006 /end MEASUREMENT
/begin MEASUREMENT o2_slow_response_timer_b1_b "Countdown loaded from CAL_obd_ii_o2_min_voltage_init." UWORD NO_COMPU_METHOD 0 0 0 65535 ECU_ADDRESS 0x40002008 /end MEASUREMENT
/begin MEASUREMENT o2_switch_monitor_timer_b2 "Bank-2 O2 switching monitor window (CAL_obd_ii_o2_precat_diag_init_counter)." SWORD NO_COMPU_METHOD 0 0 -32768 32767 ECU_ADDRESS 0x4000200A /end MEASUREMENT
/begin MEASUREMENT o2_switch_monitor_timer_b1 "Bank-1 O2 switching monitor window." SWORD NO_COMPU_METHOD 0 0 -32768 32767 ECU_ADDRESS 0x4000200C /end MEASUREMENT
/begin MEASUREMENT obd_ii_o2_precat_diag_timer_bank2 "OBD-II: O2 precat diag timer bank2 (ms = val*5)." UWORD CM_u8_time_5ms 0 0 0 327675 ECU_ADDRESS 0x4000200E /end MEASUREMENT
/begin MEASUREMENT obd_ii_o2_precat_diag_timer_bank1 "uint16_t" UWORD NO_COMPU_METHOD 0 0 0 65535 ECU_ADDRESS 0x40002010 /end MEASUREMENT
/begin MEASUREMENT o2_activity_rich_count_b2 "Bank-2 rich transitions (activity counter); r2l time = accum/count." UBYTE NO_COMPU_METHOD 0 0 0 255 ECU_ADDRESS 0x40002012 /end MEASUREMENT
/begin MEASUREMENT o2_activity_rich_count_b1 "Bank-1 rich transitions (activity counter)." UBYTE NO_COMPU_METHOD 0 0 0 255 ECU_ADDRESS 0x40002013 /end MEASUREMENT
/begin MEASUREMENT o2_activity_lean_count_b2 "Bank-2 lean transitions (activity counter)." UBYTE NO_COMPU_METHOD 0 0 0 255 ECU_ADDRESS 0x40002014 /end MEASUREMENT
/begin MEASUREMENT o2_activity_lean_count_b1 "Bank-1 lean transitions (activity counter)." UBYTE NO_COMPU_METHOD 0 0 0 255 ECU_ADDRESS 0x40002015 /end MEASUREMENT
/begin MEASUREMENT o2_slow_response_samples_a "Sample counter (to CAL_obd_ii_o2_slow_response_sample_count)." UBYTE NO_COMPU_METHOD 0 0 0 255 ECU_ADDRESS 0x40002016 /end MEASUREMENT
/begin MEASUREMENT o2_slow_response_samples_b "Sample counter (to CAL_obd_ii_o2_slow_response_sample_count)." UBYTE NO_COMPU_METHOD 0 0 0 255 ECU_ADDRESS 0x40002017 /end MEASUREMENT
/begin MEASUREMENT o2_slow_response_samples_c "Sample counter (to CAL_obd_ii_o2_slow_response_sample_count)." UBYTE NO_COMPU_METHOD 0 0 0 255 ECU_ADDRESS 0x40002018 /end MEASUREMENT
/begin MEASUREMENT o2_slow_response_samples_d "Sample counter (to CAL_obd_ii_o2_slow_response_sample_count)." UBYTE NO_COMPU_METHOD 0 0 0 255 ECU_ADDRESS 0x40002019 /end MEASUREMENT
/begin MEASUREMENT obd_ii_postcat_r2l_time_sum_b2 "Bank-2 post-cat rich-to-lean response time sum over the samples (vs LEA_obd_ii_postcat_b2_r2l_time_sum_max10)." UWORD NO_COMPU_METHOD 0 0 0 65535 ECU_ADDRESS 0x4000201A /end MEASUREMENT
/begin MEASUREMENT obd_ii_postcat_r2l_time_sum_b1 "Bank-1 post-cat rich-to-lean response time sum." UWORD NO_COMPU_METHOD 0 0 0 65535 ECU_ADDRESS 0x4000201C /end MEASUREMENT
/begin MEASUREMENT obd_ii_postcat_l2r_time_sum_b2 "Bank-2 post-cat lean-to-rich response time sum." UWORD NO_COMPU_METHOD 0 0 0 65535 ECU_ADDRESS 0x4000201E /end MEASUREMENT
/begin MEASUREMENT obd_ii_postcat_l2r_time_sum_b1 "Bank-1 post-cat lean-to-rich response time sum." UWORD NO_COMPU_METHOD 0 0 0 65535 ECU_ADDRESS 0x40002020 /end MEASUREMENT
/begin MEASUREMENT obd_ii_postcat_r2l_time_b2 "Bank-2 post-cat rich-to-lean response time (to CAL_obd_ii_o2_slow_response_limit_rich_to_lean)." UWORD CM_u8_time_5ms 0 0 0 327675 ECU_ADDRESS 0x40002022 /end MEASUREMENT
/begin MEASUREMENT obd_ii_postcat_r2l_time_b1 "Bank-1 post-cat rich-to-lean response time." UWORD CM_u8_time_5ms 0 0 0 327675 ECU_ADDRESS 0x40002024 /end MEASUREMENT
/begin MEASUREMENT obd_ii_postcat_l2r_time_b2 "Bank-2 post-cat lean-to-rich response time (to CAL_obd_ii_o2_slow_response_limit_lean_to_rich)." UWORD CM_u8_time_5ms 0 0 0 327675 ECU_ADDRESS 0x40002026 /end MEASUREMENT
/begin MEASUREMENT obd_ii_postcat_l2r_time_b1 "Bank-1 post-cat lean-to-rich response time." UWORD CM_u8_time_5ms 0 0 0 327675 ECU_ADDRESS 0x40002028 /end MEASUREMENT
/begin MEASUREMENT obd_ii_postcat_response_flags_b2 "Bank-2 post-cat O2 response test state bits." UWORD NO_COMPU_METHOD 0 0 0 65535 ECU_ADDRESS 0x4000202A /end MEASUREMENT
/begin MEASUREMENT obd_ii_postcat_response_flags_b1 "Bank-1 post-cat O2 response test state bits." UWORD NO_COMPU_METHOD 0 0 0 65535 ECU_ADDRESS 0x4000202C /end MEASUREMENT
/begin MEASUREMENT obd_ii_o2_response_test_flags_bank2 "Bank-2 pre-cat O2 response test state bits." UWORD NO_COMPU_METHOD 0 0 0 65535 ECU_ADDRESS 0x4000202E /end MEASUREMENT
/begin MEASUREMENT obd_ii_o2_response_test_flags_bank1 "Bank-1 pre-cat O2 response test state bits." UWORD NO_COMPU_METHOD 0 0 0 65535 ECU_ADDRESS 0x40002030 /end MEASUREMENT
/begin MEASUREMENT o2_activity_lean_accum_b2 "Bank-2 sum of lean transition durations; /count -> LEA_obd_ii_precat_b2_l2r_time." SLONG NO_COMPU_METHOD 0 0 -2147483648 2147483647 ECU_ADDRESS 0x40002034 /end MEASUREMENT
/begin MEASUREMENT o2_activity_lean_accum_b1 "Bank-1 sum of lean transition durations; /count -> LEA_obd_ii_precat_b1_l2r_time." SLONG NO_COMPU_METHOD 0 0 -2147483648 2147483647 ECU_ADDRESS 0x40002038 /end MEASUREMENT
/begin MEASUREMENT o2_activity_rich_accum_b2 "Bank-2 sum of rich transition durations; /count -> LEA_obd_ii_precat_b2_r2l_time." SLONG NO_COMPU_METHOD 0 0 -2147483648 2147483647 ECU_ADDRESS 0x4000203C /end MEASUREMENT
/begin MEASUREMENT o2_activity_rich_accum_b1 "Bank-1 sum of rich transition durations; /count -> LEA_obd_ii_precat_b1_r2l_time." SLONG NO_COMPU_METHOD 0 0 -2147483648 2147483647 ECU_ADDRESS 0x40002040 /end MEASUREMENT
/begin MEASUREMENT obd_ii_p0159_health "Debounce health for P0159: reset to its CAL debounce count, decremented on failing samples; DTC fails at 0." UBYTE NO_COMPU_METHOD 0 0 0 255 ECU_ADDRESS 0x40002044 /end MEASUREMENT
/begin MEASUREMENT obd_ii_p0154_health "Debounce health for P0154: reset to its CAL debounce count, decremented on failing samples; DTC fails at 0." UBYTE NO_COMPU_METHOD 0 0 0 255 ECU_ADDRESS 0x40002045 /end MEASUREMENT
/begin MEASUREMENT obd_ii_p0153_health "Debounce health for P0153: reset to CAL_obd_ii_P0153_debounce_count; +1 per passing sample (to the CAL), -1 per obd_ii_monitor_debounce_ticks failing samples; the DTC fails when it reaches 0." UBYTE NO_COMPU_METHOD 0 0 0 255 ECU_ADDRESS 0x40002046 /end MEASUREMENT
/begin MEASUREMENT obd_ii_p0139_health "Debounce health for P0139: reset to its CAL debounce count, decremented on failing samples; DTC fails at 0." UBYTE NO_COMPU_METHOD 0 0 0 255 ECU_ADDRESS 0x40002047 /end MEASUREMENT
/begin MEASUREMENT obd_ii_p0134_health "Debounce health for P0134: reset to its CAL debounce count, decremented on failing samples; DTC fails at 0." UBYTE NO_COMPU_METHOD 0 0 0 255 ECU_ADDRESS 0x40002048 /end MEASUREMENT
/begin MEASUREMENT obd_ii_p0133_health "Debounce health for P0133: reset to CAL_obd_ii_P0133_debounce_count; +1 per passing sample (to the CAL), -1 per obd_ii_monitor_debounce_ticks failing samples; the DTC fails when it reaches 0." UBYTE NO_COMPU_METHOD 0 0 0 255 ECU_ADDRESS 0x40002049 /end MEASUREMENT
/begin MEASUREMENT obd_ii_circuit_latch_a "Latched driver-chip diagnostic bits (OR of inverted SPI status 0x40003022/25); consumed by obd_ii_evaluate_electrical_circuit_monitors." UWORD NO_COMPU_METHOD 0 0 0 65535 ECU_ADDRESS 0x40002050 /end MEASUREMENT
/begin MEASUREMENT cylinder_seq_sync_flags "Cylinder sequence sync state bits." UBYTE NO_COMPU_METHOD 0 0 0 255 ECU_ADDRESS 0x40002052 /end MEASUREMENT
/begin MEASUREMENT obd_ii_circuit_latch_b "Latched driver-chip diagnostic bits (status 0x40003023/24)." UWORD NO_COMPU_METHOD 0 0 0 65535 ECU_ADDRESS 0x40002054 /end MEASUREMENT
/begin MEASUREMENT obd_ii_circuit_latch_cac "Latched charge-cooler pump driver diagnostic bits (cac_driver_status_spi)." UWORD NO_COMPU_METHOD 0 0 0 65535 ECU_ADDRESS 0x40002056 /end MEASUREMENT
/begin MEASUREMENT obd_ii_circuit_latch_c "Latched driver-chip diagnostic bits (status 0x40003027/28)." UWORD NO_COMPU_METHOD 0 0 0 65535 ECU_ADDRESS 0x40002058 /end MEASUREMENT
/begin MEASUREMENT obd_ii_p0076_health "Debounce health for P0076: reset to its CAL debounce count, decremented on failing samples; DTC fails at 0." UBYTE NO_COMPU_METHOD 0 0 0 255 ECU_ADDRESS 0x40002060 /end MEASUREMENT
/begin MEASUREMENT obd_ii_p0077_health "Debounce health for P0077: reset to its CAL debounce count, decremented on failing samples; DTC fails at 0." UBYTE NO_COMPU_METHOD 0 0 0 255 ECU_ADDRESS 0x40002061 /end MEASUREMENT
/begin MEASUREMENT obd_ii_p0079_health "Debounce health for P0079: reset to its CAL debounce count, decremented on failing samples; DTC fails at 0." UBYTE NO_COMPU_METHOD 0 0 0 255 ECU_ADDRESS 0x40002062 /end MEASUREMENT
/begin MEASUREMENT obd_ii_p0080_health "Debounce health for P0080: reset to its CAL debounce count, decremented on failing samples; DTC fails at 0." UBYTE NO_COMPU_METHOD 0 0 0 255 ECU_ADDRESS 0x40002063 /end MEASUREMENT
/begin MEASUREMENT obd_ii_p0082_health "Debounce health for P0082: reset to its CAL debounce count, decremented on failing samples; DTC fails at 0." UBYTE NO_COMPU_METHOD 0 0 0 255 ECU_ADDRESS 0x40002064 /end MEASUREMENT
/begin MEASUREMENT obd_ii_p0083_health "Debounce health for P0083: reset to its CAL debounce count, decremented on failing samples; DTC fails at 0." UBYTE NO_COMPU_METHOD 0 0 0 255 ECU_ADDRESS 0x40002065 /end MEASUREMENT
/begin MEASUREMENT obd_ii_p0085_health "Debounce health for P0085: reset to its CAL debounce count, decremented on failing samples; DTC fails at 0." UBYTE NO_COMPU_METHOD 0 0 0 255 ECU_ADDRESS 0x40002066 /end MEASUREMENT
/begin MEASUREMENT obd_ii_p0086_health "Debounce health for P0086: reset to its CAL debounce count, decremented on failing samples; DTC fails at 0." UBYTE NO_COMPU_METHOD 0 0 0 255 ECU_ADDRESS 0x40002067 /end MEASUREMENT
/begin MEASUREMENT obd_ii_p0628_health "Debounce health for P0628: reset to its CAL debounce count, decremented on failing samples; DTC fails at 0." UBYTE NO_COMPU_METHOD 0 0 0 255 ECU_ADDRESS 0x40002068 /end MEASUREMENT
/begin MEASUREMENT obd_ii_p0629_health "Debounce health for P0629: reset to its CAL debounce count, decremented on failing samples; DTC fails at 0." UBYTE NO_COMPU_METHOD 0 0 0 255 ECU_ADDRESS 0x40002069 /end MEASUREMENT
/begin MEASUREMENT obd_ii_p0261_health "Debounce health for P0261: reset to its CAL debounce count, decremented on failing samples; DTC fails at 0." UBYTE NO_COMPU_METHOD 0 0 0 255 ECU_ADDRESS 0x4000206A /end MEASUREMENT
/begin MEASUREMENT obd_ii_p0262_health "Debounce health for P0262: reset to its CAL debounce count, decremented on failing samples; DTC fails at 0." UBYTE NO_COMPU_METHOD 0 0 0 255 ECU_ADDRESS 0x4000206B /end MEASUREMENT
/begin MEASUREMENT obd_ii_p0264_health "Debounce health for P0264: reset to its CAL debounce count, decremented on failing samples; DTC fails at 0." UBYTE NO_COMPU_METHOD 0 0 0 255 ECU_ADDRESS 0x4000206C /end MEASUREMENT
/begin MEASUREMENT obd_ii_p0265_health "Debounce health for P0265: reset to its CAL debounce count, decremented on failing samples; DTC fails at 0." UBYTE NO_COMPU_METHOD 0 0 0 255 ECU_ADDRESS 0x4000206D /end MEASUREMENT
/begin MEASUREMENT obd_ii_p0267_health "Debounce health for P0267: reset to its CAL debounce count, decremented on failing samples; DTC fails at 0." UBYTE NO_COMPU_METHOD 0 0 0 255 ECU_ADDRESS 0x4000206E /end MEASUREMENT
/begin MEASUREMENT obd_ii_p0268_health "Debounce health for P0268: reset to its CAL debounce count, decremented on failing samples; DTC fails at 0." UBYTE NO_COMPU_METHOD 0 0 0 255 ECU_ADDRESS 0x4000206F /end MEASUREMENT
/begin MEASUREMENT obd_ii_p0270_health "Debounce health for P0270: reset to its CAL debounce count, decremented on failing samples; DTC fails at 0." UBYTE NO_COMPU_METHOD 0 0 0 255 ECU_ADDRESS 0x40002070 /end MEASUREMENT
/begin MEASUREMENT obd_ii_p0271_health "Debounce health for P0271: reset to its CAL debounce count, decremented on failing samples; DTC fails at 0." UBYTE NO_COMPU_METHOD 0 0 0 255 ECU_ADDRESS 0x40002071 /end MEASUREMENT
/begin MEASUREMENT obd_ii_p0273_health "Debounce health for P0273: reset to its CAL debounce count, decremented on failing samples; DTC fails at 0." UBYTE NO_COMPU_METHOD 0 0 0 255 ECU_ADDRESS 0x40002072 /end MEASUREMENT
/begin MEASUREMENT obd_ii_p0274_health "Debounce health for P0274: reset to its CAL debounce count, decremented on failing samples; DTC fails at 0." UBYTE NO_COMPU_METHOD 0 0 0 255 ECU_ADDRESS 0x40002073 /end MEASUREMENT
/begin MEASUREMENT obd_ii_p0276_health "Debounce health for P0276: reset to its CAL debounce count, decremented on failing samples; DTC fails at 0." UBYTE NO_COMPU_METHOD 0 0 0 255 ECU_ADDRESS 0x40002074 /end MEASUREMENT
/begin MEASUREMENT obd_ii_p0277_health "Debounce health for P0277: reset to its CAL debounce count, decremented on failing samples; DTC fails at 0." UBYTE NO_COMPU_METHOD 0 0 0 255 ECU_ADDRESS 0x40002075 /end MEASUREMENT
/begin MEASUREMENT obd_ii_p0351_health "Debounce health for P0351: reset to its CAL debounce count, decremented on failing samples; DTC fails at 0." UBYTE NO_COMPU_METHOD 0 0 0 255 ECU_ADDRESS 0x40002076 /end MEASUREMENT
/begin MEASUREMENT obd_ii_p0352_health "Debounce health for P0352: reset to its CAL debounce count, decremented on failing samples; DTC fails at 0." UBYTE NO_COMPU_METHOD 0 0 0 255 ECU_ADDRESS 0x40002077 /end MEASUREMENT
/begin MEASUREMENT obd_ii_p0353_health "Debounce health for P0353: reset to its CAL debounce count, decremented on failing samples; DTC fails at 0." UBYTE NO_COMPU_METHOD 0 0 0 255 ECU_ADDRESS 0x40002078 /end MEASUREMENT
/begin MEASUREMENT obd_ii_p0354_health "Debounce health for P0354: reset to its CAL debounce count, decremented on failing samples; DTC fails at 0." UBYTE NO_COMPU_METHOD 0 0 0 255 ECU_ADDRESS 0x40002079 /end MEASUREMENT
/begin MEASUREMENT obd_ii_p0355_health "Debounce health for P0355: reset to its CAL debounce count, decremented on failing samples; DTC fails at 0." UBYTE NO_COMPU_METHOD 0 0 0 255 ECU_ADDRESS 0x4000207A /end MEASUREMENT
/begin MEASUREMENT obd_ii_p0356_health "Debounce health for P0356: reset to its CAL debounce count, decremented on failing samples; DTC fails at 0." UBYTE NO_COMPU_METHOD 0 0 0 255 ECU_ADDRESS 0x4000207B /end MEASUREMENT
/begin MEASUREMENT obd_ii_p0135_health "Debounce health for P0135: reset to its CAL debounce count, decremented on failing samples; DTC fails at 0." UBYTE NO_COMPU_METHOD 0 0 0 255 ECU_ADDRESS 0x4000207C /end MEASUREMENT
/begin MEASUREMENT obd_ii_p0155_health "Debounce health for P0155: reset to its CAL debounce count, decremented on failing samples; DTC fails at 0." UBYTE NO_COMPU_METHOD 0 0 0 255 ECU_ADDRESS 0x4000207D /end MEASUREMENT
/begin MEASUREMENT obd_ii_p0141_current_health "P0141 heater-current health (CAL_obd_ii_P0141_heater_current_debounce_count)." UBYTE NO_COMPU_METHOD 0 0 0 255 ECU_ADDRESS 0x4000207E /end MEASUREMENT
/begin MEASUREMENT obd_ii_p0161_health "Debounce health for P0161: reset to its CAL debounce count, decremented on failing samples; DTC fails at 0." UBYTE NO_COMPU_METHOD 0 0 0 255 ECU_ADDRESS 0x4000207F /end MEASUREMENT
/begin MEASUREMENT aux_coolant_pump_state_and_diag_ "Aux coolant pump state + diagnostic bits (mode 22; bits 1,4-8 fault -> P123C)." UWORD NO_COMPU_METHOD 0 0 0 65535 ECU_ADDRESS 0x40002080 /end MEASUREMENT
/begin MEASUREMENT obd_ii_p0076_fail_ticks "Consecutive failing samples for P0076; at obd_ii_monitor_debounce_ticks decrements obd_ii_p0076_health." UWORD NO_COMPU_METHOD 0 0 0 65535 ECU_ADDRESS 0x40002082 /end MEASUREMENT
/begin MEASUREMENT obd_ii_p0077_fail_ticks "Consecutive failing samples for P0077; at obd_ii_monitor_debounce_ticks decrements obd_ii_p0077_health." UWORD NO_COMPU_METHOD 0 0 0 65535 ECU_ADDRESS 0x40002084 /end MEASUREMENT
/begin MEASUREMENT obd_ii_p0079_fail_ticks "Consecutive failing samples for P0079; at obd_ii_monitor_debounce_ticks decrements obd_ii_p0079_health." UWORD NO_COMPU_METHOD 0 0 0 65535 ECU_ADDRESS 0x40002086 /end MEASUREMENT
/begin MEASUREMENT obd_ii_p0080_fail_ticks "Consecutive failing samples for P0080; at obd_ii_monitor_debounce_ticks decrements obd_ii_p0080_health." UWORD NO_COMPU_METHOD 0 0 0 65535 ECU_ADDRESS 0x40002088 /end MEASUREMENT
/begin MEASUREMENT obd_ii_p0082_fail_ticks "Consecutive failing samples for P0082; at obd_ii_monitor_debounce_ticks decrements obd_ii_p0082_health." UWORD NO_COMPU_METHOD 0 0 0 65535 ECU_ADDRESS 0x4000208A /end MEASUREMENT
/begin MEASUREMENT obd_ii_p0083_fail_ticks "Consecutive failing samples for P0083; at obd_ii_monitor_debounce_ticks decrements obd_ii_p0083_health." UWORD NO_COMPU_METHOD 0 0 0 65535 ECU_ADDRESS 0x4000208C /end MEASUREMENT
/begin MEASUREMENT obd_ii_p0085_fail_ticks "Consecutive failing samples for P0085; at obd_ii_monitor_debounce_ticks decrements obd_ii_p0085_health." UWORD NO_COMPU_METHOD 0 0 0 65535 ECU_ADDRESS 0x4000208E /end MEASUREMENT
/begin MEASUREMENT obd_ii_p0086_fail_ticks "Consecutive failing samples for P0086; at obd_ii_monitor_debounce_ticks decrements obd_ii_p0086_health." UWORD NO_COMPU_METHOD 0 0 0 65535 ECU_ADDRESS 0x40002090 /end MEASUREMENT
/begin MEASUREMENT obd_ii_p0647_health "Debounce health for P0647: reset to its CAL debounce count, decremented on failing samples; DTC fails at 0." UBYTE NO_COMPU_METHOD 0 0 0 255 ECU_ADDRESS 0x40002092 /end MEASUREMENT
/begin MEASUREMENT obd_ii_p0647_fail_ticks "Consecutive failing samples for P0647; at obd_ii_monitor_debounce_ticks decrements obd_ii_p0647_health." UWORD NO_COMPU_METHOD 0 0 0 65535 ECU_ADDRESS 0x40002094 /end MEASUREMENT
/begin MEASUREMENT obd_ii_p0646_health "Debounce health for P0646: reset to its CAL debounce count, decremented on failing samples; DTC fails at 0." UBYTE NO_COMPU_METHOD 0 0 0 255 ECU_ADDRESS 0x40002096 /end MEASUREMENT
/begin MEASUREMENT obd_ii_p0646_fail_ticks "Consecutive failing samples for P0646; at obd_ii_monitor_debounce_ticks decrements obd_ii_p0646_health." UWORD NO_COMPU_METHOD 0 0 0 65535 ECU_ADDRESS 0x40002098 /end MEASUREMENT
/begin MEASUREMENT obd_ii_p0444_health "Debounce health for P0444: reset to its CAL debounce count, decremented on failing samples; DTC fails at 0." UBYTE NO_COMPU_METHOD 0 0 0 255 ECU_ADDRESS 0x4000209A /end MEASUREMENT
/begin MEASUREMENT obd_ii_p0444_fail_ticks "Consecutive failing samples for P0444; at obd_ii_monitor_debounce_ticks decrements obd_ii_p0444_health." UWORD NO_COMPU_METHOD 0 0 0 65535 ECU_ADDRESS 0x4000209C /end MEASUREMENT
/begin MEASUREMENT obd_ii_p0445_health "Debounce health for P0445: reset to its CAL debounce count, decremented on failing samples; DTC fails at 0." UBYTE NO_COMPU_METHOD 0 0 0 255 ECU_ADDRESS 0x4000209E /end MEASUREMENT
/begin MEASUREMENT obd_ii_p0445_fail_ticks "Consecutive failing samples for P0445; at obd_ii_monitor_debounce_ticks decrements obd_ii_p0445_health." UWORD NO_COMPU_METHOD 0 0 0 65535 ECU_ADDRESS 0x400020A0 /end MEASUREMENT
/begin MEASUREMENT obd_ii_p025c_fail_ticks "Consecutive failing samples for P025C; at obd_ii_monitor_debounce_ticks decrements obd_ii_p025c_health." UWORD NO_COMPU_METHOD 0 0 0 65535 ECU_ADDRESS 0x400020A2 /end MEASUREMENT
/begin MEASUREMENT obd_ii_p025d_fail_ticks "Consecutive failing samples for P025D; at obd_ii_monitor_debounce_ticks decrements obd_ii_p025d_health." UWORD NO_COMPU_METHOD 0 0 0 65535 ECU_ADDRESS 0x400020A4 /end MEASUREMENT
/begin MEASUREMENT obd_ii_p0261_fail_ticks "Consecutive failing samples for P0261; at obd_ii_monitor_debounce_ticks decrements obd_ii_p0261_health." UWORD NO_COMPU_METHOD 0 0 0 65535 ECU_ADDRESS 0x400020A6 /end MEASUREMENT
/begin MEASUREMENT obd_ii_p0262_fail_ticks "Consecutive failing samples for P0262; at obd_ii_monitor_debounce_ticks decrements obd_ii_p0262_health." UWORD NO_COMPU_METHOD 0 0 0 65535 ECU_ADDRESS 0x400020A8 /end MEASUREMENT
/begin MEASUREMENT obd_ii_p0264_fail_ticks "Consecutive failing samples for P0264; at obd_ii_monitor_debounce_ticks decrements obd_ii_p0264_health." UWORD NO_COMPU_METHOD 0 0 0 65535 ECU_ADDRESS 0x400020AA /end MEASUREMENT
/begin MEASUREMENT obd_ii_p0265_fail_ticks "Consecutive failing samples for P0265; at obd_ii_monitor_debounce_ticks decrements obd_ii_p0265_health." UWORD NO_COMPU_METHOD 0 0 0 65535 ECU_ADDRESS 0x400020AC /end MEASUREMENT
/begin MEASUREMENT obd_ii_p0267_fail_ticks "Consecutive failing samples for P0267; at obd_ii_monitor_debounce_ticks decrements obd_ii_p0267_health." UWORD NO_COMPU_METHOD 0 0 0 65535 ECU_ADDRESS 0x400020AE /end MEASUREMENT
/begin MEASUREMENT obd_ii_p0268_fail_ticks "Consecutive failing samples for P0268; at obd_ii_monitor_debounce_ticks decrements obd_ii_p0268_health." UWORD NO_COMPU_METHOD 0 0 0 65535 ECU_ADDRESS 0x400020B0 /end MEASUREMENT
/begin MEASUREMENT obd_ii_p0270_fail_ticks "Consecutive failing samples for P0270; at obd_ii_monitor_debounce_ticks decrements obd_ii_p0270_health." UWORD NO_COMPU_METHOD 0 0 0 65535 ECU_ADDRESS 0x400020B2 /end MEASUREMENT
/begin MEASUREMENT obd_ii_p0271_fail_ticks "Consecutive failing samples for P0271; at obd_ii_monitor_debounce_ticks decrements obd_ii_p0271_health." UWORD NO_COMPU_METHOD 0 0 0 65535 ECU_ADDRESS 0x400020B4 /end MEASUREMENT
/begin MEASUREMENT obd_ii_p0273_fail_ticks "Consecutive failing samples for P0273; at obd_ii_monitor_debounce_ticks decrements obd_ii_p0273_health." UWORD NO_COMPU_METHOD 0 0 0 65535 ECU_ADDRESS 0x400020B6 /end MEASUREMENT
/begin MEASUREMENT obd_ii_p0274_fail_ticks "Consecutive failing samples for P0274; at obd_ii_monitor_debounce_ticks decrements obd_ii_p0274_health." UWORD NO_COMPU_METHOD 0 0 0 65535 ECU_ADDRESS 0x400020B8 /end MEASUREMENT
/begin MEASUREMENT obd_ii_p0276_fail_ticks "Consecutive failing samples for P0276; at obd_ii_monitor_debounce_ticks decrements obd_ii_p0276_health." UWORD NO_COMPU_METHOD 0 0 0 65535 ECU_ADDRESS 0x400020BA /end MEASUREMENT
/begin MEASUREMENT obd_ii_p0277_fail_ticks "Consecutive failing samples for P0277; at obd_ii_monitor_debounce_ticks decrements obd_ii_p0277_health." UWORD NO_COMPU_METHOD 0 0 0 65535 ECU_ADDRESS 0x400020BC /end MEASUREMENT
/begin MEASUREMENT obd_ii_p0351_fail_ticks "Consecutive failing samples for P0351; at obd_ii_monitor_debounce_ticks decrements obd_ii_p0351_health." UWORD NO_COMPU_METHOD 0 0 0 65535 ECU_ADDRESS 0x400020BE /end MEASUREMENT
/begin MEASUREMENT obd_ii_p0352_fail_ticks "Consecutive failing samples for P0352; at obd_ii_monitor_debounce_ticks decrements obd_ii_p0352_health." UWORD NO_COMPU_METHOD 0 0 0 65535 ECU_ADDRESS 0x400020C0 /end MEASUREMENT
/begin MEASUREMENT obd_ii_p0353_fail_ticks "Consecutive failing samples for P0353; at obd_ii_monitor_debounce_ticks decrements obd_ii_p0353_health." UWORD NO_COMPU_METHOD 0 0 0 65535 ECU_ADDRESS 0x400020C2 /end MEASUREMENT
/begin MEASUREMENT obd_ii_p0354_fail_ticks "Consecutive failing samples for P0354; at obd_ii_monitor_debounce_ticks decrements obd_ii_p0354_health." UWORD NO_COMPU_METHOD 0 0 0 65535 ECU_ADDRESS 0x400020C4 /end MEASUREMENT
/begin MEASUREMENT obd_ii_p0355_fail_ticks "Consecutive failing samples for P0355; at obd_ii_monitor_debounce_ticks decrements obd_ii_p0355_health." UWORD NO_COMPU_METHOD 0 0 0 65535 ECU_ADDRESS 0x400020C6 /end MEASUREMENT
/begin MEASUREMENT obd_ii_p0356_fail_ticks "Consecutive failing samples for P0356; at obd_ii_monitor_debounce_ticks decrements obd_ii_p0356_health." UWORD NO_COMPU_METHOD 0 0 0 65535 ECU_ADDRESS 0x400020C8 /end MEASUREMENT
/begin MEASUREMENT obd_ii_p0141_health "Debounce health for P0141: reset to its CAL debounce count, decremented on failing samples; DTC fails at 0." UBYTE NO_COMPU_METHOD 0 0 0 255 ECU_ADDRESS 0x400020CA /end MEASUREMENT
/begin MEASUREMENT obd_ii_u0141_fail_ticks "Consecutive failing samples for U0141; at obd_ii_monitor_debounce_ticks decrements obd_ii_u0141_health." UWORD NO_COMPU_METHOD 0 0 0 65535 ECU_ADDRESS 0x400020CC /end MEASUREMENT
/begin MEASUREMENT obd_ii_p0480_health "Debounce health for P0480: reset to its CAL debounce count, decremented on failing samples; DTC fails at 0." UBYTE NO_COMPU_METHOD 0 0 0 255 ECU_ADDRESS 0x400020CE /end MEASUREMENT
/begin MEASUREMENT obd_ii_p0480_fail_ticks "Consecutive failing samples for P0480; at obd_ii_monitor_debounce_ticks decrements obd_ii_p0480_health." UWORD NO_COMPU_METHOD 0 0 0 65535 ECU_ADDRESS 0x400020D0 /end MEASUREMENT
/begin MEASUREMENT obd_ii_p0482_health "Debounce health for P0482: reset to its CAL debounce count, decremented on failing samples; DTC fails at 0." UBYTE NO_COMPU_METHOD 0 0 0 255 ECU_ADDRESS 0x400020D2 /end MEASUREMENT
/begin MEASUREMENT obd_ii_p0482_fail_ticks "Consecutive failing samples for P0482; at obd_ii_monitor_debounce_ticks decrements obd_ii_p0482_health." UWORD NO_COMPU_METHOD 0 0 0 65535 ECU_ADDRESS 0x400020D4 /end MEASUREMENT
/begin MEASUREMENT obd_ii_p0135_fail_ticks "Consecutive failing samples for P0135; at obd_ii_monitor_debounce_ticks decrements obd_ii_p0135_health." UWORD NO_COMPU_METHOD 0 0 0 65535 ECU_ADDRESS 0x400020D6 /end MEASUREMENT
/begin MEASUREMENT obd_ii_p0155_fail_ticks "Consecutive failing samples for P0155; at obd_ii_monitor_debounce_ticks decrements obd_ii_p0155_health." UWORD NO_COMPU_METHOD 0 0 0 65535 ECU_ADDRESS 0x400020D8 /end MEASUREMENT
/begin MEASUREMENT obd_ii_p0141_fail_ticks "Consecutive failing samples for P0141; at obd_ii_monitor_debounce_ticks decrements obd_ii_p0141_health." UWORD NO_COMPU_METHOD 0 0 0 65535 ECU_ADDRESS 0x400020DA /end MEASUREMENT
/begin MEASUREMENT obd_ii_p0161_fail_ticks "Consecutive failing samples for P0161; at obd_ii_monitor_debounce_ticks decrements obd_ii_p0161_health." UWORD NO_COMPU_METHOD 0 0 0 65535 ECU_ADDRESS 0x400020DC /end MEASUREMENT
/begin MEASUREMENT obd_ii_p0447_health "Debounce health for P0447: reset to its CAL debounce count, decremented on failing samples; DTC fails at 0." UBYTE NO_COMPU_METHOD 0 0 0 255 ECU_ADDRESS 0x400020DE /end MEASUREMENT
/begin MEASUREMENT obd_ii_p0447_fail_ticks "Consecutive failing samples for P0447; at obd_ii_monitor_debounce_ticks decrements obd_ii_p0447_health." UWORD NO_COMPU_METHOD 0 0 0 65535 ECU_ADDRESS 0x400020E0 /end MEASUREMENT
/begin MEASUREMENT obd_ii_p0448_health "Debounce health for P0448: reset to its CAL debounce count, decremented on failing samples; DTC fails at 0." UBYTE NO_COMPU_METHOD 0 0 0 255 ECU_ADDRESS 0x400020E2 /end MEASUREMENT
/begin MEASUREMENT obd_ii_p0448_fail_ticks "Consecutive failing samples for P0448; at obd_ii_monitor_debounce_ticks decrements obd_ii_p0448_health." UWORD NO_COMPU_METHOD 0 0 0 65535 ECU_ADDRESS 0x400020E4 /end MEASUREMENT
/begin MEASUREMENT obd_ii_p2602_health "Debounce health for P2602: reset to its CAL debounce count, decremented on failing samples; DTC fails at 0." UBYTE NO_COMPU_METHOD 0 0 0 255 ECU_ADDRESS 0x400020E6 /end MEASUREMENT
/begin MEASUREMENT obd_ii_p2602_fail_ticks "Consecutive failing samples for P2602; at obd_ii_monitor_debounce_ticks decrements obd_ii_p2602_health." UWORD NO_COMPU_METHOD 0 0 0 65535 ECU_ADDRESS 0x400020E8 /end MEASUREMENT
/begin MEASUREMENT obd_ii_p2603_health "Debounce health for P2603: reset to its CAL debounce count, decremented on failing samples; DTC fails at 0." UBYTE NO_COMPU_METHOD 0 0 0 255 ECU_ADDRESS 0x400020EA /end MEASUREMENT
/begin MEASUREMENT obd_ii_p2603_fail_ticks "Consecutive failing samples for P2603; at obd_ii_monitor_debounce_ticks decrements obd_ii_p2603_health." UWORD NO_COMPU_METHOD 0 0 0 65535 ECU_ADDRESS 0x400020EC /end MEASUREMENT
/begin MEASUREMENT obd_ii_circuit_flags_ee "Electrical circuit monitor bits (low nibble active faults)." UBYTE NO_COMPU_METHOD 0 0 0 255 ECU_ADDRESS 0x400020EE /end MEASUREMENT
/begin MEASUREMENT obd_ii_p2754_fail_ticks "Consecutive failing samples for P2754; at obd_ii_monitor_debounce_ticks decrements obd_ii_p2754_health." UWORD NO_COMPU_METHOD 0 0 0 65535 ECU_ADDRESS 0x400020F0 /end MEASUREMENT
/begin MEASUREMENT obd_ii_p2755_fail_ticks "Consecutive failing samples for P2755; at obd_ii_monitor_debounce_ticks decrements obd_ii_p2755_health." UWORD NO_COMPU_METHOD 0 0 0 65535 ECU_ADDRESS 0x400020F2 /end MEASUREMENT
/begin MEASUREMENT obd_ii_p0616_health "Debounce health for P0616: reset to its CAL debounce count, decremented on failing samples; DTC fails at 0." UBYTE NO_COMPU_METHOD 0 0 0 255 ECU_ADDRESS 0x400020F4 /end MEASUREMENT
/begin MEASUREMENT obd_ii_p0616_fail_ticks "Consecutive failing samples for P0616; at obd_ii_monitor_debounce_ticks decrements obd_ii_p0616_health." UWORD NO_COMPU_METHOD 0 0 0 65535 ECU_ADDRESS 0x400020F6 /end MEASUREMENT
/begin MEASUREMENT obd_ii_p0617_health "Debounce health for P0617: reset to its CAL debounce count, decremented on failing samples; DTC fails at 0." UBYTE NO_COMPU_METHOD 0 0 0 255 ECU_ADDRESS 0x400020F8 /end MEASUREMENT
/begin MEASUREMENT obd_ii_p0617_fail_ticks "Consecutive failing samples for P0617; at obd_ii_monitor_debounce_ticks decrements obd_ii_p0617_health." UWORD NO_COMPU_METHOD 0 0 0 65535 ECU_ADDRESS 0x400020FA /end MEASUREMENT
/begin MEASUREMENT obd_ii_p2612_health "Debounce health for P2612: reset to its CAL debounce count, decremented on failing samples; DTC fails at 0." UBYTE NO_COMPU_METHOD 0 0 0 255 ECU_ADDRESS 0x400020FC /end MEASUREMENT
/begin MEASUREMENT obd_ii_p2612_fail_ticks "Consecutive failing samples for P2612; at obd_ii_monitor_debounce_ticks decrements obd_ii_p2612_health." UWORD NO_COMPU_METHOD 0 0 0 65535 ECU_ADDRESS 0x400020FE /end MEASUREMENT
/begin MEASUREMENT obd_ii_p2613_health "Debounce health for P2613: reset to its CAL debounce count, decremented on failing samples; DTC fails at 0." UBYTE NO_COMPU_METHOD 0 0 0 255 ECU_ADDRESS 0x40002100 /end MEASUREMENT
/begin MEASUREMENT obd_ii_p2613_fail_ticks "Consecutive failing samples for P2613; at obd_ii_monitor_debounce_ticks decrements obd_ii_p2613_health." UWORD NO_COMPU_METHOD 0 0 0 65535 ECU_ADDRESS 0x40002102 /end MEASUREMENT
/begin MEASUREMENT obd_ii_p2170_health "P2170 health (CAL_obd_ii_P2170_pass_counter_max)." UBYTE NO_COMPU_METHOD 0 0 0 255 ECU_ADDRESS 0x40002104 /end MEASUREMENT
/begin MEASUREMENT obd_ii_p2170_fail_ticks "Consecutive failing samples for P2170; at obd_ii_monitor_debounce_ticks decrements obd_ii_p2170_health." UWORD NO_COMPU_METHOD 0 0 0 65535 ECU_ADDRESS 0x40002106 /end MEASUREMENT
/begin MEASUREMENT obd_ii_p2171_health "Debounce health for P2171: reset to its CAL debounce count, decremented on failing samples; DTC fails at 0." UBYTE NO_COMPU_METHOD 0 0 0 255 ECU_ADDRESS 0x40002108 /end MEASUREMENT
/begin MEASUREMENT obd_ii_p2171_fail_ticks "Consecutive failing samples for P2171; at obd_ii_monitor_debounce_ticks decrements obd_ii_p2171_health." UWORD NO_COMPU_METHOD 0 0 0 65535 ECU_ADDRESS 0x4000210A /end MEASUREMENT
/begin MEASUREMENT obd_ii_p023b_health "Debounce health for P023B: reset to its CAL debounce count, decremented on failing samples; DTC fails at 0." UBYTE NO_COMPU_METHOD 0 0 0 255 ECU_ADDRESS 0x4000210C /end MEASUREMENT
/begin MEASUREMENT obd_ii_p023b_fail_ticks "Consecutive failing samples for P023B; at obd_ii_monitor_debounce_ticks decrements obd_ii_p023b_health." UWORD NO_COMPU_METHOD 0 0 0 65535 ECU_ADDRESS 0x4000210E /end MEASUREMENT
/begin MEASUREMENT obd_ii_p023c_health "Debounce health for P023C: reset to its CAL debounce count, decremented on failing samples; DTC fails at 0." UBYTE NO_COMPU_METHOD 0 0 0 255 ECU_ADDRESS 0x40002110 /end MEASUREMENT
/begin MEASUREMENT obd_ii_p023c_fail_ticks "Consecutive failing samples for P023C; at obd_ii_monitor_debounce_ticks decrements obd_ii_p023c_health." UWORD NO_COMPU_METHOD 0 0 0 65535 ECU_ADDRESS 0x40002112 /end MEASUREMENT
/begin MEASUREMENT cac_fault_code_latched "Charge-cooler pump fault code bits (latched)." UWORD NO_COMPU_METHOD 0 0 0 65535 ECU_ADDRESS 0x40002114 /end MEASUREMENT
/begin MEASUREMENT cac_response_timestamp "Charge-cooler pump response timer (1 kHz, saturating)." UWORD CM_u8_time_ms 0 0 0 65535 ECU_ADDRESS 0x40002116 /end MEASUREMENT
/begin MEASUREMENT cac_response_time "Charge-cooler pump measured response time (timestamp - 50)." UWORD CM_u8_time_ms 0 0 0 65535 ECU_ADDRESS 0x40002118 /end MEASUREMENT
/begin MEASUREMENT cac_diag_timer "Charge-cooler diagnostic timer (1 kHz)." UWORD CM_u8_time_ms 0 0 0 65535 ECU_ADDRESS 0x4000211A /end MEASUREMENT
/begin MEASUREMENT cac_pwm_active_timer "Time the charge-cooler PWM has been active (1 kHz)." UWORD CM_u8_time_ms 0 0 0 65535 ECU_ADDRESS 0x4000211C /end MEASUREMENT
/begin MEASUREMENT cac_fault_debounce_counter "Charge-cooler fault debounce (reload 10)." UBYTE NO_COMPU_METHOD 0 0 0 255 ECU_ADDRESS 0x4000211E /end MEASUREMENT
/begin MEASUREMENT cac_pwm_mismatch_counter "Charge-cooler PWM mismatch counter (vs CAL_cac_pwm_mismatch_threshold)." UBYTE NO_COMPU_METHOD 0 0 0 255 ECU_ADDRESS 0x4000211F /end MEASUREMENT
/begin MEASUREMENT cac_diag_state_timeout_counter "Charge-cooler diag state timeout counter (> 50)." UBYTE NO_COMPU_METHOD 0 0 0 255 ECU_ADDRESS 0x40002120 /end MEASUREMENT
/begin MEASUREMENT cac_measured_dutycycle "Charge-air-cooler measured dutycycle (val/255)." UBYTE CM_u8_factor_1_255 0 0 0 100 ECU_ADDRESS 0x40002121 /end MEASUREMENT
/begin MEASUREMENT obd_ii_p0661_health "Debounce health for P0661: reset to its CAL debounce count, decremented on failing samples; DTC fails at 0." UBYTE NO_COMPU_METHOD 0 0 0 255 ECU_ADDRESS 0x40002122 /end MEASUREMENT
/begin MEASUREMENT obd_ii_p0662_health "Debounce health for P0662: reset to its CAL debounce count, decremented on failing samples; DTC fails at 0." UBYTE NO_COMPU_METHOD 0 0 0 255 ECU_ADDRESS 0x40002123 /end MEASUREMENT
/begin MEASUREMENT accelerator_pedal_pos_d "Accelerator pedal position d (val/1023)." UWORD CM_u16_factor_1_1023 0 0 0 6406.15835777126 ECU_ADDRESS 0x40002128 /end MEASUREMENT
/begin MEASUREMENT accelerator_pedal_pos_e "Accelerator pedal position e (val/1023)." UWORD CM_u16_factor_1_1023 0 0 0 6406.15835777126 ECU_ADDRESS 0x4000212A /end MEASUREMENT
/begin MEASUREMENT tps_requested_scaled_by_limit "Throttle position requested scaled by limit (val/1023)." UWORD CM_u16_factor_1_1023 0 0 0 6406.15835777126 ECU_ADDRESS 0x4000212C /end MEASUREMENT
/begin MEASUREMENT tps_requested_scaled_by_limit2 "Throttle position requested scaled by limit2 (val/255)." UWORD CM_u8_factor_1_255 0 0 0 25700 ECU_ADDRESS 0x4000212E /end MEASUREMENT
/begin MEASUREMENT accel_pedal_latched "Accelerator pedal latched (val/1023)." UWORD CM_u16_factor_1_1023 0 0 0 6406.15835777126 ECU_ADDRESS 0x40002130 /end MEASUREMENT
/begin MEASUREMENT tps_shaping_time_delta "Time delta computed in init_tps_shaping." ULONG NO_COMPU_METHOD 0 0 0 4294967295 ECU_ADDRESS 0x40002132 /end MEASUREMENT
/begin MEASUREMENT tps_driver_requested "Time delta computed in init_tps_shaping." ULONG NO_COMPU_METHOD 0 0 0 4294967295 ECU_ADDRESS 0x40002134 /end MEASUREMENT
/begin MEASUREMENT dca_stationary_wait_timer "DCA stationary wait (vs CAL_dca_stationary_wait_time*20)." UWORD CM_u8_time_5ms 0 0 0 327675 ECU_ADDRESS 0x40002136 /end MEASUREMENT
/begin MEASUREMENT dca_active_timer "Drive-cycle-assist active timer (ms = val*5)." UWORD CM_u8_time_5ms 0 0 0 327675 ECU_ADDRESS 0x40002138 /end MEASUREMENT
/begin MEASUREMENT dca_activate_timer "DCA activation counter (vs CAL_dca_activate_timer)." UBYTE NO_COMPU_METHOD 0 0 0 255 ECU_ADDRESS 0x4000213A /end MEASUREMENT
/begin MEASUREMENT dca_tps_idle_delta "u16_factor_1/1023" UWORD CM_u16_factor_1_1023 0 0 0 6406.15835777126 ECU_ADDRESS 0x4000213C /end MEASUREMENT
/begin MEASUREMENT dca_tps_target_limit "u16_factor_1/1023" UWORD CM_u16_factor_1_1023 0 0 0 6406.15835777126 ECU_ADDRESS 0x4000213E /end MEASUREMENT
/begin MEASUREMENT dca_accel_pedal_raw "u16_factor_1/1023" UWORD CM_u16_factor_1_1023 0 0 0 6406.15835777126 ECU_ADDRESS 0x40002140 /end MEASUREMENT
/begin MEASUREMENT dca_accel_pedal "u16_factor_1/1023" UWORD CM_u16_factor_1_1023 0 0 0 6406.15835777126 ECU_ADDRESS 0x40002142 /end MEASUREMENT
/begin MEASUREMENT dca_tps_ramp_step "DCA throttle ramp step lookup." UWORD NO_COMPU_METHOD 0 0 0 65535 ECU_ADDRESS 0x40002144 /end MEASUREMENT
/begin MEASUREMENT dca_tps_ramp_target "DCA throttle ramp target cap." UWORD CM_u16_factor_1_1023 0 0 0 6406.15835777126 ECU_ADDRESS 0x40002146 /end MEASUREMENT
/begin MEASUREMENT dca_tps_ramp_index "DCA throttle ramp index (>>2 axis), 0..1023." UWORD NO_COMPU_METHOD 0 0 0 65535 ECU_ADDRESS 0x40002148 /end MEASUREMENT
/begin MEASUREMENT dca_config_enabled "Drive-cycle-assist config enabled (boolean flag)." UBYTE NO_COMPU_METHOD 0 0 0 255 ECU_ADDRESS 0x4000214A /end MEASUREMENT
/begin MEASUREMENT obd_ii_p2138_health "Debounce health for P2138: reset to its CAL debounce count, decremented on failing samples; DTC fails at 0." UBYTE NO_COMPU_METHOD 0 0 0 255 ECU_ADDRESS 0x4000214B /end MEASUREMENT
/begin MEASUREMENT obd_ii_app_monitor_word_a "Cleared in obd_ii_accel_pedal_monitors." ULONG NO_COMPU_METHOD 0 0 0 4294967295 ECU_ADDRESS 0x4000214C /end MEASUREMENT
/begin MEASUREMENT obd_ii_p2122_health "Cleared in obd_ii_accel_pedal_monitors." ULONG NO_COMPU_METHOD 0 0 0 4294967295 ECU_ADDRESS 0x4000214E /end MEASUREMENT
/begin MEASUREMENT obd_ii_app_monitor_word_b "Cleared in obd_ii_accel_pedal_monitors." ULONG NO_COMPU_METHOD 0 0 0 4294967295 ECU_ADDRESS 0x40002150 /end MEASUREMENT
/begin MEASUREMENT obd_ii_p2123_health "Cleared in obd_ii_accel_pedal_monitors." ULONG NO_COMPU_METHOD 0 0 0 4294967295 ECU_ADDRESS 0x40002152 /end MEASUREMENT
/begin MEASUREMENT obd_ii_app_monitor_word_c "Cleared in obd_ii_accel_pedal_monitors." ULONG NO_COMPU_METHOD 0 0 0 4294967295 ECU_ADDRESS 0x40002154 /end MEASUREMENT
/begin MEASUREMENT obd_ii_p2127_health "Cleared in obd_ii_accel_pedal_monitors." ULONG NO_COMPU_METHOD 0 0 0 4294967295 ECU_ADDRESS 0x40002156 /end MEASUREMENT
/begin MEASUREMENT obd_ii_app_monitor_word_d "Cleared in obd_ii_accel_pedal_monitors." ULONG NO_COMPU_METHOD 0 0 0 4294967295 ECU_ADDRESS 0x40002158 /end MEASUREMENT
/begin MEASUREMENT obd_ii_p2128_health "Cleared in obd_ii_accel_pedal_monitors." ULONG NO_COMPU_METHOD 0 0 0 4294967295 ECU_ADDRESS 0x4000215A /end MEASUREMENT
/begin MEASUREMENT obd_ii_app_monitor_word_e "Cleared in obd_ii_accel_pedal_monitors." ULONG NO_COMPU_METHOD 0 0 0 4294967295 ECU_ADDRESS 0x4000215C /end MEASUREMENT
/begin MEASUREMENT accel_pedal_shift_qualify_timer "Cleared in obd_ii_accel_pedal_monitors." ULONG NO_COMPU_METHOD 0 0 0 4294967295 ECU_ADDRESS 0x4000215E /end MEASUREMENT
/begin MEASUREMENT accel_pedal_shift_qualify_armed "Cleared in obd_ii_accel_pedal_monitors." ULONG NO_COMPU_METHOD 0 0 0 4294967295 ECU_ADDRESS 0x4000215F /end MEASUREMENT
/begin MEASUREMENT dca_mode "Drive-cycle-assist mode (enumerated state)." UBYTE NO_COMPU_METHOD 0 0 0 255 ECU_ADDRESS 0x40002160 /end MEASUREMENT
/begin MEASUREMENT obd_ii_commanded_evap_purge "Commanded evap purge duty (0..255 into the freeze frame)." UWORD NO_COMPU_METHOD 0 0 0 65535 ECU_ADDRESS 0x40002168 /end MEASUREMENT
/begin MEASUREMENT evap_purge_flags "Evap purge state bits." UWORD NO_COMPU_METHOD 0 0 0 65535 ECU_ADDRESS 0x4000216A /end MEASUREMENT
/begin MEASUREMENT evap_purge_duty_hi "High byte of evap_purge_duty_ramped (duty/256); non-zero blocks alpha-N learning." UBYTE CM_u8_factor_1_256 0 0 0 99.609375 ECU_ADDRESS 0x4000216C /end MEASUREMENT
/begin MEASUREMENT idle_bypass_airflow "Air bypassing the throttle through the purge (subtracted from idle air)." UWORD CM_u16_flow_10mg_s 0 0 0 655350 ECU_ADDRESS 0x4000216E /end MEASUREMENT
/begin MEASUREMENT load_comp_idle "Load compensation idle (mg/stroke)." UWORD CM_u8_load_mg_stroke 0 0 0 65535 ECU_ADDRESS 0x40002170 /end MEASUREMENT
/begin MEASUREMENT evap_purge_fuel_mass_b1 "Bank-1 evap purge fuel mass per injection (mg = val/100)." UWORD CM_u16_mass_10ug 0 0 0 655350 ECU_ADDRESS 0x40002174 /end MEASUREMENT
/begin MEASUREMENT evap_purge_fuel_mass_b2 "Bank-2 evap purge fuel mass per injection (mg = val/100)." UWORD CM_u16_mass_10ug 0 0 0 655350 ECU_ADDRESS 0x40002176 /end MEASUREMENT
/begin MEASUREMENT obd_ii_vapor_concentration "Evap vapor concentration estimate (mode 22)." UWORD NO_COMPU_METHOD 0 0 0 65535 ECU_ADDRESS 0x40002178 /end MEASUREMENT
/begin MEASUREMENT evap_purge_state "Evap purge state machine (0 off .. 4 purging)." UBYTE NO_COMPU_METHOD 0 0 0 255 ECU_ADDRESS 0x40002180 /end MEASUREMENT
/begin MEASUREMENT evap_purge_vacuum_filtered "Filtered purge vacuum (>>2 axis)." UWORD NO_COMPU_METHOD 0 0 0 65535 ECU_ADDRESS 0x40002182 /end MEASUREMENT
/begin MEASUREMENT evap_purge_bypass_air_axis "idle_bypass_airflow / CAL_evap_idle_bypass_airflow_divisor (0xf2 max)." UBYTE NO_COMPU_METHOD 0 0 0 255 ECU_ADDRESS 0x40002184 /end MEASUREMENT
/begin MEASUREMENT evap_purge_solenoid_duty "Purge solenoid duty sent to evap_purge_solenoid_set_duty." SWORD NO_COMPU_METHOD 0 0 -32768 32767 ECU_ADDRESS 0x40002186 /end MEASUREMENT
/begin MEASUREMENT evap_purge_solenoid_duty_table "Purge solenoid duty from the table (before CAL_obd_ii_commanded_evap_purge_min)." UWORD NO_COMPU_METHOD 0 0 0 65535 ECU_ADDRESS 0x40002188 /end MEASUREMENT
/begin MEASUREMENT evap_purge_duty_integral "Running sum of evap_purge_duty_hi (100 ms)." ULONG NO_COMPU_METHOD 0 0 0 4294967295 ECU_ADDRESS 0x4000218C /end MEASUREMENT
/begin MEASUREMENT evap_stft_settle_timer "Evap STFT settle countdown (CAL_evap_stft_settle_time)." UBYTE CM_u8_time_100ms 0 0 0 25500 ECU_ADDRESS 0x40002190 /end MEASUREMENT
/begin MEASUREMENT evap_purge_duty_ramped "Ramped purge duty (x256)." UWORD NO_COMPU_METHOD 0 0 0 65535 ECU_ADDRESS 0x400021AC /end MEASUREMENT
/begin MEASUREMENT evap_purge_duty_max "Purge duty limit (min of flow/fuel limits, idle cap)." UBYTE NO_COMPU_METHOD 0 0 0 255 ECU_ADDRESS 0x400021AE /end MEASUREMENT
/begin MEASUREMENT evap_purge_duty_max_flow "Lookup result of CAL_evap_purge_flow_max_duty." UBYTE CM_u8_factor_1_255 0 0 0 100 ECU_ADDRESS 0x400021AF /end MEASUREMENT
/begin MEASUREMENT evap_purge_duty_max_fuel "Purge duty limit from the fuel-mass budget (0xff = none)." UBYTE NO_COMPU_METHOD 0 0 0 255 ECU_ADDRESS 0x400021B0 /end MEASUREMENT
/begin MEASUREMENT evap_bypass_air_integral "Running sum of idle_bypass_airflow (100 ms)." ULONG NO_COMPU_METHOD 0 0 0 4294967295 ECU_ADDRESS 0x400021B4 /end MEASUREMENT
/begin MEASUREMENT evap_purge_duty_ramped_prev "Previous evap_purge_duty_ramped." UWORD NO_COMPU_METHOD 0 0 0 65535 ECU_ADDRESS 0x400021C0 /end MEASUREMENT
/begin MEASUREMENT evap_purge_filter_q8 "Purge IIR accumulator (<<8, CAL_evap_purge_filter_alpha)." SLONG NO_COMPU_METHOD 0 0 -2147483648 2147483647 ECU_ADDRESS 0x400021C4 /end MEASUREMENT
/begin MEASUREMENT evap_purge_inj_fuel_mass_min "Minimum injector fuel mass kept when purging (mg = val/100)." UWORD CM_u16_mass_10ug 0 0 0 655350 ECU_ADDRESS 0x400021C8 /end MEASUREMENT
/begin MEASUREMENT evap_purge_enable_delay "Purge enable delay (lookup<<4), decremented at 100 ms." UWORD NO_COMPU_METHOD 0 0 0 65535 ECU_ADDRESS 0x400021CA /end MEASUREMENT
/begin MEASUREMENT evap_purge_pe_suspend_delay "Delay before suspending purge in power enrichment (CAL_evap_purge_power_enrich_suspend_delay)." UBYTE CM_u8_time_100ms 0 0 0 25500 ECU_ADDRESS 0x400021D0 /end MEASUREMENT
/begin MEASUREMENT evap_purge_pe_suspend_hold "Purge suspend hold after power enrichment (CAL_evap_purge_power_enrich_suspend_hold)." UBYTE CM_u8_time_100ms 0 0 0 25500 ECU_ADDRESS 0x400021D1 /end MEASUREMENT
/begin MEASUREMENT evap_purge_ramp_divider "Purge ramp divider (to 10)." UBYTE NO_COMPU_METHOD 0 0 0 255 ECU_ADDRESS 0x400021D2 /end MEASUREMENT
/begin MEASUREMENT evap_fuel_learn_entry_delay "Delay before fuel learning with purge (CAL_evap_fuel_learn_entry_delay)." UBYTE CM_u8_time_100ms 0 0 0 25500 ECU_ADDRESS 0x400021D3 /end MEASUREMENT
/begin MEASUREMENT evap_purge_start_delay "Purge start delay (CAL_evap_purge_start_delay<<4)." UWORD CM_u8_time_100ms 0 0 0 6553500 ECU_ADDRESS 0x400021D4 /end MEASUREMENT
/begin MEASUREMENT evap_purge_open_kick_timer "Purge open kick countdown (CAL_evap_purge_open_kick_time)." UBYTE CM_u8_time_100ms 0 0 0 25500 ECU_ADDRESS 0x400021D6 /end MEASUREMENT
/begin MEASUREMENT evap_purge_restart_delay "Purge restart countdown." UBYTE CM_u8_time_100ms 0 0 0 25500 ECU_ADDRESS 0x400021D7 /end MEASUREMENT
/begin MEASUREMENT obd_ii_mode2f_flags_enabled "uint32_t" ULONG NO_COMPU_METHOD 0 0 0 4294967295 ECU_ADDRESS 0x400021D8 /end MEASUREMENT
/begin MEASUREMENT obd_ii_mode2f_flags_state "uint32_t" ULONG NO_COMPU_METHOD 0 0 0 4294967295 ECU_ADDRESS 0x400021DC /end MEASUREMENT
/begin MEASUREMENT obd_ii_2f_trans_pump_requested "Mode $2F trans pump request bits." ULONG NO_COMPU_METHOD 0 0 0 4294967295 ECU_ADDRESS 0x400021E0 /end MEASUREMENT
/begin MEASUREMENT obd_ii_2f_trans_pump_state "Mode $2F trans pump state bits." ULONG NO_COMPU_METHOD 0 0 0 4294967295 ECU_ADDRESS 0x400021E4 /end MEASUREMENT
/begin MEASUREMENT obd_ii_mode2f_flags_misc "Mode $2F actuator test bits (third word)." ULONG NO_COMPU_METHOD 0 0 0 4294967295 ECU_ADDRESS 0x400021E8 /end MEASUREMENT
/begin MEASUREMENT timer_engine_off_unknown1 "Timer engine off unknown1 (ms = val*5)." UWORD CM_u8_time_5ms 0 0 0 327675 ECU_ADDRESS 0x400021EC /end MEASUREMENT
/begin MEASUREMENT obd_ii_mode2f_vvti_output_val "Mode $2F VVT test duty (val/256) applied to all four solenoids." UBYTE CM_u8_factor_1_256 0 0 0 99.609375 ECU_ADDRESS 0x400021EE /end MEASUREMENT
/begin MEASUREMENT obd_ii_mode2f_tach_commanded "OBD-II: mode2f tach commanded (RPM = val*4)." UWORD CM_u8_rspeed_4rpm 0 0 0 262140 ECU_ADDRESS 0x400021F0 /end MEASUREMENT
/end MODULE
/end PROJECT
