ASAP2_VERSION 1 61
/begin PROJECT C132E0278 "Lotus T6 C132E0278"
/begin HEADER "" VERSION "generated v1" /end HEADER
/begin MODULE C132E0278 ""
/begin MOD_COMMON "" BYTE_ORDER MSB_FIRST ALIGNMENT_BYTE 1 ALIGNMENT_WORD 2 ALIGNMENT_LONG 4 /end MOD_COMMON
/begin RECORD_LAYOUT RL_VALUE_UBYTE FNC_VALUES 1 UBYTE ROW_DIR DIRECT /end RECORD_LAYOUT
/begin RECORD_LAYOUT RL_AXIS_UBYTE AXIS_PTS_X 1 UBYTE INDEX_INCR DIRECT /end RECORD_LAYOUT
/begin RECORD_LAYOUT RL_VALUE_UWORD FNC_VALUES 1 UWORD ROW_DIR DIRECT /end RECORD_LAYOUT
/begin RECORD_LAYOUT RL_AXIS_UWORD AXIS_PTS_X 1 UWORD INDEX_INCR DIRECT /end RECORD_LAYOUT
/begin RECORD_LAYOUT RL_VALUE_SWORD FNC_VALUES 1 SWORD ROW_DIR DIRECT /end RECORD_LAYOUT
/begin COMPU_METHOD CM_i16_factor_1_20 "i16_factor_1/20" RAT_FUNC "%8.0" "%" COEFFS 0 1 0 0 0 5 /end COMPU_METHOD
/begin COMPU_METHOD CM_i16_pressure_mbar "i16_pressure_mbar" RAT_FUNC "%8.0" "mbar" COEFFS 0 1 0 0 0 1 /end COMPU_METHOD
/begin COMPU_METHOD CM_u16_angle_1_10deg "u16_angle_1/10deg" RAT_FUNC "%9.1" "deg" COEFFS 0 1 0 0 0 0.1 /end COMPU_METHOD
/begin COMPU_METHOD CM_u16_distance_mm "u16_distance_mm" RAT_FUNC "%8.0" "mm" COEFFS 0 1 0 0 0 1 /end COMPU_METHOD
/begin COMPU_METHOD CM_u16_distance_mm_div2 "u16_distance_mm_div2" RAT_FUNC "%9.1" "mm" COEFFS 0 1 0 0 0 0.5 /end COMPU_METHOD
/begin COMPU_METHOD CM_u16_factor_1_10000 "u16_factor_1/10000" RAT_FUNC "%10.2" "%" COEFFS 0 1 0 0 0 0.01 /end COMPU_METHOD
/begin COMPU_METHOD CM_u16_factor_1_1023 "u16_factor_1/1023" RAT_FUNC "%12.4" "%" COEFFS 0 1 0 0 0 0.0977517106549365 /end COMPU_METHOD
/begin COMPU_METHOD CM_u16_factor_1_4095 "u16_factor_1/4095" RAT_FUNC "%12.4" "%" COEFFS 0 1 0 0 0 0.0244200244200244 /end COMPU_METHOD
/begin COMPU_METHOD CM_u16_flow_100_256mg_s "u16_flow_100/256mg/s" RAT_FUNC "%12.4" "mg/s" COEFFS 0 1 0 0 0 0.390625 /end COMPU_METHOD
/begin COMPU_METHOD CM_u16_flow_10mg_s "u16_flow_10mg/s" RAT_FUNC "%8.0" "mg/s" COEFFS 0 1 0 0 0 10 /end COMPU_METHOD
/begin COMPU_METHOD CM_u16_flow_10mg_s_327680mg_s "u16_flow_10mg/s-327680mg/s" RAT_FUNC "%8.0" "mg/s" COEFFS 0 1 327680 0 0 10 /end COMPU_METHOD
/begin COMPU_METHOD CM_u16_mass_g "u16_mass_g" RAT_FUNC "%8.0" "g" COEFFS 0 1 0 0 0 1 /end COMPU_METHOD
/begin COMPU_METHOD CM_u16_power_1_100kw "u16_power_1/100kw" RAT_FUNC "%10.2" "kW" COEFFS 0 1 0 0 0 0.01 /end COMPU_METHOD
/begin COMPU_METHOD CM_u16_ratio_1_10rpm_kph "u16_ratio_1/10rpm/kph" RAT_FUNC "%9.1" "rpm/kph" COEFFS 0 1 0 0 0 0.1 /end COMPU_METHOD
/begin COMPU_METHOD CM_u16_raw_32768 "u16_raw-32768" RAT_FUNC "%8.0" "" COEFFS 0 1 32768 0 0 1 /end COMPU_METHOD
/begin COMPU_METHOD CM_u16_rspeed_1_4rpm "u16_rspeed_1/4rpm" RAT_FUNC "%10.2" "rpm" COEFFS 0 1 0 0 0 0.25 /end COMPU_METHOD
/begin COMPU_METHOD CM_u16_rspeed_rpm_32768 "u16_rspeed_rpm-32768" RAT_FUNC "%8.0" "rpm" COEFFS 0 1 32768 0 0 1 /end COMPU_METHOD
/begin COMPU_METHOD CM_u16_slip_1_8pct "u16_slip_1/8pct" RAT_FUNC "%11.3" "%" COEFFS 0 1 0 0 0 0.125 /end COMPU_METHOD
/begin COMPU_METHOD CM_u16_time_10us "u16_time_10us" RAT_FUNC "%8.0" "us" COEFFS 0 1 0 0 0 10 /end COMPU_METHOD
/begin COMPU_METHOD CM_u16_voltage_18_1023v "u16_voltage_18/1023v" RAT_FUNC "%12.4" "V" COEFFS 0 1 0 0 0 0.0175953079178886 /end COMPU_METHOD
/begin COMPU_METHOD CM_u16_voltage_5_1023v "u16_voltage_5/1023v" RAT_FUNC "%12.4" "V" COEFFS 0 1 0 0 0 0.00488758553274682 /end COMPU_METHOD
/begin COMPU_METHOD CM_u16_voltage_5_4095v "u16_voltage_5/4095v" RAT_FUNC "%12.4" "V" COEFFS 0 1 0 0 0 0.00122100122100122 /end COMPU_METHOD
/begin COMPU_METHOD CM_u8__127 "u8_-127" RAT_FUNC "%8.0" "" COEFFS 0 1 127 0 0 1 /end COMPU_METHOD
/begin COMPU_METHOD CM_u8_angle_1_4_64deg "u8_angle_1/4-64deg" RAT_FUNC "%10.2" "deg" COEFFS 0 1 64 0 0 0.25 /end COMPU_METHOD
/begin COMPU_METHOD CM_u8_angle_1_4deg "u8_angle_1/4deg" RAT_FUNC "%10.2" "deg" COEFFS 0 1 0 0 0 0.25 /end COMPU_METHOD
/begin COMPU_METHOD CM_u8_dutycycle_100_65280 "u8_dutycycle_100/65280" RAT_FUNC "%12.4" "%" COEFFS 0 1 0 0 0 0.00153186274509804 /end COMPU_METHOD
/begin COMPU_METHOD CM_u8_factor_1_100 "u8_factor_1/100" RAT_FUNC "%8.0" "%" COEFFS 0 1 0 0 0 1 /end COMPU_METHOD
/begin COMPU_METHOD CM_u8_factor_1_255 "u8_factor_1/255" RAT_FUNC "%12.4" "%" COEFFS 0 1 0 0 0 0.392156862745098 /end COMPU_METHOD
/begin COMPU_METHOD CM_u8_factor_1_256 "u8_factor_1/256" RAT_FUNC "%12.4" "%" COEFFS 0 1 0 0 0 0.390625 /end COMPU_METHOD
/begin COMPU_METHOD CM_u8_factor_1_64 "u8_factor_1/64" RAT_FUNC "%12.4" "%" COEFFS 0 1 0 0 0 1.5625 /end COMPU_METHOD
/begin COMPU_METHOD CM_u8_flow_100mg_s "u8_flow_100mg/s" RAT_FUNC "%8.0" "mg/s" COEFFS 0 1 0 0 0 100 /end COMPU_METHOD
/begin COMPU_METHOD CM_u8_flow_2g_s "u8_flow_2g/s" RAT_FUNC "%8.0" "g/s" COEFFS 0 1 0 0 0 2 /end COMPU_METHOD
/begin COMPU_METHOD CM_u8_flow_g_s "u8_flow_g/s" RAT_FUNC "%8.0" "g/s" COEFFS 0 1 0 0 0 1 /end COMPU_METHOD
/begin COMPU_METHOD CM_u8_gain__x_104_26 "u8_gain_(x-104)/26" RAT_FUNC "%12.4" "" COEFFS 0 1 4 0 0 0.0384615384615385 /end COMPU_METHOD
/begin COMPU_METHOD CM_u8_load_1173mg_255stroke "u8_load_1173mg/255stroke" RAT_FUNC "%9.1" "mg/stroke" COEFFS 0 1 0 0 0 4.6 /end COMPU_METHOD
/begin COMPU_METHOD CM_u8_load_4mg_stroke "u8_load_4mg/stroke" RAT_FUNC "%8.0" "mg/stroke" COEFFS 0 1 0 0 0 4 /end COMPU_METHOD
/begin COMPU_METHOD CM_u8_load_mg_stroke "u8_load_mg/stroke" RAT_FUNC "%8.0" "mg/stroke" COEFFS 0 1 0 0 0 1 /end COMPU_METHOD
/begin COMPU_METHOD CM_u8_mass_16g "u8_mass_16g" RAT_FUNC "%8.0" "g" COEFFS 0 1 0 0 0 16 /end COMPU_METHOD
/begin COMPU_METHOD CM_u8_mass_4g "u8_mass_4g" RAT_FUNC "%8.0" "g" COEFFS 0 1 0 0 0 4 /end COMPU_METHOD
/begin COMPU_METHOD CM_u8_pressure_1_10mbar "u8_pressure_1/10mbar" RAT_FUNC "%9.1" "mbar" COEFFS 0 1 0 0 0 0.1 /end COMPU_METHOD
/begin COMPU_METHOD CM_u8_pressure_4mbar "u8_pressure_4mbar" RAT_FUNC "%8.0" "mbar" COEFFS 0 1 0 0 0 4 /end COMPU_METHOD
/begin COMPU_METHOD CM_u8_rspeed_10rpm "u8_rspeed_10rpm" RAT_FUNC "%8.0" "rpm" COEFFS 0 1 0 0 0 10 /end COMPU_METHOD
/begin COMPU_METHOD CM_u8_rspeed_125_4_500rpm "u8_rspeed_125/4+500rpm" RAT_FUNC "%10.2" "rpm" COEFFS 0 1 -500 0 0 31.25 /end COMPU_METHOD
/begin COMPU_METHOD CM_u8_rspeed_25rpm "u8_rspeed_25rpm" RAT_FUNC "%8.0" "rpm" COEFFS 0 1 0 0 0 25 /end COMPU_METHOD
/begin COMPU_METHOD CM_u8_rspeed_2rpm "u8_rspeed_2rpm" RAT_FUNC "%8.0" "rpm" COEFFS 0 1 0 0 0 2 /end COMPU_METHOD
/begin COMPU_METHOD CM_u8_rspeed_4_500rpm "u8_rspeed_4+500rpm" RAT_FUNC "%8.0" "rpm" COEFFS 0 1 -500 0 0 4 /end COMPU_METHOD
/begin COMPU_METHOD CM_u8_rspeed_4rpm "u8_rspeed_4rpm" RAT_FUNC "%8.0" "rpm" COEFFS 0 1 0 0 0 4 /end COMPU_METHOD
/begin COMPU_METHOD CM_u8_rspeed_50rpm "u8_rspeed_50rpm" RAT_FUNC "%8.0" "rpm" COEFFS 0 1 0 0 0 50 /end COMPU_METHOD
/begin COMPU_METHOD CM_u8_rspeed_8rpm "u8_rspeed_8rpm" RAT_FUNC "%8.0" "rpm" COEFFS 0 1 0 0 0 8 /end COMPU_METHOD
/begin COMPU_METHOD CM_u8_rspeed_accel_1_168 "u8_rspeed_accel_1/168" RAT_FUNC "%8.0" "accel_1/168" COEFFS 0 1 0 0 0 1 /end COMPU_METHOD
/begin COMPU_METHOD CM_u8_rspeed_rpm "u8_rspeed_rpm" RAT_FUNC "%8.0" "rpm" COEFFS 0 1 0 0 0 1 /end COMPU_METHOD
/begin COMPU_METHOD CM_u8_slip_2pct "u8_slip_2pct" RAT_FUNC "%8.0" "%" COEFFS 0 1 0 0 0 2 /end COMPU_METHOD
/begin COMPU_METHOD CM_u8_speed_1_100kph "u8_speed_1/100kph" RAT_FUNC "%10.2" "km/h" COEFFS 0 1 0 0 0 0.01 /end COMPU_METHOD
/begin COMPU_METHOD CM_u8_speed_1_10kph "u8_speed_1/10kph" RAT_FUNC "%9.1" "km/h" COEFFS 0 1 0 0 0 0.1 /end COMPU_METHOD
/begin COMPU_METHOD CM_u8_speed_kph "u8_speed_kph" RAT_FUNC "%8.0" "km/h" COEFFS 0 1 0 0 0 1 /end COMPU_METHOD
/begin COMPU_METHOD CM_u8_temp_5_8_40c "u8_temp_5/8-40c" RAT_FUNC "%11.3" "°C" COEFFS 0 1 40 0 0 0.625 /end COMPU_METHOD
/begin COMPU_METHOD CM_u8_tempdelta_5_8c "u8_tempdelta_5/8c" RAT_FUNC "%11.3" "°C" COEFFS 0 1 0 0 0 0.625 /end COMPU_METHOD
/begin COMPU_METHOD CM_u8_time_100ms "u8_time_100ms" RAT_FUNC "%8.0" "ms" COEFFS 0 1 0 0 0 100 /end COMPU_METHOD
/begin COMPU_METHOD CM_u8_time_10ms "u8_time_10ms" RAT_FUNC "%8.0" "ms" COEFFS 0 1 0 0 0 10 /end COMPU_METHOD
/begin COMPU_METHOD CM_u8_time_1600ms "u8_time_1600ms" RAT_FUNC "%8.0" "ms" COEFFS 0 1 0 0 0 1600 /end COMPU_METHOD
/begin COMPU_METHOD CM_u8_time_250ms "u8_time_250ms" RAT_FUNC "%8.0" "ms" COEFFS 0 1 0 0 0 250 /end COMPU_METHOD
/begin COMPU_METHOD CM_u8_time_50ms "u8_time_50ms" RAT_FUNC "%8.0" "ms" COEFFS 0 1 0 0 0 50 /end COMPU_METHOD
/begin COMPU_METHOD CM_u8_time_5ms "u8_time_5ms" RAT_FUNC "%8.0" "ms" COEFFS 0 1 0 0 0 5 /end COMPU_METHOD
/begin COMPU_METHOD CM_u8_time_5s "u8_time_5s" RAT_FUNC "%8.0" "s" COEFFS 0 1 0 0 0 5 /end COMPU_METHOD
/begin COMPU_METHOD CM_u8_time_8us "u8_time_8us" RAT_FUNC "%8.0" "us" COEFFS 0 1 0 0 0 8 /end COMPU_METHOD
/begin COMPU_METHOD CM_u8_time_ms "u8_time_ms" RAT_FUNC "%8.0" "ms" COEFFS 0 1 0 0 0 1 /end COMPU_METHOD
/begin COMPU_METHOD CM_u8_time_s "u8_time_s" RAT_FUNC "%8.0" "s" COEFFS 0 1 0 0 0 1 /end COMPU_METHOD
/begin COMPU_METHOD CM_u8_time_us "u8_time_us" RAT_FUNC "%8.0" "us" COEFFS 0 1 0 0 0 1 /end COMPU_METHOD
/begin COMPU_METHOD CM_u8_torque_2nm "u8_torque_2nm" RAT_FUNC "%8.0" "Nm" COEFFS 0 1 0 0 0 2 /end COMPU_METHOD
/begin COMPU_METHOD CM_u8_torque_4nm "u8_torque_4nm" RAT_FUNC "%8.0" "Nm" COEFFS 0 1 0 0 0 4 /end COMPU_METHOD
/begin COMPU_METHOD CM_u8_torque_nm "u8_torque_nm" RAT_FUNC "%8.0" "Nm" COEFFS 0 1 0 0 0 1 /end COMPU_METHOD
/begin COMPU_METHOD CM_u8_voltage_5_255v "u8_voltage_5/255v" RAT_FUNC "%12.4" "V" COEFFS 0 1 0 0 0 0.0196078431372549 /end COMPU_METHOD
/begin COMPU_METHOD CM_u8_volume_1_10gallon "u8_volume_1/10gallon" RAT_FUNC "%9.1" "gallon" COEFFS 0 1 0 0 0 0.1 /end COMPU_METHOD
/begin CHARACTERISTIC CAL_tpssmooth_rate_closing_clamp_thresholds "Calibration: tpssmooth rate closing clamp thresholds (val/1023; 2-element array)." VAL_BLK 0x40008676 RL_VALUE_UWORD 0 CM_u16_factor_1_1023 0 6406.15835777126 NUMBER 2 /end CHARACTERISTIC
/begin CHARACTERISTIC CAL_idle_clutch_antistall_speed_threshold "Calibration: idle clutch antistall speed threshold (km/h = val/10)." VALUE 0x4000867A RL_VALUE_UBYTE 0 CM_u8_speed_1_10kph 0 25.5 /end CHARACTERISTIC
/begin CHARACTERISTIC CAL_evap_purge_pressure_offset "Calibration: evap pressure sensor offset (mbar). (0091 CAL_sensor_evap_offset)" VALUE 0x40008682 RL_VALUE_SWORD 0 CM_i16_pressure_mbar -32768 32767 /end CHARACTERISTIC
/begin CHARACTERISTIC CAL_cooling_fan_engine_bay_airtemp_enable "Calibration: cooling fan engine bay airtemp enable (°C = val*5/8−40)." VALUE 0x4000868B RL_VALUE_UBYTE 0 CM_u8_temp_5_8_40c -40 119.375 /end CHARACTERISTIC
/begin CHARACTERISTIC CAL_cooling_fan_startup_time "Calibration: cooling fan startup time (ms = val*5)." VALUE 0x4000868C RL_VALUE_UWORD 0 CM_u8_time_5ms 0 327675 /end CHARACTERISTIC
/begin CHARACTERISTIC CAL_cooling_fan_hotstart_temp "Calibration: cooling fan hotstart temperature (°C = val*5/8−40)." VALUE 0x4000868E RL_VALUE_UBYTE 0 CM_u8_temp_5_8_40c -40 119.375 /end CHARACTERISTIC
/begin CHARACTERISTIC CAL_cooling_fan_hotstart_dutycycle "Calibration: cooling fan hotstart dutycycle (val/255)." VALUE 0x4000868F RL_VALUE_UBYTE 0 CM_u8_factor_1_255 0 100 /end CHARACTERISTIC
/begin CHARACTERISTIC CAL_cooling_fan_engine_bay_radfan_threshold_enable "Calibration: cooling fan engine bay radfan threshold enable (val/255)." VALUE 0x40008691 RL_VALUE_UBYTE 0 CM_u8_factor_1_255 0 100 /end CHARACTERISTIC
/begin CHARACTERISTIC CAL_cooling_fan_engine_bay_radfan_threshold_disable "Calibration: cooling fan engine bay radfan threshold disable (val/255)." VALUE 0x40008692 RL_VALUE_UBYTE 0 CM_u8_factor_1_255 0 100 /end CHARACTERISTIC
/begin CHARACTERISTIC CAL_tps_rate_steadystate_window_size "Calibration: tpssmooth rate calculated window size." VALUE 0x4000869B RL_VALUE_UBYTE 0 NO_COMPU_METHOD 0 255 /end CHARACTERISTIC
/begin CHARACTERISTIC CAL_wheel_speed_vss_tire_circumference "Calibration: VSS tyre rolling circumference (mm; stock 2060). speed = circ*36000/period." VALUE 0x4000869C RL_VALUE_UWORD 0 CM_u16_distance_mm 0 65535 /end CHARACTERISTIC
/begin CHARACTERISTIC CAL_torque_ext_torque_limit_hold_count "u8_time_10ms" VALUE 0x400086A4 RL_VALUE_UBYTE 0 CM_u8_time_10ms 0 2550 /end CHARACTERISTIC
/begin CHARACTERISTIC CAL_engine_accel_lookback_teeth "Calibration: engine acceleration look-back (teeth), clamped to 7. (0091 0x40008e7b)" VALUE 0x400086AB RL_VALUE_UBYTE 0 NO_COMPU_METHOD 0 255 /end CHARACTERISTIC
/begin CHARACTERISTIC CAL_cooling_fan_speed_disable_speed "Calibration: cooling fan speed disable speed (km/h)." VALUE 0x400086BF RL_VALUE_UBYTE 0 CM_u8_speed_kph 0 255 /end CHARACTERISTIC
/begin CHARACTERISTIC CAL_idle_flow_integral_adj_max "Calibration: idle integral (/0x2800) upper limit -> A/C idle comp / obd_ii_idle_status=2. (0091 0x40008e90)" VALUE 0x400086C0 RL_VALUE_UBYTE 0 CM_u8_flow_100mg_s 0 25500 /end CHARACTERISTIC
/begin CHARACTERISTIC CAL_idle_flow_integral_adj_min "Calibration: idle integral (/0x2800) lower limit, applied as negative. (0091 0x40008e91, named _max there)" VALUE 0x400086C1 RL_VALUE_UBYTE 0 CM_u8_flow_100mg_s 0 25500 /end CHARACTERISTIC
/begin CHARACTERISTIC CAL_idle_learn_integral_max "Idle learn upper clamp (compared with learn>>10)." VALUE 0x400086C2 RL_VALUE_UBYTE 0 CM_u8_flow_100mg_s 0 25500 /end CHARACTERISTIC
/begin CHARACTERISTIC CAL_idle_learn_integral_min "Idle learn lower clamp (negated; compared with learn>>10)." VALUE 0x400086C3 RL_VALUE_UBYTE 0 CM_u8_flow_100mg_s 0 25500 /end CHARACTERISTIC
/begin CHARACTERISTIC CAL_cooling_recirc_reset_coolant_temp "Calibration: cooling recirc reset coolant temperature (°C = val*5/8−40)." VALUE 0x400086CD RL_VALUE_UBYTE 0 CM_u8_temp_5_8_40c -40 119.375 /end CHARACTERISTIC
/begin CHARACTERISTIC CAL_torque_torque_to_tps_scaling_rpm_range "Calibration: torque torque to throttle position scaling RPM range (RPM = val*125/4+500; 2-element array)." VAL_BLK 0x400086CF RL_VALUE_UBYTE 0 CM_u8_rspeed_125_4_500rpm 500 8468.75 NUMBER 2 /end CHARACTERISTIC
/begin CHARACTERISTIC CAL_wheel_speed_smoothing "Calibration: wheel speed IIR weight (/256)." VALUE 0x400086D3 RL_VALUE_UBYTE 0 CM_u8_factor_1_256 0 99.609375 /end CHARACTERISTIC
/begin CHARACTERISTIC CAL_evap_purge_idle_duty_max "u8_dutycycle_100/255" VALUE 0x400086DE RL_VALUE_UBYTE 0 CM_u8_factor_1_255 0 100 /end CHARACTERISTIC
/begin CHARACTERISTIC CAL_evap_purge_mode_override "Calibration: evap purge override; 0=auto, 1=force purge, 2=inhibit. (0091 0x40008ec6)" VALUE 0x400086F6 RL_VALUE_UBYTE 0 NO_COMPU_METHOD 0 255 /end CHARACTERISTIC
/begin CHARACTERISTIC CAL_evap_purge_conditioning_timer_100ms "Calibration: evap purge conditioning timer reload (100 ms ticks)." VALUE 0x400086F8 RL_VALUE_UBYTE 0 CM_u8_time_100ms 0 25500 /end CHARACTERISTIC
/begin CHARACTERISTIC CAL_evap_purge_min_inj_pulse_enter "u8_time_8us" VALUE 0x400086F9 RL_VALUE_UBYTE 0 CM_u8_time_8us 0 2040 /end CHARACTERISTIC
/begin CHARACTERISTIC CAL_evap_purge_min_inj_pulse_exit "u8_time_8us" VALUE 0x400086FA RL_VALUE_UBYTE 0 CM_u8_time_8us 0 2040 /end CHARACTERISTIC
/begin CHARACTERISTIC CAL_evap_purge_duty_ramp_up_min "u8_dutycycle_100/65280" VALUE 0x400086FB RL_VALUE_UBYTE 0 CM_u8_dutycycle_100_65280 0 0.390625 /end CHARACTERISTIC
/begin CHARACTERISTIC CAL_evap_purge_duty_ramp_down_conditioning "Calibration: evap purge ramp-down step while conditioning. (0091 0x40008ecc)" VALUE 0x400086FC RL_VALUE_UBYTE 0 CM_u8_dutycycle_100_65280 0 0.390625 /end CHARACTERISTIC
/begin CHARACTERISTIC CAL_evap_purge_dfco_suspend_timeout "Calibration: evap purge suspend timeout used instead of power-enrich timeout when inj_flags&2 (DFCO). (0091 0x40008ecd)" VALUE 0x400086FD RL_VALUE_UBYTE 0 CM_u8_time_100ms 0 25500 /end CHARACTERISTIC
/begin CHARACTERISTIC CAL_evap_purge_filter_alpha "u8_factor_1/256" VALUE 0x400086FE RL_VALUE_UBYTE 0 CM_u8_factor_1_256 0 99.609375 /end CHARACTERISTIC
/begin CHARACTERISTIC CAL_evap_purge_duty_ramp_up_leak_test "Calibration: evap purge ramp-up step (cal<<1) during leak test (leak status>=3, state 4). 0278-specific; 0091 slot is a fan cal." VALUE 0x40008701 RL_VALUE_UBYTE 0 NO_COMPU_METHOD 0 255 /end CHARACTERISTIC
/begin CHARACTERISTIC CAL_evap_purge_duty_ramp_down_leak_test "Calibration: evap purge ramp-down step (cal<<3) during leak test; replaces 0091 hardcoded 500. 0278-specific." VALUE 0x40008702 RL_VALUE_UBYTE 0 NO_COMPU_METHOD 0 255 /end CHARACTERISTIC
/begin CHARACTERISTIC CAL_tps_limit_warmup_rpm_max "Calibration: warm-up TPS limit active while engine speed <= this (stock 138 = 4812 rpm). (0091 0x40008ed4 CAL_engine_speed_3_threshold)" VALUE 0x40008704 RL_VALUE_UBYTE 0 CM_u8_rspeed_125_4_500rpm 500 8468.75 /end CHARACTERISTIC
/begin CHARACTERISTIC CAL_engine_speed_avg_samples "uint8_t" VALUE 0x40008706 RL_VALUE_UBYTE 0 NO_COMPU_METHOD 0 255 /end CHARACTERISTIC
/begin CHARACTERISTIC CAL_evap_idle_bypass_airflow_divisor "Calibration: divisor of idle_bypass_airflow in evap. (0091 0x40008edc CAL_idle_bypass_airflow_factor)" VALUE 0x4000870C RL_VALUE_UBYTE 0 NO_COMPU_METHOD 0 255 /end CHARACTERISTIC
/begin CHARACTERISTIC CAL_evap_purge_duty_ramp_down_normal "Calibration: evap purge normal ramp-down step (cal<<1; stock 150 -> 300, 0091 hardcodes 300). 0278-specific." VALUE 0x4000870D RL_VALUE_UBYTE 0 NO_COMPU_METHOD 0 255 /end CHARACTERISTIC
/begin CHARACTERISTIC CAL_evap_purge_power_enrich_suspend_delay "Calibration: evap purge power-enrich suspend delay (100 ms ticks)." VALUE 0x4000870E RL_VALUE_UBYTE 0 CM_u8_time_100ms 0 25500 /end CHARACTERISTIC
/begin CHARACTERISTIC CAL_evap_fuel_learn_entry_delay "Calibration: evap fuel-learn entry delay. (0091 0x40008ee0)" VALUE 0x40008710 RL_VALUE_UBYTE 0 CM_u8_time_5ms 0 1275 /end CHARACTERISTIC
/begin CHARACTERISTIC CAL_tps_accel_pedal_zero_calibrate_timer "Calibration: throttle position accelerator pedal zero calibrate timer (ms = val*5)." VALUE 0x40008715 RL_VALUE_UBYTE 0 CM_u8_time_5ms 0 1275 /end CHARACTERISTIC
/begin CHARACTERISTIC CAL_engine_roughness_period_history_offset "Calibration: index offset into the engine-speed period history for the roughness measure. (0091 0x40008efa, misnamed CAL_ign_zero_rpm_threshold there)" VALUE 0x4000872A RL_VALUE_UBYTE 0 NO_COMPU_METHOD 0 255 /end CHARACTERISTIC
/begin CHARACTERISTIC CAL_idle_exit_rpm_offset "u8_rspeed_rpm" VALUE 0x4000872C RL_VALUE_UBYTE 0 CM_u8_rspeed_rpm 0 255 /end CHARACTERISTIC
/begin CHARACTERISTIC CAL_idle_dashpot_decel_threshold "Calibration: idle entry requires engine_rpm_rate >= -cal. (0091 0x40008efd)" VALUE 0x4000872D RL_VALUE_UBYTE 0 CM_u8_rspeed_accel_1_168 0 255 /end CHARACTERISTIC
/begin CHARACTERISTIC CAL_idle_high_rpm_transient_air_comp "Calibration: idle high-rpm transient air comp (cal*10). (0091 0x40008eff)" VALUE 0x4000872F RL_VALUE_UBYTE 0 CM_u8_flow_100mg_s 0 25500 /end CHARACTERISTIC
/begin CHARACTERISTIC CAL_idle_car_moving_threshold "Calibration: idle car moving threshold (km/h)." VALUE 0x40008732 RL_VALUE_UBYTE 0 CM_u8_speed_kph 0 255 /end CHARACTERISTIC
/begin CHARACTERISTIC CAL_idle_comp_decay_period_ac "Calibration: idle comp decay step period with A/C comp active. (0091 0x40008f03)" VALUE 0x40008733 RL_VALUE_UBYTE 0 CM_u8_time_ms 0 255 /end CHARACTERISTIC
/begin CHARACTERISTIC CAL_cooling_recirc_enable_airtemp "Calibration: cooling recirc enable airtemp (°C = val*5/8−40)." VALUE 0x40008737 RL_VALUE_UBYTE 0 CM_u8_temp_5_8_40c -40 119.375 /end CHARACTERISTIC
/begin CHARACTERISTIC CAL_tps_etb_pid_kd "ETB position PID derivative gain. Was CAL_etb_pid_kd. (0091 CAL_tps_etb_pid_kd)" VALUE 0x4000873A RL_VALUE_UWORD 0 NO_COMPU_METHOD 0 65535 /end CHARACTERISTIC
/begin CHARACTERISTIC CAL_tps_etb_tps1_max_count "TPS1 full-open ADC count (12-bit, 4095 = 5 V); top of the learned closed..max span. Was CAL_etb_tps1_max_count. (0091)" VALUE 0x4000873E RL_VALUE_UWORD 0 CM_u16_voltage_5_4095v 0 80.018315018315 /end CHARACTERISTIC
/begin CHARACTERISTIC CAL_tps_etb_tps2_max_count "TPS2 full-open ADC count (12-bit, 4095 = 5 V). Was CAL_etb_tps2_max_count. (0091)" VALUE 0x40008742 RL_VALUE_UWORD 0 CM_u16_voltage_5_4095v 0 80.018315018315 /end CHARACTERISTIC
/begin CHARACTERISTIC CAL_tps_etb_pwm_period "ETB H-bridge eMIOS PWM period (us; stock 2000). Was CAL_etb_pwm_period. (0091)" VALUE 0x40008744 RL_VALUE_UWORD 0 CM_u8_time_us 0 65535 /end CHARACTERISTIC
/begin CHARACTERISTIC CAL_torque_limit_low_speed_min_torque "u8_torque_nm" VALUE 0x40008746 RL_VALUE_UBYTE 0 CM_u8_torque_nm 0 255 /end CHARACTERISTIC
/begin CHARACTERISTIC CAL_tps_limit_warmup_airtemp_max "Calibration: warm-up TPS limit active while temp_engine_air <= this (stock 144 = 50 C). (0091 0x40008f19 CAL_temp_engine_air_threshold)" VALUE 0x40008749 RL_VALUE_UBYTE 0 CM_u8_temp_5_8_40c -40 119.375 /end CHARACTERISTIC
/begin CHARACTERISTIC CAL_tps_etb_pid_kp "ETB position PID proportional gain. Was CAL_etb_pid_kp. (0091)" VALUE 0x4000874A RL_VALUE_UWORD 0 CM_u8_factor_1_100 0 65535 /end CHARACTERISTIC
/begin CHARACTERISTIC CAL_torque_limit_low_speed_rpm_threshold "u16_rspeed_rpm" VALUE 0x4000874C RL_VALUE_UWORD 0 CM_u8_rspeed_rpm 0 65535 /end CHARACTERISTIC
/begin CHARACTERISTIC CAL_tps_etb_pid_ki "ETB position PID integral gain. Was CAL_etb_pid_ki. (0091)" VALUE 0x4000874E RL_VALUE_UWORD 0 CM_u16_factor_1_10000 0 655.35 /end CHARACTERISTIC
/begin CHARACTERISTIC CAL_tps_etb_tps1_scale_0pct_frac "TPS1 0% point as a fraction (/4095) of the learned closed..max-count span; sets the zero offset. Was CAL_tps1_range_lo_frac." VALUE 0x40008752 RL_VALUE_UWORD 0 CM_u16_factor_1_4095 0 1600.3663003663 /end CHARACTERISTIC
/begin CHARACTERISTIC CAL_tps_etb_tps1_scale_100pct_frac "TPS1 100% point as a fraction (/4095) of the closed..max-count span; with 0pct sets the gain. Was CAL_tps1_range_hi_frac." VALUE 0x40008754 RL_VALUE_UWORD 0 CM_u16_factor_1_4095 0 1600.3663003663 /end CHARACTERISTIC
/begin CHARACTERISTIC CAL_tps_etb_tps2_scale_0pct_frac "TPS2 0% point as a fraction (/4095) of the closed..max-count span. Was CAL_tps2_range_lo_frac." VALUE 0x40008756 RL_VALUE_UWORD 0 CM_u16_factor_1_4095 0 1600.3663003663 /end CHARACTERISTIC
/begin CHARACTERISTIC CAL_tps_etb_tps2_scale_100pct_frac "TPS2 100% point as a fraction (/4095) of the closed..max-count span. Was CAL_tps2_range_hi_frac." VALUE 0x40008758 RL_VALUE_UWORD 0 CM_u16_factor_1_4095 0 1600.3663003663 /end CHARACTERISTIC
/begin CHARACTERISTIC CAL_tps_etb_pid_integral_limit "ETB position PID integral clamp (<<5). Was CAL_etb_pid_integral_limit. (0091 CAL_tps_etb_pid_i_clamp)" VALUE 0x4000875A RL_VALUE_UWORD 0 CM_u16_factor_1_10000 0 655.35 /end CHARACTERISTIC
/begin CHARACTERISTIC CAL_tpssmooth_step_timer "Calibration: reload of tps_smooth_step_timer (u16_time_10ms)." VALUE 0x4000875C RL_VALUE_UWORD 0 CM_u8_time_10ms 0 655350 /end CHARACTERISTIC
/begin CHARACTERISTIC CAL_cooling_fan_inhibit_window_end "u8_time_250ms" VALUE 0x4000875F RL_VALUE_UBYTE 0 CM_u8_time_250ms 0 63750 /end CHARACTERISTIC
/begin CHARACTERISTIC CAL_cooling_recirc_timer "Calibration: cooling recirc timer (s)." VALUE 0x40008760 RL_VALUE_UBYTE 0 CM_u8_time_s 0 255 /end CHARACTERISTIC
/begin CHARACTERISTIC CAL_cooling_fan_inhibit_temp_drop_threshold "Calibration: cooling fan inhibit temperature drop threshold (°C = val*5/8−40)." VALUE 0x40008762 RL_VALUE_UBYTE 0 CM_u8_temp_5_8_40c -40 119.375 /end CHARACTERISTIC
/begin CHARACTERISTIC CAL_cooling_fan_inhibit_resample_period_100ms "u8_time_100ms" VALUE 0x40008763 RL_VALUE_UBYTE 0 CM_u8_time_100ms 0 25500 /end CHARACTERISTIC
/begin CHARACTERISTIC CAL_idle_unknown4 "u8_rspeed_8rpm" VALUE 0x40008764 RL_VALUE_UBYTE 0 CM_u8_rspeed_8rpm 0 2040 /end CHARACTERISTIC
/begin CHARACTERISTIC CAL_idle_unknown3 "u8_rspeed_8rpm" VALUE 0x40008765 RL_VALUE_UBYTE 0 CM_u8_rspeed_8rpm 0 2040 /end CHARACTERISTIC
/begin CHARACTERISTIC CAL_cooling_fan_inhibit_window_start "u8_time_250ms" VALUE 0x40008766 RL_VALUE_UBYTE 0 CM_u8_time_250ms 0 63750 /end CHARACTERISTIC
/begin CHARACTERISTIC CAL_idle_carspeed_comp_decay_step_ac "Calibration: idle comp decay step with A/C comp active. (0091 0x40008f37)" VALUE 0x40008767 RL_VALUE_UBYTE 0 CM_u8_rspeed_rpm 0 255 /end CHARACTERISTIC
/begin CHARACTERISTIC CAL_cooling_recirc_pump_stopped_dwell "Calibration: stationary-idle dwell timer reload (cal<<2); 0xFF = never expires. (0091 0x40008f3c)" VALUE 0x4000876C RL_VALUE_UBYTE 0 CM_u8_time_100ms 0 25500 /end CHARACTERISTIC
/begin CHARACTERISTIC CAL_tpssmooth_decrement_comp_gears_manual "Calibration: tpssmooth decrement compensation gears manual (val/255; 7-element array)." VAL_BLK 0x4000876D RL_VALUE_UBYTE 0 CM_u8_factor_1_255 0 100 NUMBER 7 /end CHARACTERISTIC
/begin CHARACTERISTIC CAL_evap_purge_pwm_period "Purge solenoid PWM period (10 us; Hz = 100000/x). Was _pwm_freq." VALUE 0x40008776 RL_VALUE_UWORD 0 CM_u16_time_10us 0 655350 /end CHARACTERISTIC
/begin CHARACTERISTIC CAL_idle_high_rpm_transient_air_decay_step "Calibration: decay step for high-rpm transient idle air comp (min 1). 0278-only." VALUE 0x400087A4 RL_VALUE_UBYTE 0 NO_COMPU_METHOD 0 255 /end CHARACTERISTIC
/begin CHARACTERISTIC CAL_idle_air_fast_decay_step "Calibration: idle air fast-decay step (min 1). 0278-only." VALUE 0x400087A5 RL_VALUE_UBYTE 0 NO_COMPU_METHOD 0 255 /end CHARACTERISTIC
/begin CHARACTERISTIC CAL_cooling_engine_bay_fan_enable_delay "Engine-bay fan enable delay (compared with a 200 Hz up-counter; ms = val*5)." VALUE 0x400087AC RL_VALUE_UWORD 0 CM_u8_time_5ms 0 327675 /end CHARACTERISTIC
/begin CHARACTERISTIC CAL_tps_idle_to_current_ratio_threshold "Calibration: alpha-N learn ratio deadband. (0091 CAL_load_alphaN_learn_ratio_deadband)" VAL_BLK 0x400087B4 RL_VALUE_UWORD 0 CM_u8_factor_1_100 0 65535 NUMBER 2 /end CHARACTERISTIC
/begin CHARACTERISTIC CAL_idle_integral_update_period "Calibration: idle PI integral update period (counter reload). (0091 0x40008f92 CAL_idle_unknown3)" VALUE 0x400087C2 RL_VALUE_UBYTE 0 NO_COMPU_METHOD 0 255 /end CHARACTERISTIC
/begin CHARACTERISTIC CAL_idle_air_control_unknown "uint8_t" VALUE 0x400087C3 RL_VALUE_UBYTE 0 NO_COMPU_METHOD 0 255 /end CHARACTERISTIC
/begin CHARACTERISTIC CAL_idle_integral_min_clamp "Calibration: idle PI integral lower clamp (integral/0x2800 >= -cal). (0091 0x40008f94, misnamed CAL_injtip_tipout_decay_rate_divider)" VALUE 0x400087C4 RL_VALUE_UBYTE 0 NO_COMPU_METHOD 0 255 /end CHARACTERISTIC
/begin CHARACTERISTIC CAL_tpssmooth_decrement_cruise_scale "Calibration: TPS smoothing decrement scale in cruise. (0091 0x40008f96)" VALUE 0x400087C6 RL_VALUE_UBYTE 0 CM_u8_factor_1_255 0 100 /end CHARACTERISTIC
/begin CHARACTERISTIC CAL_idle_unknown2 "u8_rspeed_8rpm" VALUE 0x400087C7 RL_VALUE_UBYTE 0 CM_u8_rspeed_8rpm 0 2040 /end CHARACTERISTIC
/begin CHARACTERISTIC CAL_idle_unknown1 "u8_rspeed_8rpm" VALUE 0x400087C8 RL_VALUE_UBYTE 0 CM_u8_rspeed_8rpm 0 2040 /end CHARACTERISTIC
/begin CHARACTERISTIC CAL_tps_delta_rate_window_size "Calibration: throttle position delta rate window size." VALUE 0x400087CF RL_VALUE_UBYTE 0 NO_COMPU_METHOD 0 255 /end CHARACTERISTIC
/begin CHARACTERISTIC CAL_tps_warmup_max "u16_factor_1/1023" VALUE 0x400087E0 RL_VALUE_UWORD 0 CM_u16_factor_1_1023 0 6406.15835777126 /end CHARACTERISTIC
/begin CHARACTERISTIC CAL_tps_min "Effective TPS floor. TPS never be commanded less than this." VALUE 0x400087E2 RL_VALUE_UWORD 0 CM_u16_factor_1_1023 0 6406.15835777126 /end CHARACTERISTIC
/begin CHARACTERISTIC CAL_idle_tps_max_opening "Calibration: idle throttle position maximum opening (val/1023)." VALUE 0x400087E4 RL_VALUE_UWORD 0 CM_u16_factor_1_1023 0 6406.15835777126 /end CHARACTERISTIC
/begin CHARACTERISTIC CAL_idle_comp_decay_period "Calibration: idle comp decay step period (no A/C). (0091 0x40008fbf)" VALUE 0x400087EF RL_VALUE_UBYTE 0 CM_u8_time_ms 0 255 /end CHARACTERISTIC
/begin CHARACTERISTIC CAL_evap_vapor_conc_max_for_fuel_learn "Calibration: evap fuel learn only while vapor concentration < this. (0091 0x40008fc6)" VALUE 0x400087F6 RL_VALUE_UWORD 0 NO_COMPU_METHOD 0 65535 /end CHARACTERISTIC
/begin CHARACTERISTIC CAL_evap_purge_flow_vapor_min_leaktest "Calibration: leak-test vapor concentration threshold. (0091 0x40008fc8)" VALUE 0x400087F8 RL_VALUE_UWORD 0 NO_COMPU_METHOD 0 65535 /end CHARACTERISTIC
/begin CHARACTERISTIC CAL_evap_fuel_learn_purge_duty_min "Calibration: evap fuel learn requires commanded purge > this. (0091 0x40008fca; was mislabelled CAL_evap_commanded_purge_unknown)" VALUE 0x400087FA RL_VALUE_UWORD 0 CM_u8_factor_1_255 0 25700 /end CHARACTERISTIC
/begin CHARACTERISTIC CAL_evap_stft_settle_time "Calibration: evap STFT settle time (100 ms ticks)." VALUE 0x400087FE RL_VALUE_UBYTE 0 CM_u8_time_100ms 0 25500 /end CHARACTERISTIC
/begin CHARACTERISTIC CAL_evap_purge_start_delay "Calibration: purge start delay; timer = cal<<4 in 100 ms ticks (1.6 s units)." VALUE 0x400087FF RL_VALUE_UBYTE 0 CM_u8_time_1600ms 0 408000 /end CHARACTERISTIC
/begin CHARACTERISTIC CAL_evap_purge_open_kick_time "Calibration: evap purge open-kick time (100 ms ticks)." VALUE 0x40008800 RL_VALUE_UBYTE 0 CM_u8_time_100ms 0 25500 /end CHARACTERISTIC
/begin CHARACTERISTIC CAL_evap_purge_open_kick_duty "Calibration: purge duty forced while open-kick timer runs. (0091 0x40008fd1 CAL_evap_unknown1)" VALUE 0x40008801 RL_VALUE_UBYTE 0 NO_COMPU_METHOD 0 255 /end CHARACTERISTIC
/begin CHARACTERISTIC CAL_vvt_pwm_period "VVT solenoid PWM period (us; Hz = 1e6/x, also eMIOS period). Was _pwm_driver_divisor." VALUE 0x40008804 RL_VALUE_UWORD 0 CM_u8_time_us 0 65535 /end CHARACTERISTIC
/begin CHARACTERISTIC CAL_exhaust_flap_sport_mode_enable "Calibration: exhaust flap sport mode enable (boolean flag)." VALUE 0x40008806 RL_VALUE_UBYTE 0 NO_COMPU_METHOD 0 255 /end CHARACTERISTIC
/begin CHARACTERISTIC CAL_exhaust_flap_tour_mode_enable "Calibration: exhaust flap tour mode enable (boolean flag)." VALUE 0x40008807 RL_VALUE_UBYTE 0 NO_COMPU_METHOD 0 255 /end CHARACTERISTIC
/begin CHARACTERISTIC CAL_idle_carspeed_comp_decay_step "Calibration: idle comp decay step (no A/C). (0091 0x40008fdc)" VALUE 0x4000880C RL_VALUE_UBYTE 0 CM_u8_rspeed_rpm 0 255 /end CHARACTERISTIC
/begin CHARACTERISTIC CAL_vvt_error_gain_startup "Calibration: VVT error gain startup (val/255)." VALUE 0x40008812 RL_VALUE_UWORD 0 CM_u8_factor_1_255 0 25700 /end CHARACTERISTIC
/begin CHARACTERISTIC CAL_vvt_integral_gain "Calibration: VVT integral gain." VALUE 0x40008814 RL_VALUE_UWORD 0 NO_COMPU_METHOD 0 65535 /end CHARACTERISTIC
/begin CHARACTERISTIC CAL_idle_flow_adj1_maf_accum_max "u16_mass_g" VALUE 0x40008816 RL_VALUE_UWORD 0 CM_u16_mass_g 0 65535 /end CHARACTERISTIC
/begin CHARACTERISTIC CAL_cooling_recirc_enginespeed_disable_engine_on "Calibration: cooling recirc enginespeed disable engine on (RPM)." VALUE 0x4000881A RL_VALUE_UWORD 0 CM_u8_rspeed_rpm 0 65535 /end CHARACTERISTIC
/begin CHARACTERISTIC CAL_evap_purge_flow_vapor_min "Calibration: vapor concentration threshold for purge flow. (0091 0x40008fee)" VALUE 0x4000881E RL_VALUE_UWORD 0 NO_COMPU_METHOD 0 65535 /end CHARACTERISTIC
/begin CHARACTERISTIC CAL_revlimit_fuelcut_hysteresis "Calibration: rev-limit fuelcut hysteresis (RPM)." VALUE 0x40008820 RL_VALUE_UWORD 0 CM_u8_rspeed_rpm 0 65535 /end CHARACTERISTIC
/begin CHARACTERISTIC CAL_evap_purge_power_enrich_suspend_hold "Calibration: purge suspend hold after power enrichment. (0091 0x40008ff8)" VALUE 0x40008828 RL_VALUE_UBYTE 0 CM_u8_time_100ms 0 25500 /end CHARACTERISTIC
/begin CHARACTERISTIC CAL_evap_purge_power_enrich_suspend_timeout "u8_time_100ms" VALUE 0x40008829 RL_VALUE_UBYTE 0 CM_u8_time_100ms 0 25500 /end CHARACTERISTIC
/begin CHARACTERISTIC CAL_evap_fuel_learn_duration "Calibration: evap fuel learn duration. (0091 0x40009022)" VALUE 0x40008852 RL_VALUE_UWORD 0 CM_u8_time_100ms 0 6553500 /end CHARACTERISTIC
/begin CHARACTERISTIC CAL_revlimit_startup_offset_decrement "Calibration: rev-limit startup offset decrement." VALUE 0x40008854 RL_VALUE_UBYTE 0 NO_COMPU_METHOD 0 255 /end CHARACTERISTIC
/begin CHARACTERISTIC CAL_tps_idle_request_max "u16_factor_1/4095" VALUE 0x40008856 RL_VALUE_UWORD 0 CM_u16_factor_1_4095 0 1600.3663003663 /end CHARACTERISTIC
/begin CHARACTERISTIC CAL_idle_rpm_ramp_step "Calibration: idle target rpm ramp step. (0091)" VALUE 0x40008858 RL_VALUE_UBYTE 0 CM_u8_rspeed_rpm 0 255 /end CHARACTERISTIC
/begin CHARACTERISTIC CAL_tps_limit_misfire_single_bank "TPS limit (x16) while misfire_condition_flags & 0x60. Was duplicate of CAL_tps_limit_severe_misfire_1_cut. (0091)" VALUE 0x40008859 RL_VALUE_UBYTE 0 CM_u8_factor_1_255 0 100 /end CHARACTERISTIC
/begin CHARACTERISTIC CAL_torque_tps_gain "u8_factor_1/255" VALUE 0x4000885F RL_VALUE_UBYTE 0 CM_u8_factor_1_255 0 100 /end CHARACTERISTIC
/begin CHARACTERISTIC CAL_tps_limit_severe_misfire_multi_cut "u8_factor_1/255" VALUE 0x40008867 RL_VALUE_UBYTE 0 CM_u8_factor_1_255 0 100 /end CHARACTERISTIC
/begin CHARACTERISTIC CAL_tps_limit_severe_misfire_1_cut "u8_factor_1/255" VALUE 0x40008868 RL_VALUE_UBYTE 0 CM_u8_factor_1_255 0 100 /end CHARACTERISTIC
/begin CHARACTERISTIC CAL_tps_limit_severe_misfire_no_cut "u8_factor_1/255" VALUE 0x40008869 RL_VALUE_UBYTE 0 CM_u8_factor_1_255 0 100 /end CHARACTERISTIC
/begin CHARACTERISTIC CAL_tps_limit_warmup_coolant_enable "Calibration: warm-up TPS limit active while coolant <= this. (0091 0x4000903f, misnamed CAL_cooling_recirc_airtemp_disable_engine_on)" VALUE 0x4000886F RL_VALUE_UBYTE 0 CM_u8_temp_5_8_40c -40 119.375 /end CHARACTERISTIC
/begin CHARACTERISTIC CAL_tps_limit_warmup_coolant_max "Calibration: warm-up TPS limit coolant max. (0091 0x40009040)" VALUE 0x40008870 RL_VALUE_UBYTE 0 CM_u8_temp_5_8_40c -40 119.375 /end CHARACTERISTIC
/begin CHARACTERISTIC CAL_tps_limit_warmup_stepsize "Calibration: throttle position limit warmup stepsize (val/1023)." VALUE 0x40008871 RL_VALUE_UBYTE 0 CM_u16_factor_1_1023 0 24.9266862170088 /end CHARACTERISTIC
/begin CHARACTERISTIC CAL_tps_limit_warmup_tps_max "Calibration: warm-up TPS ceiling (tps_max_during_warmup). (0091 0x40009042, misnamed CAL_ecu_brake_or_clutch_inactive_timer)" VALUE 0x40008872 RL_VALUE_UWORD 0 CM_u16_factor_1_1023 0 6406.15835777126 /end CHARACTERISTIC
/begin CHARACTERISTIC CAL_torque_limit_tps_filter_coeff "u8_factor_1/1023" VALUE 0x40008876 RL_VALUE_UBYTE 0 CM_u16_factor_1_1023 0 24.9266862170088 /end CHARACTERISTIC
/begin CHARACTERISTIC CAL_cooling_recirc_airtemp_disable_engine_on "Calibration: cooling recirc airtemp disable engine on (°C = val*5/8−40)." VALUE 0x4000887A RL_VALUE_UBYTE 0 CM_u8_temp_5_8_40c -40 119.375 /end CHARACTERISTIC
/begin CHARACTERISTIC CAL_cooling_recirc_rpm_enable_engine_on "Calibration: cooling recirc RPM enable engine on (RPM)." VALUE 0x4000887C RL_VALUE_UWORD 0 CM_u8_rspeed_rpm 0 65535 /end CHARACTERISTIC
/begin CHARACTERISTIC CAL_tpssmooth_decrement_comp_gears_ips "Calibration: tpssmooth decrement compensation gears IPS (val/255; 7-element array)." VAL_BLK 0x4000887E RL_VALUE_UBYTE 0 CM_u8_factor_1_255 0 100 NUMBER 7 /end CHARACTERISTIC
/begin CHARACTERISTIC CAL_idle_air_fast_decay_period "u8_time_ms" VALUE 0x40008889 RL_VALUE_UBYTE 0 CM_u8_time_ms 0 255 /end CHARACTERISTIC
/begin CHARACTERISTIC CAL_exhaust_flap_RPM_threshold_open "Calibration: exhaust flap RPM threshold open (RPM)." VALUE 0x4000888A RL_VALUE_UWORD 0 CM_u8_rspeed_rpm 0 65535 /end CHARACTERISTIC
/begin CHARACTERISTIC CAL_exhaust_flap_RPM_threshold_close "Calibration: exhaust flap RPM threshold close (RPM)." VALUE 0x4000888C RL_VALUE_UWORD 0 CM_u8_rspeed_rpm 0 65535 /end CHARACTERISTIC
/begin CHARACTERISTIC CAL_exhaust_flap_startup_threshold "Calibration: exhaust flap startup threshold (ms = val*100)." VALUE 0x40008893 RL_VALUE_UBYTE 0 CM_u8_time_100ms 0 25500 /end CHARACTERISTIC
/begin CHARACTERISTIC CAL_revlimit_flow_proportional_limit "Calibration: rev-limit flow proportional term (g)." VALUE 0x40008894 RL_VALUE_UBYTE 0 CM_u16_mass_g 0 255 /end CHARACTERISTIC
/begin CHARACTERISTIC CAL_revlimit_flow_integral_limit "Calibration: rev-limit flow unknown2 (g)." VALUE 0x40008895 RL_VALUE_UBYTE 0 CM_u16_mass_g 0 255 /end CHARACTERISTIC
/begin CHARACTERISTIC CAL_revlimit_maf_error_max_10g "Calibration: rev-limit MAF error maximum 10g." VALUE 0x40008896 RL_VALUE_UBYTE 0 NO_COMPU_METHOD 0 255 /end CHARACTERISTIC
/begin CHARACTERISTIC CAL_revlimit_integrator_limit "Calibration: rev-limit integrator limit (val/100)." VALUE 0x40008897 RL_VALUE_UBYTE 0 CM_u8_factor_1_100 0 255 /end CHARACTERISTIC
/begin CHARACTERISTIC CAL_revlimit_rpm_rate_limit "Calibration: rev-limit RPM rate limit (RPM = val*25)." VALUE 0x40008898 RL_VALUE_UBYTE 0 CM_u8_rspeed_25rpm 0 6375 /end CHARACTERISTIC
/begin CHARACTERISTIC CAL_revlimit_flow_rpm_rate_limit "u8_factor_1/100" VALUE 0x40008899 RL_VALUE_UBYTE 0 CM_u8_factor_1_100 0 255 /end CHARACTERISTIC
/begin CHARACTERISTIC CAL_wheel_speed_front_dvdt_scaling "Calibration: wheel speed front dvdt scaling (val/255)." VALUE 0x400088AD RL_VALUE_UBYTE 0 CM_u8_factor_1_255 0 100 /end CHARACTERISTIC
/begin CHARACTERISTIC CAL_revlimit_throttle_clamp "Calibration: rev-limit throttle clamp (boolean flag)." VALUE 0x400088B1 RL_VALUE_UBYTE 0 NO_COMPU_METHOD 0 255 /end CHARACTERISTIC
/begin CHARACTERISTIC CAL_revlimit_release_rpm_delta "Calibration: rev-limit scaler (RPM = val*10)." VALUE 0x400088B2 RL_VALUE_UBYTE 0 CM_u8_rspeed_10rpm 0 2550 /end CHARACTERISTIC
/begin CHARACTERISTIC CAL_revlimit_overspeed_time "Calibration: rev-limit overspeed time (ms = val*100)." VALUE 0x400088B3 RL_VALUE_UBYTE 0 CM_u8_time_100ms 0 25500 /end CHARACTERISTIC
/begin CHARACTERISTIC CAL_revlimit_max_with_speedlimit "Calibration: rev-limit maximum with speedlimit (RPM)." VALUE 0x400088B4 RL_VALUE_UWORD 0 CM_u8_rspeed_rpm 0 65535 /end CHARACTERISTIC
/begin CHARACTERISTIC CAL_revlimit_overrun_count_threshold "Calibration: rev-limit overrun count threshold." VALUE 0x400088B7 RL_VALUE_UBYTE 0 NO_COMPU_METHOD 0 255 /end CHARACTERISTIC
/begin CHARACTERISTIC CAL_idle_rpm_ramp_step_ips "Calibration: idle target rpm ramp step, IPS." VALUE 0x400088BE RL_VALUE_UBYTE 0 CM_u8_rspeed_rpm 0 255 /end CHARACTERISTIC
/begin CHARACTERISTIC CAL_tps_brake_wheeldecel_tps_cut_threshold "Calibration: throttle position brake wheeldecel throttle position cut threshold." VALUE 0x400088D8 RL_VALUE_UBYTE 0 NO_COMPU_METHOD 0 255 /end CHARACTERISTIC
/begin CHARACTERISTIC CAL_tps_brake_safety_floor "Calibration: throttle position brake safety floor (val/1023)." VALUE 0x400088D9 RL_VALUE_UBYTE 0 CM_u16_factor_1_1023 0 24.9266862170088 /end CHARACTERISTIC
/begin CHARACTERISTIC CAL_vvt_low_load_disable "Calibration: VVT low load disable (boolean flag)." VALUE 0x400088E5 RL_VALUE_UBYTE 0 NO_COMPU_METHOD 0 255 /end CHARACTERISTIC
/begin CHARACTERISTIC CAL_vvt_low_load_map_enable_temp "Calibration: VVT low load MAP enable temperature (°C = val*5/8−40)." VALUE 0x400088E7 RL_VALUE_UBYTE 0 CM_u8_temp_5_8_40c -40 119.375 /end CHARACTERISTIC
/begin CHARACTERISTIC CAL_idle_air_ign_startup_comp_enable "Calibration: startup-ign-comp idle air enable." VALUE 0x400088E8 RL_VALUE_UBYTE 0 NO_COMPU_METHOD 0 255 /end CHARACTERISTIC
/begin CHARACTERISTIC CAL_tpssmooth_accel_pedal_modes_enable "Calibration: tpssmooth accelerator pedal modes enable (boolean flag)." VALUE 0x400088E9 RL_VALUE_UBYTE 0 NO_COMPU_METHOD 0 255 /end CHARACTERISTIC
/begin CHARACTERISTIC CAL_oil_pressure_warning_light_mode "Calibration: oil pressure warning light mode (enumerated state)." VALUE 0x400088EA RL_VALUE_UBYTE 0 NO_COMPU_METHOD 0 255 /end CHARACTERISTIC
/begin CHARACTERISTIC CAL_tpstarget_pedalmap_low_gear_threshold "Calibration: tpstarget pedalmap low gear threshold." VALUE 0x400088EB RL_VALUE_UBYTE 0 NO_COMPU_METHOD 0 255 /end CHARACTERISTIC
/begin CHARACTERISTIC CAL_tpssmooth_parking_threshold_tps "Calibration: tpssmooth parking threshold throttle position (val/255)." VALUE 0x400088ED RL_VALUE_UBYTE 0 CM_u8_factor_1_255 0 100 /end CHARACTERISTIC
/begin CHARACTERISTIC CAL_tpssmooth_parking_threshold_carspeed "Calibration: tpssmooth parking threshold carspeed (km/h)." VALUE 0x400088EE RL_VALUE_UBYTE 0 CM_u8_speed_kph 0 255 /end CHARACTERISTIC
/begin CHARACTERISTIC CAL_tpssmooth_parking_threshold_gear "Calibration: tpssmooth parking threshold gear." VALUE 0x400088EF RL_VALUE_UBYTE 0 NO_COMPU_METHOD 0 255 /end CHARACTERISTIC
/begin CHARACTERISTIC CAL_revlimit_startup_delay "Calibration: rev-limit startup delay (ms = val*250)." VALUE 0x400088F0 RL_VALUE_UBYTE 0 CM_u8_time_250ms 0 63750 /end CHARACTERISTIC
/begin CHARACTERISTIC CAL_revlimit_coolant_coldstart_threshold "Calibration: rev-limit coolant coldstart threshold (°C = val*5/8−40)." VALUE 0x400088F1 RL_VALUE_UBYTE 0 CM_u8_temp_5_8_40c -40 119.375 /end CHARACTERISTIC
/begin CHARACTERISTIC CAL_idle_high_rpm_transient_runtime_min "Calibration: idle high-rpm transient needs runtime_since_start (5 ms) > cal*10." VALUE 0x400088F5 RL_VALUE_UBYTE 0 CM_u8_time_50ms 0 12750 /end CHARACTERISTIC
/begin CHARACTERISTIC CAL_torque_estimate_min_ips "i16_torque_nm" VALUE 0x4000890E RL_VALUE_SWORD 0 CM_u8_torque_nm -32768 32767 /end CHARACTERISTIC
/begin CHARACTERISTIC CAL_idle_unknown6 "u8_temp_5/8-40c" VALUE 0x40008912 RL_VALUE_UBYTE 0 CM_u8_temp_5_8_40c -40 119.375 /end CHARACTERISTIC
/begin CHARACTERISTIC CAL_idle_learn_temp_range "Calibration: idle learn temperature range (°C = val*5/8−40; 2-element array)." VAL_BLK 0x40008913 RL_VALUE_UBYTE 0 CM_u8_temp_5_8_40c -40 119.375 NUMBER 2 /end CHARACTERISTIC
/begin CHARACTERISTIC CAL_vvt_low_load_ips_enable "Calibration: VVT low load IPS enable (boolean flag)." VALUE 0x4000891E RL_VALUE_UBYTE 0 NO_COMPU_METHOD 0 255 /end CHARACTERISTIC
/begin CHARACTERISTIC CAL_engine_speed_coolant_temp_unknown7 "Calibration: engine speed reference coolant threshold. (0091 0x400090f2)" VALUE 0x40008922 RL_VALUE_UBYTE 0 CM_u8_temp_5_8_40c -40 119.375 /end CHARACTERISTIC
/begin CHARACTERISTIC CAL_revlimit_enforce_delay_after_start "Calibration: rev-limit enforce delay after start (ms = val*50)." VALUE 0x40008923 RL_VALUE_UBYTE 0 CM_u8_time_50ms 0 12750 /end CHARACTERISTIC
/begin CHARACTERISTIC CAL_idle_underspeed_latch_rpm_delta "Calibration: idle underspeed latch rpm delta. (0091 0x400090f6)" VALUE 0x40008926 RL_VALUE_UWORD 0 CM_u16_rspeed_1_4rpm 0 16383.75 /end CHARACTERISTIC
/begin CHARACTERISTIC CAL_exhaust_flap_load_threshold_open "Calibration: exhaust flap load threshold open (mg/stroke = val*4)." VALUE 0x4000892A RL_VALUE_UBYTE 0 CM_u8_load_4mg_stroke 0 1020 /end CHARACTERISTIC
/begin CHARACTERISTIC CAL_exhaust_flap_load_threshold_close "Calibration: exhaust flap load threshold close (mg/stroke = val*4)." VALUE 0x4000892B RL_VALUE_UBYTE 0 CM_u8_load_4mg_stroke 0 1020 /end CHARACTERISTIC
/begin CHARACTERISTIC CAL_torque_hysteresis_threshold1 "Calibration: torque hysteresis threshold1 (Nm)." VALUE 0x4000892C RL_VALUE_UBYTE 0 CM_u8_torque_nm 0 255 /end CHARACTERISTIC
/begin CHARACTERISTIC CAL_tpssmooth_parking_clutch_threshold "Calibration: tpssmooth parking clutch threshold (V = val*5/255)." VALUE 0x4000892D RL_VALUE_UBYTE 0 CM_u8_voltage_5_255v 0 5 /end CHARACTERISTIC
/begin CHARACTERISTIC CAL_idle_low_car_speed_exit "Calibration: idle low car speed exit (km/h)." VALUE 0x40008944 RL_VALUE_UBYTE 0 CM_u8_speed_kph 0 255 /end CHARACTERISTIC
/begin CHARACTERISTIC CAL_idle_low_car_speed_enter "Calibration: idle low car speed enter (km/h)." VALUE 0x40008945 RL_VALUE_UBYTE 0 CM_u8_speed_kph 0 255 /end CHARACTERISTIC
/begin CHARACTERISTIC CAL_tps_etb_low_voltage_threshold "Calibration: ETB disabled below this supply voltage. (0091 0x4000911a)" VALUE 0x4000894A RL_VALUE_UWORD 0 CM_u16_voltage_18_1023v 0 1153.10850439883 /end CHARACTERISTIC
/begin CHARACTERISTIC CAL_idle_integral_max_on_exit "Calibration: idle integral clamp (cal<<3) when dropping below idle entry rpm. 0278-only." VALUE 0x4000894E RL_VALUE_UWORD 0 NO_COMPU_METHOD 0 65535 /end CHARACTERISTIC
/begin CHARACTERISTIC CAL_cooling_fan_low_rpm_hysteresis_threshold "Calibration: cooling fan low RPM hysteresis threshold (RPM = val*4; 2-element array)." VAL_BLK 0x40008952 RL_VALUE_UBYTE 0 CM_u8_rspeed_4rpm 0 1020 NUMBER 2 /end CHARACTERISTIC
/begin CHARACTERISTIC CAL_oil_pressure_switch_voltage_scaling "Calibration: oil pressure switch voltage scaling (mbar)." VALUE 0x40008954 RL_VALUE_UWORD 0 CM_i16_pressure_mbar 0 65535 /end CHARACTERISTIC
/begin CHARACTERISTIC CAL_oil_pressure_switch_offset "Calibration: oil pressure switch offset (mbar)." VALUE 0x40008956 RL_VALUE_UWORD 0 CM_i16_pressure_mbar 0 65535 /end CHARACTERISTIC
/begin CHARACTERISTIC CAL_evap_purge_o2_lean_threshold_cyl_cut "Calibration: purge O2 check lean threshold (vs pre-cat O2 voltage)." VALUE 0x40008958 RL_VALUE_UWORD 0 CM_u16_voltage_5_1023v 0 320.307917888563 /end CHARACTERISTIC
/begin CHARACTERISTIC CAL_evap_purge_o2_rich_threshold "Calibration: purge O2 check rich threshold (vs pre-cat O2 voltage)." VALUE 0x4000895A RL_VALUE_UWORD 0 CM_u16_voltage_5_1023v 0 320.307917888563 /end CHARACTERISTIC
/begin CHARACTERISTIC CAL_evap_purge_stft_window "Calibration: purge O2-consistency STFT window (vs stft_bank, i16_factor_1/20; stock 500 = 25%)." VALUE 0x4000895C RL_VALUE_SWORD 0 CM_i16_factor_1_20 -163840 163835 /end CHARACTERISTIC
/begin CHARACTERISTIC CAL_evap_purge_idle_speed_error_deadband "Calibration: purge allowed while idle speed error >= -cal (manual/clutch path). (0091 name, different slot)" VALUE 0x4000895E RL_VALUE_UBYTE 0 NO_COMPU_METHOD 0 255 /end CHARACTERISTIC
/begin CHARACTERISTIC CAL_evap_purge_o2_consistency_count "Calibration: purge O2-consistency counter reload (100 ms ticks)." VALUE 0x4000895F RL_VALUE_UBYTE 0 CM_u8_time_100ms 0 25500 /end CHARACTERISTIC
/begin CHARACTERISTIC CAL_evap_purge_mass_ratio_stft_inhibit_threshold "Calibration: STFT zeroed while purge mass ratio > this. (0091 name, different slot)" VALUE 0x40008960 RL_VALUE_UBYTE 0 NO_COMPU_METHOD 0 255 /end CHARACTERISTIC
/begin CHARACTERISTIC CAL_evap_purge_idle_speed_error_deadband2 "Calibration: purge allowed while idle speed error >= -cal. 0278-only." VALUE 0x40008961 RL_VALUE_UBYTE 0 NO_COMPU_METHOD 0 255 /end CHARACTERISTIC
/begin CHARACTERISTIC CAL_tpssmooth_rate_opening_clamp_thresholds "Calibration: tpssmooth rate opening clamp thresholds (val/1023; 2-element array)." VAL_BLK 0x4000897C RL_VALUE_UWORD 0 CM_u16_factor_1_1023 0 6406.15835777126 NUMBER 2 /end CHARACTERISTIC
/begin CHARACTERISTIC CAL_torque_proportional_limit_positive "Calibration: torque proportional limit positive (val/1023)." VALUE 0x40008980 RL_VALUE_UWORD 0 CM_u16_factor_1_1023 0 6406.15835777126 /end CHARACTERISTIC
/begin CHARACTERISTIC CAL_torque_proportional_limit_negative "Calibration: torque proportional limit negative (val/1023)." VALUE 0x40008982 RL_VALUE_UWORD 0 CM_u16_factor_1_1023 0 6406.15835777126 /end CHARACTERISTIC
/begin CHARACTERISTIC CAL_torque_integral_limit_positive "Calibration: torque integral limit positive (val/4095)." VALUE 0x40008984 RL_VALUE_UWORD 0 CM_u16_factor_1_4095 0 1600.3663003663 /end CHARACTERISTIC
/begin CHARACTERISTIC CAL_torque_integral_limit_negative "Calibration: torque integral limit negative (val/4095)." VALUE 0x40008986 RL_VALUE_UWORD 0 CM_u16_factor_1_4095 0 1600.3663003663 /end CHARACTERISTIC
/begin CHARACTERISTIC CAL_revlimit_torque_limit_confirmation_threshold "Calibration: rev-limit torque limit confirmation threshold (Nm = val*2)." VALUE 0x40008988 RL_VALUE_UBYTE 0 CM_u8_torque_2nm 0 510 /end CHARACTERISTIC
/begin CHARACTERISTIC CAL_torque_limit_integral_update_period "u8_time_ms" VALUE 0x40008989 RL_VALUE_UBYTE 0 CM_u8_time_ms 0 255 /end CHARACTERISTIC
/begin CHARACTERISTIC CAL_torque_limit_integral_deadband "Calibration: torque limit integral deadband." VALUE 0x4000898A RL_VALUE_UBYTE 0 NO_COMPU_METHOD 0 255 /end CHARACTERISTIC
/begin CHARACTERISTIC CAL_tpssmooth_increment_b_neutral_tour "Calibration: tpssmooth increment b neutral tour (val/255)." VALUE 0x40008992 RL_VALUE_UBYTE 0 CM_u8_factor_1_255 0 100 /end CHARACTERISTIC
/begin CHARACTERISTIC CAL_tpssmooth_increment_b_neutral_sport "Calibration: tpssmooth increment b neutral sport (val/255)." VALUE 0x40008993 RL_VALUE_UBYTE 0 CM_u8_factor_1_255 0 100 /end CHARACTERISTIC
/begin AXIS_PTS CAL_idle_comp_accel_pedal_pos_X_pps "Calibration: X-axis (pps) for the idle compensation accelerator pedal position table (val/255; 8-element array)." 0x400089B6 V_CAL_idle_comp_accel_pedal_pos_X_pps RL_AXIS_UBYTE 0 CM_u8_factor_1_255 8 0 100 /end AXIS_PTS
/begin CHARACTERISTIC CAL_idle_comp_accel_pedal_pos "Calibration: idle compensation accelerator pedal position (8-element array)." CURVE 0x400089BE RL_VALUE_UBYTE 0 NO_COMPU_METHOD 0 255
 /begin AXIS_DESCR COM_AXIS V_CAL_idle_comp_accel_pedal_pos_X_pps CM_u8_factor_1_255 8 0 100 AXIS_PTS_REF CAL_idle_comp_accel_pedal_pos_X_pps /end AXIS_DESCR
/end CHARACTERISTIC
/begin AXIS_PTS CAL_idle_airflow_to_tps_X_airflow "Calibration: X axis (corrected idle airflow) of CAL_idle_airflow_to_tps." 0x400089CA NO_INPUT_QUANTITY RL_AXIS_UWORD 0 CM_u16_flow_10mg_s 8 0 655350 /end AXIS_PTS
/begin AXIS_PTS CAL_idle_airflow_to_tps_Y_pressure "Calibration: Y axis (pressure, mbar) of CAL_idle_airflow_to_tps. 0278-only." 0x400089DA NO_INPUT_QUANTITY RL_AXIS_UWORD 0 CM_i16_pressure_mbar 8 0 65535 /end AXIS_PTS
/begin CHARACTERISTIC CAL_idle_airflow_to_tps "Calibration: idle airflow x pressure -> throttle (u16_factor_1/1023)." MAP 0x400089EA RL_VALUE_UWORD 0 CM_u16_factor_1_1023 0 6406.15835777126
 /begin AXIS_DESCR COM_AXIS NO_INPUT_QUANTITY CM_u16_flow_10mg_s 8 0 655350 AXIS_PTS_REF CAL_idle_airflow_to_tps_X_airflow /end AXIS_DESCR
 /begin AXIS_DESCR COM_AXIS NO_INPUT_QUANTITY CM_i16_pressure_mbar 8 0 65535 AXIS_PTS_REF CAL_idle_airflow_to_tps_Y_pressure /end AXIS_DESCR
/end CHARACTERISTIC
/begin AXIS_PTS CAL_tpssmooth_rate_decay_opening_X_rpm "Calibration: X-axis (rpm) for the tpssmooth rate decay opening table (RPM = val*125/4+500; 8-element array)." 0x40008A6A engine_speed_8bit RL_AXIS_UBYTE 0 CM_u8_rspeed_125_4_500rpm 8 500 8468.75 /end AXIS_PTS
/begin CHARACTERISTIC CAL_tpssmooth_rate_decay_opening "Calibration: tpssmooth rate decay opening (8-element array)." CURVE 0x40008A72 RL_VALUE_UBYTE 0 CM_u16_factor_1_1023 0 24.9266862170088
 /begin AXIS_DESCR COM_AXIS engine_speed_8bit CM_u8_rspeed_125_4_500rpm 8 500 8468.75 AXIS_PTS_REF CAL_tpssmooth_rate_decay_opening_X_rpm /end AXIS_DESCR
/end CHARACTERISTIC
/begin AXIS_PTS CAL_tpssmooth_rate_decay_closing_X_rpm "Calibration: X-axis (rpm) for the tpssmooth rate decay closing table (RPM = val*125/4+500; 8-element array)." 0x40008A7A engine_speed_8bit RL_AXIS_UBYTE 0 CM_u8_rspeed_125_4_500rpm 8 500 8468.75 /end AXIS_PTS
/begin CHARACTERISTIC CAL_tpssmooth_rate_decay_closing "Calibration: tpssmooth rate decay closing (8-element array)." CURVE 0x40008A82 RL_VALUE_UBYTE 0 CM_u16_factor_1_1023 0 24.9266862170088
 /begin AXIS_DESCR COM_AXIS engine_speed_8bit CM_u8_rspeed_125_4_500rpm 8 500 8468.75 AXIS_PTS_REF CAL_tpssmooth_rate_decay_closing_X_rpm /end AXIS_DESCR
/end CHARACTERISTIC
/begin AXIS_PTS CAL_idle_air_decay_period_X_phase "Calibration: X axis (decay phase) of CAL_idle_air_decay_period. (0091 0x400094d4)" 0x40008D04 NO_INPUT_QUANTITY RL_AXIS_UBYTE 0 NO_COMPU_METHOD 5 0 255 /end AXIS_PTS
/begin CHARACTERISTIC CAL_idle_air_decay_period "Calibration: idle air decay step period by phase. Was mislabelled CAL_ign_comp_coldstart_X_coolant_temp. (0091 0x400094d9)" CURVE 0x40008D09 RL_VALUE_UBYTE 0 CM_u8_time_ms 0 255
 /begin AXIS_DESCR COM_AXIS NO_INPUT_QUANTITY NO_COMPU_METHOD 5 0 255 AXIS_PTS_REF CAL_idle_air_decay_period_X_phase /end AXIS_DESCR
/end CHARACTERISTIC
/begin AXIS_PTS CAL_evap_purge_warmup_time_X_coolant_temp "Calibration: X-axis (coolant temp) for the evaporative purge warmup time table (°C = val*5/8−40; 8-element array)." 0x40008D1E coolant_temp RL_AXIS_UBYTE 0 CM_u8_temp_5_8_40c 8 -40 119.375 /end AXIS_PTS
/begin CHARACTERISTIC CAL_evap_purge_warmup_time "Calibration: purge warm-up delay vs coolant; timer = value<<4 in 100 ms ticks (1.6 s units)." CURVE 0x40008D26 RL_VALUE_UBYTE 0 CM_u8_time_1600ms 0 408000
 /begin AXIS_DESCR COM_AXIS coolant_temp CM_u8_temp_5_8_40c 8 -40 119.375 AXIS_PTS_REF CAL_evap_purge_warmup_time_X_coolant_temp /end AXIS_DESCR
/end CHARACTERISTIC
/begin AXIS_PTS CAL_idle_comp_iat_X_iat "Calibration: X-axis (iat) for the idle compensation intake air temp table (°C = val*5/8−40; 8-element array)." 0x40008D56 temp_engine_air RL_AXIS_UBYTE 0 CM_u8_temp_5_8_40c 8 -40 119.375 /end AXIS_PTS
/begin CHARACTERISTIC CAL_idle_comp_iat "Calibration: idle compensation intake air temp (RPM; 8-element array)." CURVE 0x40008D5E RL_VALUE_UBYTE 0 CM_u8_rspeed_rpm 0 255
 /begin AXIS_DESCR COM_AXIS temp_engine_air CM_u8_temp_5_8_40c 8 -40 119.375 AXIS_PTS_REF CAL_idle_comp_iat_X_iat /end AXIS_DESCR
/end CHARACTERISTIC
/begin AXIS_PTS CAL_torque_limit_proportional_X_load_error "Calibration: X-axis (load error) for the torque limit proportional table (8-element array)." 0x40008E48 NO_INPUT_QUANTITY RL_AXIS_UBYTE 0 CM_u8__127 8 -127 128 /end AXIS_PTS
/begin CHARACTERISTIC CAL_torque_limit_proportional "Calibration: torque limit proportional (val/255; 8-element array)." CURVE 0x40008E50 RL_VALUE_UBYTE 0 CM_u8_factor_1_255 0 100
 /begin AXIS_DESCR COM_AXIS NO_INPUT_QUANTITY CM_u8__127 8 -127 128 AXIS_PTS_REF CAL_torque_limit_proportional_X_load_error /end AXIS_DESCR
/end CHARACTERISTIC
/begin AXIS_PTS CAL_vvt_intake_advance_base_X_engine_speed "Calibration: X-axis (engine speed) for the VVT intake advance base table (RPM = val*125/4+500; 16-element array)." 0x40008E7A engine_speed_8bit RL_AXIS_UBYTE 0 CM_u8_rspeed_125_4_500rpm 16 500 8468.75 /end AXIS_PTS
/begin AXIS_PTS CAL_vvt_intake_advance_base_Y_load "Calibration: Y-axis (load) for the VVT intake advance base table (mg/stroke = val*4; 16-element array)." 0x40008E8A load_mass_per_stroke RL_AXIS_UBYTE 0 CM_u8_load_4mg_stroke 16 0 1020 /end AXIS_PTS
/begin CHARACTERISTIC CAL_vvt_intake_advance_base "Calibration: VVT intake advance base (° = val/4; 256-element array)." MAP 0x40008E9A RL_VALUE_UBYTE 0 CM_u8_angle_1_4deg 0 63.75
 /begin AXIS_DESCR COM_AXIS engine_speed_8bit CM_u8_rspeed_125_4_500rpm 16 500 8468.75 AXIS_PTS_REF CAL_vvt_intake_advance_base_X_engine_speed /end AXIS_DESCR
 /begin AXIS_DESCR COM_AXIS load_mass_per_stroke CM_u8_load_4mg_stroke 16 0 1020 AXIS_PTS_REF CAL_vvt_intake_advance_base_Y_load /end AXIS_DESCR
/end CHARACTERISTIC
/begin AXIS_PTS CAL_vvt_intake_advance_coolant_offset_X_temp "Calibration: X-axis (temp) for the VVT intake advance coolant offset table (°C = val*5/8−40; 16-element array)." 0x40008F9A coolant_temp RL_AXIS_UBYTE 0 CM_u8_temp_5_8_40c 16 -40 119.375 /end AXIS_PTS
/begin CHARACTERISTIC CAL_vvt_intake_advance_coolant_offset "Calibration: VVT intake advance coolant offset (° = val/4; 16-element array)." CURVE 0x40008FAA RL_VALUE_UBYTE 0 CM_u8_angle_1_4deg 0 63.75
 /begin AXIS_DESCR COM_AXIS coolant_temp CM_u8_temp_5_8_40c 16 -40 119.375 AXIS_PTS_REF CAL_vvt_intake_advance_coolant_offset_X_temp /end AXIS_DESCR
/end CHARACTERISTIC
/begin AXIS_PTS CAL_torque_engine_ac_load_base_X_ac "Calibration: X-axis (ac) for the torque engine A/C load base table (16-element array)." 0x4000913E NO_INPUT_QUANTITY RL_AXIS_UBYTE 0 NO_COMPU_METHOD 16 0 255 /end AXIS_PTS
/begin CHARACTERISTIC CAL_torque_engine_ac_load_base "Calibration: torque engine A/C load base (Nm; 16-element array)." CURVE 0x4000914E RL_VALUE_UBYTE 0 CM_u8_torque_nm 0 255
 /begin AXIS_DESCR COM_AXIS NO_INPUT_QUANTITY NO_COMPU_METHOD 16 0 255 AXIS_PTS_REF CAL_torque_engine_ac_load_base_X_ac /end AXIS_DESCR
/end CHARACTERISTIC
/begin AXIS_PTS CAL_idle_target_manual_tour_X_coolant_temp "Calibration: X-axis (coolant temp) for the idle target manual tour table (°C = val*5/8−40; 16-element array)." 0x400091C2 coolant_temp RL_AXIS_UBYTE 0 CM_u8_temp_5_8_40c 16 -40 119.375 /end AXIS_PTS
/begin CHARACTERISTIC CAL_idle_target_manual_tour "Calibration: idle target manual tour (RPM = val*4+500; 16-element array)." CURVE 0x400091D2 RL_VALUE_UBYTE 0 CM_u8_rspeed_4_500rpm 500 1520
 /begin AXIS_DESCR COM_AXIS coolant_temp CM_u8_temp_5_8_40c 16 -40 119.375 AXIS_PTS_REF CAL_idle_target_manual_tour_X_coolant_temp /end AXIS_DESCR
/end CHARACTERISTIC
/begin AXIS_PTS CAL_idle_air_warmup_factor_manual_X_coolant_temp "Calibration: X axis (coolant) of CAL_idle_air_warmup_factor_manual. (0091 0x400099b2)" 0x400091E2 NO_INPUT_QUANTITY RL_AXIS_UBYTE 0 CM_u8_temp_5_8_40c 16 -40 119.375 /end AXIS_PTS
/begin AXIS_PTS CAL_idle_air_warmup_factor_manual_Y_maf_accumulated "Calibration: Y axis (accumulated air >>2, 4 g units) of idle air warm-up factor manual." 0x400091F2 NO_INPUT_QUANTITY RL_AXIS_UBYTE 0 CM_u8_mass_4g 8 0 1020 /end AXIS_PTS
/begin CHARACTERISTIC CAL_idle_air_warmup_factor_manual "Calibration: 16x8 idle air warm-up factor, manual. (0091 0x400099ca)" MAP 0x400091FA RL_VALUE_UBYTE 0 CM_u8_factor_1_64 0 398.4375
 /begin AXIS_DESCR COM_AXIS NO_INPUT_QUANTITY CM_u8_temp_5_8_40c 16 -40 119.375 AXIS_PTS_REF CAL_idle_air_warmup_factor_manual_X_coolant_temp /end AXIS_DESCR
 /begin AXIS_DESCR COM_AXIS NO_INPUT_QUANTITY CM_u8_mass_4g 8 0 1020 AXIS_PTS_REF CAL_idle_air_warmup_factor_manual_Y_maf_accumulated /end AXIS_DESCR
/end CHARACTERISTIC
/begin AXIS_PTS CAL_tpssmooth_increment_rpm_X_rpm "Calibration: X-axis (rpm) for the tpssmooth increment RPM table (RPM = val*125/4+500; 8-element array)." 0x4000927A engine_speed_8bit RL_AXIS_UBYTE 0 CM_u8_rspeed_125_4_500rpm 8 500 8468.75 /end AXIS_PTS
/begin CHARACTERISTIC CAL_tpssmooth_increment_rpm "Calibration: tpssmooth increment RPM (val/255; 8-element array)." CURVE 0x40009282 RL_VALUE_UBYTE 0 CM_u8_factor_1_255 0 100
 /begin AXIS_DESCR COM_AXIS engine_speed_8bit CM_u8_rspeed_125_4_500rpm 8 500 8468.75 AXIS_PTS_REF CAL_tpssmooth_increment_rpm_X_rpm /end AXIS_DESCR
/end CHARACTERISTIC
/begin AXIS_PTS CAL_tpssmooth_increment_sport_X_tps_diff "Calibration: X-axis (tps diff) for the tpssmooth increment sport table (val/255; 8-element array)." 0x4000928A V_CAL_tpssmooth_increment_sport_X_tps_diff RL_AXIS_UBYTE 0 CM_u8_factor_1_255 8 0 100 /end AXIS_PTS
/begin CHARACTERISTIC CAL_tpssmooth_increment_sport "Calibration: tpssmooth increment sport (val/255; 8-element array)." CURVE 0x40009292 RL_VALUE_UBYTE 0 CM_u8_factor_1_255 0 100
 /begin AXIS_DESCR COM_AXIS V_CAL_tpssmooth_increment_sport_X_tps_diff CM_u8_factor_1_255 8 0 100 AXIS_PTS_REF CAL_tpssmooth_increment_sport_X_tps_diff /end AXIS_DESCR
/end CHARACTERISTIC
/begin AXIS_PTS CAL_idle_comp_ac_X_ac_load "Calibration: X-axis (ac load) for the idle compensation A/C table (8-element array)." 0x4000929A NO_INPUT_QUANTITY RL_AXIS_UWORD 0 NO_COMPU_METHOD 8 0 65535 /end AXIS_PTS
/begin CHARACTERISTIC CAL_idle_comp_ac "Calibration: idle air added vs A/C load." CURVE 0x400092AA RL_VALUE_UWORD 0 CM_u16_flow_10mg_s 0 655350
 /begin AXIS_DESCR COM_AXIS NO_INPUT_QUANTITY NO_COMPU_METHOD 8 0 65535 AXIS_PTS_REF CAL_idle_comp_ac_X_ac_load /end AXIS_DESCR
/end CHARACTERISTIC
/begin AXIS_PTS CAL_idle_air_hot_soak_comp_X_bay_run_time "Calibration: X axis (fan_engine_bay_run_timer) of CAL_idle_air_hot_soak_comp. 0278-only use (0091 slot = idle integral step)." 0x400092BA NO_INPUT_QUANTITY RL_AXIS_UWORD 0 NO_COMPU_METHOD 8 0 65535 /end AXIS_PTS
/begin CHARACTERISTIC CAL_idle_air_hot_soak_comp "Calibration: idle air hot-soak comp." CURVE 0x400092CA RL_VALUE_UWORD 0 CM_u16_flow_10mg_s 0 655350
 /begin AXIS_DESCR COM_AXIS NO_INPUT_QUANTITY NO_COMPU_METHOD 8 0 65535 AXIS_PTS_REF CAL_idle_air_hot_soak_comp_X_bay_run_time /end AXIS_DESCR
/end CHARACTERISTIC
/begin AXIS_PTS CAL_idle_dashpot_rpm_lift_max_X_rpm "Calibration: X axis of CAL_idle_dashpot_rpm_lift_max. (0091 0x40009bca)" 0x400093FA NO_INPUT_QUANTITY RL_AXIS_UBYTE 0 CM_u8_rspeed_125_4_500rpm 8 500 8468.75 /end AXIS_PTS
/begin CHARACTERISTIC CAL_idle_dashpot_rpm_lift_max "Calibration: idle high-rpm transient max (x10) vs rpm. (0091 0x40009bd2)" CURVE 0x40009402 RL_VALUE_UBYTE 0 CM_u8_rspeed_10rpm 0 2550
 /begin AXIS_DESCR COM_AXIS NO_INPUT_QUANTITY CM_u8_rspeed_125_4_500rpm 8 500 8468.75 AXIS_PTS_REF CAL_idle_dashpot_rpm_lift_max_X_rpm /end AXIS_DESCR
/end CHARACTERISTIC
/begin AXIS_PTS CAL_idle_comp_baro2_X_ambient_baro "Calibration: X-axis (ambiant baro) for the idle compensation baro2 table (mbar; 8-element array)." 0x4000941A obd_ii_atmospheric_baro RL_AXIS_UWORD 0 CM_i16_pressure_mbar 8 0 65535 /end AXIS_PTS
/begin CHARACTERISTIC CAL_idle_comp_baro2 "Calibration: idle air comp vs baro, offset-binary (value ^ 0x8000 = signed 10 mg/s)." CURVE 0x4000942A RL_VALUE_UWORD 0 CM_u16_flow_10mg_s_327680mg_s -327680 327670
 /begin AXIS_DESCR COM_AXIS obd_ii_atmospheric_baro CM_i16_pressure_mbar 8 0 65535 AXIS_PTS_REF CAL_idle_comp_baro2_X_ambient_baro /end AXIS_DESCR
/end CHARACTERISTIC
/begin AXIS_PTS CAL_idle_air_ign_startup_comp_X_ign_comp "Calibration: X axis (startup ign comp, 1/4 deg) of CAL_idle_air_ign_startup_comp." 0x4000943A NO_INPUT_QUANTITY RL_AXIS_UWORD 0 CM_u8_angle_1_4deg 8 0 16383.75 /end AXIS_PTS
/begin CHARACTERISTIC CAL_idle_air_ign_startup_comp "Calibration: idle air added vs startup ign comp." CURVE 0x4000944A RL_VALUE_UWORD 0 CM_u16_flow_10mg_s 0 655350
 /begin AXIS_DESCR COM_AXIS NO_INPUT_QUANTITY CM_u8_angle_1_4deg 8 0 16383.75 AXIS_PTS_REF CAL_idle_air_ign_startup_comp_X_ign_comp /end AXIS_DESCR
/end CHARACTERISTIC
/begin AXIS_PTS CAL_tpssmooth_decrement_by_rpm_X_rpm "Calibration: X-axis (rpm) for the tpssmooth decrement by RPM table (RPM = val*125/4+500; 8-element array)." 0x4000945A engine_speed_8bit RL_AXIS_UBYTE 0 CM_u8_rspeed_125_4_500rpm 8 500 8468.75 /end AXIS_PTS
/begin CHARACTERISTIC CAL_tpssmooth_decrement_by_rpm "Calibration: tpssmooth decrement by RPM (val/255; 8-element array)." CURVE 0x40009462 RL_VALUE_UBYTE 0 CM_u8_factor_1_255 0 100
 /begin AXIS_DESCR COM_AXIS engine_speed_8bit CM_u8_rspeed_125_4_500rpm 8 500 8468.75 AXIS_PTS_REF CAL_tpssmooth_decrement_by_rpm_X_rpm /end AXIS_DESCR
/end CHARACTERISTIC
/begin AXIS_PTS CAL_tps_scaling_factor_rpm_X_rpm "Calibration: X-axis (rpm) for the throttle position scaling factor RPM table (RPM = val*125/4+500; 16-element array)." 0x40009482 engine_speed_8bit RL_AXIS_UBYTE 0 CM_u8_rspeed_125_4_500rpm 16 500 8468.75 /end AXIS_PTS
/begin CHARACTERISTIC CAL_tps_scaling_factor_rpm "Calibration: throttle position scaling factor RPM (val/255; 16-element array)." CURVE 0x40009492 RL_VALUE_UBYTE 0 CM_u8_factor_1_255 0 100
 /begin AXIS_DESCR COM_AXIS engine_speed_8bit CM_u8_rspeed_125_4_500rpm 16 500 8468.75 AXIS_PTS_REF CAL_tps_scaling_factor_rpm_X_rpm /end AXIS_DESCR
/end CHARACTERISTIC
/begin AXIS_PTS CAL_idle_clutch_antistall_comp_X_clutch_voltage "Calibration: X axis (clutch position voltage>>2) of CAL_idle_clutch_antistall_comp. 0278-only use." 0x400094A2 NO_INPUT_QUANTITY RL_AXIS_UBYTE 0 CM_u8_voltage_5_255v 8 0 5 /end AXIS_PTS
/begin CHARACTERISTIC CAL_idle_clutch_antistall_comp "Calibration: idle clutch anti-stall comp factor vs clutch position. 0278-only use." CURVE 0x400094AA RL_VALUE_UBYTE 0 NO_COMPU_METHOD 0 255
 /begin AXIS_DESCR COM_AXIS NO_INPUT_QUANTITY CM_u8_voltage_5_255v 8 0 5 AXIS_PTS_REF CAL_idle_clutch_antistall_comp_X_clutch_voltage /end AXIS_DESCR
/end CHARACTERISTIC
/begin AXIS_PTS CAL_dpm_torque_cut_p_term_X_carspeed "Calibration: X-axis (carspeed) for the driver performance mode torque cut factor table (km/h = val/100; 6-element array)." 0x4000996A NO_INPUT_QUANTITY RL_AXIS_UWORD 0 CM_u8_speed_1_100kph 6 0 655.35 /end AXIS_PTS
/begin AXIS_PTS CAL_dpm_torque_cut_p_term_Y_slip "Calibration: Y-axis (slip) for the driver performance mode torque cut factor table (% = val/8; 10-element array)." 0x40009976 NO_INPUT_QUANTITY RL_AXIS_UWORD 0 CM_u16_slip_1_8pct 10 0 8191.875 /end AXIS_PTS
/begin CHARACTERISTIC CAL_dpm_torque_cut_p_term "dpm_torque_cut_factor is the proportional part of the GT430's ECU traction control. Once the filtered slip error (how far wheel slip is above the target) passes CAL_dpm_intervention_threshold, the ECU looks it up in the 6×10 table CAL_dpm_torque_cut_" MAP 0x4000998A RL_VALUE_UWORD 0 CM_u8_factor_1_255 0 25700
 /begin AXIS_DESCR COM_AXIS NO_INPUT_QUANTITY CM_u8_speed_1_100kph 6 0 655.35 AXIS_PTS_REF CAL_dpm_torque_cut_p_term_X_carspeed /end AXIS_DESCR
 /begin AXIS_DESCR COM_AXIS NO_INPUT_QUANTITY CM_u16_slip_1_8pct 10 0 8191.875 AXIS_PTS_REF CAL_dpm_torque_cut_p_term_Y_slip /end AXIS_DESCR
/end CHARACTERISTIC
/begin AXIS_PTS CAL_dpm_slip_target_from_pedal_X_carspeed "Calibration: X-axis (carspeed) for the driver performance mode slip target compensation pedal table (km/h; 6-element array)." 0x40009A02 dpm_vehicle_speed_kph RL_AXIS_UBYTE 0 CM_u8_speed_kph 6 0 255 /end AXIS_PTS
/begin AXIS_PTS CAL_dpm_slip_target_from_pedal_Y_pps "Calibration: Y-axis (pps) for the driver performance mode slip target compensation pedal table (val/255; 6-element array)." 0x40009A08 V_CAL_dpm_slip_target_from_pedal_Y_pps RL_AXIS_UBYTE 0 CM_u8_factor_1_255 6 0 100 /end AXIS_PTS
/begin CHARACTERISTIC CAL_dpm_slip_target_from_pedal "Calibration: driver performance mode slip target compensation pedal (% = val*2; 36-element array)." MAP 0x40009A0E RL_VALUE_UBYTE 0 CM_u8_slip_2pct 0 510
 /begin AXIS_DESCR COM_AXIS dpm_vehicle_speed_kph CM_u8_speed_kph 6 0 255 AXIS_PTS_REF CAL_dpm_slip_target_from_pedal_X_carspeed /end AXIS_DESCR
 /begin AXIS_DESCR COM_AXIS V_CAL_dpm_slip_target_from_pedal_Y_pps CM_u8_factor_1_255 6 0 100 AXIS_PTS_REF CAL_dpm_slip_target_from_pedal_Y_pps /end AXIS_DESCR
/end CHARACTERISTIC
/begin AXIS_PTS CAL_idle_target_manual_sport_X_coolant_temp "Calibration: X-axis (coolant temp) for the idle target manual sport table (°C = val*5/8−40; 16-element array)." 0x40009A3A coolant_temp RL_AXIS_UBYTE 0 CM_u8_temp_5_8_40c 16 -40 119.375 /end AXIS_PTS
/begin CHARACTERISTIC CAL_idle_target_manual_sport "Calibration: idle target manual sport (RPM = val*4+500; 16-element array)." CURVE 0x40009A4A RL_VALUE_UBYTE 0 CM_u8_rspeed_4_500rpm 500 1520
 /begin AXIS_DESCR COM_AXIS coolant_temp CM_u8_temp_5_8_40c 16 -40 119.375 AXIS_PTS_REF CAL_idle_target_manual_sport_X_coolant_temp /end AXIS_DESCR
/end CHARACTERISTIC
/begin AXIS_PTS CAL_vvt_exhaust_advance_base_X_engine_speed "Calibration: X-axis (engine speed) for the VVT exhaust advance base table (RPM = val*125/4+500; 16-element array)." 0x40009A7A engine_speed_8bit RL_AXIS_UBYTE 0 CM_u8_rspeed_125_4_500rpm 16 500 8468.75 /end AXIS_PTS
/begin AXIS_PTS CAL_vvt_exhaust_advance_base_Y_load "Calibration: Y-axis (load) for the VVT exhaust advance base table (mg/stroke = val*4; 16-element array)." 0x40009A8A load_mass_per_stroke RL_AXIS_UBYTE 0 CM_u8_load_4mg_stroke 16 0 1020 /end AXIS_PTS
/begin CHARACTERISTIC CAL_vvt_exhaust_advance_base "Calibration: VVT exhaust advance base (° = val/4; 256-element array)." MAP 0x40009A9A RL_VALUE_UBYTE 0 CM_u8_angle_1_4deg 0 63.75
 /begin AXIS_DESCR COM_AXIS engine_speed_8bit CM_u8_rspeed_125_4_500rpm 16 500 8468.75 AXIS_PTS_REF CAL_vvt_exhaust_advance_base_X_engine_speed /end AXIS_DESCR
 /begin AXIS_DESCR COM_AXIS load_mass_per_stroke CM_u8_load_4mg_stroke 16 0 1020 AXIS_PTS_REF CAL_vvt_exhaust_advance_base_Y_load /end AXIS_DESCR
/end CHARACTERISTIC
/begin AXIS_PTS CAL_tpssmooth_increment_tour_X_tps_diff "Calibration: X-axis (tps diff) for the tpssmooth increment tour table (val/255; 8-element array)." 0x40009BCA V_CAL_tpssmooth_increment_tour_X_tps_diff RL_AXIS_UBYTE 0 CM_u8_factor_1_255 8 0 100 /end AXIS_PTS
/begin CHARACTERISTIC CAL_tpssmooth_increment_tour "Calibration: tpssmooth increment tour (val/255; 8-element array)." CURVE 0x40009BD2 RL_VALUE_UBYTE 0 CM_u8_factor_1_255 0 100
 /begin AXIS_DESCR COM_AXIS V_CAL_tpssmooth_increment_tour_X_tps_diff CM_u8_factor_1_255 8 0 100 AXIS_PTS_REF CAL_tpssmooth_increment_tour_X_tps_diff /end AXIS_DESCR
/end CHARACTERISTIC
/begin AXIS_PTS CAL_torque_engine_ac_load_scaler_X_engine_speed "Calibration: X-axis (engine speed) for the torque engine A/C load scaler table (RPM = val*125/4+500; 8-element array)." 0x40009CD6 engine_speed_8bit RL_AXIS_UBYTE 0 CM_u8_rspeed_125_4_500rpm 8 500 8468.75 /end AXIS_PTS
/begin CHARACTERISTIC CAL_torque_engine_ac_load_scaler "Calibration: torque engine A/C load scaler (val/255; 8-element array)." CURVE 0x40009CDE RL_VALUE_UBYTE 0 CM_u8_factor_1_255 0 100
 /begin AXIS_DESCR COM_AXIS engine_speed_8bit CM_u8_rspeed_125_4_500rpm 8 500 8468.75 AXIS_PTS_REF CAL_torque_engine_ac_load_scaler_X_engine_speed /end AXIS_DESCR
/end CHARACTERISTIC
/begin AXIS_PTS CAL_torque_limit_by_coolant_X_coolant "Calibration: X-axis (coolant) for the torque limit by coolant table (°C = val*5/8−40; 4-element array)." 0x40009D0E coolant_temp RL_AXIS_UBYTE 0 CM_u8_temp_5_8_40c 4 -40 119.375 /end AXIS_PTS
/begin CHARACTERISTIC CAL_torque_limit_by_coolant "*WARNING* This table has been patched to double the torque values. Each 8bit value represents 4nm of torque." CURVE 0x40009D12 RL_VALUE_UBYTE 0 CM_u8_torque_4nm 0 1020
 /begin AXIS_DESCR COM_AXIS coolant_temp CM_u8_temp_5_8_40c 4 -40 119.375 AXIS_PTS_REF CAL_torque_limit_by_coolant_X_coolant /end AXIS_DESCR
/end CHARACTERISTIC
/begin AXIS_PTS CAL_idle_comp_tps_while_cranking_X_baro "Calibration: X-axis (baro) for the idle compensation throttle position while cranking table (mbar = val*4; 4-element array)." 0x40009DD2 NO_INPUT_QUANTITY RL_AXIS_UBYTE 0 CM_u8_pressure_4mbar 4 0 1020 /end AXIS_PTS
/begin AXIS_PTS CAL_idle_comp_tps_while_cranking_Y_coolant_temp "Calibration: Y-axis (coolant temp) for the idle compensation throttle position while cranking table (°C = val*5/8−40; 16-element array)." 0x40009DD6 coolant_temp RL_AXIS_UBYTE 0 CM_u8_temp_5_8_40c 16 -40 119.375 /end AXIS_PTS
/begin CHARACTERISTIC CAL_idle_comp_tps_while_cranking "Calibration: idle compensation throttle position while cranking (val/255; 64-element array)." MAP 0x40009DE6 RL_VALUE_UBYTE 0 CM_u8_factor_1_255 0 100
 /begin AXIS_DESCR COM_AXIS NO_INPUT_QUANTITY CM_u8_pressure_4mbar 4 0 1020 AXIS_PTS_REF CAL_idle_comp_tps_while_cranking_X_baro /end AXIS_DESCR
 /begin AXIS_DESCR COM_AXIS coolant_temp CM_u8_temp_5_8_40c 16 -40 119.375 AXIS_PTS_REF CAL_idle_comp_tps_while_cranking_Y_coolant_temp /end AXIS_DESCR
/end CHARACTERISTIC
/begin AXIS_PTS CAL_idle_airflow_expected_X_rpm "Calibration: X-axis (rpm) for the idle airflow expected table (RPM; 16-element array)." 0x40009E4A obd_ii_idle_speed_target_total RL_AXIS_UWORD 0 CM_u8_rspeed_rpm 16 0 65535 /end AXIS_PTS
/begin CHARACTERISTIC CAL_idle_airflow_expected "Calibration: expected idle airflow vs idle target rpm (2.8-20.7 g/s)." CURVE 0x40009E6A RL_VALUE_UWORD 0 CM_u16_flow_10mg_s 0 655350
 /begin AXIS_DESCR COM_AXIS obd_ii_idle_speed_target_total CM_u8_rspeed_rpm 16 0 65535 AXIS_PTS_REF CAL_idle_airflow_expected_X_rpm /end AXIS_DESCR
/end CHARACTERISTIC
/begin AXIS_PTS CAL_cooling_fan_afterrun_X_air_temp "Calibration: X-axis (air temp) for the cooling fan afterrun table (°C = val*5/8−40; 8-element array)." 0x40009E8A temp_engine_air RL_AXIS_UBYTE 0 CM_u8_temp_5_8_40c 8 -40 119.375 /end AXIS_PTS
/begin AXIS_PTS CAL_cooling_fan_afterrun_Y_coolant_temp "Calibration: Y-axis (coolant temp) for the cooling fan afterrun table (°C = val*5/8−40; 8-element array)." 0x40009E92 coolant_temp RL_AXIS_UBYTE 0 CM_u8_temp_5_8_40c 8 -40 119.375 /end AXIS_PTS
/begin CHARACTERISTIC CAL_cooling_fan_afterrun "Calibration: cooling fan afterrun (ms = val*250; 64-element array)." MAP 0x40009E9A RL_VALUE_UBYTE 0 CM_u8_time_5s 0 1275
 /begin AXIS_DESCR COM_AXIS temp_engine_air CM_u8_temp_5_8_40c 8 -40 119.375 AXIS_PTS_REF CAL_cooling_fan_afterrun_X_air_temp /end AXIS_DESCR
 /begin AXIS_DESCR COM_AXIS coolant_temp CM_u8_temp_5_8_40c 8 -40 119.375 AXIS_PTS_REF CAL_cooling_fan_afterrun_Y_coolant_temp /end AXIS_DESCR
/end CHARACTERISTIC
/begin AXIS_PTS CAL_idle_comp_fan_X_duty_cycle "Calibration: X axis (radiator fan duty) of CAL_idle_comp_fan." 0x40009EDA radiator_fan_duty_cycle_target RL_AXIS_UWORD 0 CM_u8_factor_1_255 8 0 25700 /end AXIS_PTS
/begin CHARACTERISTIC CAL_idle_comp_fan "Calibration: idle air added vs radiator fan duty." CURVE 0x40009EEA RL_VALUE_UWORD 0 CM_u16_flow_10mg_s 0 655350
 /begin AXIS_DESCR COM_AXIS radiator_fan_duty_cycle_target CM_u8_factor_1_255 8 0 25700 AXIS_PTS_REF CAL_idle_comp_fan_X_duty_cycle /end AXIS_DESCR
/end CHARACTERISTIC
/begin AXIS_PTS CAL_idle_comp_carspeed_manual_X_carspeed "Calibration: X-axis (carspeed) for the idle compensation carspeed manual table (km/h; 8-element array)." 0x40009F2A car_speed_u8 RL_AXIS_UBYTE 0 CM_u8_speed_kph 8 0 255 /end AXIS_PTS
/begin CHARACTERISTIC CAL_idle_comp_carspeed_manual "Calibration: idle compensation carspeed manual (RPM = val*4; 8-element array)." CURVE 0x40009F32 RL_VALUE_UBYTE 0 CM_u8_rspeed_4rpm 0 1020
 /begin AXIS_DESCR COM_AXIS car_speed_u8 CM_u8_speed_kph 8 0 255 AXIS_PTS_REF CAL_idle_comp_carspeed_manual_X_carspeed /end AXIS_DESCR
/end CHARACTERISTIC
/begin AXIS_PTS CAL_idle_comp_timer_carspeed_manual_X_airtemp "Calibration: X-axis (airtemp) for the idle compensation timer carspeed manual table (°C = val*5/8−40; 8-element array)." 0x40009F4A NO_INPUT_QUANTITY RL_AXIS_UBYTE 0 CM_u8_temp_5_8_40c 8 -40 119.375 /end AXIS_PTS
/begin AXIS_PTS CAL_idle_comp_timer_carspeed_manual_Y_time_above_speed "Calibration: Y-axis (time above speed) for the idle compensation timer carspeed manual table (8-element array)." 0x40009F52 idle_low_carspeed_timer RL_AXIS_UBYTE 0 NO_COMPU_METHOD 8 0 255 /end AXIS_PTS
/begin CHARACTERISTIC CAL_idle_comp_timer_carspeed_manual "Calibration: idle compensation timer carspeed manual (RPM = val*8; 64-element array)." MAP 0x40009F5A RL_VALUE_UBYTE 0 CM_u8_rspeed_8rpm 0 2040
 /begin AXIS_DESCR COM_AXIS NO_INPUT_QUANTITY CM_u8_temp_5_8_40c 8 -40 119.375 AXIS_PTS_REF CAL_idle_comp_timer_carspeed_manual_X_airtemp /end AXIS_DESCR
 /begin AXIS_DESCR COM_AXIS idle_low_carspeed_timer NO_COMPU_METHOD 8 0 255 AXIS_PTS_REF CAL_idle_comp_timer_carspeed_manual_Y_time_above_speed /end AXIS_DESCR
/end CHARACTERISTIC
/begin AXIS_PTS CAL_torque_engine_friction_speed_component_X_engine_speed "Calibration: X-axis (engine speed) for the torque engine friction speed component table (RPM = val*125/4+500; 20-element array)." 0x4000A56A engine_speed_8bit RL_AXIS_UBYTE 0 CM_u8_rspeed_125_4_500rpm 20 500 8468.75 /end AXIS_PTS
/begin AXIS_PTS CAL_torque_engine_friction_speed_component_Y_load "Calibration: Y-axis (load) for the torque engine friction speed component table (mg/stroke = val*1173; 20-element array)." 0x4000A57E NO_INPUT_QUANTITY RL_AXIS_UBYTE 0 CM_u8_load_1173mg_255stroke 20 0 1173 /end AXIS_PTS
/begin CHARACTERISTIC CAL_torque_engine_friction_speed_component "Calibration: torque engine friction speed component (Nm; 400-element array)." MAP 0x4000A592 RL_VALUE_UBYTE 0 CM_u8_torque_nm 0 255
 /begin AXIS_DESCR COM_AXIS engine_speed_8bit CM_u8_rspeed_125_4_500rpm 20 500 8468.75 AXIS_PTS_REF CAL_torque_engine_friction_speed_component_X_engine_speed /end AXIS_DESCR
 /begin AXIS_DESCR COM_AXIS NO_INPUT_QUANTITY CM_u8_load_1173mg_255stroke 20 0 1173 AXIS_PTS_REF CAL_torque_engine_friction_speed_component_Y_load /end AXIS_DESCR
/end CHARACTERISTIC
/begin AXIS_PTS CAL_tps_rate_steadystate_threshold_X_rpm "Calibration: X-axis (rpm) for the throttle position rate steadystate threshold table (RPM = val*125/4+500; 4-element array)." 0x4000A8A6 engine_speed_8bit RL_AXIS_UBYTE 0 CM_u8_rspeed_125_4_500rpm 4 500 8468.75 /end AXIS_PTS
/begin AXIS_PTS CAL_tps_rate_steadystate_threshold_Y_tps "Calibration: Y-axis (tps) for the throttle position rate steadystate threshold table (val/255; 4-element array)." 0x4000A8AA tps_8bit RL_AXIS_UBYTE 0 CM_u8_factor_1_255 4 0 100 /end AXIS_PTS
/begin CHARACTERISTIC CAL_tps_rate_steadystate_threshold "Calibration: throttle position rate steadystate threshold (val/255; 16-element array)." MAP 0x4000A8AE RL_VALUE_UBYTE 0 CM_u8_factor_1_255 0 100
 /begin AXIS_DESCR COM_AXIS engine_speed_8bit CM_u8_rspeed_125_4_500rpm 4 500 8468.75 AXIS_PTS_REF CAL_tps_rate_steadystate_threshold_X_rpm /end AXIS_DESCR
 /begin AXIS_DESCR COM_AXIS tps_8bit CM_u8_factor_1_255 4 0 100 AXIS_PTS_REF CAL_tps_rate_steadystate_threshold_Y_tps /end AXIS_DESCR
/end CHARACTERISTIC
/begin AXIS_PTS CAL_idle_comp_vehicle_speed_manual_X_carspeed "Calibration: X-axis (carspeed) for the idle compensation vehicle speed manual table (km/h = val/100; 8-element array)." 0x4000A942 car_speed_x100 RL_AXIS_UWORD 0 CM_u8_speed_1_100kph 8 0 655.35 /end AXIS_PTS
/begin CHARACTERISTIC CAL_idle_comp_vehicle_speed_manual "Calibration: idle air added vs car speed, manual (capped 0x9F6)." CURVE 0x4000A952 RL_VALUE_UWORD 0 CM_u16_flow_10mg_s 0 655350
 /begin AXIS_DESCR COM_AXIS car_speed_x100 CM_u8_speed_1_100kph 8 0 655.35 AXIS_PTS_REF CAL_idle_comp_vehicle_speed_manual_X_carspeed /end AXIS_DESCR
/end CHARACTERISTIC
/begin AXIS_PTS CAL_tpssmooth_decrement_by_delta_X_tps_delta "Calibration: X-axis (tps delta) for the tpssmooth decrement by delta table (val/255; 8-element array)." 0x4000A962 NO_INPUT_QUANTITY RL_AXIS_UBYTE 0 CM_u8_factor_1_255 8 0 100 /end AXIS_PTS
/begin CHARACTERISTIC CAL_tpssmooth_decrement_by_delta "Calibration: tpssmooth decrement by delta (val/255; 8-element array)." CURVE 0x4000A96A RL_VALUE_UBYTE 0 CM_u8_factor_1_255 0 100
 /begin AXIS_DESCR COM_AXIS NO_INPUT_QUANTITY CM_u8_factor_1_255 8 0 100 AXIS_PTS_REF CAL_tpssmooth_decrement_by_delta_X_tps_delta /end AXIS_DESCR
/end CHARACTERISTIC
/begin AXIS_PTS CAL_revlimit_speedbase_manual_tour_X_coolant_temp "Calibration: X-axis (coolant temp) for the rev-limit speedbase manual tour table (°C = val*5/8−40; 4-element array)." 0x4000A972 coolant_temp RL_AXIS_UWORD 0 CM_u8_temp_5_8_40c 4 -40 40919.375 /end AXIS_PTS
/begin AXIS_PTS CAL_revlimit_speedbase_manual_tour_Y_timer "Calibration: Y-axis (timer) for the rev-limit speedbase manual tour table (ms = val*5; 4-element array)." 0x4000A97A NO_INPUT_QUANTITY RL_AXIS_UWORD 0 CM_u8_time_5ms 4 0 327675 /end AXIS_PTS
/begin CHARACTERISTIC CAL_revlimit_speedbase_manual_tour "Calibration: rev-limit speedbase manual tour (RPM; 16-element array)." MAP 0x4000A982 RL_VALUE_UWORD 0 CM_u8_rspeed_rpm 0 65535
 /begin AXIS_DESCR COM_AXIS coolant_temp CM_u8_temp_5_8_40c 4 -40 40919.375 AXIS_PTS_REF CAL_revlimit_speedbase_manual_tour_X_coolant_temp /end AXIS_DESCR
 /begin AXIS_DESCR COM_AXIS NO_INPUT_QUANTITY CM_u8_time_5ms 4 0 327675 AXIS_PTS_REF CAL_revlimit_speedbase_manual_tour_Y_timer /end AXIS_DESCR
/end CHARACTERISTIC
/begin AXIS_PTS CAL_idle_comp_ecu_voltage_X_voltage "Calibration: X-axis (voltage) for the idle compensation ECU voltage table (V = val*18/1023; 8-element array)." 0x4000A9A2 sensor_adc_ecu_voltage RL_AXIS_UWORD 0 CM_u16_voltage_18_1023v 8 0 1153.10850439883 /end AXIS_PTS
/begin CHARACTERISTIC CAL_idle_comp_ecu_voltage "Calibration: idle air comp vs ECU voltage, offset-binary (all 0 stock)." CURVE 0x4000A9B2 RL_VALUE_UWORD 0 CM_u16_flow_10mg_s_327680mg_s -327680 327670
 /begin AXIS_DESCR COM_AXIS sensor_adc_ecu_voltage CM_u16_voltage_18_1023v 8 0 1153.10850439883 AXIS_PTS_REF CAL_idle_comp_ecu_voltage_X_voltage /end AXIS_DESCR
/end CHARACTERISTIC
/begin AXIS_PTS CAL_vvt_start_timer_X_coolant_temp "Calibration: X-axis (coolant temp) for the VVT start timer table (°C = val*5/8−40; 8-element array)." 0x4000AA12 coolant_temp_engine_stopped RL_AXIS_UBYTE 0 CM_u8_temp_5_8_40c 8 -40 119.375 /end AXIS_PTS
/begin CHARACTERISTIC CAL_vvt_start_timer "Calibration: VVT start timer (ms = val*100; 8-element array)." CURVE 0x4000AA1A RL_VALUE_UBYTE 0 CM_u8_time_100ms 0 25500
 /begin AXIS_DESCR COM_AXIS coolant_temp_engine_stopped CM_u8_temp_5_8_40c 8 -40 119.375 AXIS_PTS_REF CAL_vvt_start_timer_X_coolant_temp /end AXIS_DESCR
/end CHARACTERISTIC
/begin AXIS_PTS CAL_cooling_fan_ac_on_X_air_temp "Calibration: X-axis (air temp) for the cooling fan A/C on table (°C = val*5/8−40; 6-element array)." 0x4000AC82 temp_engine_air_cooling_control RL_AXIS_UBYTE 0 CM_u8_temp_5_8_40c 6 -40 119.375 /end AXIS_PTS
/begin AXIS_PTS CAL_cooling_fan_ac_on_Y_carspeed "Calibration: Y axis (car speed) of the A/C-on radiator fan table." 0x4000AC88 car_speed_u8 RL_AXIS_UBYTE 0 CM_u8_speed_kph 6 0 255 /end AXIS_PTS
/begin CHARACTERISTIC CAL_cooling_fan_ac_on "Calibration: cooling fan A/C on (% = val*100/255; 36-element array)." MAP 0x4000AC8E RL_VALUE_UBYTE 0 CM_u8_factor_1_255 0 100
 /begin AXIS_DESCR COM_AXIS temp_engine_air_cooling_control CM_u8_temp_5_8_40c 6 -40 119.375 AXIS_PTS_REF CAL_cooling_fan_ac_on_X_air_temp /end AXIS_DESCR
 /begin AXIS_DESCR COM_AXIS car_speed_u8 CM_u8_speed_kph 6 0 255 AXIS_PTS_REF CAL_cooling_fan_ac_on_Y_carspeed /end AXIS_DESCR
/end CHARACTERISTIC
/begin AXIS_PTS CAL_idle_comp_vehicle_speed_ips_X_vehicle_speed "Calibration: X-axis (vehicle speed) for the idle compensation vehicle speed IPS table (km/h = val/100; 8-element array)." 0x4000ACB2 car_speed_x100 RL_AXIS_UWORD 0 CM_u8_speed_1_100kph 8 0 655.35 /end AXIS_PTS
/begin CHARACTERISTIC CAL_idle_comp_vehicle_speed_ips "Calibration: idle air added vs car speed, IPS." CURVE 0x4000ACC2 RL_VALUE_UWORD 0 CM_u16_flow_10mg_s 0 655350
 /begin AXIS_DESCR COM_AXIS car_speed_x100 CM_u8_speed_1_100kph 8 0 655.35 AXIS_PTS_REF CAL_idle_comp_vehicle_speed_ips_X_vehicle_speed /end AXIS_DESCR
/end CHARACTERISTIC
/begin AXIS_PTS CAL_revlimit_escalation_integrator_step_X_gear "Calibration: X-axis (gear) for the rev-limit escalation integrator step table (7-element array)." 0x4000AD92 car_current_gear RL_AXIS_UBYTE 0 NO_COMPU_METHOD 7 0 255 /end AXIS_PTS
/begin CHARACTERISTIC CAL_revlimit_escalation_integrator_step "Calibration: rev-limit escalation integrator step (7-element array)." CURVE 0x4000AD99 RL_VALUE_UBYTE 0 NO_COMPU_METHOD 0 255
 /begin AXIS_DESCR COM_AXIS car_current_gear NO_COMPU_METHOD 7 0 255 AXIS_PTS_REF CAL_revlimit_escalation_integrator_step_X_gear /end AXIS_DESCR
/end CHARACTERISTIC
/begin AXIS_PTS CAL_torque_limit_integral_X_load_error "Calibration: X-axis (load error) for the torque limit integral table (8-element array)." 0x4000ADC2 NO_INPUT_QUANTITY RL_AXIS_UBYTE 0 CM_u8__127 8 -127 128 /end AXIS_PTS
/begin CHARACTERISTIC CAL_torque_limit_integral "Calibration: torque limit integral (val/255; 8-element array)." CURVE 0x4000ADCA RL_VALUE_UBYTE 0 CM_u8_factor_1_255 0 100
 /begin AXIS_DESCR COM_AXIS NO_INPUT_QUANTITY CM_u8__127 8 -127 128 AXIS_PTS_REF CAL_torque_limit_integral_X_load_error /end AXIS_DESCR
/end CHARACTERISTIC
/begin AXIS_PTS CAL_idle_target_ips_coolant_fallback_X_coolant_temp "Calibration: X-axis (coolant temp) for the idle target IPS coolant fallback table (°C = val*5/8−40; 16-element array)." 0x4000ADD2 coolant_temp RL_AXIS_UBYTE 0 CM_u8_temp_5_8_40c 16 -40 119.375 /end AXIS_PTS
/begin CHARACTERISTIC CAL_idle_target_ips_coolant_fallback "Calibration: idle target IPS coolant fallback (RPM = val*4+500; 16-element array)." CURVE 0x4000ADE2 RL_VALUE_UBYTE 0 CM_u8_rspeed_4_500rpm 500 1520
 /begin AXIS_DESCR COM_AXIS coolant_temp CM_u8_temp_5_8_40c 16 -40 119.375 AXIS_PTS_REF CAL_idle_target_ips_coolant_fallback_X_coolant_temp /end AXIS_DESCR
/end CHARACTERISTIC
/begin AXIS_PTS CAL_torque_limit_by_rpm_X_gear "Calibration: X-axis (gear) for the torque limit by RPM table (8-element array)." 0x4000AFAA car_current_gear RL_AXIS_UBYTE 0 NO_COMPU_METHOD 8 0 255 /end AXIS_PTS
/begin AXIS_PTS CAL_torque_limit_by_rpm_Y_rpm "Calibration: Y-axis (rpm) for the torque limit by RPM table (RPM = val*125/4+500; 8-element array)." 0x4000AFB2 engine_speed_8bit RL_AXIS_UBYTE 0 CM_u8_rspeed_125_4_500rpm 8 500 8468.75 /end AXIS_PTS
/begin CHARACTERISTIC CAL_torque_limit_by_rpm "*WARNING* This table has been patched to double the torque values. Each 8bit value represents 4nm of torque." MAP 0x4000AFBA RL_VALUE_UBYTE 0 CM_u8_torque_4nm 0 1020
 /begin AXIS_DESCR COM_AXIS car_current_gear NO_COMPU_METHOD 8 0 255 AXIS_PTS_REF CAL_torque_limit_by_rpm_X_gear /end AXIS_DESCR
 /begin AXIS_DESCR COM_AXIS engine_speed_8bit CM_u8_rspeed_125_4_500rpm 8 500 8468.75 AXIS_PTS_REF CAL_torque_limit_by_rpm_Y_rpm /end AXIS_DESCR
/end CHARACTERISTIC
/begin AXIS_PTS CAL_tpstarget_tour_ips_X_pps "Calibration: X-axis (pps) for the tpstarget tour IPS table (val/1023; 16-element array)." 0x4000B032 accel_pedal_pos_16bit RL_AXIS_UWORD 0 CM_u16_factor_1_1023 16 0 6406.15835777126 /end AXIS_PTS
/begin CHARACTERISTIC CAL_tpstarget_tour_ips "Calibration: tpstarget tour IPS (val/1023; 16-element array)." CURVE 0x4000B052 RL_VALUE_UWORD 0 CM_u16_factor_1_1023 0 6406.15835777126
 /begin AXIS_DESCR COM_AXIS accel_pedal_pos_16bit CM_u16_factor_1_1023 16 0 6406.15835777126 AXIS_PTS_REF CAL_tpstarget_tour_ips_X_pps /end AXIS_DESCR
/end CHARACTERISTIC
/begin AXIS_PTS CAL_tpstarget_sport_ips_X_pps "Calibration: X-axis (pps) for the tpstarget sport IPS table (val/1023; 16-element array)." 0x4000B072 accel_pedal_pos_16bit RL_AXIS_UWORD 0 CM_u16_factor_1_1023 16 0 6406.15835777126 /end AXIS_PTS
/begin CHARACTERISTIC CAL_tpstarget_sport_ips "Calibration: tpstarget sport IPS (val/1023; 16-element array)." CURVE 0x4000B092 RL_VALUE_UWORD 0 CM_u16_factor_1_1023 0 6406.15835777126
 /begin AXIS_DESCR COM_AXIS accel_pedal_pos_16bit CM_u16_factor_1_1023 16 0 6406.15835777126 AXIS_PTS_REF CAL_tpstarget_sport_ips_X_pps /end AXIS_DESCR
/end CHARACTERISTIC
/begin AXIS_PTS CAL_evap_purge_flow_coefficient_X_dutycycle "Calibration: X-axis (dutycycle) for the evaporative purge flow coefficient table (val/255; 16-element array)." 0x4000B182 evap_purge_duty_hi RL_AXIS_UBYTE 0 CM_u8_factor_1_255 16 0 100 /end AXIS_PTS
/begin AXIS_PTS CAL_evap_purge_flow_coefficient_Y_vacuum "Calibration: Y-axis (vacuum) for the evaporative purge flow coefficient table (mbar = val*4; 16-element array)." 0x4000B192 V_CAL_evap_purge_flow_coefficient_Y_vacuum RL_AXIS_UBYTE 0 CM_u8_pressure_4mbar 16 0 1020 /end AXIS_PTS
/begin CHARACTERISTIC CAL_evap_purge_flow_coefficient "Calibration: evaporative purge flow coefficient (256-element array)." MAP 0x4000B1A2 RL_VALUE_UBYTE 0 NO_COMPU_METHOD 0 255
 /begin AXIS_DESCR COM_AXIS evap_purge_duty_hi CM_u8_factor_1_255 16 0 100 AXIS_PTS_REF CAL_evap_purge_flow_coefficient_X_dutycycle /end AXIS_DESCR
 /begin AXIS_DESCR COM_AXIS V_CAL_evap_purge_flow_coefficient_Y_vacuum CM_u8_pressure_4mbar 16 0 1020 AXIS_PTS_REF CAL_evap_purge_flow_coefficient_Y_vacuum /end AXIS_DESCR
/end CHARACTERISTIC
/begin CHARACTERISTIC CAL_evap_purge_flow_X_vacuum "Calibration: X axis (purge vacuum) of CAL_evap_purge_flow_max_duty. (0091 0x4000ba72)" VAL_BLK 0x4000B2A2 RL_VALUE_UBYTE 0 CM_u8_pressure_4mbar 0 1020 NUMBER 8 /end CHARACTERISTIC
/begin CHARACTERISTIC CAL_evap_purge_flow_max_duty "Calibration: evap purge max duty vs vacuum. (0091 0x4000ba7a)" VAL_BLK 0x4000B2AA RL_VALUE_UBYTE 0 CM_u8_factor_1_255 0 100 NUMBER 8 /end CHARACTERISTIC
/begin AXIS_PTS CAL_tpstarget_tour_manual_X_pps "Calibration: X-axis (pps) for the tpstarget tour manual table (val/1023; 16-element array)." 0x4000B2B2 accel_pedal_pos_16bit RL_AXIS_UWORD 0 CM_u16_factor_1_1023 16 0 6406.15835777126 /end AXIS_PTS
/begin CHARACTERISTIC CAL_tpstarget_tour_manual "Calibration: tpstarget tour manual (val/1023; 16-element array)." CURVE 0x4000B2D2 RL_VALUE_UWORD 0 CM_u16_factor_1_1023 0 6406.15835777126
 /begin AXIS_DESCR COM_AXIS accel_pedal_pos_16bit CM_u16_factor_1_1023 16 0 6406.15835777126 AXIS_PTS_REF CAL_tpstarget_tour_manual_X_pps /end AXIS_DESCR
/end CHARACTERISTIC
/begin AXIS_PTS CAL_tpstarget_sport_manual_X_pps "Calibration: X-axis (pps) for the tpstarget sport manual table (val/1023; 16-element array)." 0x4000B332 accel_pedal_pos_16bit RL_AXIS_UWORD 0 CM_u16_factor_1_1023 16 0 6406.15835777126 /end AXIS_PTS
/begin CHARACTERISTIC CAL_tpstarget_sport_manual "Calibration: tpstarget sport manual (val/1023; 16-element array)." CURVE 0x4000B352 RL_VALUE_UWORD 0 CM_u16_factor_1_1023 0 6406.15835777126
 /begin AXIS_DESCR COM_AXIS accel_pedal_pos_16bit CM_u16_factor_1_1023 16 0 6406.15835777126 AXIS_PTS_REF CAL_tpstarget_sport_manual_X_pps /end AXIS_DESCR
/end CHARACTERISTIC
/begin AXIS_PTS CAL_torque_torque_to_load_X_engine_speed "Calibration: X-axis (engine speed) for the torque torque to load table (RPM; 16-element array)." 0x4000B64A engine_speed_16bit RL_AXIS_UWORD 0 CM_u8_rspeed_rpm 16 0 65535 /end AXIS_PTS
/begin AXIS_PTS CAL_torque_torque_to_load_Y_torque "Calibration: Y-axis (torque) for the torque torque to load table (Nm; 16-element array)." 0x4000B66A NO_INPUT_QUANTITY RL_AXIS_UWORD 0 CM_u8_torque_nm 16 0 65535 /end AXIS_PTS
/begin CHARACTERISTIC CAL_torque_torque_to_load "Calibration: torque torque to load (mg/stroke; 256-element array)." MAP 0x4000B68A RL_VALUE_UWORD 0 CM_u8_load_mg_stroke 0 65535
 /begin AXIS_DESCR COM_AXIS engine_speed_16bit CM_u8_rspeed_rpm 16 0 65535 AXIS_PTS_REF CAL_torque_torque_to_load_X_engine_speed /end AXIS_DESCR
 /begin AXIS_DESCR COM_AXIS NO_INPUT_QUANTITY CM_u8_torque_nm 16 0 65535 AXIS_PTS_REF CAL_torque_torque_to_load_Y_torque /end AXIS_DESCR
/end CHARACTERISTIC
/begin AXIS_PTS CAL_torque_ign_retard_base_X_engine_speed "Calibration: X-axis (engine speed) for the torque ignition retard base table (RPM = val*125/4+500; 16-element array)." 0x4000B88A engine_speed_8bit RL_AXIS_UBYTE 0 CM_u8_rspeed_125_4_500rpm 16 500 8468.75 /end AXIS_PTS
/begin AXIS_PTS CAL_torque_ign_retard_base_Y_torque_reduction_factor "Calibration: Y-axis (torque reduction factor) for the torque ignition retard base table (val/255; 16-element array)." 0x4000B89A torque_reduction_factor_ign RL_AXIS_UBYTE 0 CM_u8_factor_1_255 16 0 100 /end AXIS_PTS
/begin CHARACTERISTIC CAL_torque_ign_retard_base "Calibration: torque ignition retard base (° = val/4−64; 256-element array)." MAP 0x4000B8AA RL_VALUE_UBYTE 0 CM_u8_angle_1_4_64deg -64 -0.25
 /begin AXIS_DESCR COM_AXIS engine_speed_8bit CM_u8_rspeed_125_4_500rpm 16 500 8468.75 AXIS_PTS_REF CAL_torque_ign_retard_base_X_engine_speed /end AXIS_DESCR
 /begin AXIS_DESCR COM_AXIS torque_reduction_factor_ign CM_u8_factor_1_255 16 0 100 AXIS_PTS_REF CAL_torque_ign_retard_base_Y_torque_reduction_factor /end AXIS_DESCR
/end CHARACTERISTIC
/begin AXIS_PTS CAL_idle_target_ips_X_coolant_temp "Calibration: X-axis (coolant temp) for the idle target IPS table (°C = val*5/8−40; 16-element array)." 0x4000BACA coolant_temp RL_AXIS_UBYTE 0 CM_u8_temp_5_8_40c 16 -40 119.375 /end AXIS_PTS
/begin CHARACTERISTIC CAL_idle_target_ips "Calibration: idle target IPS (RPM = val*4+500; 16-element array)." CURVE 0x4000BADA RL_VALUE_UBYTE 0 CM_u8_rspeed_4_500rpm 500 1520
 /begin AXIS_DESCR COM_AXIS coolant_temp CM_u8_temp_5_8_40c 16 -40 119.375 AXIS_PTS_REF CAL_idle_target_ips_X_coolant_temp /end AXIS_DESCR
/end CHARACTERISTIC
/begin AXIS_PTS CAL_torque_limit_base_factor_X_rpm "Calibration: X-axis (rpm) for the torque limit base factor table (RPM = val*125/4+500; 16-element array)." 0x4000BAEA engine_speed_8bit RL_AXIS_UBYTE 0 CM_u8_rspeed_125_4_500rpm 16 500 8468.75 /end AXIS_PTS
/begin AXIS_PTS CAL_torque_limit_base_factor_Y_load "Calibration: Y-axis (load) for the torque limit base factor table (mg/stroke = val*4; 16-element array)." 0x4000BAFA load_mass_per_stroke RL_AXIS_UBYTE 0 CM_u8_load_4mg_stroke 16 0 1020 /end AXIS_PTS
/begin CHARACTERISTIC CAL_torque_limit_base_factor "// Used in cylinder cut calculation" MAP 0x4000BB0A RL_VALUE_UBYTE 0 CM_u8_factor_1_255 0 100
 /begin AXIS_DESCR COM_AXIS engine_speed_8bit CM_u8_rspeed_125_4_500rpm 16 500 8468.75 AXIS_PTS_REF CAL_torque_limit_base_factor_X_rpm /end AXIS_DESCR
 /begin AXIS_DESCR COM_AXIS load_mass_per_stroke CM_u8_load_4mg_stroke 16 0 1020 AXIS_PTS_REF CAL_torque_limit_base_factor_Y_load /end AXIS_DESCR
/end CHARACTERISTIC
/begin AXIS_PTS CAL_torque_engine_friction_temp_component_X_coolant "Calibration: X-axis (coolant) for the torque engine friction temperature component table (°C = val*5/8−40; 8-element array)." 0x4000BC0A coolant_temp RL_AXIS_UBYTE 0 CM_u8_temp_5_8_40c 8 -40 119.375 /end AXIS_PTS
/begin AXIS_PTS CAL_torque_engine_friction_temp_component_Y_load "Calibration: Y-axis (load) for the torque engine friction temperature component table (mg/stroke = val*4; 8-element array)." 0x4000BC12 load_mass_per_stroke RL_AXIS_UBYTE 0 CM_u8_load_4mg_stroke 8 0 1020 /end AXIS_PTS
/begin CHARACTERISTIC CAL_torque_engine_friction_temp_component "Calibration: torque engine friction temperature component (Nm; 64-element array)." MAP 0x4000BC1A RL_VALUE_UBYTE 0 CM_u8_torque_nm 0 255
 /begin AXIS_DESCR COM_AXIS coolant_temp CM_u8_temp_5_8_40c 8 -40 119.375 AXIS_PTS_REF CAL_torque_engine_friction_temp_component_X_coolant /end AXIS_DESCR
 /begin AXIS_DESCR COM_AXIS load_mass_per_stroke CM_u8_load_4mg_stroke 8 0 1020 AXIS_PTS_REF CAL_torque_engine_friction_temp_component_Y_load /end AXIS_DESCR
/end CHARACTERISTIC
/begin AXIS_PTS CAL_torque_spark_efficiency_X_rpm "Calibration: X axis (rpm) of spark efficiency. (0091)" 0x4000BC5A engine_speed_8bit RL_AXIS_UBYTE 0 CM_u8_rspeed_125_4_500rpm 16 500 8468.75 /end AXIS_PTS
/begin AXIS_PTS CAL_torque_spark_efficiency_Y_ign_retard_from_mbt "Calibration: Y-axis (ign retard from mbt) for the torque spark efficiency table (° = val/4; 16-element array)." 0x4000BC6A NO_INPUT_QUANTITY RL_AXIS_UBYTE 0 CM_u8_angle_1_4deg 16 0 63.75 /end AXIS_PTS
/begin CHARACTERISTIC CAL_torque_spark_efficiency "Calibration: torque spark efficiency (val/255; 256-element array)." MAP 0x4000BC7A RL_VALUE_UBYTE 0 CM_u8_factor_1_255 0 100
 /begin AXIS_DESCR COM_AXIS engine_speed_8bit CM_u8_rspeed_125_4_500rpm 16 500 8468.75 AXIS_PTS_REF CAL_torque_spark_efficiency_X_rpm /end AXIS_DESCR
 /begin AXIS_DESCR COM_AXIS NO_INPUT_QUANTITY CM_u8_angle_1_4deg 16 0 63.75 AXIS_PTS_REF CAL_torque_spark_efficiency_Y_ign_retard_from_mbt /end AXIS_DESCR
/end CHARACTERISTIC
/begin AXIS_PTS CAL_torque_spark_efficiency_slope_X_rpm "Calibration: X-axis (rpm) for the torque spark efficiency slope table (RPM = val*125/4+500; 16-element array)." 0x4000BD7A engine_speed_8bit RL_AXIS_UBYTE 0 CM_u8_rspeed_125_4_500rpm 16 500 8468.75 /end AXIS_PTS
/begin AXIS_PTS CAL_torque_spark_efficiency_slope_Y_load "Calibration: Y-axis (load) for the torque spark efficiency slope table (mg/stroke = val*4; 16-element array)." 0x4000BD8A load_mass_per_stroke RL_AXIS_UBYTE 0 CM_u8_load_4mg_stroke 16 0 1020 /end AXIS_PTS
/begin CHARACTERISTIC CAL_torque_spark_efficiency_slope "Calibration: spark efficiency slope. (0091)" MAP 0x4000BD9A RL_VALUE_UBYTE 0 CM_u8_gain__x_104_26 -4 5.80769230769231
 /begin AXIS_DESCR COM_AXIS engine_speed_8bit CM_u8_rspeed_125_4_500rpm 16 500 8468.75 AXIS_PTS_REF CAL_torque_spark_efficiency_slope_X_rpm /end AXIS_DESCR
 /begin AXIS_DESCR COM_AXIS load_mass_per_stroke CM_u8_load_4mg_stroke 16 0 1020 AXIS_PTS_REF CAL_torque_spark_efficiency_slope_Y_load /end AXIS_DESCR
/end CHARACTERISTIC
/begin AXIS_PTS CAL_idle_air_base_ips_ingear_tour_X_rpm "Calibration: X axis (idle target) of CAL_idle_air_base_ips_ingear_tour. (0091 0x4000c78a)" 0x4000BFBA NO_INPUT_QUANTITY RL_AXIS_UWORD 0 CM_u8_rspeed_rpm 16 0 65535 /end AXIS_PTS
/begin CHARACTERISTIC CAL_idle_air_base_ips_ingear_tour "Calibration: idle base air, IPS in gear, tour. (0091 0x4000c7aa)" CURVE 0x4000BFDA RL_VALUE_UWORD 0 CM_u16_flow_100_256mg_s 0 25599.609375
 /begin AXIS_DESCR COM_AXIS NO_INPUT_QUANTITY CM_u8_rspeed_rpm 16 0 65535 AXIS_PTS_REF CAL_idle_air_base_ips_ingear_tour_X_rpm /end AXIS_DESCR
/end CHARACTERISTIC
/begin AXIS_PTS CAL_revlimit_speedbase_manual_sport_X_coolant_temp "Calibration: X-axis (coolant temp) for the rev-limit speedbase manual sport table (°C = val*5/8−40; 4-element array)." 0x4000C01A coolant_temp RL_AXIS_UWORD 0 CM_u8_temp_5_8_40c 4 -40 40919.375 /end AXIS_PTS
/begin AXIS_PTS CAL_revlimit_speedbase_manual_sport_Y_timer "Calibration: Y-axis (timer) for the rev-limit speedbase manual sport table (ms = val*5; 4-element array)." 0x4000C022 NO_INPUT_QUANTITY RL_AXIS_UWORD 0 CM_u8_time_5ms 4 0 327675 /end AXIS_PTS
/begin CHARACTERISTIC CAL_revlimit_speedbase_manual_sport "Calibration: rev-limit speedbase manual sport (RPM; 16-element array)." MAP 0x4000C02A RL_VALUE_UWORD 0 CM_u8_rspeed_rpm 0 65535
 /begin AXIS_DESCR COM_AXIS coolant_temp CM_u8_temp_5_8_40c 4 -40 40919.375 AXIS_PTS_REF CAL_revlimit_speedbase_manual_sport_X_coolant_temp /end AXIS_DESCR
 /begin AXIS_DESCR COM_AXIS NO_INPUT_QUANTITY CM_u8_time_5ms 4 0 327675 AXIS_PTS_REF CAL_revlimit_speedbase_manual_sport_Y_timer /end AXIS_DESCR
/end CHARACTERISTIC
/begin AXIS_PTS CAL_revlimit_speedbase_ips_tour_X_coolant_temp "Calibration: X-axis (coolant temp) for the rev-limit speedbase IPS tour table (°C = val*5/8−40; 4-element array)." 0x4000C04A coolant_temp RL_AXIS_UWORD 0 CM_u8_temp_5_8_40c 4 -40 40919.375 /end AXIS_PTS
/begin AXIS_PTS CAL_revlimit_speedbase_ips_tour_Y_timer "Calibration: Y-axis (timer) for the rev-limit speedbase IPS tour table (ms = val*5; 4-element array)." 0x4000C052 NO_INPUT_QUANTITY RL_AXIS_UWORD 0 CM_u8_time_5ms 4 0 327675 /end AXIS_PTS
/begin CHARACTERISTIC CAL_revlimit_speedbase_ips_tour "Calibration: rev-limit speedbase IPS tour (RPM; 16-element array)." MAP 0x4000C05A RL_VALUE_UWORD 0 CM_u8_rspeed_rpm 0 65535
 /begin AXIS_DESCR COM_AXIS coolant_temp CM_u8_temp_5_8_40c 4 -40 40919.375 AXIS_PTS_REF CAL_revlimit_speedbase_ips_tour_X_coolant_temp /end AXIS_DESCR
 /begin AXIS_DESCR COM_AXIS NO_INPUT_QUANTITY CM_u8_time_5ms 4 0 327675 AXIS_PTS_REF CAL_revlimit_speedbase_ips_tour_Y_timer /end AXIS_DESCR
/end CHARACTERISTIC
/begin AXIS_PTS CAL_revlimit_speedbase_ips_sport_X_coolant_temp "Calibration: X-axis (coolant temp) for the rev-limit speedbase IPS sport table (°C = val*5/8−40; 4-element array)." 0x4000C07A coolant_temp RL_AXIS_UWORD 0 CM_u8_temp_5_8_40c 4 -40 40919.375 /end AXIS_PTS
/begin AXIS_PTS CAL_revlimit_speedbase_ips_sport_Y_timer "Calibration: Y-axis (timer) for the rev-limit speedbase IPS sport table (ms = val*5; 4-element array)." 0x4000C082 NO_INPUT_QUANTITY RL_AXIS_UWORD 0 CM_u8_time_5ms 4 0 327675 /end AXIS_PTS
/begin CHARACTERISTIC CAL_revlimit_speedbase_ips_sport "Calibration: rev-limit speedbase IPS sport (RPM; 16-element array)." MAP 0x4000C08A RL_VALUE_UWORD 0 CM_u8_rspeed_rpm 0 65535
 /begin AXIS_DESCR COM_AXIS coolant_temp CM_u8_temp_5_8_40c 4 -40 40919.375 AXIS_PTS_REF CAL_revlimit_speedbase_ips_sport_X_coolant_temp /end AXIS_DESCR
 /begin AXIS_DESCR COM_AXIS NO_INPUT_QUANTITY CM_u8_time_5ms 4 0 327675 AXIS_PTS_REF CAL_revlimit_speedbase_ips_sport_Y_timer /end AXIS_DESCR
/end CHARACTERISTIC
/begin AXIS_PTS CAL_revlimit_coldstart_rpm_envelope_X_index "Calibration: X-axis (index) for the rev-limit coldstart RPM envelope table (4-element array)." 0x4000C0AA NO_INPUT_QUANTITY RL_AXIS_UWORD 0 NO_COMPU_METHOD 4 0 65535 /end AXIS_PTS
/begin CHARACTERISTIC CAL_revlimit_coldstart_rpm_envelope "Calibration: rev-limit coldstart RPM envelope (RPM; 4-element array)." CURVE 0x4000C0B2 RL_VALUE_UWORD 0 CM_u8_rspeed_rpm 0 65535
 /begin AXIS_DESCR COM_AXIS NO_INPUT_QUANTITY NO_COMPU_METHOD 4 0 65535 AXIS_PTS_REF CAL_revlimit_coldstart_rpm_envelope_X_index /end AXIS_DESCR
/end CHARACTERISTIC
/begin AXIS_PTS CAL_idle_comp_carspeed_ips_X_carspeed "Calibration: X-axis (carspeed) for the idle compensation carspeed IPS table (km/h; 8-element array)." 0x4000C0BA car_speed_u8 RL_AXIS_UBYTE 0 CM_u8_speed_kph 8 0 255 /end AXIS_PTS
/begin CHARACTERISTIC CAL_idle_comp_carspeed_ips "Calibration: idle compensation carspeed IPS (RPM = val*4; 8-element array)." CURVE 0x4000C0C2 RL_VALUE_UBYTE 0 CM_u8_rspeed_4rpm 0 1020
 /begin AXIS_DESCR COM_AXIS car_speed_u8 CM_u8_speed_kph 8 0 255 AXIS_PTS_REF CAL_idle_comp_carspeed_ips_X_carspeed /end AXIS_DESCR
/end CHARACTERISTIC
/begin AXIS_PTS CAL_idle_comp_while_moving_X_rpm "Calibration: X-axis (rpm) for the idle compensation while moving table (RPM; 16-element array)." 0x4000C63A engine_speed_16bit RL_AXIS_UWORD 0 CM_u8_rspeed_rpm 16 0 65535 /end AXIS_PTS
/begin CHARACTERISTIC CAL_idle_comp_while_moving "Calibration: idle compensation while moving (mg/s = val*100; 16-element array)." CURVE 0x4000C65A RL_VALUE_UWORD 0 CM_u8_flow_100mg_s 0 6553500
 /begin AXIS_DESCR COM_AXIS engine_speed_16bit CM_u8_rspeed_rpm 16 0 65535 AXIS_PTS_REF CAL_idle_comp_while_moving_X_rpm /end AXIS_DESCR
/end CHARACTERISTIC
/begin AXIS_PTS CAL_vvt_exhaust_comp_temp_X_coolant_temp "Calibration: X-axis (coolant temp) for the VVT exhaust compensation temperature table (°C = val*5/8−40; 16-element array)." 0x4000C68A coolant_temp RL_AXIS_UBYTE 0 CM_u8_temp_5_8_40c 16 -40 119.375 /end AXIS_PTS
/begin CHARACTERISTIC CAL_vvt_exhaust_comp_temp "Calibration: VVT exhaust compensation temperature (° = val/4; 16-element array)." CURVE 0x4000C69A RL_VALUE_UBYTE 0 CM_u8_angle_1_4deg 0 63.75
 /begin AXIS_DESCR COM_AXIS coolant_temp CM_u8_temp_5_8_40c 16 -40 119.375 AXIS_PTS_REF CAL_vvt_exhaust_comp_temp_X_coolant_temp /end AXIS_DESCR
/end CHARACTERISTIC
/begin AXIS_PTS CAL_idle_comp_steering_X_steering_load "Calibration: X-axis (steering load) for the idle compensation steering table (4-element array)." 0x4000C6AA NO_INPUT_QUANTITY RL_AXIS_UBYTE 0 NO_COMPU_METHOD 4 0 255 /end AXIS_PTS
/begin CHARACTERISTIC CAL_idle_comp_steering "Calibration: idle compensation steering (4-element array)." CURVE 0x4000C6AE RL_VALUE_UBYTE 0 NO_COMPU_METHOD 0 255
 /begin AXIS_DESCR COM_AXIS NO_INPUT_QUANTITY NO_COMPU_METHOD 4 0 255 AXIS_PTS_REF CAL_idle_comp_steering_X_steering_load /end AXIS_DESCR
/end CHARACTERISTIC
/begin AXIS_PTS CAL_vvt_intake_advance_base_low_load_X_engine_speed "Calibration: X-axis (engine speed) for the VVT intake advance base low load table (RPM = val*125/4+500; 6-element array)." 0x4000C6F2 engine_speed_8bit RL_AXIS_UBYTE 0 CM_u8_rspeed_125_4_500rpm 6 500 8468.75 /end AXIS_PTS
/begin AXIS_PTS CAL_vvt_intake_advance_base_low_load_Y_load "Calibration: Y-axis (load) for the VVT intake advance base low load table (mg/stroke = val*4; 6-element array)." 0x4000C6F8 load_mass_per_stroke RL_AXIS_UBYTE 0 CM_u8_load_4mg_stroke 6 0 1020 /end AXIS_PTS
/begin CHARACTERISTIC CAL_vvt_intake_advance_base_low_load "Calibration: VVT intake advance base low load (° = val/4; 36-element array)." MAP 0x4000C6FE RL_VALUE_UBYTE 0 CM_u8_angle_1_4deg 0 63.75
 /begin AXIS_DESCR COM_AXIS engine_speed_8bit CM_u8_rspeed_125_4_500rpm 6 500 8468.75 AXIS_PTS_REF CAL_vvt_intake_advance_base_low_load_X_engine_speed /end AXIS_DESCR
 /begin AXIS_DESCR COM_AXIS load_mass_per_stroke CM_u8_load_4mg_stroke 6 0 1020 AXIS_PTS_REF CAL_vvt_intake_advance_base_low_load_Y_load /end AXIS_DESCR
/end CHARACTERISTIC
/begin AXIS_PTS CAL_idle_air_base_ips_neutral_tour_X_rpm "Calibration: X axis (idle target) of CAL_idle_air_base_ips_neutral_tour. (0091 0x4000cefa)" 0x4000C72A NO_INPUT_QUANTITY RL_AXIS_UWORD 0 CM_u8_rspeed_rpm 16 0 65535 /end AXIS_PTS
/begin CHARACTERISTIC CAL_idle_air_base_ips_neutral_tour "Calibration: idle base air, IPS neutral, tour. (0091 0x4000cf1a)" CURVE 0x4000C74A RL_VALUE_UWORD 0 CM_u16_flow_100_256mg_s 0 25599.609375
 /begin AXIS_DESCR COM_AXIS NO_INPUT_QUANTITY CM_u8_rspeed_rpm 16 0 65535 AXIS_PTS_REF CAL_idle_air_base_ips_neutral_tour_X_rpm /end AXIS_DESCR
/end CHARACTERISTIC
/begin AXIS_PTS CAL_vvt_exhaust_advance_base_low_load_X_engine_speed "Calibration: X-axis (engine speed) for the VVT exhaust advance base low load table (RPM = val*125/4+500; 6-element array)." 0x4000C76A engine_speed_8bit RL_AXIS_UBYTE 0 CM_u8_rspeed_125_4_500rpm 6 500 8468.75 /end AXIS_PTS
/begin AXIS_PTS CAL_vvt_exhaust_advance_base_low_load_Y_load "Calibration: Y-axis (load) for the VVT exhaust advance base low load table (mg/stroke = val*4; 6-element array)." 0x4000C770 load_mass_per_stroke RL_AXIS_UBYTE 0 CM_u8_load_4mg_stroke 6 0 1020 /end AXIS_PTS
/begin CHARACTERISTIC CAL_vvt_exhaust_advance_base_low_load "Calibration: VVT exhaust advance base low load (° = val/4; 36-element array)." MAP 0x4000C776 RL_VALUE_UBYTE 0 CM_u8_angle_1_4deg 0 63.75
 /begin AXIS_DESCR COM_AXIS engine_speed_8bit CM_u8_rspeed_125_4_500rpm 6 500 8468.75 AXIS_PTS_REF CAL_vvt_exhaust_advance_base_low_load_X_engine_speed /end AXIS_DESCR
 /begin AXIS_DESCR COM_AXIS load_mass_per_stroke CM_u8_load_4mg_stroke 6 0 1020 AXIS_PTS_REF CAL_vvt_exhaust_advance_base_low_load_Y_load /end AXIS_DESCR
/end CHARACTERISTIC
/begin AXIS_PTS CAL_idle_air_control_proportional_X_speed_error "Calibration: X axis (idle speed error + 0x8000, rpm) of CAL_idle_air_control_proportional." 0x4000C7A2 V_CAL_idle_air_control_proportional_X_speed_error RL_AXIS_UWORD 0 CM_u16_rspeed_rpm_32768 16 -32768 32767 /end AXIS_PTS
/begin CHARACTERISTIC CAL_idle_air_control_proportional "Calibration: idle P term vs speed error, offset-binary." CURVE 0x4000C7C2 RL_VALUE_UWORD 0 CM_u16_raw_32768 -32768 32767
 /begin AXIS_DESCR COM_AXIS V_CAL_idle_air_control_proportional_X_speed_error CM_u16_rspeed_rpm_32768 16 -32768 32767 AXIS_PTS_REF CAL_idle_air_control_proportional_X_speed_error /end AXIS_DESCR
/end CHARACTERISTIC
/begin AXIS_PTS CAL_revlimit_trim_per_gear_X_gear "Calibration: X-axis (gear) for the rev-limit trim per gear table (7-element array)." 0x4000C84E car_current_gear RL_AXIS_UBYTE 0 NO_COMPU_METHOD 7 0 255 /end AXIS_PTS
/begin CHARACTERISTIC CAL_revlimit_trim_per_gear "Calibration: rev-limit trim per gear (RPM = val*2; 7-element array)." CURVE 0x4000C855 RL_VALUE_UBYTE 0 CM_u8_rspeed_2rpm 0 510
 /begin AXIS_DESCR COM_AXIS car_current_gear NO_COMPU_METHOD 7 0 255 AXIS_PTS_REF CAL_revlimit_trim_per_gear_X_gear /end AXIS_DESCR
/end CHARACTERISTIC
/begin AXIS_PTS CAL_revlimit_airflow_threshold_X_gear "Calibration: X-axis (gear) for the rev-limit airflow threshold table (7-element array)." 0x4000C85C car_current_gear RL_AXIS_UBYTE 0 NO_COMPU_METHOD 7 0 255 /end AXIS_PTS
/begin CHARACTERISTIC CAL_revlimit_airflow_threshold "Calibration: rev-limit airflow threshold (g/s = val*2; 7-element array)." CURVE 0x4000C863 RL_VALUE_UBYTE 0 CM_u8_flow_2g_s 0 510
 /begin AXIS_DESCR COM_AXIS car_current_gear NO_COMPU_METHOD 7 0 255 AXIS_PTS_REF CAL_revlimit_airflow_threshold_X_gear /end AXIS_DESCR
/end CHARACTERISTIC
/begin AXIS_PTS CAL_idle_error_correction_unknown_X_speed_error "Calibration: X axis (idle speed error + 0x8000, rpm) of CAL_idle_error_correction_unknown." 0x4000C892 V_CAL_idle_error_correction_unknown_X_speed_error RL_AXIS_UWORD 0 CM_u16_rspeed_rpm_32768 16 -32768 32767 /end AXIS_PTS
/begin CHARACTERISTIC CAL_idle_error_correction_unknown "Calibration: idle error correction vs speed error, offset-binary." CURVE 0x4000C8B2 RL_VALUE_UWORD 0 CM_u16_raw_32768 -32768 32767
 /begin AXIS_DESCR COM_AXIS V_CAL_idle_error_correction_unknown_X_speed_error CM_u16_rspeed_rpm_32768 16 -32768 32767 AXIS_PTS_REF CAL_idle_error_correction_unknown_X_speed_error /end AXIS_DESCR
/end CHARACTERISTIC
/begin AXIS_PTS CAL_idle_comp_misfire_X_failed_cyl_count "Calibration: X-axis (failed cyl count) for the idle compensation misfire table (8-element array)." 0x4000C8F2 failed_ignition_cyl_count RL_AXIS_UBYTE 0 NO_COMPU_METHOD 8 0 255 /end AXIS_PTS
/begin CHARACTERISTIC CAL_idle_comp_misfire "Calibration: idle compensation misfire (g/s; 8-element array)." CURVE 0x4000C8FA RL_VALUE_UBYTE 0 CM_u8_flow_g_s 0 255
 /begin AXIS_DESCR COM_AXIS failed_ignition_cyl_count NO_COMPU_METHOD 8 0 255 AXIS_PTS_REF CAL_idle_comp_misfire_X_failed_cyl_count /end AXIS_DESCR
/end CHARACTERISTIC
/begin AXIS_PTS CAL_tpstarget_tour_shifting_X_pps "Calibration: X-axis (pps) for the tpstarget tour shifting table (val/1023; 16-element array)." 0x4000C912 accel_pedal_pos_16bit RL_AXIS_UWORD 0 CM_u16_factor_1_1023 16 0 6406.15835777126 /end AXIS_PTS
/begin CHARACTERISTIC CAL_tpstarget_tour_shifting "Calibration: tpstarget tour shifting (val/1023; 16-element array)." CURVE 0x4000C932 RL_VALUE_UWORD 0 CM_u16_factor_1_1023 0 6406.15835777126
 /begin AXIS_DESCR COM_AXIS accel_pedal_pos_16bit CM_u16_factor_1_1023 16 0 6406.15835777126 AXIS_PTS_REF CAL_tpstarget_tour_shifting_X_pps /end AXIS_DESCR
/end CHARACTERISTIC
/begin AXIS_PTS CAL_tpstarget_sport_shifting_X_pps "Calibration: X-axis (pps) for the tpstarget sport shifting table (val/1023; 16-element array)." 0x4000C952 accel_pedal_pos_16bit RL_AXIS_UWORD 0 CM_u16_factor_1_1023 16 0 6406.15835777126 /end AXIS_PTS
/begin CHARACTERISTIC CAL_tpstarget_sport_shifting "Calibration: tpstarget sport shifting (val/1023; 16-element array)." CURVE 0x4000C972 RL_VALUE_UWORD 0 CM_u16_factor_1_1023 0 6406.15835777126
 /begin AXIS_DESCR COM_AXIS accel_pedal_pos_16bit CM_u16_factor_1_1023 16 0 6406.15835777126 AXIS_PTS_REF CAL_tpstarget_sport_shifting_X_pps /end AXIS_DESCR
/end CHARACTERISTIC
/begin AXIS_PTS CAL_revlimit_airflow_gain_from_rpm_delta_X_gear "Calibration: X-axis (gear) for the rev-limit airflow gain from RPM delta table (7-element array)." 0x4000C992 car_current_gear RL_AXIS_UBYTE 0 NO_COMPU_METHOD 7 0 255 /end AXIS_PTS
/begin CHARACTERISTIC CAL_revlimit_airflow_gain_from_rpm_delta "Calibration: rev-limit airflow gain from RPM delta (val/255; 7-element array)." CURVE 0x4000C999 RL_VALUE_UBYTE 0 CM_u8_factor_1_255 0 100
 /begin AXIS_DESCR COM_AXIS car_current_gear NO_COMPU_METHOD 7 0 255 AXIS_PTS_REF CAL_revlimit_airflow_gain_from_rpm_delta_X_gear /end AXIS_DESCR
/end CHARACTERISTIC
/begin AXIS_PTS CAL_revlimit_airflow_gain_from_integrator_X_gear "Calibration: X-axis (gear) for the rev-limit airflow gain from integrator table (7-element array)." 0x4000C9A0 car_current_gear RL_AXIS_UBYTE 0 NO_COMPU_METHOD 7 0 255 /end AXIS_PTS
/begin CHARACTERISTIC CAL_revlimit_airflow_gain_from_integrator "Calibration: rev-limit airflow gain from integrator (val/255; 7-element array)." CURVE 0x4000C9A7 RL_VALUE_UBYTE 0 CM_u8_factor_1_255 0 100
 /begin AXIS_DESCR COM_AXIS car_current_gear NO_COMPU_METHOD 7 0 255 AXIS_PTS_REF CAL_revlimit_airflow_gain_from_integrator_X_gear /end AXIS_DESCR
/end CHARACTERISTIC
/begin AXIS_PTS CAL_revlimit_airflow_gain_from_rpm_X_gear "Calibration: X-axis (gear) for the rev-limit airflow gain from RPM table (7-element array)." 0x4000C9AE car_current_gear RL_AXIS_UBYTE 0 NO_COMPU_METHOD 7 0 255 /end AXIS_PTS
/begin CHARACTERISTIC CAL_revlimit_airflow_gain_from_rpm "Calibration: rev-limit airflow gain from RPM (val/255; 7-element array)." CURVE 0x4000C9B5 RL_VALUE_UBYTE 0 CM_u8_factor_1_255 0 100
 /begin AXIS_DESCR COM_AXIS car_current_gear NO_COMPU_METHOD 7 0 255 AXIS_PTS_REF CAL_revlimit_airflow_gain_from_rpm_X_gear /end AXIS_DESCR
/end CHARACTERISTIC
/begin CHARACTERISTIC CAL_oil_pressure_low_timer_threshold "Calibration: oil pressure low timer threshold." VALUE 0x4000C9D6 RL_VALUE_UBYTE 0 NO_COMPU_METHOD 0 255 /end CHARACTERISTIC
/begin CHARACTERISTIC CAL_evap_pressure_filter_coeff "u8_factor_1/256" VALUE 0x4000C9E1 RL_VALUE_UBYTE 0 CM_u8_factor_1_256 0 99.609375 /end CHARACTERISTIC
/begin CHARACTERISTIC CAL_evap_vacuum_threshold "Calibration: evap monitor vacuum threshold (vs obd_ii_evap_purge_pressure, 1/10 mbar)." VALUE 0x4000C9E3 RL_VALUE_UBYTE 0 CM_u8_pressure_1_10mbar 0 25.5 /end CHARACTERISTIC
/begin CHARACTERISTIC CAL_evap_purge_stuck_open_test_passes "Calibration: purge stuck-open test countdown. (0091 0x4000d1b4)" VALUE 0x4000C9E4 RL_VALUE_UBYTE 0 CM_u8_time_100ms 0 25500 /end CHARACTERISTIC
/begin CHARACTERISTIC CAL_revlimit_limp_mode "Calibration: rev-limit limp mode (RPM)." VALUE 0x4000CA08 RL_VALUE_UWORD 0 CM_u8_rspeed_rpm 0 65535 /end CHARACTERISTIC
/begin CHARACTERISTIC CAL_idle_monitor_voltage_operating_range "Calibration: idle speed monitor ECU-voltage window [lo,hi]. (0091 0x4000d210)" VAL_BLK 0x4000CA40 RL_VALUE_UWORD 0 CM_u16_voltage_18_1023v 0 1153.10850439883 NUMBER 2 /end CHARACTERISTIC
/begin CHARACTERISTIC CAL_idle_learn_ac_on_param "u8_flow_100mg/s" VALUE 0x4000CA44 RL_VALUE_UBYTE 0 CM_u8_flow_100mg_s 0 25500 /end CHARACTERISTIC
/begin CHARACTERISTIC CAL_vvt_zero_target_timeout "Calibration: VVT zero target timeout (ms = val*100)." VALUE 0x4000CA47 RL_VALUE_UBYTE 0 CM_u8_time_100ms 0 25500 /end CHARACTERISTIC
/begin CHARACTERISTIC CAL_wheel_speed_rate_min "Calibration: rough-road wheel speed rate min. (0091 u16_speed_1/100kph)" VALUE 0x4000CA54 RL_VALUE_UWORD 0 CM_u8_speed_1_100kph 0 655.35 /end CHARACTERISTIC
/begin CHARACTERISTIC CAL_coolant_temp_threshold "u8_temp_5/8-40c" VALUE 0x4000CA5C RL_VALUE_UBYTE 0 CM_u8_temp_5_8_40c -40 119.375 /end CHARACTERISTIC
/begin CHARACTERISTIC CAL_engine_speed_3_limit "Calibration: monitor-completion rpm max. (0091 0x4000d241)" VALUE 0x4000CA71 RL_VALUE_UBYTE 0 CM_u8_rspeed_125_4_500rpm 500 8468.75 /end CHARACTERISTIC
/begin CHARACTERISTIC CAL_engine_speed_3_threshold_2 "u8_rspeed_125/4+500rpm" VALUE 0x4000CA76 RL_VALUE_UBYTE 0 CM_u8_rspeed_125_4_500rpm 500 8468.75 /end CHARACTERISTIC
/begin CHARACTERISTIC CAL_engine_speed_3_threshold_3 "u8_rspeed_125/4+500rpm" VALUE 0x4000CA77 RL_VALUE_UBYTE 0 CM_u8_rspeed_125_4_500rpm 500 8468.75 /end CHARACTERISTIC
/begin CHARACTERISTIC CAL_tps_obd_throttle_monitor_error_parity_mask "uint16_t" VALUE 0x4000CA86 RL_VALUE_UWORD 0 NO_COMPU_METHOD 0 65535 /end CHARACTERISTIC
/begin CHARACTERISTIC CAL_coolant_temp_threshold_1 "Calibration: monitor-completion coolant threshold. (0091 0x4000d263)" VALUE 0x4000CA93 RL_VALUE_UBYTE 0 CM_u8_temp_5_8_40c -40 119.375 /end CHARACTERISTIC
/begin CHARACTERISTIC CAL_tps_commanded_during_fault "Calibration: throttle position commanded during fault (val/255)." VALUE 0x4000CA9B RL_VALUE_UBYTE 0 CM_u8_factor_1_255 0 100 /end CHARACTERISTIC
/begin CHARACTERISTIC CAL_evap_purge_duty_ramp_down_monitor "Calibration: purge ramp-down step (cal<<3) while evap monitor drives purge. 0278-only (0091 slot unused)." VALUE 0x4000CAA4 RL_VALUE_UBYTE 0 NO_COMPU_METHOD 0 255 /end CHARACTERISTIC
/begin CHARACTERISTIC CAL_coolant_temp_threshold_1_hysteresis "Calibration: hysteresis for CAL_coolant_temp_threshold_1. 0278-only." VALUE 0x4000CAA5 RL_VALUE_UBYTE 0 CM_u8_tempdelta_5_8c 0 159.375 /end CHARACTERISTIC
/begin CHARACTERISTIC CAL_oil_pressure_switch_startup_time "Calibration: oil pressure switch startup time (s)." VALUE 0x4000CAB0 RL_VALUE_UBYTE 0 CM_u8_time_s 0 255 /end CHARACTERISTIC
/begin CHARACTERISTIC CAL_evap_purge_leaktest_count_min "Calibration: evap leak-test count threshold. 0278-only." VALUE 0x4000CAB1 RL_VALUE_UBYTE 0 NO_COMPU_METHOD 0 255 /end CHARACTERISTIC
/begin CHARACTERISTIC CAL_evap_purge_pressure_voltage_threshold "Calibration: evap pressure sensor voltage high limit. (0091 0x4000d2b4)" VALUE 0x4000CAE4 RL_VALUE_UWORD 0 CM_u16_voltage_5_1023v 0 320.307917888563 /end CHARACTERISTIC
/begin CHARACTERISTIC CAL_evap_purge_pressure_voltage_threshold_0 "Calibration: evap pressure sensor voltage low limit. (0091 0x4000d2b6)" VALUE 0x4000CAE6 RL_VALUE_UWORD 0 CM_u16_voltage_5_1023v 0 320.307917888563 /end CHARACTERISTIC
/begin CHARACTERISTIC CAL_evap_leak_test_delay "Calibration: evap leak test delay (cal<<4). 0278-only." VALUE 0x4000CAEE RL_VALUE_UBYTE 0 NO_COMPU_METHOD 0 255 /end CHARACTERISTIC
/begin CHARACTERISTIC CAL_evap_leak_test_coolant_min "Calibration: evap leak test coolant min. (0091 0x4000d2bf)" VALUE 0x4000CAEF RL_VALUE_UBYTE 0 CM_u8_temp_5_8_40c -40 119.375 /end CHARACTERISTIC
/begin CHARACTERISTIC CAL_evap_leak_test_iat_max "Calibration: evap leak test enable needs engine air temp < this. (0091 CAL_temp_engine_air_threshold_0)" VALUE 0x4000CAF0 RL_VALUE_UBYTE 0 CM_u8_temp_5_8_40c -40 119.375 /end CHARACTERISTIC
/begin CHARACTERISTIC CAL_evap_leak_test_iat_engine_stopped_threshold "Calibration: evap leak test branch on engine-off IAT < this. (0091 CAL_evap_unknown2)" VALUE 0x4000CAF1 RL_VALUE_UBYTE 0 CM_u8_temp_5_8_40c -40 119.375 /end CHARACTERISTIC
/begin CHARACTERISTIC CAL_evap_leak_vacuum_decay_sample "Calibration: (0091 0x4000d2c3 CAL_evap_leak_vacuum_decay_sample)" VALUE 0x4000CAF3 RL_VALUE_UBYTE 0 NO_COMPU_METHOD 0 255 /end CHARACTERISTIC
/begin CHARACTERISTIC CAL_cat_check_unknown4 "u16_time_5ms" VALUE 0x4000CAF4 RL_VALUE_UWORD 0 CM_u8_time_5ms 0 327675 /end CHARACTERISTIC
/begin CHARACTERISTIC CAL_evap_tank_vacuum_flow_threshold "i16_pressure_1/10mbar" VALUE 0x4000CAF8 RL_VALUE_SWORD 0 CM_u8_pressure_1_10mbar -3276.8 3276.7 /end CHARACTERISTIC
/begin CHARACTERISTIC CAL_evap_system_state_flags_param "i16_pressure_1/10mbar" VALUE 0x4000CAFA RL_VALUE_SWORD 0 CM_u8_pressure_1_10mbar -3276.8 3276.7 /end CHARACTERISTIC
/begin CHARACTERISTIC CAL_evap_purge_flow_state_timer_init "u8_time_100ms" VALUE 0x4000CAFC RL_VALUE_UBYTE 0 CM_u8_time_100ms 0 25500 /end CHARACTERISTIC
/begin CHARACTERISTIC CAL_evap_canister_purge_solenoid_timer_init "u8_time_100ms" VALUE 0x4000CAFD RL_VALUE_UBYTE 0 CM_u8_time_100ms 0 25500 /end CHARACTERISTIC
/begin CHARACTERISTIC CAL_evap_purge_min_load "u8_load_4mg/stroke" VALUE 0x4000CAFE RL_VALUE_UBYTE 0 CM_u8_load_4mg_stroke 0 1020 /end CHARACTERISTIC
/begin CHARACTERISTIC CAL_evap_purge_min_load_active "Calibration: (0091 0x4000d2cf CAL_evap_purge_min_load_active)" VALUE 0x4000CAFF RL_VALUE_UBYTE 0 CM_u8_load_4mg_stroke 0 1020 /end CHARACTERISTIC
/begin CHARACTERISTIC CAL_evap_purge_vacuum_min "i16_pressure_mbar" VALUE 0x4000CB00 RL_VALUE_SWORD 0 CM_i16_pressure_mbar -32768 32767 /end CHARACTERISTIC
/begin CHARACTERISTIC CAL_evap_leak_test_fuel_level_min "Calibration: (0091 CAL_evap_leak_test_fuel_level_min)" VALUE 0x4000CB06 RL_VALUE_UBYTE 0 CM_u8_volume_1_10gallon 0 25.5 /end CHARACTERISTIC
/begin CHARACTERISTIC CAL_evap_leak_test_fuel_level_max "u8_volume_1/10gallon" VALUE 0x4000CB07 RL_VALUE_UBYTE 0 CM_u8_volume_1_10gallon 0 25.5 /end CHARACTERISTIC
/begin CHARACTERISTIC CAL_evap_purge_flow_vacuum_min "Calibration: evap purge flow vacuum min (vs obd_ii_evap_purge_pressure, 1/10 mbar)." VALUE 0x4000CB08 RL_VALUE_SWORD 0 CM_u8_pressure_1_10mbar -3276.8 3276.7 /end CHARACTERISTIC
/begin CHARACTERISTIC CAL_evap_leak_test_pre_start_delay "Calibration: (0091 0x4000d2da CAL_evap_leak_test_pre_start_delay)" VALUE 0x4000CB0A RL_VALUE_UBYTE 0 NO_COMPU_METHOD 0 255 /end CHARACTERISTIC
/begin CHARACTERISTIC CAL_evap_leak_test_purge_settle_delay "u8_count" VALUE 0x4000CB0B RL_VALUE_UBYTE 0 NO_COMPU_METHOD 0 255 /end CHARACTERISTIC
/begin CHARACTERISTIC CAL_evap_leak_test_settle_samples "u8_time_100ms" VALUE 0x4000CB0C RL_VALUE_UBYTE 0 CM_u8_time_100ms 0 25500 /end CHARACTERISTIC
/begin CHARACTERISTIC CAL_evap_leak_test_stage4_dwell "Calibration: (0091 0x4000d2dd CAL_evap_leak_test_stage4_dwell)" VALUE 0x4000CB0D RL_VALUE_UBYTE 0 CM_u8_time_100ms 0 25500 /end CHARACTERISTIC
/begin CHARACTERISTIC CAL_evap_leak_test_sample_count "Calibration: (0091 0x4000d2de CAL_evap_leak_test_sample_count)" VALUE 0x4000CB0E RL_VALUE_UWORD 0 CM_u8_time_100ms 0 6553500 /end CHARACTERISTIC
/begin CHARACTERISTIC CAL_evap_leak_test_baro_min "Calibration: (0091 0x4000d2ea CAL_evap_leak_test_baro_min)" VALUE 0x4000CB1A RL_VALUE_UWORD 0 CM_i16_pressure_mbar 0 65535 /end CHARACTERISTIC
/begin CHARACTERISTIC CAL_evap_leak_test_force_enable "Calibration: (0091 0x4000d2ec CAL_evap_leak_test_force_enable)" VALUE 0x4000CB1C RL_VALUE_UBYTE 0 NO_COMPU_METHOD 0 255 /end CHARACTERISTIC
/begin CHARACTERISTIC CAL_evap_leak_test_idle_dwell "Calibration: (0091 0x4000d2ee CAL_evap_leak_test_idle_dwell)" VALUE 0x4000CB1E RL_VALUE_UWORD 0 CM_u8_time_100ms 0 6553500 /end CHARACTERISTIC
/begin CHARACTERISTIC CAL_cooling_thermostat_open "Calibration: cooling thermostat open (°C = val*5/8−40)." VALUE 0x4000CB22 RL_VALUE_UBYTE 0 CM_u8_temp_5_8_40c -40 119.375 /end CHARACTERISTIC
/begin CHARACTERISTIC CAL_evap_fuel_level_threshold_mid "Calibration: (0091 0x4000d315 CAL_evap_fuel_level_threshold_mid)" VALUE 0x4000CB45 RL_VALUE_UBYTE 0 NO_COMPU_METHOD 0 255 /end CHARACTERISTIC
/begin CHARACTERISTIC CAL_wheel_speed_multiplier_front "Calibration: wheel speed multiplier front (mm_div2)." VALUE 0x4000CB46 RL_VALUE_UWORD 0 CM_u16_distance_mm_div2 0 32767.5 /end CHARACTERISTIC
/begin CHARACTERISTIC CAL_wheel_speed_multiplier_rear "Calibration: wheel speed multiplier rear (mm_div2)." VALUE 0x4000CB48 RL_VALUE_UWORD 0 CM_u16_distance_mm_div2 0 32767.5 /end CHARACTERISTIC
/begin CHARACTERISTIC CAL_vvt_cam_park_offset_max "u8_angle_1/4deg" VALUE 0x4000CB58 RL_VALUE_UBYTE 0 CM_u8_angle_1_4deg 0 63.75 /end CHARACTERISTIC
/begin CHARACTERISTIC CAL_evap_fuel_used_window_level_high "Calibration: (0091 0x4000d360 CAL_evap_fuel_used_window_level_high)" VALUE 0x4000CB90 RL_VALUE_UBYTE 0 NO_COMPU_METHOD 0 255 /end CHARACTERISTIC
/begin CHARACTERISTIC CAL_evap_fuel_used_window_level_low "Calibration: (0091 0x4000d361 CAL_evap_fuel_used_window_level_low)" VALUE 0x4000CB91 RL_VALUE_UBYTE 0 NO_COMPU_METHOD 0 255 /end CHARACTERISTIC
/begin CHARACTERISTIC CAL_evap_fuel_used_window_level_mid "Calibration: (0091 0x4000d362 CAL_evap_fuel_used_window_level_mid)" VALUE 0x4000CB92 RL_VALUE_UBYTE 0 NO_COMPU_METHOD 0 255 /end CHARACTERISTIC
/begin CHARACTERISTIC CAL_idle_sensor_fault_coolant_temp "Calibration: idle sensor fault coolant temperature (°C = val*5/8−40)." VALUE 0x4000CBB0 RL_VALUE_UBYTE 0 CM_u8_temp_5_8_40c -40 119.375 /end CHARACTERISTIC
/begin CHARACTERISTIC CAL_evap_pressure_deviation_max "u8_pressure_1/10mbar" VALUE 0x4000CBB4 RL_VALUE_UBYTE 0 CM_u8_pressure_1_10mbar 0 25.5 /end CHARACTERISTIC
/begin CHARACTERISTIC CAL_wheel_speed_min "Calibration: rough-road wheel speed min. (0091 u16_speed_1/100kph)" VALUE 0x4000CBC4 RL_VALUE_UWORD 0 CM_u8_speed_1_100kph 0 655.35 /end CHARACTERISTIC
/begin CHARACTERISTIC CAL_slip_gear_speed_ratios_ips "Calibration: slip detection gear ratios, IPS (rpm/kph x10). (0091 CAL_gsi_rpm_per_kph_ips)" VAL_BLK 0x4000CC04 RL_VALUE_UWORD 0 CM_u16_ratio_1_10rpm_kph 0 6553.5 NUMBER 6 /end CHARACTERISTIC
/begin CHARACTERISTIC CAL_slip_gear_speed_ratios_cr "Calibration: slip detection gear ratios, close ratio (rpm/kph x10)." VAL_BLK 0x4000CC10 RL_VALUE_UWORD 0 CM_u16_ratio_1_10rpm_kph 0 6553.5 NUMBER 6 /end CHARACTERISTIC
/begin CHARACTERISTIC CAL_slip_gear_speed_ratios_long "Calibration: slip detection gear ratios, long (rpm/kph x10)." VAL_BLK 0x4000CC1C RL_VALUE_UWORD 0 CM_u16_ratio_1_10rpm_kph 0 6553.5 NUMBER 6 /end CHARACTERISTIC
/begin CHARACTERISTIC CAL_slip_threshold_1st_Gear "Calibration: slip threshold 1st Gear (RPM = val*4+500)." VALUE 0x4000CC28 RL_VALUE_UBYTE 0 CM_u8_rspeed_4_500rpm 500 1520 /end CHARACTERISTIC
/begin CHARACTERISTIC CAL_slip_threshold_per_gear_manual "Calibration: slip threshold per gear manual (RPM = val*4+500; 5-element array)." VAL_BLK 0x4000CC29 RL_VALUE_UBYTE 0 CM_u8_rspeed_4_500rpm 500 1520 NUMBER 5 /end CHARACTERISTIC
/begin CHARACTERISTIC CAL_slip_slip_threshold_per_gear_ips "Calibration: slip slip threshold per gear IPS (RPM = val*4+500; 5-element array)." VAL_BLK 0x4000CC2E RL_VALUE_UBYTE 0 CM_u8_rspeed_4_500rpm 500 1520 NUMBER 5 /end CHARACTERISTIC
/begin CHARACTERISTIC CAL_slip_detect_mode "Calibration: slip detect mode (enumerated state)." VALUE 0x4000CC33 RL_VALUE_UBYTE 0 NO_COMPU_METHOD 0 255 /end CHARACTERISTIC
/begin CHARACTERISTIC CAL_slip_inhibit_accel_pedal_min "Calibration: slip inhibit accelerator pedal minimum (val/1023)." VALUE 0x4000CC34 RL_VALUE_UWORD 0 CM_u16_factor_1_1023 0 6406.15835777126 /end CHARACTERISTIC
/begin CHARACTERISTIC CAL_slip_steering_angle_max_unknown "Calibration: slip steering angle maximum (° = val/10)." VALUE 0x4000CC36 RL_VALUE_UWORD 0 CM_u16_angle_1_10deg 0 6553.5 /end CHARACTERISTIC
/begin CHARACTERISTIC CAL_slip_car_speed_unknown1 "Calibration: slip car speed unknown1 (km/h = val/100)." VALUE 0x4000CC38 RL_VALUE_UWORD 0 CM_u8_speed_1_100kph 0 655.35 /end CHARACTERISTIC
/begin CHARACTERISTIC CAL_slip_threshold_car_speed "Calibration: slip threshold car speed (km/h)." VALUE 0x4000CC3A RL_VALUE_UBYTE 0 CM_u8_speed_kph 0 255 /end CHARACTERISTIC
/begin CHARACTERISTIC CAL_slip_coldstart_coolant_threshold "Calibration: slip coldstart coolant threshold (°C = val*5/8−40)." VALUE 0x4000CC3B RL_VALUE_UBYTE 0 CM_u8_temp_5_8_40c -40 119.375 /end CHARACTERISTIC
/begin CHARACTERISTIC CAL_slip_timer_per_gear_intervention "Calibration: slip timer per gear intervention (ms = val*100)." VALUE 0x4000CC3C RL_VALUE_UBYTE 0 CM_u8_time_100ms 0 25500 /end CHARACTERISTIC
/begin CHARACTERISTIC CAL_slip_inhibit_cornering_base "Calibration: slip inhibit cornering base (val/255)." VALUE 0x4000CC3D RL_VALUE_UBYTE 0 CM_u8_factor_1_255 0 100 /end CHARACTERISTIC
/begin CHARACTERISTIC CAL_slip_inhibit_cornering_offset "Calibration: slip inhibit cornering offset (val/255)." VALUE 0x4000CC3E RL_VALUE_UBYTE 0 CM_u8_factor_1_255 0 100 /end CHARACTERISTIC
/begin CHARACTERISTIC CAL_slip_steering_rate_factor "Calibration: slip steering rate factor (val/100)." VALUE 0x4000CC3F RL_VALUE_UBYTE 0 CM_u8_factor_1_100 0 255 /end CHARACTERISTIC
/begin CHARACTERISTIC CAL_slip_steering_increase_factor_min "Calibration: slip steering increase factor minimum (val/255)." VALUE 0x4000CC40 RL_VALUE_UBYTE 0 CM_u8_factor_1_255 0 100 /end CHARACTERISTIC
/begin CHARACTERISTIC CAL_slip_steering_angle_smooth_factor "Calibration: slip steering angle smooth factor (val/255)." VALUE 0x4000CC41 RL_VALUE_UBYTE 0 CM_u8_factor_1_255 0 100 /end CHARACTERISTIC
/begin CHARACTERISTIC CAL_slip_inhibit_accel_pedal_timer "Calibration: slip inhibit accelerator pedal timer (ms = val*100)." VALUE 0x4000CC42 RL_VALUE_UBYTE 0 CM_u8_time_100ms 0 25500 /end CHARACTERISTIC
/begin CHARACTERISTIC CAL_slip_threshold_hysteresis_offset "Calibration: slip threshold hysteresis offset (RPM = val*4+500)." VALUE 0x4000CC44 RL_VALUE_UBYTE 0 CM_u8_rspeed_4_500rpm 500 1520 /end CHARACTERISTIC
/begin CHARACTERISTIC CAL_slip_timer_intervention2 "Calibration: slip timer intervention2 (ms = val*100)." VALUE 0x4000CC45 RL_VALUE_UBYTE 0 CM_u8_time_100ms 0 25500 /end CHARACTERISTIC
/begin CHARACTERISTIC CAL_slip_gear_offset_unknown "Calibration: slip gear offset." VALUE 0x4000CC46 RL_VALUE_UBYTE 0 NO_COMPU_METHOD 0 255 /end CHARACTERISTIC
/begin CHARACTERISTIC CAL_slip_threshold_rpm_margin "Calibration: traction: rpm gate = (LEA slip threshold - cal)*5+500. 0278-only." VALUE 0x4000CC47 RL_VALUE_UBYTE 0 NO_COMPU_METHOD 0 255 /end CHARACTERISTIC
/begin CHARACTERISTIC CAL_slip_wheelspeed_front_accel_threshold "Calibration: slip wheelspeed front accelerator threshold." VALUE 0x4000CC48 RL_VALUE_UBYTE 0 NO_COMPU_METHOD 0 255 /end CHARACTERISTIC
/begin CHARACTERISTIC CAL_slip_enable_speed "Calibration: slip enable speed (km/h)." VALUE 0x4000CC49 RL_VALUE_UBYTE 0 CM_u8_speed_kph 0 255 /end CHARACTERISTIC
/begin CHARACTERISTIC CAL_tps_obd_throttle_model_gain_opening "uint8_t" VALUE 0x4000CC4E RL_VALUE_UBYTE 0 NO_COMPU_METHOD 0 255 /end CHARACTERISTIC
/begin CHARACTERISTIC CAL_tps_obd_throttle_model_gain_closing "uint8_t" VALUE 0x4000CC4F RL_VALUE_UBYTE 0 NO_COMPU_METHOD 0 255 /end CHARACTERISTIC
/begin CHARACTERISTIC CAL_tps_obd_throttle_model_step_max_opening "uint16_t" VALUE 0x4000CC50 RL_VALUE_UWORD 0 NO_COMPU_METHOD 0 65535 /end CHARACTERISTIC
/begin CHARACTERISTIC CAL_tps_obd_throttle_model_step_max_closing "uint16_t" VALUE 0x4000CC52 RL_VALUE_UWORD 0 NO_COMPU_METHOD 0 65535 /end CHARACTERISTIC
/begin CHARACTERISTIC CAL_tps_obd_throttle_model_slewrate_accel "uint8_t" VALUE 0x4000CC54 RL_VALUE_UBYTE 0 NO_COMPU_METHOD 0 255 /end CHARACTERISTIC
/begin CHARACTERISTIC CAL_tps_obd_throttle_model_velocity_step "Calibration: throttle actuator model monitor velocity step (cal*2). 0278-only." VALUE 0x4000CC55 RL_VALUE_UBYTE 0 NO_COMPU_METHOD 0 255 /end CHARACTERISTIC
/begin CHARACTERISTIC CAL_tps_obd_throttle_model_slewrate_rev_closing "uint8_t" VALUE 0x4000CC56 RL_VALUE_UBYTE 0 NO_COMPU_METHOD 0 255 /end CHARACTERISTIC
/begin CHARACTERISTIC CAL_tps_obd_throttle_model_slewrate_rev_opening "uint8_t" VALUE 0x4000CC57 RL_VALUE_UBYTE 0 NO_COMPU_METHOD 0 255 /end CHARACTERISTIC
/begin CHARACTERISTIC CAL_tps_obd_throttle_monitor_error_threshold "uint16_t" VALUE 0x4000CC58 RL_VALUE_UWORD 0 NO_COMPU_METHOD 0 65535 /end CHARACTERISTIC
/begin CHARACTERISTIC CAL_tps_obd_throttle_monitor_fail_threshold "uint16_t" VALUE 0x4000CC5A RL_VALUE_UWORD 0 NO_COMPU_METHOD 0 65535 /end CHARACTERISTIC
/begin CHARACTERISTIC CAL_tps_obd_throttle_monitor_tps_rate_blank_threshold "Calibration: throttle model monitor blank when |TPS rate| > this." VALUE 0x4000CC5C RL_VALUE_UWORD 0 CM_u16_factor_1_1023 0 6406.15835777126 /end CHARACTERISTIC
/begin CHARACTERISTIC CAL_tps_obd_throttle_monitor_blank_time "u8_time_5ms" VALUE 0x4000CC5E RL_VALUE_UBYTE 0 CM_u8_time_5ms 0 1275 /end CHARACTERISTIC
/begin CHARACTERISTIC CAL_exhaust_flap_stationary_override_enable "Calibration: exhaust flap stationary override enable (enumerated state)." VALUE 0x4000CCA9 RL_VALUE_UBYTE 0 NO_COMPU_METHOD 0 255 /end CHARACTERISTIC
/begin CHARACTERISTIC CAL_dpm_min_engine_rpm "Calibration: driver performance mode minimum engine RPM (RPM)." VALUE 0x4000CCAE RL_VALUE_UWORD 0 CM_u8_rspeed_rpm 0 65535 /end CHARACTERISTIC
/begin CHARACTERISTIC CAL_dpm_cornering_lr_speed_diff_threshold "Calibration: driver performance mode lr diff threshold (km/h = val/100)." VALUE 0x4000CCB0 RL_VALUE_UWORD 0 CM_u8_speed_1_100kph 0 655.35 /end CHARACTERISTIC
/begin CHARACTERISTIC CAL_dpm_cornering_release_delay "\\Direct mode\\ (flag bit 2) likely means more aggressive TC intervention when there's significant left-right wheel speed difference - i.e., one wheel spinning more than the other." VALUE 0x4000CCB2 RL_VALUE_UWORD 0 CM_u8_time_5ms 0 327675 /end CHARACTERISTIC
/begin CHARACTERISTIC CAL_dpm_cornering_detect_delay "\\Direct mode\\ (flag bit 2) likely means more aggressive TC intervention when there's significant left-right wheel speed difference - i.e., one wheel spinning more than the other." VALUE 0x4000CCB4 RL_VALUE_UWORD 0 CM_u8_time_5ms 0 327675 /end CHARACTERISTIC
/begin CHARACTERISTIC CAL_dpm_integral_update_period "Integral adapation is very slow. It seems to be used to account for tire condition changes and surface changes." VALUE 0x4000CCB6 RL_VALUE_UWORD 0 CM_u8_time_5ms 0 327675 /end CHARACTERISTIC
/begin CHARACTERISTIC CAL_dpm_torque_min_allowed "Calibration: driver performance mode torque minimum allowed (Nm)." VALUE 0x4000CCB8 RL_VALUE_UWORD 0 CM_u8_torque_nm 0 65535 /end CHARACTERISTIC
/begin CHARACTERISTIC CAL_dpm_slip_target_straight_line_offset "A fixed extra slip allowance, in 1/8 % steps (u8_slip_1/8pct), added to the pedal-derived target dpm_slip_target_from_pedal to give the final dpm_slip_target. It's only applied while flag bit 2 is clear. dpm_system_state_manager_200hz sets that bit w" VALUE 0x4000CCBA RL_VALUE_UBYTE 0 CM_u16_slip_1_8pct 0 31.875 /end CHARACTERISTIC
/begin CHARACTERISTIC CAL_dpm_max_vehicle_speed "Calibration: driver performance mode maximum vehicle speed (km/h)." VALUE 0x4000CCBB RL_VALUE_UBYTE 0 CM_u8_speed_kph 0 255 /end CHARACTERISTIC
/begin CHARACTERISTIC CAL_dpm_min_vehicle_speed "Calibration: driver performance mode minimum vehicle speed (km/h)." VALUE 0x4000CCBC RL_VALUE_UBYTE 0 CM_u8_speed_kph 0 255 /end CHARACTERISTIC
/begin CHARACTERISTIC CAL_dpm_intervention_threshold "Calibration: driver performance mode intervention threshold (% = val/8)." VALUE 0x4000CCBD RL_VALUE_UBYTE 0 CM_u16_slip_1_8pct 0 31.875 /end CHARACTERISTIC
/begin CHARACTERISTIC CAL_dpm_torque_cut_i_gain "Calibration: driver performance mode integral gain." VALUE 0x4000CCBE RL_VALUE_UBYTE 0 NO_COMPU_METHOD 0 255 /end CHARACTERISTIC
/begin CHARACTERISTIC CAL_dpm_torque_cut_i_limit "Calibration: driver performance mode integral limit." VALUE 0x4000CCBF RL_VALUE_UBYTE 0 NO_COMPU_METHOD 0 255 /end CHARACTERISTIC
/begin CHARACTERISTIC CAL_dpm_torque_margin_factor "Calibration: driver performance mode torque margin factor (val/255)." VALUE 0x4000CCC1 RL_VALUE_UBYTE 0 CM_u8_factor_1_255 0 100 /end CHARACTERISTIC
/begin CHARACTERISTIC CAL_torque_limit_tps_rate_limit "Calibration: torque limit throttle position rate limit (2-element array)." VAL_BLK 0x4000CCC4 RL_VALUE_UWORD 0 NO_COMPU_METHOD 0 65535 NUMBER 2 /end CHARACTERISTIC
/begin CHARACTERISTIC CAL_torque_limit_cooldown_timer "uint16_t" VALUE 0x4000CCC8 RL_VALUE_UWORD 0 NO_COMPU_METHOD 0 65535 /end CHARACTERISTIC
/begin CHARACTERISTIC CAL_torque_limit_cooldown_tps_rate_threshold "u8_factor_1/255" VALUE 0x4000CCCA RL_VALUE_UBYTE 0 CM_u8_factor_1_255 0 100 /end CHARACTERISTIC
/begin AXIS_PTS CAL_idle_air_low_load_cam_X_vvt_error_scale "Calibration: X axis of CAL_idle_air_low_load_cam. 0278-only." 0x4000CD14 NO_INPUT_QUANTITY RL_AXIS_UWORD 0 CM_u8_factor_1_255 8 0 25700 /end AXIS_PTS
/begin AXIS_PTS CAL_idle_air_low_load_cam_Y_idle_target "Calibration: Y axis (idle target rpm) of CAL_idle_air_low_load_cam. 0278-only." 0x4000CD24 NO_INPUT_QUANTITY RL_AXIS_UWORD 0 CM_u8_rspeed_rpm 8 0 65535 /end AXIS_PTS
/begin CHARACTERISTIC CAL_idle_air_low_load_cam "Calibration: 8x8 expected idle airflow with low-load cam active. 0278-only." MAP 0x4000CD34 RL_VALUE_UWORD 0 CM_u8_flow_100mg_s 0 6553500
 /begin AXIS_DESCR COM_AXIS NO_INPUT_QUANTITY CM_u8_factor_1_255 8 0 25700 AXIS_PTS_REF CAL_idle_air_low_load_cam_X_vvt_error_scale /end AXIS_DESCR
 /begin AXIS_DESCR COM_AXIS NO_INPUT_QUANTITY CM_u8_rspeed_rpm 8 0 65535 AXIS_PTS_REF CAL_idle_air_low_load_cam_Y_idle_target /end AXIS_DESCR
/end CHARACTERISTIC
/begin AXIS_PTS CAL_torque_load_to_torque_X_engine_speed "Calibration: X-axis (engine speed) for the torque load to torque table (RPM; 16-element array)." 0x4000CDB4 engine_speed_16bit RL_AXIS_UWORD 0 CM_u8_rspeed_rpm 16 0 65535 /end AXIS_PTS
/begin AXIS_PTS CAL_torque_load_to_torque_Y_load "Calibration: Y-axis (load) for the torque load to torque table (mg/stroke; 16-element array)." 0x4000CDD4 NO_INPUT_QUANTITY RL_AXIS_UWORD 0 CM_u8_load_mg_stroke 16 0 65535 /end AXIS_PTS
/begin CHARACTERISTIC CAL_torque_load_to_torque "Calibration: torque load to torque (Nm; 256-element array)." MAP 0x4000CDF4 RL_VALUE_UWORD 0 CM_u8_torque_nm 0 65535
 /begin AXIS_DESCR COM_AXIS engine_speed_16bit CM_u8_rspeed_rpm 16 0 65535 AXIS_PTS_REF CAL_torque_load_to_torque_X_engine_speed /end AXIS_DESCR
 /begin AXIS_DESCR COM_AXIS NO_INPUT_QUANTITY CM_u8_load_mg_stroke 16 0 65535 AXIS_PTS_REF CAL_torque_load_to_torque_Y_load /end AXIS_DESCR
/end CHARACTERISTIC
/begin CHARACTERISTIC CAL_tps_obd_throttle_monitor_pass_threshold "u8_count" VALUE 0x4000D3F1 RL_VALUE_UBYTE 0 NO_COMPU_METHOD 0 255 /end CHARACTERISTIC
/begin AXIS_PTS CAL_dpm_slip_target_base_X_dpm_level "Calibration: X-axis (dpm level) for the driver performance mode slip target base table (16-element array)." 0x4000D644 dpm_mode_index RL_AXIS_UBYTE 0 NO_COMPU_METHOD 16 0 255 /end AXIS_PTS
/begin CHARACTERISTIC CAL_dpm_slip_target_base "Calibration: driver performance mode slip target base (% = val/8; 16-element array)." CURVE 0x4000D654 RL_VALUE_UBYTE 0 CM_u16_slip_1_8pct 0 31.875
 /begin AXIS_DESCR COM_AXIS dpm_mode_index NO_COMPU_METHOD 16 0 255 AXIS_PTS_REF CAL_dpm_slip_target_base_X_dpm_level /end AXIS_DESCR
/end CHARACTERISTIC
/begin AXIS_PTS CAL_cooling_fan_duty_cycle_stopped_X_coolant_temp "Calibration: X-axis (coolant temp) for the cooling fan duty cycle stopped table (°C = val*5/8−40; 8-element array)." 0x4000D6B4 coolant_temp RL_AXIS_UBYTE 0 CM_u8_temp_5_8_40c 8 -40 119.375 /end AXIS_PTS
/begin CHARACTERISTIC CAL_cooling_fan_duty_cycle_stopped "Calibration: cooling fan duty cycle stopped (% = val*100/255; 8-element array)." CURVE 0x4000D6BC RL_VALUE_UBYTE 0 CM_u8_factor_1_255 0 100
 /begin AXIS_DESCR COM_AXIS coolant_temp CM_u8_temp_5_8_40c 8 -40 119.375 AXIS_PTS_REF CAL_cooling_fan_duty_cycle_stopped_X_coolant_temp /end AXIS_DESCR
/end CHARACTERISTIC
/begin AXIS_PTS CAL_cooling_fan_ac_off_X_air_temp "Calibration: X-axis (air temp) for the cooling fan A/C off table (°C = val*5/8−40; 8-element array)." 0x4000D6C4 temp_engine_air_cooling_control RL_AXIS_UBYTE 0 CM_u8_temp_5_8_40c 8 -40 119.375 /end AXIS_PTS
/begin AXIS_PTS CAL_cooling_fan_ac_off_Y_carspeed "Calibration: Y axis (car speed) of the A/C-off radiator fan table." 0x4000D6CC car_speed_u8 RL_AXIS_UBYTE 0 CM_u8_speed_kph 8 0 255 /end AXIS_PTS
/begin CHARACTERISTIC CAL_cooling_fan_ac_off "Calibration: cooling fan A/C off (% = val*100/255; 64-element array)." MAP 0x4000D6D4 RL_VALUE_UBYTE 0 CM_u8_factor_1_255 0 100
 /begin AXIS_DESCR COM_AXIS temp_engine_air_cooling_control CM_u8_temp_5_8_40c 8 -40 119.375 AXIS_PTS_REF CAL_cooling_fan_ac_off_X_air_temp /end AXIS_DESCR
 /begin AXIS_DESCR COM_AXIS car_speed_u8 CM_u8_speed_kph 8 0 255 AXIS_PTS_REF CAL_cooling_fan_ac_off_Y_carspeed /end AXIS_DESCR
/end CHARACTERISTIC
/begin AXIS_PTS CAL_cooling_fan_scaling_X_dutycycle "Calibration: X-axis (dutycycle) for the cooling fan scaling table (% = val*100/255; 8-element array)." 0x4000D714 radiator_fan_duty_cycle_target RL_AXIS_UBYTE 0 CM_u8_factor_1_255 8 0 100 /end AXIS_PTS
/begin CHARACTERISTIC CAL_cooling_fan_scaling "Calibration: cooling fan scaling (8-element array)." CURVE 0x4000D71C RL_VALUE_UBYTE 0 NO_COMPU_METHOD 0 255
 /begin AXIS_DESCR COM_AXIS radiator_fan_duty_cycle_target CM_u8_factor_1_255 8 0 100 AXIS_PTS_REF CAL_cooling_fan_scaling_X_dutycycle /end AXIS_DESCR
/end CHARACTERISTIC
/begin AXIS_PTS CAL_slip_comp_maf_accum_manual_X_maf_accum "Calibration: X axis (accumulated air, g) of slip comp." 0x4000D95C maf_accumulated_since_start_raw RL_AXIS_UWORD 0 CM_u16_mass_g 4 0 65535 /end AXIS_PTS
/begin CHARACTERISTIC CAL_slip_comp_maf_accum_manual "Calibration: slip compensation MAF accum manual (4-element array)." CURVE 0x4000D964 RL_VALUE_UWORD 0 NO_COMPU_METHOD 0 65535
 /begin AXIS_DESCR COM_AXIS maf_accumulated_since_start_raw CM_u16_mass_g 4 0 65535 AXIS_PTS_REF CAL_slip_comp_maf_accum_manual_X_maf_accum /end AXIS_DESCR
/end CHARACTERISTIC
/begin AXIS_PTS CAL_slip_power_based_rpm_thresholds_X_power "Calibration: X-axis (power) for the slip power based RPM thresholds table (kW = val/100; 8-element array)." 0x4000D96C engine_power_corrected RL_AXIS_UWORD 0 CM_u16_power_1_100kw 8 0 655.35 /end AXIS_PTS
/begin CHARACTERISTIC CAL_slip_power_based_rpm_thresholds "Calibration: slip power based RPM thresholds (RPM; 8-element array)." CURVE 0x4000D97C RL_VALUE_UWORD 0 CM_u8_rspeed_rpm 0 65535
 /begin AXIS_DESCR COM_AXIS engine_power_corrected CM_u16_power_1_100kw 8 0 655.35 AXIS_PTS_REF CAL_slip_power_based_rpm_thresholds_X_power /end AXIS_DESCR
/end CHARACTERISTIC
/begin AXIS_PTS CAL_emissions_cat_efficiency_unknown1_X_coolant_temp "Calibration: X-axis (coolant temp) for the emissions cat efficiency unknown1 table (°C = val*5/8−40; 8-element array)." 0x4000DEE0 coolant_temp_engine_stopped RL_AXIS_UBYTE 0 CM_u8_temp_5_8_40c 8 -40 119.375 /end AXIS_PTS
/begin CHARACTERISTIC CAL_emissions_cat_efficiency_unknown1 "Calibration: cat monitor min accumulated air vs engine-off coolant (compared with accum>>4, 16 g units)." CURVE 0x4000DEE8 RL_VALUE_UBYTE 0 CM_u8_mass_16g 0 4080
 /begin AXIS_DESCR COM_AXIS coolant_temp_engine_stopped CM_u8_temp_5_8_40c 8 -40 119.375 AXIS_PTS_REF CAL_emissions_cat_efficiency_unknown1_X_coolant_temp /end AXIS_DESCR
/end CHARACTERISTIC
/begin AXIS_PTS CAL_evap_leak_test_P0442_decay_limit_X_fuel_level "Calibration: X axis (fuel level, 1/10 US gal) of CAL_evap_leak_test_P0442_decay_limit. (0091 0x4000e6f0)" 0x4000DF20 NO_INPUT_QUANTITY RL_AXIS_UBYTE 0 CM_u8_volume_1_10gallon 16 0 25.5 /end AXIS_PTS
/begin CHARACTERISTIC CAL_evap_leak_test_P0442_decay_limit "Calibration: evap leak test P0442 decay limit vs fuel level. (0091 0x4000e700)" CURVE 0x4000DF30 RL_VALUE_UBYTE 0 NO_COMPU_METHOD 0 255
 /begin AXIS_DESCR COM_AXIS NO_INPUT_QUANTITY CM_u8_volume_1_10gallon 16 0 25.5 AXIS_PTS_REF CAL_evap_leak_test_P0442_decay_limit_X_fuel_level /end AXIS_DESCR
/end CHARACTERISTIC
/begin AXIS_PTS CAL_evap_leak_test_pulldown_vacuum_X_pressure_swing "Calibration: X axis of CAL_evap_leak_test_pulldown_vacuum. (0091 0x4000e710)" 0x4000DF40 NO_INPUT_QUANTITY RL_AXIS_UBYTE 0 NO_COMPU_METHOD 8 0 255 /end AXIS_PTS
/begin AXIS_PTS CAL_evap_leak_test_pulldown_vacuum_Y_fuel_level "Calibration: Y axis (fuel level, 1/10 US gal) of CAL_evap_leak_test_pulldown_vacuum. (0091 0x4000e718)" 0x4000DF48 NO_INPUT_QUANTITY RL_AXIS_UBYTE 0 CM_u8_volume_1_10gallon 16 0 25.5 /end AXIS_PTS
/begin CHARACTERISTIC CAL_evap_leak_test_pulldown_vacuum "Calibration: evap leak test pull-down vacuum target 8x16. (0091 0x4000e728)" MAP 0x4000DF58 RL_VALUE_UBYTE 0 NO_COMPU_METHOD 0 255
 /begin AXIS_DESCR COM_AXIS NO_INPUT_QUANTITY NO_COMPU_METHOD 8 0 255 AXIS_PTS_REF CAL_evap_leak_test_pulldown_vacuum_X_pressure_swing /end AXIS_DESCR
 /begin AXIS_DESCR COM_AXIS NO_INPUT_QUANTITY CM_u8_volume_1_10gallon 16 0 25.5 AXIS_PTS_REF CAL_evap_leak_test_pulldown_vacuum_Y_fuel_level /end AXIS_DESCR
/end CHARACTERISTIC
/begin AXIS_PTS CAL_cooling_thermostat_warmup_load_factor_X_load "Calibration: X-axis (load) for the cooling thermostat warmup load factor table (mg/stroke = val*4; 8-element array)." 0x4000DFD8 load_mass_per_stroke RL_AXIS_UBYTE 0 CM_u8_load_4mg_stroke 8 0 1020 /end AXIS_PTS
/begin CHARACTERISTIC CAL_cooling_thermostat_warmup_load_factor "Calibration: cooling thermostat warmup load factor (8-element array)." CURVE 0x4000DFE0 RL_VALUE_UBYTE 0 NO_COMPU_METHOD 0 255
 /begin AXIS_DESCR COM_AXIS load_mass_per_stroke CM_u8_load_4mg_stroke 8 0 1020 AXIS_PTS_REF CAL_cooling_thermostat_warmup_load_factor_X_load /end AXIS_DESCR
/end CHARACTERISTIC
/begin AXIS_PTS CAL_evap_leak_test_P0456_decay_limit_X_ambient_temp "Calibration: X axis (ambient temp) of CAL_evap_leak_test_P0456_decay_limit. 0278-only 3D form." 0x4000E0F8 NO_INPUT_QUANTITY RL_AXIS_UBYTE 0 CM_u8_temp_5_8_40c 4 -40 119.375 /end AXIS_PTS
/begin AXIS_PTS CAL_evap_leak_test_P0456_decay_limit_Y_fuel_level "Calibration: Y axis (fuel level, 1/10 US gal) of CAL_evap_leak_test_P0456_decay_limit. 0278-only." 0x4000E0FC NO_INPUT_QUANTITY RL_AXIS_UBYTE 0 CM_u8_volume_1_10gallon 10 0 25.5 /end AXIS_PTS
/begin CHARACTERISTIC CAL_evap_leak_test_P0456_decay_limit "Calibration: evap leak test decay limit 4x10 (ambient temp x fuel level) -> DAT_40001e78. 0278-only (0091 uses a 2D table)." MAP 0x4000E106 RL_VALUE_UBYTE 0 NO_COMPU_METHOD 0 255
 /begin AXIS_DESCR COM_AXIS NO_INPUT_QUANTITY CM_u8_temp_5_8_40c 4 -40 119.375 AXIS_PTS_REF CAL_evap_leak_test_P0456_decay_limit_X_ambient_temp /end AXIS_DESCR
 /begin AXIS_DESCR COM_AXIS NO_INPUT_QUANTITY CM_u8_volume_1_10gallon 10 0 25.5 AXIS_PTS_REF CAL_evap_leak_test_P0456_decay_limit_Y_fuel_level /end AXIS_DESCR
/end CHARACTERISTIC
/begin AXIS_PTS CAL_idle_air_warmup_factor_ips_X_coolant_temp "Used by idle (IPS warmup factor lookup). Was CAL_unused_*." 0x4000E190 NO_INPUT_QUANTITY RL_AXIS_UBYTE 0 CM_u8_temp_5_8_40c 16 -40 119.375 /end AXIS_PTS
/begin AXIS_PTS CAL_idle_air_warmup_factor_ips_Y_maf_accum "Used by idle (IPS warmup factor lookup). Was CAL_unused_*." 0x4000E1A0 NO_INPUT_QUANTITY RL_AXIS_UBYTE 0 CM_u8_mass_4g 8 0 1020 /end AXIS_PTS
/begin CHARACTERISTIC CAL_idle_air_warmup_factor_ips "Idle air warmup factor, IPS (coolant x maf_accum/4). Live; was CAL_unused_*." MAP 0x4000E1A8 RL_VALUE_UBYTE 0 CM_u8_factor_1_64 0 398.4375
 /begin AXIS_DESCR COM_AXIS NO_INPUT_QUANTITY CM_u8_temp_5_8_40c 16 -40 119.375 AXIS_PTS_REF CAL_idle_air_warmup_factor_ips_X_coolant_temp /end AXIS_DESCR
 /begin AXIS_DESCR COM_AXIS NO_INPUT_QUANTITY CM_u8_mass_4g 8 0 1020 AXIS_PTS_REF CAL_idle_air_warmup_factor_ips_Y_maf_accum /end AXIS_DESCR
/end CHARACTERISTIC
/begin AXIS_PTS CAL_tpstarget_low_gear_tour_manual_X_pps "Calibration: X-axis (pps) for the tpstarget low gear tour manual table (val/1023; 16-element array)." 0x4000E228 accel_pedal_pos_16bit RL_AXIS_UWORD 0 CM_u16_factor_1_1023 16 0 6406.15835777126 /end AXIS_PTS
/begin CHARACTERISTIC CAL_tpstarget_low_gear_tour_manual "Calibration: tpstarget low gear tour manual (val/1023; 16-element array)." CURVE 0x4000E248 RL_VALUE_UWORD 0 CM_u16_factor_1_1023 0 6406.15835777126
 /begin AXIS_DESCR COM_AXIS accel_pedal_pos_16bit CM_u16_factor_1_1023 16 0 6406.15835777126 AXIS_PTS_REF CAL_tpstarget_low_gear_tour_manual_X_pps /end AXIS_DESCR
/end CHARACTERISTIC
/begin AXIS_PTS CAL_tpssmooth_increment_parking_X_tps_diff "Calibration: X-axis (tps diff) for the tpssmooth increment parking table (val/255; 8-element array)." 0x4000E268 V_CAL_tpssmooth_increment_parking_X_tps_diff RL_AXIS_UBYTE 0 CM_u8_factor_1_255 8 0 100 /end AXIS_PTS
/begin CHARACTERISTIC CAL_tpssmooth_increment_parking "Calibration: tpssmooth increment parking (val/255; 8-element array)." CURVE 0x4000E270 RL_VALUE_UBYTE 0 CM_u8_factor_1_255 0 100
 /begin AXIS_DESCR COM_AXIS V_CAL_tpssmooth_increment_parking_X_tps_diff CM_u8_factor_1_255 8 0 100 AXIS_PTS_REF CAL_tpssmooth_increment_parking_X_tps_diff /end AXIS_DESCR
/end CHARACTERISTIC
/begin AXIS_PTS CAL_dpm_slip_filter_coeff_X_carspeed "Calibration: X-axis (carspeed) for the driver performance mode slip filter coeff table (km/h; 8-element array)." 0x4000E2B8 dpm_vehicle_speed_kph RL_AXIS_UBYTE 0 CM_u8_speed_kph 8 0 255 /end AXIS_PTS
/begin CHARACTERISTIC CAL_dpm_slip_filter_coeff "Calibration: driver performance mode slip filter coeff (val/255; 8-element array)." CURVE 0x4000E2C0 RL_VALUE_UBYTE 0 CM_u8_factor_1_255 0 100
 /begin AXIS_DESCR COM_AXIS dpm_vehicle_speed_kph CM_u8_speed_kph 8 0 255 AXIS_PTS_REF CAL_dpm_slip_filter_coeff_X_carspeed /end AXIS_DESCR
/end CHARACTERISTIC
/begin AXIS_PTS CAL_exhaust_flap_state_control_tour_X_rpm "Calibration: X-axis (rpm) for the exhaust flap state control tour table (RPM = val*50; 8-element array)." 0x4000E2C8 V_CAL_exhaust_flap_state_control_tour_X_rpm RL_AXIS_UBYTE 0 CM_u8_rspeed_50rpm 8 0 12750 /end AXIS_PTS
/begin AXIS_PTS CAL_exhaust_flap_state_control_tour_Y_accel_pedal "Calibration: Y-axis (accel pedal) for the exhaust flap state control tour table (val/255; 8-element array)." 0x4000E2D0 V_CAL_exhaust_flap_state_control_tour_Y_accel_pedal RL_AXIS_UBYTE 0 CM_u8_factor_1_255 8 0 100 /end AXIS_PTS
/begin CHARACTERISTIC CAL_exhaust_flap_state_control_tour "Calibration: exhaust flap state control tour (64-element array)." MAP 0x4000E2D8 RL_VALUE_UBYTE 0 NO_COMPU_METHOD 0 255
 /begin AXIS_DESCR COM_AXIS V_CAL_exhaust_flap_state_control_tour_X_rpm CM_u8_rspeed_50rpm 8 0 12750 AXIS_PTS_REF CAL_exhaust_flap_state_control_tour_X_rpm /end AXIS_DESCR
 /begin AXIS_DESCR COM_AXIS V_CAL_exhaust_flap_state_control_tour_Y_accel_pedal CM_u8_factor_1_255 8 0 100 AXIS_PTS_REF CAL_exhaust_flap_state_control_tour_Y_accel_pedal /end AXIS_DESCR
/end CHARACTERISTIC
/begin AXIS_PTS CAL_exhaust_flap_state_control_sport_X_rpm "Calibration: X-axis (rpm) for the exhaust flap state control sport table (RPM = val*50; 8-element array)." 0x4000E318 V_CAL_exhaust_flap_state_control_sport_X_rpm RL_AXIS_UBYTE 0 CM_u8_rspeed_50rpm 8 0 12750 /end AXIS_PTS
/begin AXIS_PTS CAL_exhaust_flap_state_control_sport_Y_accel_pedal "Calibration: Y-axis (accel pedal) for the exhaust flap state control sport table (val/255; 8-element array)." 0x4000E320 V_CAL_exhaust_flap_state_control_sport_Y_accel_pedal RL_AXIS_UBYTE 0 CM_u8_factor_1_255 8 0 100 /end AXIS_PTS
/begin CHARACTERISTIC CAL_exhaust_flap_state_control_sport "Calibration: exhaust flap state control sport (64-element array)." MAP 0x4000E328 RL_VALUE_UBYTE 0 NO_COMPU_METHOD 0 255
 /begin AXIS_DESCR COM_AXIS V_CAL_exhaust_flap_state_control_sport_X_rpm CM_u8_rspeed_50rpm 8 0 12750 AXIS_PTS_REF CAL_exhaust_flap_state_control_sport_X_rpm /end AXIS_DESCR
 /begin AXIS_DESCR COM_AXIS V_CAL_exhaust_flap_state_control_sport_Y_accel_pedal CM_u8_factor_1_255 8 0 100 AXIS_PTS_REF CAL_exhaust_flap_state_control_sport_Y_accel_pedal /end AXIS_DESCR
/end CHARACTERISTIC
/begin AXIS_PTS CAL_idle_comp_timer_carspeed_ips_X_airtemp "Calibration: X-axis (airtemp) for the idle compensation timer carspeed IPS table (°C = val*5/8−40; 8-element array)." 0x4000E368 NO_INPUT_QUANTITY RL_AXIS_UBYTE 0 CM_u8_temp_5_8_40c 8 -40 119.375 /end AXIS_PTS
/begin AXIS_PTS CAL_idle_comp_timer_carspeed_ips_Y_time_above_speed "Calibration: Y-axis (time above speed) for the idle compensation timer carspeed IPS table (8-element array)." 0x4000E370 idle_low_carspeed_timer RL_AXIS_UBYTE 0 NO_COMPU_METHOD 8 0 255 /end AXIS_PTS
/begin CHARACTERISTIC CAL_idle_comp_timer_carspeed_ips "Calibration: idle compensation timer carspeed IPS (RPM = val*8; 64-element array)." MAP 0x4000E378 RL_VALUE_UBYTE 0 CM_u8_rspeed_8rpm 0 2040
 /begin AXIS_DESCR COM_AXIS NO_INPUT_QUANTITY CM_u8_temp_5_8_40c 8 -40 119.375 AXIS_PTS_REF CAL_idle_comp_timer_carspeed_ips_X_airtemp /end AXIS_DESCR
 /begin AXIS_DESCR COM_AXIS idle_low_carspeed_timer NO_COMPU_METHOD 8 0 255 AXIS_PTS_REF CAL_idle_comp_timer_carspeed_ips_Y_time_above_speed /end AXIS_DESCR
/end CHARACTERISTIC
/begin AXIS_PTS CAL_torque_external_request_overshoot_margin_X_rpm "Calibration: X-axis (rpm) for the torque external request overshoot margin table (RPM = val*125/4+500; 16-element array)." 0x4000E4E8 engine_speed_8bit RL_AXIS_UBYTE 0 CM_u8_rspeed_125_4_500rpm 16 500 8468.75 /end AXIS_PTS
/begin AXIS_PTS CAL_torque_external_request_overshoot_margin_Y_torque "Calibration: Y-axis (torque) for the torque external request overshoot margin table (Nm = val*4; 16-element array)." 0x4000E4F8 V_CAL_torque_external_request_overshoot_margin_Y_torque RL_AXIS_UBYTE 0 CM_u8_torque_4nm 16 0 1020 /end AXIS_PTS
/begin CHARACTERISTIC CAL_torque_external_request_overshoot_margin "Calibration: torque external request overshoot margin (val/100; 256-element array)." MAP 0x4000E508 RL_VALUE_UBYTE 0 CM_u8_factor_1_100 0 255
 /begin AXIS_DESCR COM_AXIS engine_speed_8bit CM_u8_rspeed_125_4_500rpm 16 500 8468.75 AXIS_PTS_REF CAL_torque_external_request_overshoot_margin_X_rpm /end AXIS_DESCR
 /begin AXIS_DESCR COM_AXIS V_CAL_torque_external_request_overshoot_margin_Y_torque CM_u8_torque_4nm 16 0 1020 AXIS_PTS_REF CAL_torque_external_request_overshoot_margin_Y_torque /end AXIS_DESCR
/end CHARACTERISTIC
/begin AXIS_PTS CAL_exhaust_flap_state_control_race_X_rpm "Calibration: X-axis (rpm) for the exhaust flap state control race table (RPM = val*50; 8-element array)." 0x4000E7CC V_CAL_exhaust_flap_state_control_race_X_rpm RL_AXIS_UBYTE 0 CM_u8_rspeed_50rpm 8 0 12750 /end AXIS_PTS
/begin AXIS_PTS CAL_exhaust_flap_state_control_race_Y_accel_pedal "Calibration: Y-axis (accel pedal) for the exhaust flap state control race table (val/255; 8-element array)." 0x4000E7D4 V_CAL_exhaust_flap_state_control_race_Y_accel_pedal RL_AXIS_UBYTE 0 CM_u8_factor_1_255 8 0 100 /end AXIS_PTS
/begin CHARACTERISTIC CAL_exhaust_flap_state_control_race "Calibration: exhaust flap state control race (64-element array)." MAP 0x4000E7DC RL_VALUE_UBYTE 0 NO_COMPU_METHOD 0 255
 /begin AXIS_DESCR COM_AXIS V_CAL_exhaust_flap_state_control_race_X_rpm CM_u8_rspeed_50rpm 8 0 12750 AXIS_PTS_REF CAL_exhaust_flap_state_control_race_X_rpm /end AXIS_DESCR
 /begin AXIS_DESCR COM_AXIS V_CAL_exhaust_flap_state_control_race_Y_accel_pedal CM_u8_factor_1_255 8 0 100 AXIS_PTS_REF CAL_exhaust_flap_state_control_race_Y_accel_pedal /end AXIS_DESCR
/end CHARACTERISTIC
/begin AXIS_PTS CAL_tpstarget_low_gear_sport_ips_X_pps "Calibration: X-axis (pps) for the tpstarget low gear sport IPS table (val/1023; 16-element array)." 0x4000EA5C accel_pedal_pos_16bit RL_AXIS_UWORD 0 CM_u16_factor_1_1023 16 0 6406.15835777126 /end AXIS_PTS
/begin CHARACTERISTIC CAL_tpstarget_low_gear_sport_ips "Calibration: tpstarget low gear sport IPS (val/1023; 16-element array)." CURVE 0x4000EA7C RL_VALUE_UWORD 0 CM_u16_factor_1_1023 0 6406.15835777126
 /begin AXIS_DESCR COM_AXIS accel_pedal_pos_16bit CM_u16_factor_1_1023 16 0 6406.15835777126 AXIS_PTS_REF CAL_tpstarget_low_gear_sport_ips_X_pps /end AXIS_DESCR
/end CHARACTERISTIC
/begin AXIS_PTS CAL_tpstarget_low_gear_sport_manual_X_pps "Calibration: X-axis (pps) for the tpstarget low gear sport manual table (val/1023; 16-element array)." 0x4000EA9C accel_pedal_pos_16bit RL_AXIS_UWORD 0 CM_u16_factor_1_1023 16 0 6406.15835777126 /end AXIS_PTS
/begin CHARACTERISTIC CAL_tpstarget_low_gear_sport_manual "Calibration: tpstarget low gear sport manual (val/1023; 16-element array)." CURVE 0x4000EABC RL_VALUE_UWORD 0 CM_u16_factor_1_1023 0 6406.15835777126
 /begin AXIS_DESCR COM_AXIS accel_pedal_pos_16bit CM_u16_factor_1_1023 16 0 6406.15835777126 AXIS_PTS_REF CAL_tpstarget_low_gear_sport_manual_X_pps /end AXIS_DESCR
/end CHARACTERISTIC
/begin AXIS_PTS CAL_tpstarget_low_gear_tour_ips_X_pps "Calibration: X-axis (pps) for the tpstarget low gear tour IPS table (val/1023; 16-element array)." 0x4000EADC accel_pedal_pos_16bit RL_AXIS_UWORD 0 CM_u16_factor_1_1023 16 0 6406.15835777126 /end AXIS_PTS
/begin CHARACTERISTIC CAL_tpstarget_low_gear_tour_ips "Calibration: tpstarget low gear tour IPS (val/1023; 16-element array)." CURVE 0x4000EAFC RL_VALUE_UWORD 0 CM_u16_factor_1_1023 0 6406.15835777126
 /begin AXIS_DESCR COM_AXIS accel_pedal_pos_16bit CM_u16_factor_1_1023 16 0 6406.15835777126 AXIS_PTS_REF CAL_tpstarget_low_gear_tour_ips_X_pps /end AXIS_DESCR
/end CHARACTERISTIC
/begin AXIS_PTS CAL_cooling_fan_base_engine_on_X_coolant_temp "Calibration: X-axis (coolant temp) for the cooling fan base engine on table (°C = val*5/8−40; 6-element array)." 0x4000EB1C coolant_temp RL_AXIS_UBYTE 0 CM_u8_temp_5_8_40c 6 -40 119.375 /end AXIS_PTS
/begin AXIS_PTS CAL_cooling_fan_base_engine_on_Y_carspeed "Calibration: Y-axis (carspeed) for the cooling fan base engine on table (km/h; 6-element array)." 0x4000EB22 car_speed_u8 RL_AXIS_UBYTE 0 CM_u8_speed_kph 6 0 255 /end AXIS_PTS
/begin CHARACTERISTIC CAL_cooling_fan_base_engine_on "Calibration: cooling fan base engine on (% = val*100/255; 36-element array)." MAP 0x4000EB28 RL_VALUE_UBYTE 0 CM_u8_factor_1_255 0 100
 /begin AXIS_DESCR COM_AXIS coolant_temp CM_u8_temp_5_8_40c 6 -40 119.375 AXIS_PTS_REF CAL_cooling_fan_base_engine_on_X_coolant_temp /end AXIS_DESCR
 /begin AXIS_DESCR COM_AXIS car_speed_u8 CM_u8_speed_kph 6 0 255 AXIS_PTS_REF CAL_cooling_fan_base_engine_on_Y_carspeed /end AXIS_DESCR
/end CHARACTERISTIC
/begin GROUP G_Throttle_tps "tps"
 /begin REF_CHARACTERISTIC CAL_tps_accel_pedal_zero_calibrate_timer CAL_tps_brake_safety_floor CAL_tps_brake_wheeldecel_tps_cut_threshold CAL_tps_commanded_during_fault CAL_tps_delta_rate_window_size CAL_tps_etb_low_voltage_threshold CAL_tps_etb_pid_integral_limit CAL_tps_etb_pid_kd CAL_tps_etb_pid_ki CAL_tps_etb_pid_kp CAL_tps_etb_pwm_period CAL_tps_etb_tps1_max_count CAL_tps_etb_tps1_scale_0pct_frac CAL_tps_etb_tps1_scale_100pct_frac CAL_tps_etb_tps2_max_count CAL_tps_etb_tps2_scale_0pct_frac CAL_tps_etb_tps2_scale_100pct_frac CAL_tps_idle_request_max CAL_tps_idle_to_current_ratio_threshold CAL_tps_limit_misfire_single_bank CAL_tps_limit_severe_misfire_1_cut CAL_tps_limit_severe_misfire_multi_cut CAL_tps_limit_severe_misfire_no_cut CAL_tps_limit_warmup_airtemp_max CAL_tps_limit_warmup_coolant_enable CAL_tps_limit_warmup_coolant_max CAL_tps_limit_warmup_rpm_max CAL_tps_limit_warmup_stepsize CAL_tps_limit_warmup_tps_max CAL_tps_min CAL_tps_obd_throttle_model_gain_closing CAL_tps_obd_throttle_model_gain_opening CAL_tps_obd_throttle_model_slewrate_accel CAL_tps_obd_throttle_model_slewrate_rev_closing CAL_tps_obd_throttle_model_slewrate_rev_opening CAL_tps_obd_throttle_model_step_max_closing CAL_tps_obd_throttle_model_step_max_opening CAL_tps_obd_throttle_model_velocity_step CAL_tps_obd_throttle_monitor_blank_time CAL_tps_obd_throttle_monitor_error_parity_mask CAL_tps_obd_throttle_monitor_error_threshold CAL_tps_obd_throttle_monitor_fail_threshold CAL_tps_obd_throttle_monitor_pass_threshold CAL_tps_obd_throttle_monitor_tps_rate_blank_threshold CAL_tps_rate_steadystate_threshold CAL_tps_rate_steadystate_threshold_X_rpm CAL_tps_rate_steadystate_threshold_Y_tps CAL_tps_rate_steadystate_window_size CAL_tps_scaling_factor_rpm CAL_tps_scaling_factor_rpm_X_rpm CAL_tps_warmup_max /end REF_CHARACTERISTIC
/end GROUP
/begin GROUP G_Throttle_tpssmooth "tpssmooth"
 /begin REF_CHARACTERISTIC CAL_tpssmooth_accel_pedal_modes_enable CAL_tpssmooth_decrement_by_delta CAL_tpssmooth_decrement_by_delta_X_tps_delta CAL_tpssmooth_decrement_by_rpm CAL_tpssmooth_decrement_by_rpm_X_rpm CAL_tpssmooth_decrement_comp_gears_ips CAL_tpssmooth_decrement_comp_gears_manual CAL_tpssmooth_decrement_cruise_scale CAL_tpssmooth_increment_b_neutral_sport CAL_tpssmooth_increment_b_neutral_tour CAL_tpssmooth_increment_parking CAL_tpssmooth_increment_parking_X_tps_diff CAL_tpssmooth_increment_rpm CAL_tpssmooth_increment_rpm_X_rpm CAL_tpssmooth_increment_sport CAL_tpssmooth_increment_sport_X_tps_diff CAL_tpssmooth_increment_tour CAL_tpssmooth_increment_tour_X_tps_diff CAL_tpssmooth_parking_clutch_threshold CAL_tpssmooth_parking_threshold_carspeed CAL_tpssmooth_parking_threshold_gear CAL_tpssmooth_parking_threshold_tps CAL_tpssmooth_rate_closing_clamp_thresholds CAL_tpssmooth_rate_decay_closing CAL_tpssmooth_rate_decay_closing_X_rpm CAL_tpssmooth_rate_decay_opening CAL_tpssmooth_rate_decay_opening_X_rpm CAL_tpssmooth_rate_opening_clamp_thresholds CAL_tpssmooth_step_timer /end REF_CHARACTERISTIC
/end GROUP
/begin GROUP G_Throttle_tpstarget "tpstarget"
 /begin REF_CHARACTERISTIC CAL_tpstarget_low_gear_sport_ips CAL_tpstarget_low_gear_sport_ips_X_pps CAL_tpstarget_low_gear_sport_manual CAL_tpstarget_low_gear_sport_manual_X_pps CAL_tpstarget_low_gear_tour_ips CAL_tpstarget_low_gear_tour_ips_X_pps CAL_tpstarget_low_gear_tour_manual CAL_tpstarget_low_gear_tour_manual_X_pps CAL_tpstarget_pedalmap_low_gear_threshold CAL_tpstarget_sport_ips CAL_tpstarget_sport_ips_X_pps CAL_tpstarget_sport_manual CAL_tpstarget_sport_manual_X_pps CAL_tpstarget_sport_shifting CAL_tpstarget_sport_shifting_X_pps CAL_tpstarget_tour_ips CAL_tpstarget_tour_ips_X_pps CAL_tpstarget_tour_manual CAL_tpstarget_tour_manual_X_pps CAL_tpstarget_tour_shifting CAL_tpstarget_tour_shifting_X_pps /end REF_CHARACTERISTIC
/end GROUP
/begin GROUP G_Idle "Idle" ROOT
 /begin REF_CHARACTERISTIC CAL_idle_air_base_ips_ingear_tour CAL_idle_air_base_ips_ingear_tour_X_rpm CAL_idle_air_base_ips_neutral_tour CAL_idle_air_base_ips_neutral_tour_X_rpm CAL_idle_air_control_proportional CAL_idle_air_control_proportional_X_speed_error CAL_idle_air_control_unknown CAL_idle_air_decay_period CAL_idle_air_decay_period_X_phase CAL_idle_air_fast_decay_period CAL_idle_air_fast_decay_step CAL_idle_air_hot_soak_comp CAL_idle_air_hot_soak_comp_X_bay_run_time CAL_idle_air_ign_startup_comp CAL_idle_air_ign_startup_comp_X_ign_comp CAL_idle_air_ign_startup_comp_enable CAL_idle_air_low_load_cam CAL_idle_air_low_load_cam_X_vvt_error_scale CAL_idle_air_low_load_cam_Y_idle_target CAL_idle_air_warmup_factor_ips CAL_idle_air_warmup_factor_ips_X_coolant_temp CAL_idle_air_warmup_factor_ips_Y_maf_accum CAL_idle_air_warmup_factor_manual CAL_idle_air_warmup_factor_manual_X_coolant_temp CAL_idle_air_warmup_factor_manual_Y_maf_accumulated CAL_idle_airflow_expected CAL_idle_airflow_expected_X_rpm CAL_idle_airflow_to_tps CAL_idle_airflow_to_tps_X_airflow CAL_idle_airflow_to_tps_Y_pressure CAL_idle_car_moving_threshold CAL_idle_carspeed_comp_decay_step CAL_idle_carspeed_comp_decay_step_ac CAL_idle_clutch_antistall_comp CAL_idle_clutch_antistall_comp_X_clutch_voltage CAL_idle_clutch_antistall_speed_threshold CAL_idle_comp_ac CAL_idle_comp_ac_X_ac_load CAL_idle_comp_accel_pedal_pos CAL_idle_comp_accel_pedal_pos_X_pps CAL_idle_comp_baro2 CAL_idle_comp_baro2_X_ambient_baro CAL_idle_comp_carspeed_ips CAL_idle_comp_carspeed_ips_X_carspeed CAL_idle_comp_carspeed_manual CAL_idle_comp_carspeed_manual_X_carspeed CAL_idle_comp_decay_period CAL_idle_comp_decay_period_ac CAL_idle_comp_ecu_voltage CAL_idle_comp_ecu_voltage_X_voltage CAL_idle_comp_fan CAL_idle_comp_fan_X_duty_cycle CAL_idle_comp_iat CAL_idle_comp_iat_X_iat CAL_idle_comp_misfire CAL_idle_comp_misfire_X_failed_cyl_count CAL_idle_comp_steering CAL_idle_comp_steering_X_steering_load CAL_idle_comp_timer_carspeed_ips CAL_idle_comp_timer_carspeed_ips_X_airtemp CAL_idle_comp_timer_carspeed_ips_Y_time_above_speed CAL_idle_comp_timer_carspeed_manual CAL_idle_comp_timer_carspeed_manual_X_airtemp CAL_idle_comp_timer_carspeed_manual_Y_time_above_speed CAL_idle_comp_tps_while_cranking CAL_idle_comp_tps_while_cranking_X_baro CAL_idle_comp_tps_while_cranking_Y_coolant_temp CAL_idle_comp_vehicle_speed_ips CAL_idle_comp_vehicle_speed_ips_X_vehicle_speed CAL_idle_comp_vehicle_speed_manual CAL_idle_comp_vehicle_speed_manual_X_carspeed CAL_idle_comp_while_moving CAL_idle_comp_while_moving_X_rpm CAL_idle_dashpot_decel_threshold CAL_idle_dashpot_rpm_lift_max CAL_idle_dashpot_rpm_lift_max_X_rpm CAL_idle_error_correction_unknown CAL_idle_error_correction_unknown_X_speed_error CAL_idle_exit_rpm_offset CAL_idle_flow_adj1_maf_accum_max CAL_idle_flow_integral_adj_max CAL_idle_flow_integral_adj_min CAL_idle_high_rpm_transient_air_comp CAL_idle_high_rpm_transient_air_decay_step CAL_idle_high_rpm_transient_runtime_min CAL_idle_integral_max_on_exit CAL_idle_integral_min_clamp CAL_idle_integral_update_period CAL_idle_learn_ac_on_param CAL_idle_learn_integral_max CAL_idle_learn_integral_min CAL_idle_learn_temp_range CAL_idle_low_car_speed_enter CAL_idle_low_car_speed_exit CAL_idle_monitor_voltage_operating_range CAL_idle_rpm_ramp_step CAL_idle_rpm_ramp_step_ips CAL_idle_sensor_fault_coolant_temp CAL_idle_target_ips CAL_idle_target_ips_X_coolant_temp CAL_idle_target_ips_coolant_fallback CAL_idle_target_ips_coolant_fallback_X_coolant_temp CAL_idle_target_manual_sport CAL_idle_target_manual_sport_X_coolant_temp CAL_idle_target_manual_tour CAL_idle_target_manual_tour_X_coolant_temp CAL_idle_tps_max_opening CAL_idle_underspeed_latch_rpm_delta CAL_idle_unknown1 CAL_idle_unknown2 CAL_idle_unknown3 CAL_idle_unknown4 CAL_idle_unknown6 /end REF_CHARACTERISTIC
/end GROUP
/begin GROUP G_Torque "Torque and limits" ROOT
 /begin SUB_GROUP G_Torque_dpm G_Torque_revlimit G_Torque_slip G_Torque_torque G_Torque_wheel /end SUB_GROUP
/end GROUP
/begin GROUP G_Torque_dpm "dpm"
 /begin REF_CHARACTERISTIC CAL_dpm_cornering_detect_delay CAL_dpm_cornering_lr_speed_diff_threshold CAL_dpm_cornering_release_delay CAL_dpm_integral_update_period CAL_dpm_intervention_threshold CAL_dpm_max_vehicle_speed CAL_dpm_min_engine_rpm CAL_dpm_min_vehicle_speed CAL_dpm_slip_filter_coeff CAL_dpm_slip_filter_coeff_X_carspeed CAL_dpm_slip_target_base CAL_dpm_slip_target_base_X_dpm_level CAL_dpm_slip_target_from_pedal CAL_dpm_slip_target_from_pedal_X_carspeed CAL_dpm_slip_target_from_pedal_Y_pps CAL_dpm_slip_target_straight_line_offset CAL_dpm_torque_cut_i_gain CAL_dpm_torque_cut_i_limit CAL_dpm_torque_cut_p_term CAL_dpm_torque_cut_p_term_X_carspeed CAL_dpm_torque_cut_p_term_Y_slip CAL_dpm_torque_margin_factor CAL_dpm_torque_min_allowed /end REF_CHARACTERISTIC
/end GROUP
/begin GROUP G_Torque_revlimit "revlimit"
 /begin REF_CHARACTERISTIC CAL_revlimit_airflow_gain_from_integrator CAL_revlimit_airflow_gain_from_integrator_X_gear CAL_revlimit_airflow_gain_from_rpm CAL_revlimit_airflow_gain_from_rpm_X_gear CAL_revlimit_airflow_gain_from_rpm_delta CAL_revlimit_airflow_gain_from_rpm_delta_X_gear CAL_revlimit_airflow_threshold CAL_revlimit_airflow_threshold_X_gear CAL_revlimit_coldstart_rpm_envelope CAL_revlimit_coldstart_rpm_envelope_X_index CAL_revlimit_coolant_coldstart_threshold CAL_revlimit_enforce_delay_after_start CAL_revlimit_escalation_integrator_step CAL_revlimit_escalation_integrator_step_X_gear CAL_revlimit_flow_integral_limit CAL_revlimit_flow_proportional_limit CAL_revlimit_flow_rpm_rate_limit CAL_revlimit_fuelcut_hysteresis CAL_revlimit_integrator_limit CAL_revlimit_limp_mode CAL_revlimit_maf_error_max_10g CAL_revlimit_max_with_speedlimit CAL_revlimit_overrun_count_threshold CAL_revlimit_overspeed_time CAL_revlimit_release_rpm_delta CAL_revlimit_rpm_rate_limit CAL_revlimit_speedbase_ips_sport CAL_revlimit_speedbase_ips_sport_X_coolant_temp CAL_revlimit_speedbase_ips_sport_Y_timer CAL_revlimit_speedbase_ips_tour CAL_revlimit_speedbase_ips_tour_X_coolant_temp CAL_revlimit_speedbase_ips_tour_Y_timer CAL_revlimit_speedbase_manual_sport CAL_revlimit_speedbase_manual_sport_X_coolant_temp CAL_revlimit_speedbase_manual_sport_Y_timer CAL_revlimit_speedbase_manual_tour CAL_revlimit_speedbase_manual_tour_X_coolant_temp CAL_revlimit_speedbase_manual_tour_Y_timer CAL_revlimit_startup_delay CAL_revlimit_startup_offset_decrement CAL_revlimit_throttle_clamp CAL_revlimit_torque_limit_confirmation_threshold CAL_revlimit_trim_per_gear CAL_revlimit_trim_per_gear_X_gear /end REF_CHARACTERISTIC
/end GROUP
/begin GROUP G_Torque_slip "slip"
 /begin REF_CHARACTERISTIC CAL_slip_car_speed_unknown1 CAL_slip_coldstart_coolant_threshold CAL_slip_comp_maf_accum_manual CAL_slip_comp_maf_accum_manual_X_maf_accum CAL_slip_detect_mode CAL_slip_enable_speed CAL_slip_gear_offset_unknown CAL_slip_gear_speed_ratios_cr CAL_slip_gear_speed_ratios_ips CAL_slip_gear_speed_ratios_long CAL_slip_inhibit_accel_pedal_min CAL_slip_inhibit_accel_pedal_timer CAL_slip_inhibit_cornering_base CAL_slip_inhibit_cornering_offset CAL_slip_power_based_rpm_thresholds CAL_slip_power_based_rpm_thresholds_X_power CAL_slip_slip_threshold_per_gear_ips CAL_slip_steering_angle_max_unknown CAL_slip_steering_angle_smooth_factor CAL_slip_steering_increase_factor_min CAL_slip_steering_rate_factor CAL_slip_threshold_1st_Gear CAL_slip_threshold_car_speed CAL_slip_threshold_hysteresis_offset CAL_slip_threshold_per_gear_manual CAL_slip_threshold_rpm_margin CAL_slip_timer_intervention2 CAL_slip_timer_per_gear_intervention CAL_slip_wheelspeed_front_accel_threshold /end REF_CHARACTERISTIC
/end GROUP
/begin GROUP G_Torque_torque "torque"
 /begin REF_CHARACTERISTIC CAL_torque_engine_ac_load_base CAL_torque_engine_ac_load_base_X_ac CAL_torque_engine_ac_load_scaler CAL_torque_engine_ac_load_scaler_X_engine_speed CAL_torque_engine_friction_speed_component CAL_torque_engine_friction_speed_component_X_engine_speed CAL_torque_engine_friction_speed_component_Y_load CAL_torque_engine_friction_temp_component CAL_torque_engine_friction_temp_component_X_coolant CAL_torque_engine_friction_temp_component_Y_load CAL_torque_estimate_min_ips CAL_torque_ext_torque_limit_hold_count CAL_torque_external_request_overshoot_margin CAL_torque_external_request_overshoot_margin_X_rpm CAL_torque_external_request_overshoot_margin_Y_torque CAL_torque_hysteresis_threshold1 CAL_torque_ign_retard_base CAL_torque_ign_retard_base_X_engine_speed CAL_torque_ign_retard_base_Y_torque_reduction_factor CAL_torque_integral_limit_negative CAL_torque_integral_limit_positive CAL_torque_limit_base_factor CAL_torque_limit_base_factor_X_rpm CAL_torque_limit_base_factor_Y_load CAL_torque_limit_by_coolant CAL_torque_limit_by_coolant_X_coolant CAL_torque_limit_by_rpm CAL_torque_limit_by_rpm_X_gear CAL_torque_limit_by_rpm_Y_rpm CAL_torque_limit_cooldown_timer CAL_torque_limit_cooldown_tps_rate_threshold CAL_torque_limit_integral CAL_torque_limit_integral_X_load_error CAL_torque_limit_integral_deadband CAL_torque_limit_integral_update_period CAL_torque_limit_low_speed_min_torque CAL_torque_limit_low_speed_rpm_threshold CAL_torque_limit_proportional CAL_torque_limit_proportional_X_load_error CAL_torque_limit_tps_filter_coeff CAL_torque_limit_tps_rate_limit CAL_torque_load_to_torque CAL_torque_load_to_torque_X_engine_speed CAL_torque_load_to_torque_Y_load CAL_torque_proportional_limit_negative CAL_torque_proportional_limit_positive CAL_torque_spark_efficiency CAL_torque_spark_efficiency_X_rpm CAL_torque_spark_efficiency_Y_ign_retard_from_mbt CAL_torque_spark_efficiency_slope CAL_torque_spark_efficiency_slope_X_rpm CAL_torque_spark_efficiency_slope_Y_load CAL_torque_torque_to_load CAL_torque_torque_to_load_X_engine_speed CAL_torque_torque_to_load_Y_torque CAL_torque_torque_to_tps_scaling_rpm_range CAL_torque_tps_gain /end REF_CHARACTERISTIC
/end GROUP
/begin GROUP G_Torque_wheel "wheel"
 /begin REF_CHARACTERISTIC CAL_wheel_speed_front_dvdt_scaling CAL_wheel_speed_min CAL_wheel_speed_multiplier_front CAL_wheel_speed_multiplier_rear CAL_wheel_speed_rate_min CAL_wheel_speed_smoothing CAL_wheel_speed_vss_tire_circumference /end REF_CHARACTERISTIC
/end GROUP
/begin GROUP G_Vvt "Variable valve timing" ROOT
 /begin REF_CHARACTERISTIC CAL_vvt_cam_park_offset_max CAL_vvt_error_gain_startup CAL_vvt_exhaust_advance_base CAL_vvt_exhaust_advance_base_X_engine_speed CAL_vvt_exhaust_advance_base_Y_load CAL_vvt_exhaust_advance_base_low_load CAL_vvt_exhaust_advance_base_low_load_X_engine_speed CAL_vvt_exhaust_advance_base_low_load_Y_load CAL_vvt_exhaust_comp_temp CAL_vvt_exhaust_comp_temp_X_coolant_temp CAL_vvt_intake_advance_base CAL_vvt_intake_advance_base_X_engine_speed CAL_vvt_intake_advance_base_Y_load CAL_vvt_intake_advance_base_low_load CAL_vvt_intake_advance_base_low_load_X_engine_speed CAL_vvt_intake_advance_base_low_load_Y_load CAL_vvt_intake_advance_coolant_offset CAL_vvt_intake_advance_coolant_offset_X_temp CAL_vvt_integral_gain CAL_vvt_low_load_disable CAL_vvt_low_load_ips_enable CAL_vvt_low_load_map_enable_temp CAL_vvt_pwm_period CAL_vvt_start_timer CAL_vvt_start_timer_X_coolant_temp CAL_vvt_zero_target_timeout /end REF_CHARACTERISTIC
/end GROUP
/begin GROUP G_Cooling "Cooling and temperatures" ROOT
 /begin SUB_GROUP G_Cooling_coolant G_Cooling_cooling G_Cooling_engine G_Cooling_oil /end SUB_GROUP
/end GROUP
/begin GROUP G_Cooling_coolant "coolant"
 /begin REF_CHARACTERISTIC CAL_coolant_temp_threshold CAL_coolant_temp_threshold_1 CAL_coolant_temp_threshold_1_hysteresis /end REF_CHARACTERISTIC
/end GROUP
/begin GROUP G_Cooling_cooling "cooling"
 /begin REF_CHARACTERISTIC CAL_cooling_engine_bay_fan_enable_delay CAL_cooling_fan_ac_off CAL_cooling_fan_ac_off_X_air_temp CAL_cooling_fan_ac_off_Y_carspeed CAL_cooling_fan_ac_on CAL_cooling_fan_ac_on_X_air_temp CAL_cooling_fan_ac_on_Y_carspeed CAL_cooling_fan_afterrun CAL_cooling_fan_afterrun_X_air_temp CAL_cooling_fan_afterrun_Y_coolant_temp CAL_cooling_fan_base_engine_on CAL_cooling_fan_base_engine_on_X_coolant_temp CAL_cooling_fan_base_engine_on_Y_carspeed CAL_cooling_fan_duty_cycle_stopped CAL_cooling_fan_duty_cycle_stopped_X_coolant_temp CAL_cooling_fan_engine_bay_airtemp_enable CAL_cooling_fan_engine_bay_radfan_threshold_disable CAL_cooling_fan_engine_bay_radfan_threshold_enable CAL_cooling_fan_hotstart_dutycycle CAL_cooling_fan_hotstart_temp CAL_cooling_fan_inhibit_resample_period_100ms CAL_cooling_fan_inhibit_temp_drop_threshold CAL_cooling_fan_inhibit_window_end CAL_cooling_fan_inhibit_window_start CAL_cooling_fan_low_rpm_hysteresis_threshold CAL_cooling_fan_scaling CAL_cooling_fan_scaling_X_dutycycle CAL_cooling_fan_speed_disable_speed CAL_cooling_fan_startup_time CAL_cooling_recirc_airtemp_disable_engine_on CAL_cooling_recirc_enable_airtemp CAL_cooling_recirc_enginespeed_disable_engine_on CAL_cooling_recirc_pump_stopped_dwell CAL_cooling_recirc_reset_coolant_temp CAL_cooling_recirc_rpm_enable_engine_on CAL_cooling_recirc_timer CAL_cooling_thermostat_open CAL_cooling_thermostat_warmup_load_factor CAL_cooling_thermostat_warmup_load_factor_X_load /end REF_CHARACTERISTIC
/end GROUP
/begin GROUP G_Cooling_engine "engine"
 /begin REF_CHARACTERISTIC CAL_engine_accel_lookback_teeth CAL_engine_roughness_period_history_offset CAL_engine_speed_3_limit CAL_engine_speed_3_threshold_2 CAL_engine_speed_3_threshold_3 CAL_engine_speed_avg_samples CAL_engine_speed_coolant_temp_unknown7 /end REF_CHARACTERISTIC
/end GROUP
/begin GROUP G_Cooling_oil "oil"
 /begin REF_CHARACTERISTIC CAL_oil_pressure_low_timer_threshold CAL_oil_pressure_switch_offset CAL_oil_pressure_switch_startup_time CAL_oil_pressure_switch_voltage_scaling CAL_oil_pressure_warning_light_mode /end REF_CHARACTERISTIC
/end GROUP
/begin GROUP G_Emissions "Emissions and evaporative" ROOT
 /begin SUB_GROUP G_Emissions_cat G_Emissions_emissions G_Emissions_evap G_Emissions_exhaust G_Emissions_misfire /end SUB_GROUP
/end GROUP
/begin GROUP G_Emissions_cat "cat" /begin REF_CHARACTERISTIC CAL_cat_check_unknown4 /end REF_CHARACTERISTIC /end GROUP
/begin GROUP G_Emissions_emissions "emissions"
 /begin REF_CHARACTERISTIC CAL_emissions_cat_efficiency_unknown1 CAL_emissions_cat_efficiency_unknown1_X_coolant_temp /end REF_CHARACTERISTIC
/end GROUP
/begin GROUP G_Emissions_evap "evap"
 /begin REF_CHARACTERISTIC CAL_evap_canister_purge_solenoid_timer_init CAL_evap_fuel_learn_duration CAL_evap_fuel_learn_entry_delay CAL_evap_fuel_learn_purge_duty_min CAL_evap_fuel_level_threshold_mid CAL_evap_fuel_used_window_level_high CAL_evap_fuel_used_window_level_low CAL_evap_fuel_used_window_level_mid CAL_evap_idle_bypass_airflow_divisor CAL_evap_leak_test_P0442_decay_limit CAL_evap_leak_test_P0442_decay_limit_X_fuel_level CAL_evap_leak_test_P0456_decay_limit CAL_evap_leak_test_P0456_decay_limit_X_ambient_temp CAL_evap_leak_test_P0456_decay_limit_Y_fuel_level CAL_evap_leak_test_baro_min CAL_evap_leak_test_coolant_min CAL_evap_leak_test_delay CAL_evap_leak_test_force_enable CAL_evap_leak_test_fuel_level_max CAL_evap_leak_test_fuel_level_min CAL_evap_leak_test_iat_engine_stopped_threshold CAL_evap_leak_test_iat_max CAL_evap_leak_test_idle_dwell CAL_evap_leak_test_pre_start_delay CAL_evap_leak_test_pulldown_vacuum CAL_evap_leak_test_pulldown_vacuum_X_pressure_swing CAL_evap_leak_test_pulldown_vacuum_Y_fuel_level CAL_evap_leak_test_purge_settle_delay CAL_evap_leak_test_sample_count CAL_evap_leak_test_settle_samples CAL_evap_leak_test_stage4_dwell CAL_evap_leak_vacuum_decay_sample CAL_evap_pressure_deviation_max CAL_evap_pressure_filter_coeff CAL_evap_purge_conditioning_timer_100ms CAL_evap_purge_dfco_suspend_timeout CAL_evap_purge_duty_ramp_down_conditioning CAL_evap_purge_duty_ramp_down_leak_test CAL_evap_purge_duty_ramp_down_monitor CAL_evap_purge_duty_ramp_down_normal CAL_evap_purge_duty_ramp_up_leak_test CAL_evap_purge_duty_ramp_up_min CAL_evap_purge_filter_alpha CAL_evap_purge_flow_X_vacuum CAL_evap_purge_flow_coefficient CAL_evap_purge_flow_coefficient_X_dutycycle CAL_evap_purge_flow_coefficient_Y_vacuum CAL_evap_purge_flow_max_duty CAL_evap_purge_flow_state_timer_init CAL_evap_purge_flow_vacuum_min CAL_evap_purge_flow_vapor_min CAL_evap_purge_flow_vapor_min_leaktest CAL_evap_purge_idle_duty_max CAL_evap_purge_idle_speed_error_deadband CAL_evap_purge_idle_speed_error_deadband2 CAL_evap_purge_leaktest_count_min CAL_evap_purge_mass_ratio_stft_inhibit_threshold CAL_evap_purge_min_inj_pulse_enter CAL_evap_purge_min_inj_pulse_exit CAL_evap_purge_min_load CAL_evap_purge_min_load_active CAL_evap_purge_mode_override CAL_evap_purge_o2_consistency_count CAL_evap_purge_o2_lean_threshold_cyl_cut CAL_evap_purge_o2_rich_threshold CAL_evap_purge_open_kick_duty CAL_evap_purge_open_kick_time CAL_evap_purge_power_enrich_suspend_delay CAL_evap_purge_power_enrich_suspend_hold CAL_evap_purge_power_enrich_suspend_timeout CAL_evap_purge_pressure_offset CAL_evap_purge_pressure_voltage_threshold CAL_evap_purge_pressure_voltage_threshold_0 CAL_evap_purge_pwm_period CAL_evap_purge_start_delay CAL_evap_purge_stft_window CAL_evap_purge_stuck_open_test_passes CAL_evap_purge_vacuum_min CAL_evap_purge_warmup_time CAL_evap_purge_warmup_time_X_coolant_temp CAL_evap_stft_settle_time CAL_evap_system_state_flags_param CAL_evap_tank_vacuum_flow_threshold CAL_evap_vacuum_threshold CAL_evap_vapor_conc_max_for_fuel_learn /end REF_CHARACTERISTIC
/end GROUP
/begin GROUP G_Emissions_exhaust "exhaust"
 /begin REF_CHARACTERISTIC CAL_exhaust_flap_RPM_threshold_close CAL_exhaust_flap_RPM_threshold_open CAL_exhaust_flap_load_threshold_close CAL_exhaust_flap_load_threshold_open CAL_exhaust_flap_sport_mode_enable CAL_exhaust_flap_startup_threshold CAL_exhaust_flap_state_control_race CAL_exhaust_flap_state_control_race_X_rpm CAL_exhaust_flap_state_control_race_Y_accel_pedal CAL_exhaust_flap_state_control_sport CAL_exhaust_flap_state_control_sport_X_rpm CAL_exhaust_flap_state_control_sport_Y_accel_pedal CAL_exhaust_flap_state_control_tour CAL_exhaust_flap_state_control_tour_X_rpm CAL_exhaust_flap_state_control_tour_Y_accel_pedal CAL_exhaust_flap_stationary_override_enable CAL_exhaust_flap_tour_mode_enable /end REF_CHARACTERISTIC
/end GROUP
/end MODULE
/end PROJECT
