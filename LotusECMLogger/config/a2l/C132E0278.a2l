ASAP2_VERSION 1 61
/begin PROJECT C132E0278 "Lotus T6 C132E0278"
/begin HEADER "" VERSION "generated v1" /end HEADER
/begin MODULE C132E0278 ""
/begin MOD_COMMON "" BYTE_ORDER MSB_FIRST ALIGNMENT_BYTE 1 ALIGNMENT_WORD 2 ALIGNMENT_LONG 4 /end MOD_COMMON
/begin RECORD_LAYOUT RL_AXIS_ULONG AXIS_PTS_X 1 ULONG INDEX_INCR DIRECT /end RECORD_LAYOUT
/begin RECORD_LAYOUT RL_VALUE_SLONG FNC_VALUES 1 SLONG ROW_DIR DIRECT /end RECORD_LAYOUT
/begin RECORD_LAYOUT RL_AXIS_SLONG AXIS_PTS_X 1 SLONG INDEX_INCR DIRECT /end RECORD_LAYOUT
/begin COMPU_METHOD CM_u16_angle_1_10deg "u16_angle_1/10deg" RAT_FUNC "%9.1" "deg" COEFFS 0 1 0 0 0 0.1 /end COMPU_METHOD
/begin COMPU_METHOD CM_u16_distance_km "u16_distance_km" RAT_FUNC "%8.0" "km" COEFFS 0 1 0 0 0 1 /end COMPU_METHOD
/begin COMPU_METHOD CM_u16_factor_1_10000 "u16_factor_1/10000" RAT_FUNC "%10.2" "%" COEFFS 0 1 0 0 0 0.01 /end COMPU_METHOD
/begin COMPU_METHOD CM_u16_factor_1_1023 "u16_factor_1/1023" RAT_FUNC "%12.4" "%" COEFFS 0 1 0 0 0 0.0977517106549365 /end COMPU_METHOD
/begin COMPU_METHOD CM_u16_factor_1_4095 "u16_factor_1/4095" RAT_FUNC "%12.4" "%" COEFFS 0 1 0 0 0 0.0244200244200244 /end COMPU_METHOD
/begin COMPU_METHOD CM_u16_flow_10mg_s "u16_flow_10mg/s" RAT_FUNC "%8.0" "mg/s" COEFFS 0 1 0 0 0 10 /end COMPU_METHOD
/begin COMPU_METHOD CM_u16_load_mg_stroke "u16_load_mg/stroke" RAT_FUNC "%8.0" "mg/stroke" COEFFS 0 1 0 0 0 1 /end COMPU_METHOD
/begin COMPU_METHOD CM_u16_power_1_100kw "u16_power_1/100kw" RAT_FUNC "%10.2" "kW" COEFFS 0 1 0 0 0 0.01 /end COMPU_METHOD
/begin COMPU_METHOD CM_u16_pressure_mbar "u16_pressure_mbar" RAT_FUNC "%8.0" "mbar" COEFFS 0 1 0 0 0 1 /end COMPU_METHOD
/begin COMPU_METHOD CM_u16_rspeed_rpm "u16_rspeed_rpm" RAT_FUNC "%8.0" "rpm" COEFFS 0 1 0 0 0 1 /end COMPU_METHOD
/begin COMPU_METHOD CM_u16_slip_1_8pct "u16_slip_1/8pct" RAT_FUNC "%11.3" "%" COEFFS 0 1 0 0 0 0.125 /end COMPU_METHOD
/begin COMPU_METHOD CM_u16_time_us "u16_time_us" RAT_FUNC "%8.0" "us" COEFFS 0 1 0 0 0 1 /end COMPU_METHOD
/begin COMPU_METHOD CM_u32_distance_1_112500km "u32_distance_1/112500km" RAT_FUNC "%12.4" "km" COEFFS 0 1 0 0 0 8.88888888888889E-06 /end COMPU_METHOD
/begin COMPU_METHOD CM_u8_angle_1_4deg "u8_angle_1/4deg" RAT_FUNC "%10.2" "deg" COEFFS 0 1 0 0 0 0.25 /end COMPU_METHOD
/begin COMPU_METHOD CM_u8_factor_1_255 "u8_factor_1/255" RAT_FUNC "%12.4" "%" COEFFS 0 1 0 0 0 0.392156862745098 /end COMPU_METHOD
/begin COMPU_METHOD CM_u8_flow_2g_s "u8_flow_2g/s" RAT_FUNC "%8.0" "g/s" COEFFS 0 1 0 0 0 2 /end COMPU_METHOD
/begin COMPU_METHOD CM_u8_load_1173mg_255stroke "u8_load_1173mg/255stroke" RAT_FUNC "%9.1" "mg/stroke" COEFFS 0 1 0 0 0 4.6 /end COMPU_METHOD
/begin COMPU_METHOD CM_u8_pressure_50mbar "u8_pressure_50mbar" RAT_FUNC "%8.0" "mbar" COEFFS 0 1 0 0 0 50 /end COMPU_METHOD
/begin COMPU_METHOD CM_u8_rspeed_2rpm "u8_rspeed_2rpm" RAT_FUNC "%8.0" "rpm" COEFFS 0 1 0 0 0 2 /end COMPU_METHOD
/begin COMPU_METHOD CM_u8_speed_1_100kph "u8_speed_1/100kph" RAT_FUNC "%10.2" "km/h" COEFFS 0 1 0 0 0 0.01 /end COMPU_METHOD
/begin COMPU_METHOD CM_u8_speed_kph "u8_speed_kph" RAT_FUNC "%8.0" "km/h" COEFFS 0 1 0 0 0 1 /end COMPU_METHOD
/begin COMPU_METHOD CM_u8_temp_1_10C "u8_temp_1/10C" RAT_FUNC "%9.1" "°C" COEFFS 0 1 0 0 0 0.1 /end COMPU_METHOD
/begin COMPU_METHOD CM_u8_temp_5_8_40c "u8_temp_5/8-40c" RAT_FUNC "%11.3" "°C" COEFFS 0 1 40 0 0 0.625 /end COMPU_METHOD
/begin COMPU_METHOD CM_u8_time_100ms "u8_time_100ms" RAT_FUNC "%8.0" "ms" COEFFS 0 1 0 0 0 100 /end COMPU_METHOD
/begin COMPU_METHOD CM_u8_time_10ms "u8_time_10ms" RAT_FUNC "%8.0" "ms" COEFFS 0 1 0 0 0 10 /end COMPU_METHOD
/begin COMPU_METHOD CM_u8_time_5ms "u8_time_5ms" RAT_FUNC "%8.0" "ms" COEFFS 0 1 0 0 0 5 /end COMPU_METHOD
/begin COMPU_METHOD CM_u8_torque_nm "u8_torque_nm" RAT_FUNC "%8.0" "Nm" COEFFS 0 1 0 0 0 1 /end COMPU_METHOD
/begin MEASUREMENT cruise_flags_unknown "undefined2" UWORD NO_COMPU_METHOD 0 0 0 65535 ECU_ADDRESS 0x40002622 /end MEASUREMENT
/begin MEASUREMENT cruise_cancel_button_hold_count "undefined1" UBYTE NO_COMPU_METHOD 0 0 0 255 ECU_ADDRESS 0x40002628 /end MEASUREMENT
/begin MEASUREMENT cruise_resume_button_hold_count "undefined1" UBYTE NO_COMPU_METHOD 0 0 0 255 ECU_ADDRESS 0x40002629 /end MEASUREMENT
/begin MEASUREMENT cruise_set_button_hold_count "undefined1" UBYTE NO_COMPU_METHOD 0 0 0 255 ECU_ADDRESS 0x4000262A /end MEASUREMENT
/begin MEASUREMENT cruise_integral_accum "int16_t" SWORD NO_COMPU_METHOD 0 0 -32768 32767 ECU_ADDRESS 0x4000262E /end MEASUREMENT
/begin MEASUREMENT cruise_coast_switch_override_timer "undefined1" UBYTE NO_COMPU_METHOD 0 0 0 255 ECU_ADDRESS 0x40002634 /end MEASUREMENT
/begin MEASUREMENT cruise_speed_smoothed "Cruise speed smoothed (km/h = val/100)." UWORD CM_u8_speed_1_100kph 0 0 0 655.35 ECU_ADDRESS 0x40002636 /end MEASUREMENT
/begin MEASUREMENT cruise_switch_unknown_voltage2 "undefined2" UWORD NO_COMPU_METHOD 0 0 0 65535 ECU_ADDRESS 0x40002638 /end MEASUREMENT
/begin MEASUREMENT cruise_transition_lockout_timer "undefined2" UWORD NO_COMPU_METHOD 0 0 0 65535 ECU_ADDRESS 0x40002640 /end MEASUREMENT
/begin MEASUREMENT cruise_integral_gain "undefined1" UBYTE NO_COMPU_METHOD 0 0 0 255 ECU_ADDRESS 0x4000264A /end MEASUREMENT
/begin MEASUREMENT cruise_stalk_idle_debounce_timer "undefined1" UBYTE NO_COMPU_METHOD 0 0 0 255 ECU_ADDRESS 0x4000264B /end MEASUREMENT
/begin MEASUREMENT cruise_switch_pos "Cruise switch position (enumerated state)." UBYTE NO_COMPU_METHOD 0 0 0 255 ECU_ADDRESS 0x4000264C /end MEASUREMENT
/begin MEASUREMENT cruise_speed_error_normalized "undefined1" UBYTE NO_COMPU_METHOD 0 0 0 255 ECU_ADDRESS 0x4000264D /end MEASUREMENT
/begin MEASUREMENT obd_ii_engine_torque "OBD-II: engine torque (Nm)." UWORD CM_u8_torque_nm 0 0 0 65535 ECU_ADDRESS 0x40002650 /end MEASUREMENT
/begin MEASUREMENT torque_estimated_actual_load "undefined2" UWORD NO_COMPU_METHOD 0 0 0 65535 ECU_ADDRESS 0x40002652 /end MEASUREMENT
/begin MEASUREMENT engine_friction_torque "Engine friction torque (Nm)." UWORD CM_u8_torque_nm 0 0 0 65535 ECU_ADDRESS 0x40002654 /end MEASUREMENT
/begin MEASUREMENT torque_estimated_alphaN "Torque estimated alphaN (Nm)." UWORD CM_u8_torque_nm 0 0 0 65535 ECU_ADDRESS 0x40002656 /end MEASUREMENT
/begin MEASUREMENT torque_engine_friction_base "Torque engine friction base (Nm)." UWORD CM_u8_torque_nm 0 0 0 65535 ECU_ADDRESS 0x40002658 /end MEASUREMENT
/begin MEASUREMENT load_estimated_alphaN "Load estimated alphaN (mg/stroke)." UWORD CM_u16_load_mg_stroke 0 0 0 65535 ECU_ADDRESS 0x4000265A /end MEASUREMENT
/begin MEASUREMENT load_learned_alphaN "Load learned alphaN (mg/stroke)." UWORD CM_u16_load_mg_stroke 0 0 0 65535 ECU_ADDRESS 0x4000265C /end MEASUREMENT
/begin MEASUREMENT load_target_with_torque_limit "Load target with torque limit (mg/stroke = val*1173)." UWORD CM_u8_load_1173mg_255stroke 0 0 0 301461 ECU_ADDRESS 0x4000265E /end MEASUREMENT
/begin MEASUREMENT torque_limit_tps_target "Torque limit throttle position target (val/4095)." UWORD CM_u16_factor_1_4095 0 0 0 1600.3663003663 ECU_ADDRESS 0x40002660 /end MEASUREMENT
/begin MEASUREMENT ign_comp_torque_reduction "undefined2" UWORD NO_COMPU_METHOD 0 0 0 65535 ECU_ADDRESS 0x40002662 /end MEASUREMENT
/begin MEASUREMENT torque_allowed_factor "Torque allowed factor (val/255)." UBYTE CM_u8_factor_1_255 0 0 0 100 ECU_ADDRESS 0x40002664 /end MEASUREMENT
/begin MEASUREMENT torque_limit_external_net "Torque limit external net (Nm)." UWORD CM_u8_torque_nm 0 0 0 65535 ECU_ADDRESS 0x40002666 /end MEASUREMENT
/begin MEASUREMENT torque_limit_external_factor "Torque limit external factor (val/255)." UBYTE CM_u8_factor_1_255 0 0 0 100 ECU_ADDRESS 0x40002668 /end MEASUREMENT
/begin MEASUREMENT torque_margin_above_limit "Torque margin above limit (Nm)." UWORD CM_u8_torque_nm 0 0 0 65535 ECU_ADDRESS 0x4000266A /end MEASUREMENT
/begin MEASUREMENT torque_net_engine_combustion "Torque net engine combustion (Nm)." UWORD CM_u8_torque_nm 0 0 0 65535 ECU_ADDRESS 0x4000266C /end MEASUREMENT
/begin MEASUREMENT torque_alphaN_net "Torque alphaN net (Nm)." UWORD CM_u8_torque_nm 0 0 0 65535 ECU_ADDRESS 0x4000266E /end MEASUREMENT
/begin MEASUREMENT torque_limit_base_factor "Torque limit base factor (val/255)." UBYTE CM_u8_factor_1_255 0 0 0 100 ECU_ADDRESS 0x40002670 /end MEASUREMENT
/begin MEASUREMENT torque_efficiency_factor "undefined1" UBYTE NO_COMPU_METHOD 0 0 0 255 ECU_ADDRESS 0x40002671 /end MEASUREMENT
/begin MEASUREMENT torque_engine_friction_temp_component "Torque engine friction temperature component (Nm)." UWORD CM_u8_torque_nm 0 0 0 65535 ECU_ADDRESS 0x40002672 /end MEASUREMENT
/begin MEASUREMENT torque_engine_friction_ac_load "Torque engine friction A/C load (Nm)." UWORD CM_u8_torque_nm 0 0 0 65535 ECU_ADDRESS 0x40002674 /end MEASUREMENT
/begin MEASUREMENT torque_cut_demand_factor "Torque cut demand factor (val/255)." UWORD CM_u8_factor_1_255 0 0 0 25700 ECU_ADDRESS 0x40002676 /end MEASUREMENT
/begin MEASUREMENT torque_factor_per_cyl_step "undefined1" UBYTE NO_COMPU_METHOD 0 0 0 255 ECU_ADDRESS 0x40002678 /end MEASUREMENT
/begin MEASUREMENT torque_cut_level "Torque cut level." UBYTE NO_COMPU_METHOD 0 0 0 255 ECU_ADDRESS 0x40002679 /end MEASUREMENT
/begin MEASUREMENT spark_retard_from_mbt "undefined2" UWORD NO_COMPU_METHOD 0 0 0 65535 ECU_ADDRESS 0x4000267A /end MEASUREMENT
/begin MEASUREMENT message_102_complete "Message 102 complete (boolean flag)." UBYTE NO_COMPU_METHOD 0 0 0 255 ECU_ADDRESS 0x4000267C /end MEASUREMENT
/begin MEASUREMENT torque_limit_source_flags "uint8_t" UBYTE NO_COMPU_METHOD 0 0 0 255 ECU_ADDRESS 0x4000267D /end MEASUREMENT
/begin MEASUREMENT torque_req_0xb7_abs_esp_active "Torque req 0xb7 ABS ESP active (boolean flag)." UBYTE NO_COMPU_METHOD 0 0 0 255 ECU_ADDRESS 0x4000267E /end MEASUREMENT
/begin MEASUREMENT torque_req_0xb7_cruise_control_active "Torque req 0xb7 cruise control active (boolean flag)." UBYTE NO_COMPU_METHOD 0 0 0 255 ECU_ADDRESS 0x4000267F /end MEASUREMENT
/begin MEASUREMENT tcu_0xc7_torque_request_active "bool" UBYTE NO_COMPU_METHOD 0 0 0 255 ECU_ADDRESS 0x40002680 /end MEASUREMENT
/begin MEASUREMENT trqlimit_ign_base_delta_from_mbt "Trqlimit ignition base delta from MBT (° = val/4)." SWORD CM_u8_angle_1_4deg 0 0 -8192 8191.75 ECU_ADDRESS 0x40002682 /end MEASUREMENT
/begin MEASUREMENT ign_retard_knock_avg "Ignition retard knock avg (° = val/4)." UWORD CM_u8_angle_1_4deg 0 0 0 16383.75 ECU_ADDRESS 0x40002684 /end MEASUREMENT
/begin MEASUREMENT abs_esp_flags "undefined1" UBYTE NO_COMPU_METHOD 0 0 0 255 ECU_ADDRESS 0x40002686 /end MEASUREMENT
/begin MEASUREMENT ips_shift_torque_request_active "undefined1" UBYTE NO_COMPU_METHOD 0 0 0 255 ECU_ADDRESS 0x40002687 /end MEASUREMENT
/begin MEASUREMENT torque_limit_0xb7_hold_timer "u8_time_10ms" UBYTE CM_u8_time_10ms 0 0 0 2550 ECU_ADDRESS 0x40002688 /end MEASUREMENT
/begin MEASUREMENT torque_limit_tcu_hold_timer "u8_time_10ms" UBYTE CM_u8_time_10ms 0 0 0 2550 ECU_ADDRESS 0x40002689 /end MEASUREMENT
/begin MEASUREMENT tc_torque_limit_use_slow_path "Flexcan mesg 0xb7 is 7byte (boolean flag)." UBYTE NO_COMPU_METHOD 0 0 0 255 ECU_ADDRESS 0x4000268A /end MEASUREMENT
/begin MEASUREMENT tcu_slow_channel_active_never_set "bool" UBYTE NO_COMPU_METHOD 0 0 0 255 ECU_ADDRESS 0x4000268B /end MEASUREMENT
/begin MEASUREMENT dpm_torque_split_active "bool" UBYTE NO_COMPU_METHOD 0 0 0 255 ECU_ADDRESS 0x4000268D /end MEASUREMENT
/begin MEASUREMENT torque_limit_slow_path_active "undefined1" UBYTE NO_COMPU_METHOD 0 0 0 255 ECU_ADDRESS 0x4000268E /end MEASUREMENT
/begin MEASUREMENT torque_driver_net_clamped "Torque driver net clamped (Nm)." UWORD CM_u8_torque_nm 0 0 0 65535 ECU_ADDRESS 0x40002690 /end MEASUREMENT
/begin MEASUREMENT cruise_brake_cancel_timer "undefined2" UWORD NO_COMPU_METHOD 0 0 0 65535 ECU_ADDRESS 0x40002692 /end MEASUREMENT
/begin MEASUREMENT torque_external_request_margin "Torque external request margin (Nm)." UWORD CM_u8_torque_nm 0 0 0 65535 ECU_ADDRESS 0x40002694 /end MEASUREMENT
/begin MEASUREMENT load_limit_from_torque_limit "Load limit from torque limit (mg/stroke)." UWORD CM_u16_load_mg_stroke 0 0 0 65535 ECU_ADDRESS 0x40002696 /end MEASUREMENT
/begin MEASUREMENT torque_loss_from_ign_retard "Torque loss from ignition retard (Nm)." UWORD CM_u8_torque_nm 0 0 0 65535 ECU_ADDRESS 0x40002698 /end MEASUREMENT
/begin MEASUREMENT ign_retard_torque_limit "undefined2" UWORD NO_COMPU_METHOD 0 0 0 65535 ECU_ADDRESS 0x4000269A /end MEASUREMENT
/begin MEASUREMENT ign_comp_torque_reduction_unclipped "Ignition compensation torque reduction unclipped (° = val/4)." UWORD CM_u8_angle_1_4deg 0 0 0 16383.75 ECU_ADDRESS 0x4000269C /end MEASUREMENT
/begin MEASUREMENT torque_reduction_ign_unclamped "Torque reduction ignition unclamped (val/255)." UWORD CM_u8_factor_1_255 0 0 0 25700 ECU_ADDRESS 0x4000269E /end MEASUREMENT
/begin MEASUREMENT torque_limit_engine_protection "Torque limit engine protection (Nm)." UWORD CM_u8_torque_nm 0 0 0 65535 ECU_ADDRESS 0x400026A0 /end MEASUREMENT
/begin MEASUREMENT torque_limit_external_and_internal "Torque limit external and internal (Nm)." UWORD CM_u8_torque_nm 0 0 0 65535 ECU_ADDRESS 0x400026A2 /end MEASUREMENT
/begin MEASUREMENT nonfiring_cyl_count "undefined1" UBYTE NO_COMPU_METHOD 0 0 0 255 ECU_ADDRESS 0x400026A4 /end MEASUREMENT
/begin MEASUREMENT torque_limit_output_clamp_flags "undefined1" UBYTE NO_COMPU_METHOD 0 0 0 255 ECU_ADDRESS 0x400026A5 /end MEASUREMENT
/begin MEASUREMENT torque_tps_limit_delay_timer "undefined1" UBYTE NO_COMPU_METHOD 0 0 0 255 ECU_ADDRESS 0x400026A6 /end MEASUREMENT
/begin MEASUREMENT tcu_torque_limit_onset_latch "undefined1" UBYTE NO_COMPU_METHOD 0 0 0 255 ECU_ADDRESS 0x400026A7 /end MEASUREMENT
/begin MEASUREMENT torque_request_cruise_active "bool" UBYTE NO_COMPU_METHOD 0 0 0 255 ECU_ADDRESS 0x400026A8 /end MEASUREMENT
/begin MEASUREMENT brake_timer2 "undefined1" UBYTE NO_COMPU_METHOD 0 0 0 255 ECU_ADDRESS 0x400026A9 /end MEASUREMENT
/begin MEASUREMENT runaway_protection_timeout_unknown "u8_time_10ms" UBYTE CM_u8_time_10ms 0 0 0 2550 ECU_ADDRESS 0x400026AA /end MEASUREMENT
/begin MEASUREMENT ign_adv_sum_firing_cyl "Ignition adv sum firing cyl (° = val/4)." SWORD CM_u8_angle_1_4deg 0 0 -8192 8191.75 ECU_ADDRESS 0x400026AC /end MEASUREMENT
/begin MEASUREMENT torque_external_request_final "Torque external request final (Nm)." UWORD CM_u8_torque_nm 0 0 0 65535 ECU_ADDRESS 0x400026AE /end MEASUREMENT
/begin MEASUREMENT torque_engine_ac_load_base "undefined2" UWORD NO_COMPU_METHOD 0 0 0 65535 ECU_ADDRESS 0x400026B0 /end MEASUREMENT
/begin MEASUREMENT torque_engine_ac_load_scaler "Torque engine A/C load scaler (val/255)." UBYTE CM_u8_factor_1_255 0 0 0 100 ECU_ADDRESS 0x400026B2 /end MEASUREMENT
/begin MEASUREMENT torque_engine_friction_speed_component "Torque engine friction speed component (Nm)." UWORD CM_u8_torque_nm 0 0 0 65535 ECU_ADDRESS 0x400026B4 /end MEASUREMENT
/begin MEASUREMENT load_density_compensated "Load density compensated (mg/stroke)." UWORD CM_u16_load_mg_stroke 0 0 0 65535 ECU_ADDRESS 0x400026B6 /end MEASUREMENT
/begin MEASUREMENT tps_from_load_lea "undefined2" UWORD NO_COMPU_METHOD 0 0 0 65535 ECU_ADDRESS 0x400026B8 /end MEASUREMENT
/begin MEASUREMENT torque_limit_net_friction_and_ign_retard "Torque limit net friction and ignition retard (Nm)." UWORD CM_u8_torque_nm 0 0 0 65535 ECU_ADDRESS 0x400026BA /end MEASUREMENT
/begin MEASUREMENT torque_limit_flags_pi "undefined1" UBYTE NO_COMPU_METHOD 0 0 0 255 ECU_ADDRESS 0x400026BC /end MEASUREMENT
/begin MEASUREMENT torque_limit_load_error "Torque limit load error (mg/stroke)." UWORD CM_u16_load_mg_stroke 0 0 0 65535 ECU_ADDRESS 0x400026BE /end MEASUREMENT
/begin MEASUREMENT tps_correction_proportional "undefined2" UWORD NO_COMPU_METHOD 0 0 0 65535 ECU_ADDRESS 0x400026C0 /end MEASUREMENT
/begin MEASUREMENT tps_correction_integral "undefined2" UWORD NO_COMPU_METHOD 0 0 0 65535 ECU_ADDRESS 0x400026C2 /end MEASUREMENT
/begin MEASUREMENT integral_update_timer "undefined1" UBYTE NO_COMPU_METHOD 0 0 0 255 ECU_ADDRESS 0x400026C4 /end MEASUREMENT
/begin MEASUREMENT tps_torque_filtered_scaled_x1024 "undefined4" ULONG NO_COMPU_METHOD 0 0 0 4294967295 ECU_ADDRESS 0x400026C8 /end MEASUREMENT
/begin MEASUREMENT tps_torque_limit_pi_target "Throttle position torque limit pi target (val/4095)." UWORD CM_u16_factor_1_4095 0 0 0 1600.3663003663 ECU_ADDRESS 0x400026CC /end MEASUREMENT
/begin MEASUREMENT tps_accumulator_torque_limit "undefined4" ULONG NO_COMPU_METHOD 0 0 0 4294967295 ECU_ADDRESS 0x400026D0 /end MEASUREMENT
/begin MEASUREMENT ac_compressor_request "undefined1" UBYTE NO_COMPU_METHOD 0 0 0 255 ECU_ADDRESS 0x400026D8 /end MEASUREMENT
/begin MEASUREMENT ac_compressor_state "A/C compressor state (enumerated state)." UBYTE NO_COMPU_METHOD 0 0 0 255 ECU_ADDRESS 0x400026D9 /end MEASUREMENT
/begin MEASUREMENT obd_ii_ac_clutch_relay "undefined1" UBYTE NO_COMPU_METHOD 0 0 0 255 ECU_ADDRESS 0x400026DA /end MEASUREMENT
/begin MEASUREMENT ac_load2__ "undefined2" UWORD NO_COMPU_METHOD 0 0 0 65535 ECU_ADDRESS 0x400026DC /end MEASUREMENT
/begin MEASUREMENT ac_inhibit_flags "undefined2" UWORD NO_COMPU_METHOD 0 0 0 65535 ECU_ADDRESS 0x400026DE /end MEASUREMENT
/begin MEASUREMENT ac_tps_inhibit_timer "undefined1" UBYTE NO_COMPU_METHOD 0 0 0 255 ECU_ADDRESS 0x400026E3 /end MEASUREMENT
/begin MEASUREMENT ac_clutch_input "A/C clutch input (boolean flag)." UBYTE NO_COMPU_METHOD 0 0 0 255 ECU_ADDRESS 0x400026E4 /end MEASUREMENT
/begin MEASUREMENT ac_cooling_fan_required "A/C cooling fan required (boolean flag)." UBYTE NO_COMPU_METHOD 0 0 0 255 ECU_ADDRESS 0x400026E5 /end MEASUREMENT
/begin MEASUREMENT ac_compressor_ign_compensation_active "A/C compressor ignition compensation active (boolean flag)." UBYTE NO_COMPU_METHOD 0 0 0 255 ECU_ADDRESS 0x400026E6 /end MEASUREMENT
/begin MEASUREMENT ac_pid_p_term "undefined2" UWORD NO_COMPU_METHOD 0 0 0 65535 ECU_ADDRESS 0x400026EA /end MEASUREMENT
/begin MEASUREMENT ac_pid_d_term "undefined2" UWORD NO_COMPU_METHOD 0 0 0 65535 ECU_ADDRESS 0x400026EE /end MEASUREMENT
/begin MEASUREMENT ac_pid_out_accum "undefined2" UWORD NO_COMPU_METHOD 0 0 0 65535 ECU_ADDRESS 0x400026F0 /end MEASUREMENT
/begin MEASUREMENT ac_pid_target_accum "undefined2" UWORD NO_COMPU_METHOD 0 0 0 65535 ECU_ADDRESS 0x400026F2 /end MEASUREMENT
/begin MEASUREMENT ac_power_limit "undefined2" UWORD NO_COMPU_METHOD 0 0 0 65535 ECU_ADDRESS 0x400026F6 /end MEASUREMENT
/begin MEASUREMENT ac_evap_temp_delta "A/C evaporative temperature delta (°C = val/10)." UWORD CM_u8_temp_1_10C 0 0 0 6553.5 ECU_ADDRESS 0x400026F8 /end MEASUREMENT
/begin MEASUREMENT ac_compressor_dc "undefined2" UWORD NO_COMPU_METHOD 0 0 0 65535 ECU_ADDRESS 0x400026FC /end MEASUREMENT
/begin MEASUREMENT ac_fan_startup_hold_timer "undefined2" UWORD NO_COMPU_METHOD 0 0 0 65535 ECU_ADDRESS 0x400026FE /end MEASUREMENT
/begin MEASUREMENT ac_clutch_engage_request "undefined1" UBYTE NO_COMPU_METHOD 0 0 0 255 ECU_ADDRESS 0x4000270E /end MEASUREMENT
/begin MEASUREMENT ac_evap_pid_update_period "undefined1" UBYTE NO_COMPU_METHOD 0 0 0 255 ECU_ADDRESS 0x4000270F /end MEASUREMENT
/begin MEASUREMENT ac_load_mw_ "undefined2" UWORD NO_COMPU_METHOD 0 0 0 65535 ECU_ADDRESS 0x40002712 /end MEASUREMENT
/begin MEASUREMENT ac_rpm_inhibit_delay_timer "undefined1" UBYTE NO_COMPU_METHOD 0 0 0 255 ECU_ADDRESS 0x40002716 /end MEASUREMENT
/begin MEASUREMENT ac_evap_freeze_inhibit_timer "undefined2" UWORD NO_COMPU_METHOD 0 0 0 65535 ECU_ADDRESS 0x40002718 /end MEASUREMENT
/begin MEASUREMENT ac_rpm_cutoff_min_hold_timer "undefined2" UWORD NO_COMPU_METHOD 0 0 0 65535 ECU_ADDRESS 0x40002722 /end MEASUREMENT
/begin MEASUREMENT etb_driver_diag_latched "undefined1" UBYTE NO_COMPU_METHOD 0 0 0 255 ECU_ADDRESS 0x40002738 /end MEASUREMENT
/begin MEASUREMENT tps_sensor_fault_active "Throttle position sensor fault active (boolean flag)." UBYTE NO_COMPU_METHOD 0 0 0 255 ECU_ADDRESS 0x40002739 /end MEASUREMENT
/begin MEASUREMENT tps_feedback_position "Throttle position feedback position (val/1023)." UWORD CM_u16_factor_1_1023 0 0 0 6406.15835777126 ECU_ADDRESS 0x4000273A /end MEASUREMENT
/begin MEASUREMENT tps_system_state "Throttle position system state (enumerated state)." UBYTE NO_COMPU_METHOD 0 0 0 255 ECU_ADDRESS 0x40002768 /end MEASUREMENT
/begin MEASUREMENT accel_pedal_system_state "undefined1" UBYTE NO_COMPU_METHOD 0 0 0 255 ECU_ADDRESS 0x40002769 /end MEASUREMENT
/begin MEASUREMENT accel_pedal_track_d_selected "Accelerator pedal track d selected (boolean flag)." UBYTE NO_COMPU_METHOD 0 0 0 255 ECU_ADDRESS 0x4000276B /end MEASUREMENT
/begin MEASUREMENT coding_cmd "undefined1" UBYTE NO_COMPU_METHOD 0 0 0 255 ECU_ADDRESS 0x40002770 /end MEASUREMENT
/begin MEASUREMENT coding_vin_buf "undefined1" UBYTE NO_COMPU_METHOD 0 0 0 255 ECU_ADDRESS 0x40002780 /end MEASUREMENT
/begin MEASUREMENT eeprom_update_flags "undefined1" UBYTE NO_COMPU_METHOD 0 0 0 255 ECU_ADDRESS 0x4000278E /end MEASUREMENT
/begin MEASUREMENT prog_version_mismatch "Prog version mismatch (boolean flag)." UBYTE NO_COMPU_METHOD 0 0 0 255 ECU_ADDRESS 0x4000278F /end MEASUREMENT
/begin MEASUREMENT vin_type "VIN type (enumerated state)." UBYTE NO_COMPU_METHOD 0 0 0 255 ECU_ADDRESS 0x40002790 /end MEASUREMENT
/begin MEASUREMENT vin_byte_arrival_mask "undefined4" ULONG NO_COMPU_METHOD 0 0 0 4294967295 ECU_ADDRESS 0x40002794 /end MEASUREMENT
/begin MEASUREMENT cod_oil_sump_system "undefined1" UBYTE NO_COMPU_METHOD 0 0 0 255 ECU_ADDRESS 0x40002798 /end MEASUREMENT
/begin MEASUREMENT central_door_locking_present "undefined1" UBYTE NO_COMPU_METHOD 0 0 0 255 ECU_ADDRESS 0x40002799 /end MEASUREMENT
/begin MEASUREMENT tps_config_unknown "undefined1" UBYTE NO_COMPU_METHOD 0 0 0 255 ECU_ADDRESS 0x4000279A /end MEASUREMENT
/begin MEASUREMENT power_fold_mirrors_installed "undefined1" UBYTE NO_COMPU_METHOD 0 0 0 255 ECU_ADDRESS 0x4000279B /end MEASUREMENT
/begin MEASUREMENT reverse_camera "undefined1" UBYTE NO_COMPU_METHOD 0 0 0 255 ECU_ADDRESS 0x4000279C /end MEASUREMENT
/begin MEASUREMENT speed_limiter "undefined1" UBYTE NO_COMPU_METHOD 0 0 0 255 ECU_ADDRESS 0x4000279D /end MEASUREMENT
/begin MEASUREMENT race_mode_present "undefined1" UBYTE NO_COMPU_METHOD 0 0 0 255 ECU_ADDRESS 0x4000279E /end MEASUREMENT
/begin MEASUREMENT launch_mode_present "undefined1" UBYTE NO_COMPU_METHOD 0 0 0 255 ECU_ADDRESS 0x4000279F /end MEASUREMENT
/begin MEASUREMENT abs_present "undefined1" UBYTE NO_COMPU_METHOD 0 0 0 255 ECU_ADDRESS 0x400027A0 /end MEASUREMENT
/begin MEASUREMENT instrument_cluster_is_2011plus "undefined1" UBYTE NO_COMPU_METHOD 0 0 0 255 ECU_ADDRESS 0x400027A1 /end MEASUREMENT
/begin MEASUREMENT yaw_sensor_present "undefined1" UBYTE NO_COMPU_METHOD 0 0 0 255 ECU_ADDRESS 0x400027A2 /end MEASUREMENT
/begin MEASUREMENT sas_present "undefined1" UBYTE NO_COMPU_METHOD 0 0 0 255 ECU_ADDRESS 0x400027A3 /end MEASUREMENT
/begin MEASUREMENT tpms_present "undefined1" UBYTE NO_COMPU_METHOD 0 0 0 255 ECU_ADDRESS 0x400027A4 /end MEASUREMENT
/begin MEASUREMENT tcu_installed "undefined1" UBYTE NO_COMPU_METHOD 0 0 0 255 ECU_ADDRESS 0x400027A5 /end MEASUREMENT
/begin MEASUREMENT bcm_installed "undefined1" UBYTE NO_COMPU_METHOD 0 0 0 255 ECU_ADDRESS 0x400027A6 /end MEASUREMENT
/begin MEASUREMENT fuel_pump_is_pwm "undefined1" UBYTE NO_COMPU_METHOD 0 0 0 255 ECU_ADDRESS 0x400027A8 /end MEASUREMENT
/begin MEASUREMENT trans_fluid_pump "undefined1" UBYTE NO_COMPU_METHOD 0 0 0 255 ECU_ADDRESS 0x400027A9 /end MEASUREMENT
/begin MEASUREMENT recirc_valve_installed "undefined1" UBYTE NO_COMPU_METHOD 0 0 0 255 ECU_ADDRESS 0x400027AA /end MEASUREMENT
/begin MEASUREMENT clutch_type "undefined1" UBYTE NO_COMPU_METHOD 0 0 0 255 ECU_ADDRESS 0x400027AB /end MEASUREMENT
/begin MEASUREMENT sport_button_installed "undefined1" UBYTE NO_COMPU_METHOD 0 0 0 255 ECU_ADDRESS 0x400027AC /end MEASUREMENT
/begin MEASUREMENT tcp_esp_button_installed "undefined1" UBYTE NO_COMPU_METHOD 0 0 0 255 ECU_ADDRESS 0x400027AD /end MEASUREMENT
/begin MEASUREMENT speed_alert_buzzer "undefined1" UBYTE NO_COMPU_METHOD 0 0 0 255 ECU_ADDRESS 0x400027AE /end MEASUREMENT
/begin MEASUREMENT aux_cooling_fan_installed "undefined1" UBYTE NO_COMPU_METHOD 0 0 0 255 ECU_ADDRESS 0x400027AF /end MEASUREMENT
/begin MEASUREMENT silencer_bypass_valve_installed "undefined1" UBYTE NO_COMPU_METHOD 0 0 0 255 ECU_ADDRESS 0x400027B0 /end MEASUREMENT
/begin MEASUREMENT seat_heaters_installed "undefined1" UBYTE NO_COMPU_METHOD 0 0 0 255 ECU_ADDRESS 0x400027B1 /end MEASUREMENT
/begin MEASUREMENT dpm_switch_installed "undefined1" UBYTE NO_COMPU_METHOD 0 0 0 255 ECU_ADDRESS 0x400027B2 /end MEASUREMENT
/begin MEASUREMENT exhaust_bypass_override_button_installed "undefined1" UBYTE NO_COMPU_METHOD 0 0 0 255 ECU_ADDRESS 0x400027B3 /end MEASUREMENT
/begin MEASUREMENT race_button_installed "undefined1" UBYTE NO_COMPU_METHOD 0 0 0 255 ECU_ADDRESS 0x400027B4 /end MEASUREMENT
/begin MEASUREMENT cod_drive_pos "undefined1" UBYTE NO_COMPU_METHOD 0 0 0 255 ECU_ADDRESS 0x400027B5 /end MEASUREMENT
/begin MEASUREMENT cod_symbol_display "undefined1" UBYTE NO_COMPU_METHOD 0 0 0 255 ECU_ADDRESS 0x400027B6 /end MEASUREMENT
/begin MEASUREMENT cod_japan_seatbelt_warning "undefined1" UBYTE NO_COMPU_METHOD 0 0 0 255 ECU_ADDRESS 0x400027B7 /end MEASUREMENT
/begin MEASUREMENT cod_rear_fog_fitted "undefined1" UBYTE NO_COMPU_METHOD 0 0 0 255 ECU_ADDRESS 0x400027B8 /end MEASUREMENT
/begin MEASUREMENT cod_fuel_tank_capacity "undefined1" UBYTE NO_COMPU_METHOD 0 0 0 255 ECU_ADDRESS 0x400027B9 /end MEASUREMENT
/begin MEASUREMENT speed_units "undefined1" UBYTE NO_COMPU_METHOD 0 0 0 255 ECU_ADDRESS 0x400027BA /end MEASUREMENT
/begin MEASUREMENT srs_present "undefined1" UBYTE NO_COMPU_METHOD 0 0 0 255 ECU_ADDRESS 0x400027BB /end MEASUREMENT
/begin MEASUREMENT cod_trans_type "undefined1" UBYTE NO_COMPU_METHOD 0 0 0 255 ECU_ADDRESS 0x400027BC /end MEASUREMENT
/begin MEASUREMENT close_ratio_gears "undefined1" UBYTE NO_COMPU_METHOD 0 0 0 255 ECU_ADDRESS 0x400027BD /end MEASUREMENT
/begin MEASUREMENT gear_count "undefined1" UBYTE NO_COMPU_METHOD 0 0 0 255 ECU_ADDRESS 0x400027BE /end MEASUREMENT
/begin MEASUREMENT large_wheel_profile_set "undefined1" UBYTE NO_COMPU_METHOD 0 0 0 255 ECU_ADDRESS 0x400027BF /end MEASUREMENT
/begin MEASUREMENT mechanical_lsd_installed "Mechanical lsd installed (boolean flag)." UBYTE NO_COMPU_METHOD 0 0 0 255 ECU_ADDRESS 0x400027C0 /end MEASUREMENT
/begin MEASUREMENT traction_control_level "undefined1" UBYTE NO_COMPU_METHOD 0 0 0 255 ECU_ADDRESS 0x400027C1 /end MEASUREMENT
/begin MEASUREMENT cruise_type "undefined1" UBYTE NO_COMPU_METHOD 0 0 0 255 ECU_ADDRESS 0x400027C2 /end MEASUREMENT
/begin MEASUREMENT hvac_type "undefined1" UBYTE NO_COMPU_METHOD 0 0 0 255 ECU_ADDRESS 0x400027C3 /end MEASUREMENT
/begin MEASUREMENT coding_oil_cooling_additional "Coding oil cooling additional (boolean flag)." UBYTE NO_COMPU_METHOD 0 0 0 255 ECU_ADDRESS 0x400027C4 /end MEASUREMENT
/begin MEASUREMENT revlimit_state_flags "undefined2" UWORD NO_COMPU_METHOD 0 0 0 65535 ECU_ADDRESS 0x400027C8 /end MEASUREMENT
/begin MEASUREMENT revlimit_rpm_error "Rev-limit RPM error (RPM)." UWORD CM_u16_rspeed_rpm 0 0 0 65535 ECU_ADDRESS 0x400027CA /end MEASUREMENT
/begin MEASUREMENT revlimit_tps_max "Rev-limit throttle position maximum (val/1023)." UWORD CM_u16_factor_1_1023 0 0 0 6406.15835777126 ECU_ADDRESS 0x400027CC /end MEASUREMENT
/begin MEASUREMENT revlimit_tps_max_remapped_unused "revlimit_tps_max converted to pedal scale and passed through CAL_tpstarget_* (pedal->throttle) at the end of revlimit(). Write-only: nothing reads it." UWORD CM_u16_factor_1_1023 0 0 0 6406.15835777126 ECU_ADDRESS 0x400027CE /end MEASUREMENT
/begin MEASUREMENT revlimit_flow_setpoint "undefined2" UWORD NO_COMPU_METHOD 0 0 0 65535 ECU_ADDRESS 0x400027D0 /end MEASUREMENT
/begin MEASUREMENT revlimit_load_setpoint "undefined2" UWORD NO_COMPU_METHOD 0 0 0 65535 ECU_ADDRESS 0x400027D2 /end MEASUREMENT
/begin MEASUREMENT revlimit_hard_exit_rpm "Rev-limit hard for IPS (RPM)." UWORD CM_u16_rspeed_rpm 0 0 0 65535 ECU_ADDRESS 0x400027D4 /end MEASUREMENT
/begin MEASUREMENT revlimit_hard "Rev-limit hard (RPM)." UWORD CM_u16_rspeed_rpm 0 0 0 65535 ECU_ADDRESS 0x400027D6 /end MEASUREMENT
/begin MEASUREMENT ips_enforce_speed_limit "IPS enforce speed limit (boolean flag)." UBYTE NO_COMPU_METHOD 0 0 0 255 ECU_ADDRESS 0x400027D8 /end MEASUREMENT
/begin MEASUREMENT ips_throttle_restrict "undefined1" UBYTE NO_COMPU_METHOD 0 0 0 255 ECU_ADDRESS 0x400027DA /end MEASUREMENT
/begin MEASUREMENT revlimit_current "Rev-limit current (RPM)." UWORD CM_u16_rspeed_rpm 0 0 0 65535 ECU_ADDRESS 0x400027DC /end MEASUREMENT
/begin MEASUREMENT revlimit_soft "Rev-limit soft (RPM)." UWORD CM_u16_rspeed_rpm 0 0 0 65535 ECU_ADDRESS 0x400027DE /end MEASUREMENT
/begin MEASUREMENT revlimit_limp_mode_active "Rev-limit limp mode active (boolean flag)." UBYTE NO_COMPU_METHOD 0 0 0 255 ECU_ADDRESS 0x400027E0 /end MEASUREMENT
/begin MEASUREMENT revlimit_rpm_error_integral "undefined2" UWORD NO_COMPU_METHOD 0 0 0 65535 ECU_ADDRESS 0x400027E2 /end MEASUREMENT
/begin MEASUREMENT revlimit_rpm_approach_rate "undefined2" UWORD NO_COMPU_METHOD 0 0 0 65535 ECU_ADDRESS 0x400027E4 /end MEASUREMENT
/begin MEASUREMENT revlimit_flow_proportional_term "undefined2" UWORD NO_COMPU_METHOD 0 0 0 65535 ECU_ADDRESS 0x400027E6 /end MEASUREMENT
/begin MEASUREMENT revlimit_flow_integral_term "undefined2" UWORD NO_COMPU_METHOD 0 0 0 65535 ECU_ADDRESS 0x400027E8 /end MEASUREMENT
/begin MEASUREMENT revlimit_airflow_rpm_term "undefined2" UWORD NO_COMPU_METHOD 0 0 0 65535 ECU_ADDRESS 0x400027EA /end MEASUREMENT
/begin MEASUREMENT revlimit_flow_update_divider "Vehicle speed limit enforce timer (ms = val*5)." UBYTE CM_u8_time_5ms 0 0 0 1275 ECU_ADDRESS 0x400027EC /end MEASUREMENT
/begin MEASUREMENT revlimit_approach_rate_divider "Rev-limit RPM rate update timer." UBYTE NO_COMPU_METHOD 0 0 0 255 ECU_ADDRESS 0x400027ED /end MEASUREMENT
/begin MEASUREMENT revlimit_flow_base "undefined2" UWORD NO_COMPU_METHOD 0 0 0 65535 ECU_ADDRESS 0x400027EE /end MEASUREMENT
/begin MEASUREMENT revlimit_rpm_error_prev "u16_rspeed_rpm" UWORD CM_u16_rspeed_rpm 0 0 0 65535 ECU_ADDRESS 0x400027F0 /end MEASUREMENT
/begin MEASUREMENT revlimit_i_term_step "undefined2" UWORD NO_COMPU_METHOD 0 0 0 65535 ECU_ADDRESS 0x400027F2 /end MEASUREMENT
/begin MEASUREMENT rpm_speed_estimated_clipped_tomax "undefined2" UWORD NO_COMPU_METHOD 0 0 0 65535 ECU_ADDRESS 0x400027F4 /end MEASUREMENT
/begin MEASUREMENT revlimit_trim_per_gear "Rev-limit trim per gear (RPM = val*2)." UBYTE CM_u8_rspeed_2rpm 0 0 0 510 ECU_ADDRESS 0x400027F6 /end MEASUREMENT
/begin MEASUREMENT revlimit_timer_ticks_past_limit "Rev-limit timer ticks past limit (ms = val*5)." UWORD CM_u8_time_5ms 0 0 0 327675 ECU_ADDRESS 0x400027F8 /end MEASUREMENT
/begin MEASUREMENT revlimit_airflow_threshold "Rev-limit airflow threshold (g/s = val*2)." UBYTE CM_u8_flow_2g_s 0 0 0 510 ECU_ADDRESS 0x400027FA /end MEASUREMENT
/begin MEASUREMENT revlimit_max "undefined2" UWORD NO_COMPU_METHOD 0 0 0 65535 ECU_ADDRESS 0x400027FC /end MEASUREMENT
/begin MEASUREMENT rpm_speed_estimated "undefined2" UWORD NO_COMPU_METHOD 0 0 0 65535 ECU_ADDRESS 0x400027FE /end MEASUREMENT
/begin MEASUREMENT revlimit_startup_offset "undefined2" UWORD NO_COMPU_METHOD 0 0 0 65535 ECU_ADDRESS 0x40002800 /end MEASUREMENT
/begin MEASUREMENT revlimit_startup_max_offset "Rev-limit startup maximum offset (RPM)." UWORD CM_u16_rspeed_rpm 0 0 0 65535 ECU_ADDRESS 0x40002802 /end MEASUREMENT
/begin MEASUREMENT revlimit_active_gear_ips "undefined1" UBYTE NO_COMPU_METHOD 0 0 0 255 ECU_ADDRESS 0x40002804 /end MEASUREMENT
/begin MEASUREMENT revlimit_coldstart_rpm_envelope_min "Rev-limit coldstart RPM envelope minimum (RPM)." UWORD CM_u16_rspeed_rpm 0 0 0 65535 ECU_ADDRESS 0x40002806 /end MEASUREMENT
/begin MEASUREMENT revlimit_coldstart_rpm_envelope_max "Rev-limit coldstart RPM envelope maximum (RPM)." UWORD CM_u16_rspeed_rpm 0 0 0 65535 ECU_ADDRESS 0x40002808 /end MEASUREMENT
/begin MEASUREMENT revlimit_esclated_timer "Rev-limit esclated timer (ms = val*5)." UBYTE CM_u8_time_5ms 0 0 0 1275 ECU_ADDRESS 0x4000280A /end MEASUREMENT
/begin MEASUREMENT tcu_can_status_flags "undefined2" UWORD NO_COMPU_METHOD 0 0 0 65535 ECU_ADDRESS 0x40002816 /end MEASUREMENT
/begin MEASUREMENT abs_esp_can_torque_request_flags "undefined2" UWORD NO_COMPU_METHOD 0 0 0 65535 ECU_ADDRESS 0x40002818 /end MEASUREMENT
/begin MEASUREMENT tc_enable_condition_1 "Traction control enable condition 1 (boolean flag)." UBYTE NO_COMPU_METHOD 0 0 0 255 ECU_ADDRESS 0x4000281C /end MEASUREMENT
/begin MEASUREMENT tc_enable_condition_2 "Traction control enable condition 2 (boolean flag)." UBYTE NO_COMPU_METHOD 0 0 0 255 ECU_ADDRESS 0x4000281D /end MEASUREMENT
/begin MEASUREMENT ips_cal_version_received "undefined1" UBYTE NO_COMPU_METHOD 0 0 0 255 ECU_ADDRESS 0x4000281E /end MEASUREMENT
/begin MEASUREMENT can_b7_failure_counter "undefined1" UBYTE NO_COMPU_METHOD 0 0 0 255 ECU_ADDRESS 0x40002820 /end MEASUREMENT
/begin MEASUREMENT engine_power_corrected "Engine power corrected (kW = val/100)." UWORD CM_u16_power_1_100kw 0 0 0 655.35 ECU_ADDRESS 0x40002848 /end MEASUREMENT
/begin MEASUREMENT tc_cornering_intensity_ "Traction control cornering intensity (val/255)." UBYTE CM_u8_factor_1_255 0 0 0 100 ECU_ADDRESS 0x4000284A /end MEASUREMENT
/begin MEASUREMENT traction_power_based_rpm_threshold "Traction power based RPM threshold (RPM)." UWORD CM_u16_rspeed_rpm 0 0 0 65535 ECU_ADDRESS 0x4000284C /end MEASUREMENT
/begin MEASUREMENT traction_relax_factor_starting "Traction relax factor starting." UWORD NO_COMPU_METHOD 0 0 0 65535 ECU_ADDRESS 0x4000284E /end MEASUREMENT
/begin MEASUREMENT traction_slip_detected_gear "undefined1" UBYTE NO_COMPU_METHOD 0 0 0 255 ECU_ADDRESS 0x40002850 /end MEASUREMENT
/begin MEASUREMENT traction_power_limit_gear "undefined1" UBYTE NO_COMPU_METHOD 0 0 0 255 ECU_ADDRESS 0x40002851 /end MEASUREMENT
/begin MEASUREMENT tc_is_moving "Traction control is moving (boolean flag)." UBYTE NO_COMPU_METHOD 0 0 0 255 ECU_ADDRESS 0x40002852 /end MEASUREMENT
/begin MEASUREMENT steering_angle_abs_last "Steering angle ABS last (° = val/10)." UWORD CM_u16_angle_1_10deg 0 0 0 6553.5 ECU_ADDRESS 0x40002854 /end MEASUREMENT
/begin MEASUREMENT steering_angle_smoothed "undefined4" ULONG NO_COMPU_METHOD 0 0 0 4294967295 ECU_ADDRESS 0x40002858 /end MEASUREMENT
/begin MEASUREMENT steering_angle_delta "Steering angle delta (° = val/10)." UWORD CM_u16_angle_1_10deg 0 0 0 6553.5 ECU_ADDRESS 0x4000285C /end MEASUREMENT
/begin MEASUREMENT traction_steering_increase_factor "Traction steering increase factor (val/255)." UBYTE CM_u8_factor_1_255 0 0 0 100 ECU_ADDRESS 0x4000285E /end MEASUREMENT
/begin MEASUREMENT slip_gear_change_holdoff_timer "u8_time_100ms" UBYTE CM_u8_time_100ms 0 0 0 25500 ECU_ADDRESS 0x4000285F /end MEASUREMENT
/begin MEASUREMENT traction_inhibit_accel_pedal_timer "Traction inhibit accelerator pedal timer (ms = val*100)." UBYTE CM_u8_time_100ms 0 0 0 25500 ECU_ADDRESS 0x40002860 /end MEASUREMENT
/begin MEASUREMENT gsi_downshift_advisory_timer "u8_time_100ms" UBYTE CM_u8_time_100ms 0 0 0 25500 ECU_ADDRESS 0x40002861 /end MEASUREMENT
/begin MEASUREMENT traction_timer_per_gear_intervention "Traction timer per gear intervention (ms = val*100)." UBYTE CM_u8_time_100ms 0 0 0 25500 ECU_ADDRESS 0x40002862 /end MEASUREMENT
/begin MEASUREMENT tc_gear_tracker "undefined1" UBYTE NO_COMPU_METHOD 0 0 0 255 ECU_ADDRESS 0x4000286A /end MEASUREMENT
/begin MEASUREMENT traction_control_gear_recommended_ "Traction control gear recommended??." UBYTE NO_COMPU_METHOD 0 0 0 255 ECU_ADDRESS 0x4000286B /end MEASUREMENT
/begin MEASUREMENT traction_flags_unknown "undefined1" UBYTE NO_COMPU_METHOD 0 0 0 255 ECU_ADDRESS 0x4000286C /end MEASUREMENT
/begin MEASUREMENT fuel_pump_crank_activity_timer "undefined2" UWORD NO_COMPU_METHOD 0 0 0 65535 ECU_ADDRESS 0x40002870 /end MEASUREMENT
/begin MEASUREMENT fuel_pressure_target_clamped "Fuel pressure target clamped (mbar = val*50)." UBYTE CM_u8_pressure_50mbar 0 0 0 12750 ECU_ADDRESS 0x40002872 /end MEASUREMENT
/begin MEASUREMENT inj_flow_required_or_estimated "undefined2" UWORD NO_COMPU_METHOD 0 0 0 65535 ECU_ADDRESS 0x40002874 /end MEASUREMENT
/begin MEASUREMENT fuel_pressure_state_flags "undefined1" UBYTE NO_COMPU_METHOD 0 0 0 255 ECU_ADDRESS 0x40002876 /end MEASUREMENT
/begin MEASUREMENT fuel_pump_dutycycle_commanded "Fuel pump dutycycle commanded (val/10000)." UWORD CM_u16_factor_1_10000 0 0 0 655.35 ECU_ADDRESS 0x40002878 /end MEASUREMENT
/begin MEASUREMENT fuel_pressure_lookup_relative "Fuel pressure lookup relative (mbar)." UWORD CM_u16_pressure_mbar 0 0 0 65535 ECU_ADDRESS 0x4000287A /end MEASUREMENT
/begin MEASUREMENT fuel_pump_state "undefined1" UBYTE NO_COMPU_METHOD 0 0 0 255 ECU_ADDRESS 0x4000287C /end MEASUREMENT
/begin MEASUREMENT fuel_pressure_pid_correction "undefined2" UWORD NO_COMPU_METHOD 0 0 0 65535 ECU_ADDRESS 0x4000287E /end MEASUREMENT
/begin MEASUREMENT fuel_pump_integral_update_countdown "undefined1" UBYTE NO_COMPU_METHOD 0 0 0 255 ECU_ADDRESS 0x40002880 /end MEASUREMENT
/begin MEASUREMENT fuel_pump_commanded_scaled "Fuel pump commanded scaled (val/10000)." UWORD CM_u16_factor_1_10000 0 0 0 655.35 ECU_ADDRESS 0x40002882 /end MEASUREMENT
/begin MEASUREMENT fuel_pump_prime_timer "undefined2" UWORD NO_COMPU_METHOD 0 0 0 65535 ECU_ADDRESS 0x4000288C /end MEASUREMENT
/begin MEASUREMENT fuel_pressure_target "Fuel pressure target (mbar = val*50)." UBYTE CM_u8_pressure_50mbar 0 0 0 12750 ECU_ADDRESS 0x4000289A /end MEASUREMENT
/begin MEASUREMENT fuel_pump_pwm_output "Fuel pump PWM output." UWORD NO_COMPU_METHOD 0 0 0 65535 ECU_ADDRESS 0x4000289C /end MEASUREMENT
/begin MEASUREMENT obd_ii_P0713_failure_count "undefined2" UWORD NO_COMPU_METHOD 0 0 0 65535 ECU_ADDRESS 0x400028B0 /end MEASUREMENT
/begin MEASUREMENT trans_fluid_pump_mode "undefined1" UBYTE NO_COMPU_METHOD 0 0 0 255 ECU_ADDRESS 0x400028BF /end MEASUREMENT
/begin MEASUREMENT trans_fluid_last "Transmission fluid last (°C = val*5/8−40)." UBYTE CM_u8_temp_5_8_40c 0 0 -40 119.375 ECU_ADDRESS 0x400028C0 /end MEASUREMENT
/begin MEASUREMENT trans_pump_condition_flags "undefined1" UBYTE NO_COMPU_METHOD 0 0 0 255 ECU_ADDRESS 0x400028C1 /end MEASUREMENT
/begin MEASUREMENT dpm_slip "Driver performance mode slip (% = val/8)." UWORD CM_u16_slip_1_8pct 0 0 0 8191.875 ECU_ADDRESS 0x400028C8 /end MEASUREMENT
/begin MEASUREMENT dpm_slip_target "Driver performance mode slip target (% = val/8)." UWORD CM_u16_slip_1_8pct 0 0 0 8191.875 ECU_ADDRESS 0x400028CA /end MEASUREMENT
/begin MEASUREMENT tc_slip_target_mode_state "undefined1" UBYTE NO_COMPU_METHOD 0 0 0 255 ECU_ADDRESS 0x400028CC /end MEASUREMENT
/begin MEASUREMENT dpm_slip_target_base "Driver performance mode clip target base (% = val/8)." UBYTE CM_u16_slip_1_8pct 0 0 0 31.875 ECU_ADDRESS 0x400028CD /end MEASUREMENT
/begin MEASUREMENT dpm_max_lr_speed_diff "Driver performance mode maximum lr speed diff (km/h = val/100)." UWORD CM_u8_speed_1_100kph 0 0 0 655.35 ECU_ADDRESS 0x400028CE /end MEASUREMENT
/begin MEASUREMENT dpm_slip_error_filtered "Driver performance mode slip error filtered (% = val/8)." UWORD CM_u16_slip_1_8pct 0 0 0 8191.875 ECU_ADDRESS 0x400028D0 /end MEASUREMENT
/begin MEASUREMENT dpm_min_activation_speed "Driver performance mode minimum activation speed (km/h)." UBYTE CM_u8_speed_kph 0 0 0 255 ECU_ADDRESS 0x400028D2 /end MEASUREMENT
/begin MEASUREMENT dpm_vehicle_speed_kph "Driver performance mode vehicle speed kph (km/h)." UBYTE CM_u8_speed_kph 0 0 0 255 ECU_ADDRESS 0x400028D3 /end MEASUREMENT
/begin MEASUREMENT dpm_cornering_detect_timer "Driver performance mode direct mode on delay (ms = val*5)." UWORD CM_u8_time_5ms 0 0 0 327675 ECU_ADDRESS 0x400028D4 /end MEASUREMENT
/begin MEASUREMENT dpm_cornering_release_timer "Driver performance mode direct mode off delay (ms = val*5)." UWORD CM_u8_time_5ms 0 0 0 327675 ECU_ADDRESS 0x400028D6 /end MEASUREMENT
/begin MEASUREMENT dpm_slip_error_raw "Driver performance mode slip error (% = val/8)." UWORD CM_u16_slip_1_8pct 0 0 0 8191.875 ECU_ADDRESS 0x400028D8 /end MEASUREMENT
/begin MEASUREMENT tc_inhibit_flags "undefined1" UBYTE NO_COMPU_METHOD 0 0 0 255 ECU_ADDRESS 0x400028DA /end MEASUREMENT
/begin MEASUREMENT dpm_front_axle_speed_max "Driver performance mode front axle speed maximum (km/h = val/100)." UWORD CM_u8_speed_1_100kph 0 0 0 655.35 ECU_ADDRESS 0x400028DC /end MEASUREMENT
/begin MEASUREMENT dpm_rear_axle_speed_max "Driver performance mode rear axle speed maximum (km/h = val/100)." UWORD CM_u8_speed_1_100kph 0 0 0 655.35 ECU_ADDRESS 0x400028DE /end MEASUREMENT
/begin MEASUREMENT dpm_front_lr_speed_diff "Driver performance mode front lr speed diff (km/h = val/100)." UWORD CM_u8_speed_1_100kph 0 0 0 655.35 ECU_ADDRESS 0x400028E0 /end MEASUREMENT
/begin MEASUREMENT dpm_rear_lr_speed_diff "Driver performance mode rear lr speed diff (km/h = val/100)." UWORD CM_u8_speed_1_100kph 0 0 0 655.35 ECU_ADDRESS 0x400028E2 /end MEASUREMENT
/begin MEASUREMENT dpm_slip_filter_accumulator "undefined4" ULONG NO_COMPU_METHOD 0 0 0 4294967295 ECU_ADDRESS 0x400028E4 /end MEASUREMENT
/begin MEASUREMENT dpm_integral_update_timer "Driver performance mode integral update timer (ms = val*5)." UWORD CM_u8_time_5ms 0 0 0 327675 ECU_ADDRESS 0x400028E8 /end MEASUREMENT
/begin MEASUREMENT dpm_torque_cut_fraction "Driver performance mode torque cut total (val/255)." UBYTE CM_u8_factor_1_255 0 0 0 100 ECU_ADDRESS 0x400028EA /end MEASUREMENT
/begin MEASUREMENT dpm_torque_cut_i_term "Driver performance mode torque cut accumulated (val/255)." UBYTE CM_u8_factor_1_255 0 0 0 100 ECU_ADDRESS 0x400028EB /end MEASUREMENT
/begin MEASUREMENT dpm_slip_integral_accumulator "undefined2" UWORD NO_COMPU_METHOD 0 0 0 65535 ECU_ADDRESS 0x400028EC /end MEASUREMENT
/begin MEASUREMENT dpm_torque_cut_p_term "u8_factor_1/255" UBYTE CM_u8_factor_1_255 0 0 0 100 ECU_ADDRESS 0x400028EE /end MEASUREMENT
/begin MEASUREMENT dpm_slip_target_from_pedal "Driver performance mode slip target base (% = val/8)." UWORD CM_u16_slip_1_8pct 0 0 0 8191.875 ECU_ADDRESS 0x400028F0 /end MEASUREMENT
/begin MEASUREMENT dpm_both_buttons_pressed "Driver performance mode both buttons pressed (boolean flag)." UBYTE NO_COMPU_METHOD 0 0 0 255 ECU_ADDRESS 0x400028F2 /end MEASUREMENT
/begin MEASUREMENT dpm_decrease_hold_time "Driver performance mode decrease hold time." UBYTE NO_COMPU_METHOD 0 0 0 255 ECU_ADDRESS 0x400028F3 /end MEASUREMENT
/begin MEASUREMENT dpm_increase_hold_time "Driver performance mode increase hold time." UBYTE NO_COMPU_METHOD 0 0 0 255 ECU_ADDRESS 0x400028F4 /end MEASUREMENT
/begin MEASUREMENT flash_driver_init "Flash driver init." ULONG NO_COMPU_METHOD 0 0 0 4294967295 ECU_ADDRESS 0x40002910 /end MEASUREMENT
/begin MEASUREMENT etpu_elapsed_ticks "undefined4" ULONG NO_COMPU_METHOD 0 0 0 4294967295 ECU_ADDRESS 0x40002EEC /end MEASUREMENT
/begin MEASUREMENT timer_main_start1 "undefined4" ULONG NO_COMPU_METHOD 0 0 0 4294967295 ECU_ADDRESS 0x40002EF0 /end MEASUREMENT
/begin MEASUREMENT timer_main3 "undefined4" ULONG NO_COMPU_METHOD 0 0 0 4294967295 ECU_ADDRESS 0x40002EF4 /end MEASUREMENT
/begin MEASUREMENT timing_main_loop_last "undefined4" ULONG NO_COMPU_METHOD 0 0 0 4294967295 ECU_ADDRESS 0x40002EF8 /end MEASUREMENT
/begin MEASUREMENT timing_main_loop_max "undefined4" ULONG NO_COMPU_METHOD 0 0 0 4294967295 ECU_ADDRESS 0x40002EFC /end MEASUREMENT
/begin MEASUREMENT timer_main_start1_40002F00 "undefined4" ULONG NO_COMPU_METHOD 0 0 0 4294967295 ECU_ADDRESS 0x40002F00 /end MEASUREMENT
/begin MEASUREMENT timer_main_start2_40002F04 "undefined4" ULONG NO_COMPU_METHOD 0 0 0 4294967295 ECU_ADDRESS 0x40002F04 /end MEASUREMENT
/begin MEASUREMENT timing_flexcan_diag_last "undefined4" ULONG NO_COMPU_METHOD 0 0 0 4294967295 ECU_ADDRESS 0x40002F08 /end MEASUREMENT
/begin MEASUREMENT timing_flexcan_diag_max "undefined4" ULONG NO_COMPU_METHOD 0 0 0 4294967295 ECU_ADDRESS 0x40002F0C /end MEASUREMENT
/begin MEASUREMENT etpu_elapsed_max_ticks "uint32_t" ULONG NO_COMPU_METHOD 0 0 0 4294967295 ECU_ADDRESS 0x40002F3C /end MEASUREMENT
/begin MEASUREMENT etpu_timestamp_load_filter_end "uint32_t" ULONG NO_COMPU_METHOD 0 0 0 4294967295 ECU_ADDRESS 0x40002F44 /end MEASUREMENT
/begin MEASUREMENT etpu_timestamp_current "uint32_t" ULONG NO_COMPU_METHOD 0 0 0 4294967295 ECU_ADDRESS 0x40002F6C /end MEASUREMENT
/begin MEASUREMENT etpu_timestamp_1000hz_task "uint32_t" ULONG NO_COMPU_METHOD 0 0 0 4294967295 ECU_ADDRESS 0x40002F74 /end MEASUREMENT
/begin MEASUREMENT etpu_timestamp_200hz_task "uint32_t" ULONG NO_COMPU_METHOD 0 0 0 4294967295 ECU_ADDRESS 0x40002F78 /end MEASUREMENT
/begin MEASUREMENT etpu_timestamp_last "uint32_t" ULONG NO_COMPU_METHOD 0 0 0 4294967295 ECU_ADDRESS 0x40002F9C /end MEASUREMENT
/begin MEASUREMENT tps_error_flags "undefined1" UBYTE NO_COMPU_METHOD 0 0 0 255 ECU_ADDRESS 0x40003021 /end MEASUREMENT
/begin MEASUREMENT cac_driver_status_spi "undefined1" UBYTE NO_COMPU_METHOD 0 0 0 255 ECU_ADDRESS 0x40003026 /end MEASUREMENT
/begin MEASUREMENT sport_button_toggle_state "uint8_t" UBYTE NO_COMPU_METHOD 0 0 0 255 ECU_ADDRESS 0x40003043 /end MEASUREMENT
/begin MEASUREMENT brake_pedal_switch_state_always_zero_ "Brake pedal switch state always zero? (boolean flag)." UBYTE NO_COMPU_METHOD 0 0 0 255 ECU_ADDRESS 0x40003044 /end MEASUREMENT
/begin MEASUREMENT tc_button_toggle_state "uint8_t" UBYTE NO_COMPU_METHOD 0 0 0 255 ECU_ADDRESS 0x40003046 /end MEASUREMENT
/begin MEASUREMENT trans_cooling_pump_enabled "Transmission cooling pump enabled (boolean flag)." UBYTE NO_COMPU_METHOD 0 0 0 255 ECU_ADDRESS 0x4000304A /end MEASUREMENT
/begin MEASUREMENT dpm_button_increase "Driver performance mode button increase (boolean flag)." UBYTE NO_COMPU_METHOD 0 0 0 255 ECU_ADDRESS 0x4000304B /end MEASUREMENT
/begin MEASUREMENT exahust_override_switch_status "uint8_t" UBYTE NO_COMPU_METHOD 0 0 0 255 ECU_ADDRESS 0x4000304C /end MEASUREMENT
/begin MEASUREMENT dpm_button_decrease "Driver performance mode button decrease (boolean flag)." UBYTE NO_COMPU_METHOD 0 0 0 255 ECU_ADDRESS 0x4000304D /end MEASUREMENT
/begin MEASUREMENT ign_torque_margin_cyl1 "i16_angle_1/4deg" SWORD CM_u8_angle_1_4deg 0 0 -8192 8191.75 ECU_ADDRESS 0x4000305E /end MEASUREMENT
/begin MEASUREMENT ign_torque_margin_cyl2 "i16_angle_1/4deg" SWORD CM_u8_angle_1_4deg 0 0 -8192 8191.75 ECU_ADDRESS 0x40003060 /end MEASUREMENT
/begin MEASUREMENT ign_torque_margin_cyl3 "i16_angle_1/4deg" SWORD CM_u8_angle_1_4deg 0 0 -8192 8191.75 ECU_ADDRESS 0x40003062 /end MEASUREMENT
/begin MEASUREMENT ign_torque_margin_cyl4 "i16_angle_1/4deg" SWORD CM_u8_angle_1_4deg 0 0 -8192 8191.75 ECU_ADDRESS 0x40003064 /end MEASUREMENT
/begin MEASUREMENT ign_torque_margin_cyl5 "i16_angle_1/4deg" SWORD CM_u8_angle_1_4deg 0 0 -8192 8191.75 ECU_ADDRESS 0x40003066 /end MEASUREMENT
/begin MEASUREMENT LEA_fuel_learn_zone_2_bank1 "undefined1" UBYTE NO_COMPU_METHOD 0 0 0 255 ECU_ADDRESS 0x40003478 /end MEASUREMENT
/begin MEASUREMENT obd_ii_fuel_learn_zone_3_bank1 "undefined1" UBYTE NO_COMPU_METHOD 0 0 0 255 ECU_ADDRESS 0x40003479 /end MEASUREMENT
/begin MEASUREMENT LEA_fuel_learn_zone_2_bank2 "undefined1" UBYTE NO_COMPU_METHOD 0 0 0 255 ECU_ADDRESS 0x4000347A /end MEASUREMENT
/begin MEASUREMENT obd_ii_fuel_learn_zone_3_bank2 "undefined1" UBYTE NO_COMPU_METHOD 0 0 0 255 ECU_ADDRESS 0x4000347B /end MEASUREMENT
/begin MEASUREMENT LEA_fuel_learn_lean_time_bank1 "Learned/adaptive value: fuel learn lean time bank1 (µs)." SWORD CM_u16_time_us 0 0 -32768 32767 ECU_ADDRESS 0x40003488 /end MEASUREMENT
/begin MEASUREMENT LEA_fuel_learn_lean_time_bank2 "Learned/adaptive value: fuel learn lean time bank2 (µs)." SWORD CM_u16_time_us 0 0 -32768 32767 ECU_ADDRESS 0x4000348A /end MEASUREMENT
/begin MEASUREMENT LEA_obd_ii_idle_learn "OBD-II: idle learn." UWORD CM_u16_flow_10mg_s 0 0 0 655350 ECU_ADDRESS 0x4000378C /end MEASUREMENT
/begin MEASUREMENT LEA_idle_learn_ac_on "Learned/adaptive value: idle learn A/C on." UWORD CM_u16_flow_10mg_s 0 0 0 655350 ECU_ADDRESS 0x4000378E /end MEASUREMENT
/begin MEASUREMENT LEA_fuel_learn_lean_time_bank1_40003B98 "undefined2" UWORD NO_COMPU_METHOD 0 0 0 65535 ECU_ADDRESS 0x40003B98 /end MEASUREMENT
/begin MEASUREMENT LEA_fuel_learn_lean_time_bank2_40003B9A "undefined2" UWORD NO_COMPU_METHOD 0 0 0 65535 ECU_ADDRESS 0x40003B9A /end MEASUREMENT
/begin MEASUREMENT LEA_idle_cold_learning_coolant "Learned/adaptive value: idle cold learning coolant." UWORD NO_COMPU_METHOD 0 0 0 65535 ECU_ADDRESS 0x40003B9C /end MEASUREMENT
/begin MEASUREMENT LEA_idle_cold_learning_coolant_ac_on "Learned/adaptive value: idle cold learning coolant A/C on." UWORD CM_u16_flow_10mg_s 0 0 0 655350 ECU_ADDRESS 0x40003B9E /end MEASUREMENT
/begin MEASUREMENT engine_run_timer_total "Engine run timer total (ms = val*100)." ULONG CM_u8_time_100ms 0 0 0 429496729500 ECU_ADDRESS 0x40003F10 /end MEASUREMENT
/begin MEASUREMENT LEA_perf_stat_sentinel_max1 "undefined1" UBYTE NO_COMPU_METHOD 0 0 0 255 ECU_ADDRESS 0x40003F14 /end MEASUREMENT
/begin MEASUREMENT LEA_perf_stat_sentinel_max2 "undefined1" UBYTE NO_COMPU_METHOD 0 0 0 255 ECU_ADDRESS 0x40003F15 /end MEASUREMENT
/begin MEASUREMENT LEA_obd_ii_last_standing_start_0_100kmh "undefined1" UBYTE NO_COMPU_METHOD 0 0 0 255 ECU_ADDRESS 0x40003F16 /end MEASUREMENT
/begin MEASUREMENT LEA_obd_ii_last_standing_start_0_160kmh "undefined1" UBYTE NO_COMPU_METHOD 0 0 0 255 ECU_ADDRESS 0x40003F17 /end MEASUREMENT
/begin MEASUREMENT LEA_number_standing_starts "undefined2" UWORD NO_COMPU_METHOD 0 0 0 65535 ECU_ADDRESS 0x40003F18 /end MEASUREMENT
/begin MEASUREMENT LEA_perf_stat_gear1_lo "u8_temp_5/8-40c" UBYTE CM_u8_temp_5_8_40c 0 0 -40 119.375 ECU_ADDRESS 0x40003F26 /end MEASUREMENT
/begin MEASUREMENT LEA_perf_stat_gear1_val "u32_time_100ms" ULONG CM_u8_time_100ms 0 0 0 429496729500 ECU_ADDRESS 0x40003F28 /end MEASUREMENT
/begin MEASUREMENT LEA_perf_stat_gear2_hi "u16_rspeed_rpm" UWORD CM_u16_rspeed_rpm 0 0 0 65535 ECU_ADDRESS 0x40003F2C /end MEASUREMENT
/begin MEASUREMENT LEA_perf_stat_gear2_val "u32_time_100ms" ULONG CM_u8_time_100ms 0 0 0 429496729500 ECU_ADDRESS 0x40003F30 /end MEASUREMENT
/begin MEASUREMENT LEA_tps_fault_ff_engine_runtime "undefined4" ULONG NO_COMPU_METHOD 0 0 0 4294967295 ECU_ADDRESS 0x40003F4C /end MEASUREMENT
/begin MEASUREMENT LEA_perf_stat_extra2 "undefined4" ULONG NO_COMPU_METHOD 0 0 0 4294967295 ECU_ADDRESS 0x40003F50 /end MEASUREMENT
/begin MEASUREMENT LEA_tps_fault_bank1_data "undefined2" UWORD NO_COMPU_METHOD 0 0 0 65535 ECU_ADDRESS 0x40003F54 /end MEASUREMENT
/begin MEASUREMENT LEA_tps_fault_trim_data "undefined2" UWORD NO_COMPU_METHOD 0 0 0 65535 ECU_ADDRESS 0x40004014 /end MEASUREMENT
/begin MEASUREMENT LEA_tps_fault_ff_ecu_runtime "undefined2" UWORD NO_COMPU_METHOD 0 0 0 65535 ECU_ADDRESS 0x40004054 /end MEASUREMENT
/begin MEASUREMENT LEA_tps_fault_ff_ecu_voltage "undefined2" UWORD NO_COMPU_METHOD 0 0 0 65535 ECU_ADDRESS 0x40004056 /end MEASUREMENT
/begin MEASUREMENT LEA_tps_calib_retry_count "undefined2" UWORD NO_COMPU_METHOD 0 0 0 65535 ECU_ADDRESS 0x4000405A /end MEASUREMENT
/begin MEASUREMENT LEA_tps_fault_event_count "undefined2" UWORD NO_COMPU_METHOD 0 0 0 65535 ECU_ADDRESS 0x4000405C /end MEASUREMENT
/begin MEASUREMENT LEA_tps_fault_recovery_count "undefined2" UWORD NO_COMPU_METHOD 0 0 0 65535 ECU_ADDRESS 0x4000405E /end MEASUREMENT
/begin MEASUREMENT LEA_tps_calib_pass_first_attempt "undefined2" UWORD NO_COMPU_METHOD 0 0 0 65535 ECU_ADDRESS 0x40004062 /end MEASUREMENT
/begin MEASUREMENT LEA_learned_flags_0E4E "undefined1" UBYTE NO_COMPU_METHOD 0 0 0 255 ECU_ADDRESS 0x40004066 /end MEASUREMENT
/begin MEASUREMENT LEA_learned_flags_0E4F "undefined1" UBYTE NO_COMPU_METHOD 0 0 0 255 ECU_ADDRESS 0x40004067 /end MEASUREMENT
/begin MEASUREMENT total_num_low_oil_pres_events "Total num low oil pres events." UBYTE NO_COMPU_METHOD 0 0 0 255 ECU_ADDRESS 0x40004068 /end MEASUREMENT
/begin MEASUREMENT LEA_perf_struct_A_byte0 "undefined1" UBYTE NO_COMPU_METHOD 0 0 0 255 ECU_ADDRESS 0x40004084 /end MEASUREMENT
/begin MEASUREMENT LEA_perf_struct_A_byte1 "undefined1" UBYTE NO_COMPU_METHOD 0 0 0 255 ECU_ADDRESS 0x40004085 /end MEASUREMENT
/begin MEASUREMENT LEA_perf_struct_A_word0 "undefined2" UWORD NO_COMPU_METHOD 0 0 0 65535 ECU_ADDRESS 0x40004086 /end MEASUREMENT
/begin MEASUREMENT LEA_perf_struct_A_word1 "undefined2" UWORD NO_COMPU_METHOD 0 0 0 65535 ECU_ADDRESS 0x40004088 /end MEASUREMENT
/begin MEASUREMENT LEA_perf_struct_A_dword "undefined4" ULONG NO_COMPU_METHOD 0 0 0 4294967295 ECU_ADDRESS 0x4000408C /end MEASUREMENT
/begin MEASUREMENT LEA_perf_struct_B_byte0 "undefined4" ULONG NO_COMPU_METHOD 0 0 0 4294967295 ECU_ADDRESS 0x40004090 /end MEASUREMENT
/begin MEASUREMENT LEA_perf_struct_B_word1 "undefined4" ULONG NO_COMPU_METHOD 0 0 0 4294967295 ECU_ADDRESS 0x40004094 /end MEASUREMENT
/begin MEASUREMENT LEA_perf_struct_B_dword "undefined4" ULONG NO_COMPU_METHOD 0 0 0 4294967295 ECU_ADDRESS 0x40004098 /end MEASUREMENT
/begin MEASUREMENT LEA_perf_struct_A_b_byte0 "undefined1" UBYTE NO_COMPU_METHOD 0 0 0 255 ECU_ADDRESS 0x400040A8 /end MEASUREMENT
/begin MEASUREMENT LEA_perf_struct_A_b_byte1 "u8_speed_kph" UBYTE CM_u8_speed_kph 0 0 0 255 ECU_ADDRESS 0x400040A9 /end MEASUREMENT
/begin MEASUREMENT LEA_perf_struct_A_b_word0 "u16_rspeed_rpm" UWORD CM_u16_rspeed_rpm 0 0 0 65535 ECU_ADDRESS 0x400040AA /end MEASUREMENT
/begin MEASUREMENT LEA_perf_struct_A_b_word1 "undefined2" UWORD NO_COMPU_METHOD 0 0 0 65535 ECU_ADDRESS 0x400040AC /end MEASUREMENT
/begin MEASUREMENT LEA_perf_struct_A_b_dword "undefined4" ULONG NO_COMPU_METHOD 0 0 0 4294967295 ECU_ADDRESS 0x400040B0 /end MEASUREMENT
/begin MEASUREMENT LEA_perf_struct_B_b_byte0 "undefined4" ULONG NO_COMPU_METHOD 0 0 0 4294967295 ECU_ADDRESS 0x400040B4 /end MEASUREMENT
/begin MEASUREMENT LEA_perf_struct_B_b_word1 "undefined4" ULONG NO_COMPU_METHOD 0 0 0 4294967295 ECU_ADDRESS 0x400040B8 /end MEASUREMENT
/begin MEASUREMENT LEA_perf_struct_B_b_dword "undefined4" ULONG NO_COMPU_METHOD 0 0 0 4294967295 ECU_ADDRESS 0x400040BC /end MEASUREMENT
/begin MEASUREMENT LEA_tps_both_sensors_invalid_count "undefined2" UWORD NO_COMPU_METHOD 0 0 0 65535 ECU_ADDRESS 0x400040CC /end MEASUREMENT
/begin MEASUREMENT car_distance_accum_unknown "undefined4" ULONG NO_COMPU_METHOD 0 0 0 4294967295 ECU_ADDRESS 0x400040D0 /end MEASUREMENT
/begin MEASUREMENT engine_breakin_distance_complete "Engine breakin distance complete (boolean flag)." UBYTE NO_COMPU_METHOD 0 0 0 255 ECU_ADDRESS 0x400040D4 /end MEASUREMENT
/begin MEASUREMENT lea_cal_version_stamp "undefined2" UWORD NO_COMPU_METHOD 0 0 0 65535 ECU_ADDRESS 0x4000471A /end MEASUREMENT
/begin MEASUREMENT lea_base_size "undefined4" ULONG NO_COMPU_METHOD 0 0 0 4294967295 ECU_ADDRESS 0x4000471C /end MEASUREMENT
/begin MEASUREMENT lea_crc_core "undefined4" ULONG NO_COMPU_METHOD 0 0 0 4294967295 ECU_ADDRESS 0x40004720 /end MEASUREMENT
/begin MEASUREMENT LEA_obd_iumpr_denominator "undefined2" UWORD NO_COMPU_METHOD 0 0 0 65535 ECU_ADDRESS 0x40004724 /end MEASUREMENT
/begin MEASUREMENT LEA_obd_iumpr_numerator "undefined2" UWORD NO_COMPU_METHOD 0 0 0 65535 ECU_ADDRESS 0x4000474A /end MEASUREMENT
/begin MEASUREMENT LEA_obd_ii_J1979_IGN_CNTR "Learned/adaptive value: OBD-II J1979 ignition CNTR." UWORD NO_COMPU_METHOD 0 0 0 65535 ECU_ADDRESS 0x40004770 /end MEASUREMENT
/begin MEASUREMENT LEA_obd_ii_J1979_OBDCOND "Learned/adaptive value: OBD-II J1979 OBDCOND." UWORD NO_COMPU_METHOD 0 0 0 65535 ECU_ADDRESS 0x40004772 /end MEASUREMENT
/begin MEASUREMENT LEA_obd_monitor_01 "undefined2" UWORD NO_COMPU_METHOD 0 0 0 65535 ECU_ADDRESS 0x40004774 /end MEASUREMENT
/begin MEASUREMENT LEA_obd_monitor_02 "undefined2" UWORD NO_COMPU_METHOD 0 0 0 65535 ECU_ADDRESS 0x40004788 /end MEASUREMENT
/begin MEASUREMENT LEA_obd_monitor_04 "undefined2" UWORD NO_COMPU_METHOD 0 0 0 65535 ECU_ADDRESS 0x400047B0 /end MEASUREMENT
/begin MEASUREMENT LEA_obd_monitor_flag_A "undefined2" UWORD NO_COMPU_METHOD 0 0 0 65535 ECU_ADDRESS 0x400047C4 /end MEASUREMENT
/begin MEASUREMENT LEA_obd_monitor_flag_B "undefined2" UWORD NO_COMPU_METHOD 0 0 0 65535 ECU_ADDRESS 0x400047C6 /end MEASUREMENT
/begin MEASUREMENT LEA_obd_monitor_flag_C "undefined2" UWORD NO_COMPU_METHOD 0 0 0 65535 ECU_ADDRESS 0x400047C8 /end MEASUREMENT
/begin MEASUREMENT LEA_obd_monitor_flag_D "undefined2" UWORD NO_COMPU_METHOD 0 0 0 65535 ECU_ADDRESS 0x400047CA /end MEASUREMENT
/begin MEASUREMENT LEA_obd_monitor_flag_E "undefined2" UWORD NO_COMPU_METHOD 0 0 0 65535 ECU_ADDRESS 0x400047CC /end MEASUREMENT
/begin MEASUREMENT LEA_obd_monitor_flag_F "undefined2" UWORD NO_COMPU_METHOD 0 0 0 65535 ECU_ADDRESS 0x400047CE /end MEASUREMENT
/begin MEASUREMENT LEA_obd_monitor_flag_G "undefined2" UWORD NO_COMPU_METHOD 0 0 0 65535 ECU_ADDRESS 0x400047D0 /end MEASUREMENT
/begin MEASUREMENT LEA_obd_monitor_flag_H "undefined2" UWORD NO_COMPU_METHOD 0 0 0 65535 ECU_ADDRESS 0x400047D2 /end MEASUREMENT
/begin MEASUREMENT LEA_obd_monitor_05 "undefined2" UWORD NO_COMPU_METHOD 0 0 0 65535 ECU_ADDRESS 0x400047D4 /end MEASUREMENT
/begin MEASUREMENT LEA_obd_monitor_06 "undefined2" UWORD NO_COMPU_METHOD 0 0 0 65535 ECU_ADDRESS 0x400047E8 /end MEASUREMENT
/begin MEASUREMENT LEA_obd_monitor_07 "undefined2" UWORD NO_COMPU_METHOD 0 0 0 65535 ECU_ADDRESS 0x400047FC /end MEASUREMENT
/begin MEASUREMENT LEA_obd_monitor_08 "undefined2" UWORD NO_COMPU_METHOD 0 0 0 65535 ECU_ADDRESS 0x40004810 /end MEASUREMENT
/begin MEASUREMENT LEA_obd_monitor_09 "undefined2" UWORD NO_COMPU_METHOD 0 0 0 65535 ECU_ADDRESS 0x40004824 /end MEASUREMENT
/begin MEASUREMENT LEA_obd_monitor_10 "undefined2" UWORD NO_COMPU_METHOD 0 0 0 65535 ECU_ADDRESS 0x40004838 /end MEASUREMENT
/begin MEASUREMENT LEA_obd_monitor_11 "undefined2" UWORD NO_COMPU_METHOD 0 0 0 65535 ECU_ADDRESS 0x4000484C /end MEASUREMENT
/begin MEASUREMENT LEA_obd_monitor_12 "undefined2" UWORD NO_COMPU_METHOD 0 0 0 65535 ECU_ADDRESS 0x40004860 /end MEASUREMENT
/begin MEASUREMENT LEA_obd_monitor_13 "undefined2" UWORD NO_COMPU_METHOD 0 0 0 65535 ECU_ADDRESS 0x40004874 /end MEASUREMENT
/begin MEASUREMENT LEA_obd_monitor_14 "undefined2" UWORD NO_COMPU_METHOD 0 0 0 65535 ECU_ADDRESS 0x40004888 /end MEASUREMENT
/begin MEASUREMENT LEA_obd_monitor_sentinel "undefined1" UBYTE NO_COMPU_METHOD 0 0 0 255 ECU_ADDRESS 0x4000489C /end MEASUREMENT
/begin MEASUREMENT LEA_tps_track_a_closed_count "undefined2" UWORD NO_COMPU_METHOD 0 0 0 65535 ECU_ADDRESS 0x4000489E /end MEASUREMENT
/begin MEASUREMENT LEA_hc08_sf_mode_event_count "undefined1" UBYTE NO_COMPU_METHOD 0 0 0 255 ECU_ADDRESS 0x400048A6 /end MEASUREMENT
/begin MEASUREMENT LEA_hc08_sf_mode_max_duration "undefined2" UWORD NO_COMPU_METHOD 0 0 0 65535 ECU_ADDRESS 0x400048A8 /end MEASUREMENT
/begin MEASUREMENT LEA_cod_changed "Learned/adaptive value: cod changed (boolean flag)." UBYTE NO_COMPU_METHOD 0 0 0 255 ECU_ADDRESS 0x400048AA /end MEASUREMENT
/begin MEASUREMENT obd_ii_DTC_causing_FF "undefined2" UWORD NO_COMPU_METHOD 0 0 0 65535 ECU_ADDRESS 0x400048EE /end MEASUREMENT
/begin MEASUREMENT obd_FF_fuel_system_status "undefined2" UWORD NO_COMPU_METHOD 0 0 0 65535 ECU_ADDRESS 0x400048F2 /end MEASUREMENT
/begin MEASUREMENT obd_FF_engine_speed "undefined2" UWORD NO_COMPU_METHOD 0 0 0 65535 ECU_ADDRESS 0x400048FC /end MEASUREMENT
/begin MEASUREMENT obd_FF_car_speed "undefined1" UBYTE NO_COMPU_METHOD 0 0 0 255 ECU_ADDRESS 0x400048FE /end MEASUREMENT
/begin MEASUREMENT obd_FF_ign_advance "undefined1" UBYTE NO_COMPU_METHOD 0 0 0 255 ECU_ADDRESS 0x400048FF /end MEASUREMENT
/begin MEASUREMENT obd_FF_iat "undefined1" UBYTE NO_COMPU_METHOD 0 0 0 255 ECU_ADDRESS 0x40004900 /end MEASUREMENT
/begin MEASUREMENT obd_FF_maf_flow_1 "undefined2" UWORD NO_COMPU_METHOD 0 0 0 65535 ECU_ADDRESS 0x40004902 /end MEASUREMENT
/begin MEASUREMENT obd_FF_tps_x4 "undefined1" UBYTE NO_COMPU_METHOD 0 0 0 255 ECU_ADDRESS 0x40004904 /end MEASUREMENT
/begin MEASUREMENT obd_FF_runtime_since_start "undefined2" UWORD NO_COMPU_METHOD 0 0 0 65535 ECU_ADDRESS 0x40004906 /end MEASUREMENT
/begin MEASUREMENT obd_ff_commanded_evap_purge "undefined1" UBYTE NO_COMPU_METHOD 0 0 0 255 ECU_ADDRESS 0x40004908 /end MEASUREMENT
/begin MEASUREMENT obd_FF_fuel_level "undefined1" UBYTE NO_COMPU_METHOD 0 0 0 255 ECU_ADDRESS 0x40004909 /end MEASUREMENT
/begin MEASUREMENT obd_FF_atmo_pressure "undefined1" UBYTE NO_COMPU_METHOD 0 0 0 255 ECU_ADDRESS 0x4000490A /end MEASUREMENT
/begin MEASUREMENT obd_FF_ecu_voltage "undefined2" UWORD NO_COMPU_METHOD 0 0 0 65535 ECU_ADDRESS 0x4000490C /end MEASUREMENT
/begin MEASUREMENT obd_FF_load_abs_percentage "undefined2" UWORD NO_COMPU_METHOD 0 0 0 65535 ECU_ADDRESS 0x4000490E /end MEASUREMENT
/begin MEASUREMENT obd_FF_afr_commanded "undefined2" UWORD NO_COMPU_METHOD 0 0 0 65535 ECU_ADDRESS 0x40004910 /end MEASUREMENT
/begin MEASUREMENT obd_ii_FF_accelerator_pos_d "undefined1" UBYTE NO_COMPU_METHOD 0 0 0 255 ECU_ADDRESS 0x40004915 /end MEASUREMENT
/begin MEASUREMENT obd_ii_FF_accelerator_pos_e "undefined1" UBYTE NO_COMPU_METHOD 0 0 0 255 ECU_ADDRESS 0x40004916 /end MEASUREMENT
/begin MEASUREMENT obd_ii_FF_throttle_target_pos "undefined1" UBYTE NO_COMPU_METHOD 0 0 0 255 ECU_ADDRESS 0x40004917 /end MEASUREMENT
/begin MEASUREMENT obd_ii_FF_chargecooler_temp "undefined1" UBYTE NO_COMPU_METHOD 0 0 0 255 ECU_ADDRESS 0x40004918 /end MEASUREMENT
/begin MEASUREMENT obd_ii_engine_tests_completeness "undefined1" UBYTE NO_COMPU_METHOD 0 0 0 255 ECU_ADDRESS 0x40004949 /end MEASUREMENT
/begin MEASUREMENT obd_ii_car_speed_freeze_frame "undefined2" UWORD NO_COMPU_METHOD 0 0 0 65535 ECU_ADDRESS 0x4000494C /end MEASUREMENT
/begin MEASUREMENT obd_ii_maf_flow_freeze_frame "undefined2" UWORD NO_COMPU_METHOD 0 0 0 65535 ECU_ADDRESS 0x4000494E /end MEASUREMENT
/begin MEASUREMENT obd_ii_car_speed_FF__ "undefined1" UBYTE NO_COMPU_METHOD 0 0 0 255 ECU_ADDRESS 0x4000496C /end MEASUREMENT
/begin MEASUREMENT obd_ii_distance_traveled_with_MIL "OBD-II: distance traveled with MIL." ULONG NO_COMPU_METHOD 0 0 0 4294967295 ECU_ADDRESS 0x40004970 /end MEASUREMENT
/begin MEASUREMENT obd_ii_warmups_since_code_cleared "OBD-II: warmups since code cleared." UBYTE NO_COMPU_METHOD 0 0 0 255 ECU_ADDRESS 0x40004974 /end MEASUREMENT
/begin MEASUREMENT obd_ii_distance_since_codes_cleared_km "OBD-II: distance since codes cleared km (km)." UWORD CM_u16_distance_km 0 0 0 65535 ECU_ADDRESS 0x40004976 /end MEASUREMENT
/begin MEASUREMENT evap_p0441_test_result_pressure "undefined2" UWORD NO_COMPU_METHOD 0 0 0 65535 ECU_ADDRESS 0x400049A2 /end MEASUREMENT
/begin MEASUREMENT lea_misfire_baseline_set "undefined1" UBYTE NO_COMPU_METHOD 0 0 0 255 ECU_ADDRESS 0x400049C0 /end MEASUREMENT
/begin MEASUREMENT fuel_system_diagnostic2_ "undefined2" UWORD NO_COMPU_METHOD 0 0 0 65535 ECU_ADDRESS 0x400049F4 /end MEASUREMENT
/begin MEASUREMENT fuel_system_diagnostic "undefined1" UBYTE NO_COMPU_METHOD 0 0 0 255 ECU_ADDRESS 0x400049F6 /end MEASUREMENT
/begin MEASUREMENT fuel_usage_running_total_avg_trip "undefined4" ULONG NO_COMPU_METHOD 0 0 0 4294967295 ECU_ADDRESS 0x400049F8 /end MEASUREMENT
/begin MEASUREMENT car_speed_running_total_avg_trip "Car speed running total avg trip (km = val/112500)." ULONG CM_u32_distance_1_112500km 0 0 0 38177.4870666667 ECU_ADDRESS 0x400049FC /end MEASUREMENT
/begin MEASUREMENT fuel_usage_running_total_range_to_empty "undefined4" ULONG NO_COMPU_METHOD 0 0 0 4294967295 ECU_ADDRESS 0x40004A00 /end MEASUREMENT
/begin MEASUREMENT car_speed_running_total_range_to_empty "Car speed running total range to empty (km = val/112500)." ULONG CM_u32_distance_1_112500km 0 0 0 38177.4870666667 ECU_ADDRESS 0x40004A04 /end MEASUREMENT
/begin MEASUREMENT fuel_economy_factor_smoothed "undefined2" UWORD NO_COMPU_METHOD 0 0 0 65535 ECU_ADDRESS 0x40004A08 /end MEASUREMENT
/begin MEASUREMENT LEA_fuel_range_smoothed "Learned/adaptive value: fuel range smoothed (km)." UWORD CM_u16_distance_km 0 0 0 65535 ECU_ADDRESS 0x40004A0A /end MEASUREMENT
/begin MEASUREMENT LEA_obd_ii_P0011_dtc_state "Learned/adaptive value: OBD-II P0011 DTC state." UBYTE NO_COMPU_METHOD 0 0 0 255 ECU_ADDRESS 0x40004A14 /end MEASUREMENT
/begin MEASUREMENT LEA_obd_ii_P0011_fail_counter "Learned/adaptive value: OBD-II P0011 fail counter." UBYTE NO_COMPU_METHOD 0 0 0 255 ECU_ADDRESS 0x40004A15 /end MEASUREMENT
/begin MEASUREMENT LEA_obd_ii_P0011_pass_counter "Learned/adaptive value: OBD-II P0011 pass counter." UBYTE NO_COMPU_METHOD 0 0 0 255 ECU_ADDRESS 0x40004A16 /end MEASUREMENT
/begin MEASUREMENT LEA_obd_ii_P0012_dtc_state "Learned/adaptive value: OBD-II P0012 DTC state." UBYTE NO_COMPU_METHOD 0 0 0 255 ECU_ADDRESS 0x40004A17 /end MEASUREMENT
/begin MEASUREMENT LEA_obd_ii_P0012_fail_counter "Learned/adaptive value: OBD-II P0012 fail counter." UBYTE NO_COMPU_METHOD 0 0 0 255 ECU_ADDRESS 0x40004A18 /end MEASUREMENT
/begin MEASUREMENT LEA_obd_ii_P0012_pass_counter "Learned/adaptive value: OBD-II P0012 pass counter." UBYTE NO_COMPU_METHOD 0 0 0 255 ECU_ADDRESS 0x40004A19 /end MEASUREMENT
/begin MEASUREMENT LEA_obd_ii_P0021_dtc_state "Learned/adaptive value: OBD-II P0021 DTC state." UBYTE NO_COMPU_METHOD 0 0 0 255 ECU_ADDRESS 0x40004A1A /end MEASUREMENT
/begin MEASUREMENT LEA_obd_ii_P0021_fail_counter "Learned/adaptive value: OBD-II P0021 fail counter." UBYTE NO_COMPU_METHOD 0 0 0 255 ECU_ADDRESS 0x40004A1B /end MEASUREMENT
/begin MEASUREMENT LEA_obd_ii_P0021_pass_counter "Learned/adaptive value: OBD-II P0021 pass counter." UBYTE NO_COMPU_METHOD 0 0 0 255 ECU_ADDRESS 0x40004A1C /end MEASUREMENT
/begin MEASUREMENT LEA_obd_ii_P0022_dtc_state "Learned/adaptive value: OBD-II P0022 DTC state." UBYTE NO_COMPU_METHOD 0 0 0 255 ECU_ADDRESS 0x40004A1D /end MEASUREMENT
/begin MEASUREMENT LEA_obd_ii_P0022_fail_counter "Learned/adaptive value: OBD-II P0022 fail counter." UBYTE NO_COMPU_METHOD 0 0 0 255 ECU_ADDRESS 0x40004A1E /end MEASUREMENT
/begin MEASUREMENT LEA_obd_ii_P0022_pass_counter "Learned/adaptive value: OBD-II P0022 pass counter." UBYTE NO_COMPU_METHOD 0 0 0 255 ECU_ADDRESS 0x40004A1F /end MEASUREMENT
/begin MEASUREMENT LEA_obd_ii_P0014_dtc_state "Learned/adaptive value: OBD-II P0014 DTC state." UBYTE NO_COMPU_METHOD 0 0 0 255 ECU_ADDRESS 0x40004A20 /end MEASUREMENT
/begin MEASUREMENT LEA_obd_ii_P0014_fail_counter "Learned/adaptive value: OBD-II P0014 fail counter." UBYTE NO_COMPU_METHOD 0 0 0 255 ECU_ADDRESS 0x40004A21 /end MEASUREMENT
/begin MEASUREMENT LEA_obd_ii_P0014_pass_counter "Learned/adaptive value: OBD-II P0014 pass counter." UBYTE NO_COMPU_METHOD 0 0 0 255 ECU_ADDRESS 0x40004A22 /end MEASUREMENT
/begin MEASUREMENT LEA_obd_ii_P0015_dtc_state "Learned/adaptive value: OBD-II P0015 DTC state." UBYTE NO_COMPU_METHOD 0 0 0 255 ECU_ADDRESS 0x40004A23 /end MEASUREMENT
/begin MEASUREMENT LEA_obd_ii_P0015_fail_counter "Learned/adaptive value: OBD-II P0015 fail counter." UBYTE NO_COMPU_METHOD 0 0 0 255 ECU_ADDRESS 0x40004A24 /end MEASUREMENT
/begin MEASUREMENT LEA_obd_ii_P0015_pass_counter "Learned/adaptive value: OBD-II P0015 pass counter." UBYTE NO_COMPU_METHOD 0 0 0 255 ECU_ADDRESS 0x40004A25 /end MEASUREMENT
/begin MEASUREMENT LEA_obd_ii_P0024_dtc_state "Learned/adaptive value: OBD-II P0024 DTC state." UBYTE NO_COMPU_METHOD 0 0 0 255 ECU_ADDRESS 0x40004A26 /end MEASUREMENT
/begin MEASUREMENT LEA_obd_ii_P0024_fail_counter "Learned/adaptive value: OBD-II P0024 fail counter." UBYTE NO_COMPU_METHOD 0 0 0 255 ECU_ADDRESS 0x40004A27 /end MEASUREMENT
/begin MEASUREMENT LEA_obd_ii_P0024_pass_counter "Learned/adaptive value: OBD-II P0024 pass counter." UBYTE NO_COMPU_METHOD 0 0 0 255 ECU_ADDRESS 0x40004A28 /end MEASUREMENT
/begin MEASUREMENT LEA_obd_ii_P0025_dtc_state "Learned/adaptive value: OBD-II P0025 DTC state." UBYTE NO_COMPU_METHOD 0 0 0 255 ECU_ADDRESS 0x40004A29 /end MEASUREMENT
/begin MEASUREMENT LEA_obd_ii_P0025_fail_counter "Learned/adaptive value: OBD-II P0025 fail counter." UBYTE NO_COMPU_METHOD 0 0 0 255 ECU_ADDRESS 0x40004A2A /end MEASUREMENT
/begin MEASUREMENT LEA_obd_ii_P0025_pass_counter "Learned/adaptive value: OBD-II P0025 pass counter." UBYTE NO_COMPU_METHOD 0 0 0 255 ECU_ADDRESS 0x40004A2B /end MEASUREMENT
/begin MEASUREMENT LEA_obd_ii_P0016_dtc_state "Learned/adaptive value: OBD-II P0016 DTC state." UBYTE NO_COMPU_METHOD 0 0 0 255 ECU_ADDRESS 0x40004A2C /end MEASUREMENT
/begin MEASUREMENT LEA_obd_ii_P0016_fail_counter "Learned/adaptive value: OBD-II P0016 fail counter." UBYTE NO_COMPU_METHOD 0 0 0 255 ECU_ADDRESS 0x40004A2D /end MEASUREMENT
/begin MEASUREMENT LEA_obd_ii_P0016_pass_counter "Learned/adaptive value: OBD-II P0016 pass counter." UBYTE NO_COMPU_METHOD 0 0 0 255 ECU_ADDRESS 0x40004A2E /end MEASUREMENT
/begin MEASUREMENT LEA_obd_ii_P0017_dtc_state "Learned/adaptive value: OBD-II P0017 DTC state." UBYTE NO_COMPU_METHOD 0 0 0 255 ECU_ADDRESS 0x40004A2F /end MEASUREMENT
/begin MEASUREMENT LEA_obd_ii_P0017_fail_counter "Learned/adaptive value: OBD-II P0017 fail counter." UBYTE NO_COMPU_METHOD 0 0 0 255 ECU_ADDRESS 0x40004A30 /end MEASUREMENT
/begin MEASUREMENT LEA_obd_ii_P0017_pass_counter "Learned/adaptive value: OBD-II P0017 pass counter." UBYTE NO_COMPU_METHOD 0 0 0 255 ECU_ADDRESS 0x40004A31 /end MEASUREMENT
/begin MEASUREMENT LEA_obd_ii_P0018_dtc_state "Learned/adaptive value: OBD-II P0018 DTC state." UBYTE NO_COMPU_METHOD 0 0 0 255 ECU_ADDRESS 0x40004A32 /end MEASUREMENT
/begin MEASUREMENT LEA_obd_ii_P0018_fail_counter "Learned/adaptive value: OBD-II P0018 fail counter." UBYTE NO_COMPU_METHOD 0 0 0 255 ECU_ADDRESS 0x40004A33 /end MEASUREMENT
/begin MEASUREMENT LEA_obd_ii_P0018_pass_counter "Learned/adaptive value: OBD-II P0018 pass counter." UBYTE NO_COMPU_METHOD 0 0 0 255 ECU_ADDRESS 0x40004A34 /end MEASUREMENT
/begin MEASUREMENT LEA_obd_ii_P0019_dtc_state "Learned/adaptive value: OBD-II P0019 DTC state." UBYTE NO_COMPU_METHOD 0 0 0 255 ECU_ADDRESS 0x40004A35 /end MEASUREMENT
/begin MEASUREMENT LEA_obd_ii_P0019_fail_counter "Learned/adaptive value: OBD-II P0019 fail counter." UBYTE NO_COMPU_METHOD 0 0 0 255 ECU_ADDRESS 0x40004A36 /end MEASUREMENT
/begin MEASUREMENT LEA_obd_ii_P0019_pass_counter "Learned/adaptive value: OBD-II P0019 pass counter." UBYTE NO_COMPU_METHOD 0 0 0 255 ECU_ADDRESS 0x40004A37 /end MEASUREMENT
/begin MEASUREMENT LEA_obd_ii_P0076_dtc_state "Learned/adaptive value: OBD-II P0076 DTC state." UBYTE NO_COMPU_METHOD 0 0 0 255 ECU_ADDRESS 0x40004A38 /end MEASUREMENT
/begin MEASUREMENT LEA_obd_ii_P0076_fail_counter "Learned/adaptive value: OBD-II P0076 fail counter." UBYTE NO_COMPU_METHOD 0 0 0 255 ECU_ADDRESS 0x40004A39 /end MEASUREMENT
/begin MEASUREMENT LEA_obd_ii_P0076_pass_counter "Learned/adaptive value: OBD-II P0076 pass counter." UBYTE NO_COMPU_METHOD 0 0 0 255 ECU_ADDRESS 0x40004A3A /end MEASUREMENT
/begin MEASUREMENT LEA_obd_ii_P0077_dtc_state "Learned/adaptive value: OBD-II P0077 DTC state." UBYTE NO_COMPU_METHOD 0 0 0 255 ECU_ADDRESS 0x40004A3B /end MEASUREMENT
/begin MEASUREMENT LEA_obd_ii_P0077_fail_counter "Learned/adaptive value: OBD-II P0077 fail counter." UBYTE NO_COMPU_METHOD 0 0 0 255 ECU_ADDRESS 0x40004A3C /end MEASUREMENT
/begin MEASUREMENT LEA_obd_ii_P0077_pass_counter "Learned/adaptive value: OBD-II P0077 pass counter." UBYTE NO_COMPU_METHOD 0 0 0 255 ECU_ADDRESS 0x40004A3D /end MEASUREMENT
/begin MEASUREMENT LEA_obd_ii_P0079_dtc_state "Learned/adaptive value: OBD-II P0079 DTC state." UBYTE NO_COMPU_METHOD 0 0 0 255 ECU_ADDRESS 0x40004A3E /end MEASUREMENT
/begin MEASUREMENT LEA_obd_ii_P0079_fail_counter "Learned/adaptive value: OBD-II P0079 fail counter." UBYTE NO_COMPU_METHOD 0 0 0 255 ECU_ADDRESS 0x40004A3F /end MEASUREMENT
/begin MEASUREMENT LEA_obd_ii_P0079_pass_counter "Learned/adaptive value: OBD-II P0079 pass counter." UBYTE NO_COMPU_METHOD 0 0 0 255 ECU_ADDRESS 0x40004A40 /end MEASUREMENT
/begin MEASUREMENT LEA_obd_ii_P0080_dtc_state "Learned/adaptive value: OBD-II P0080 DTC state." UBYTE NO_COMPU_METHOD 0 0 0 255 ECU_ADDRESS 0x40004A41 /end MEASUREMENT
/begin MEASUREMENT LEA_obd_ii_P0080_fail_counter "Learned/adaptive value: OBD-II P0080 fail counter." UBYTE NO_COMPU_METHOD 0 0 0 255 ECU_ADDRESS 0x40004A42 /end MEASUREMENT
/begin MEASUREMENT LEA_obd_ii_P0080_pass_counter "Learned/adaptive value: OBD-II P0080 pass counter." UBYTE NO_COMPU_METHOD 0 0 0 255 ECU_ADDRESS 0x40004A43 /end MEASUREMENT
/begin MEASUREMENT LEA_obd_ii_P0082_dtc_state "Learned/adaptive value: OBD-II P0082 DTC state." UBYTE NO_COMPU_METHOD 0 0 0 255 ECU_ADDRESS 0x40004A44 /end MEASUREMENT
/begin MEASUREMENT LEA_obd_ii_P0082_fail_counter "Learned/adaptive value: OBD-II P0082 fail counter." UBYTE NO_COMPU_METHOD 0 0 0 255 ECU_ADDRESS 0x40004A45 /end MEASUREMENT
/begin MEASUREMENT LEA_obd_ii_P0082_pass_counter "Learned/adaptive value: OBD-II P0082 pass counter." UBYTE NO_COMPU_METHOD 0 0 0 255 ECU_ADDRESS 0x40004A46 /end MEASUREMENT
/begin MEASUREMENT LEA_obd_ii_P0083_dtc_state "Learned/adaptive value: OBD-II P0083 DTC state." UBYTE NO_COMPU_METHOD 0 0 0 255 ECU_ADDRESS 0x40004A47 /end MEASUREMENT
/begin MEASUREMENT LEA_obd_ii_P0083_fail_counter "Learned/adaptive value: OBD-II P0083 fail counter." UBYTE NO_COMPU_METHOD 0 0 0 255 ECU_ADDRESS 0x40004A48 /end MEASUREMENT
/begin MEASUREMENT LEA_obd_ii_P0083_pass_counter "Learned/adaptive value: OBD-II P0083 pass counter." UBYTE NO_COMPU_METHOD 0 0 0 255 ECU_ADDRESS 0x40004A49 /end MEASUREMENT
/begin MEASUREMENT LEA_obd_ii_P0085_dtc_state "Learned/adaptive value: OBD-II P0085 DTC state." UBYTE NO_COMPU_METHOD 0 0 0 255 ECU_ADDRESS 0x40004A4A /end MEASUREMENT
/begin MEASUREMENT LEA_obd_ii_P0085_fail_counter "Learned/adaptive value: OBD-II P0085 fail counter." UBYTE NO_COMPU_METHOD 0 0 0 255 ECU_ADDRESS 0x40004A4B /end MEASUREMENT
/begin MEASUREMENT LEA_obd_ii_P0085_pass_counter "Learned/adaptive value: OBD-II P0085 pass counter." UBYTE NO_COMPU_METHOD 0 0 0 255 ECU_ADDRESS 0x40004A4C /end MEASUREMENT
/begin MEASUREMENT LEA_obd_ii_P0086_dtc_state "Learned/adaptive value: OBD-II P0086 DTC state." UBYTE NO_COMPU_METHOD 0 0 0 255 ECU_ADDRESS 0x40004A4D /end MEASUREMENT
/begin MEASUREMENT LEA_obd_ii_P0086_fail_counter "Learned/adaptive value: OBD-II P0086 fail counter." UBYTE NO_COMPU_METHOD 0 0 0 255 ECU_ADDRESS 0x40004A4E /end MEASUREMENT
/begin MEASUREMENT LEA_obd_ii_P0086_pass_counter "Learned/adaptive value: OBD-II P0086 pass counter." UBYTE NO_COMPU_METHOD 0 0 0 255 ECU_ADDRESS 0x40004A4F /end MEASUREMENT
/begin MEASUREMENT LEA_obd_ii_P0087_dtc_state "Learned/adaptive value: OBD-II P0087 DTC state." UBYTE NO_COMPU_METHOD 0 0 0 255 ECU_ADDRESS 0x40004A50 /end MEASUREMENT
/begin MEASUREMENT LEA_obd_ii_P0087_fail_counter "Learned/adaptive value: OBD-II P0087 fail counter." UBYTE NO_COMPU_METHOD 0 0 0 255 ECU_ADDRESS 0x40004A51 /end MEASUREMENT
/begin MEASUREMENT LEA_obd_ii_P0087_pass_counter "Learned/adaptive value: OBD-II P0087 pass counter." UBYTE NO_COMPU_METHOD 0 0 0 255 ECU_ADDRESS 0x40004A52 /end MEASUREMENT
/begin MEASUREMENT LEA_obd_ii_P0088_dtc_state "Learned/adaptive value: OBD-II P0088 DTC state." UBYTE NO_COMPU_METHOD 0 0 0 255 ECU_ADDRESS 0x40004A53 /end MEASUREMENT
/begin MEASUREMENT LEA_obd_ii_P0088_fail_counter "Learned/adaptive value: OBD-II P0088 fail counter." UBYTE NO_COMPU_METHOD 0 0 0 255 ECU_ADDRESS 0x40004A54 /end MEASUREMENT
/begin MEASUREMENT LEA_obd_ii_P0088_pass_counter "Learned/adaptive value: OBD-II P0088 pass counter." UBYTE NO_COMPU_METHOD 0 0 0 255 ECU_ADDRESS 0x40004A55 /end MEASUREMENT
/begin MEASUREMENT LEA_obd_ii_P0096_dtc_state "Learned/adaptive value: OBD-II P0096 DTC state." UBYTE NO_COMPU_METHOD 0 0 0 255 ECU_ADDRESS 0x40004A56 /end MEASUREMENT
/begin MEASUREMENT LEA_obd_ii_P0096_fail_counter "Learned/adaptive value: OBD-II P0096 fail counter." UBYTE NO_COMPU_METHOD 0 0 0 255 ECU_ADDRESS 0x40004A57 /end MEASUREMENT
/begin MEASUREMENT LEA_obd_ii_P0096_pass_counter "Learned/adaptive value: OBD-II P0096 pass counter." UBYTE NO_COMPU_METHOD 0 0 0 255 ECU_ADDRESS 0x40004A58 /end MEASUREMENT
/begin MEASUREMENT LEA_obd_ii_P0097_dtc_state "Learned/adaptive value: OBD-II P0097 DTC state." UBYTE NO_COMPU_METHOD 0 0 0 255 ECU_ADDRESS 0x40004A59 /end MEASUREMENT
/begin MEASUREMENT LEA_obd_ii_P0097_fail_counter "Learned/adaptive value: OBD-II P0097 fail counter." UBYTE NO_COMPU_METHOD 0 0 0 255 ECU_ADDRESS 0x40004A5A /end MEASUREMENT
/begin MEASUREMENT LEA_obd_ii_P0097_pass_counter "Learned/adaptive value: OBD-II P0097 pass counter." UBYTE NO_COMPU_METHOD 0 0 0 255 ECU_ADDRESS 0x40004A5B /end MEASUREMENT
/begin MEASUREMENT LEA_obd_ii_P0098_dtc_state "Learned/adaptive value: OBD-II P0098 DTC state." UBYTE NO_COMPU_METHOD 0 0 0 255 ECU_ADDRESS 0x40004A5C /end MEASUREMENT
/begin MEASUREMENT LEA_obd_ii_P0098_fail_counter "Learned/adaptive value: OBD-II P0098 fail counter." UBYTE NO_COMPU_METHOD 0 0 0 255 ECU_ADDRESS 0x40004A5D /end MEASUREMENT
/begin MEASUREMENT LEA_obd_ii_P0098_pass_counter "Learned/adaptive value: OBD-II P0098 pass counter." UBYTE NO_COMPU_METHOD 0 0 0 255 ECU_ADDRESS 0x40004A5E /end MEASUREMENT
/begin MEASUREMENT LEA_obd_ii_P0101_dtc_state "Learned/adaptive value: OBD-II P0101 DTC state." UBYTE NO_COMPU_METHOD 0 0 0 255 ECU_ADDRESS 0x40004A5F /end MEASUREMENT
/begin MEASUREMENT LEA_obd_ii_P0101_fail_counter "Learned/adaptive value: OBD-II P0101 fail counter." UBYTE NO_COMPU_METHOD 0 0 0 255 ECU_ADDRESS 0x40004A60 /end MEASUREMENT
/begin MEASUREMENT LEA_obd_ii_P0101_pass_counter "Learned/adaptive value: OBD-II P0101 pass counter." UBYTE NO_COMPU_METHOD 0 0 0 255 ECU_ADDRESS 0x40004A61 /end MEASUREMENT
/begin MEASUREMENT LEA_obd_ii_P0102_dtc_state "Learned/adaptive value: OBD-II P0102 DTC state." UBYTE NO_COMPU_METHOD 0 0 0 255 ECU_ADDRESS 0x40004A62 /end MEASUREMENT
/begin MEASUREMENT LEA_obd_ii_P0102_fail_counter "Learned/adaptive value: OBD-II P0102 fail counter." UBYTE NO_COMPU_METHOD 0 0 0 255 ECU_ADDRESS 0x40004A63 /end MEASUREMENT
/begin MEASUREMENT LEA_obd_ii_P0102_pass_counter "Learned/adaptive value: OBD-II P0102 pass counter." UBYTE NO_COMPU_METHOD 0 0 0 255 ECU_ADDRESS 0x40004A64 /end MEASUREMENT
/begin MEASUREMENT LEA_obd_ii_P0103_dtc_state "Learned/adaptive value: OBD-II P0103 DTC state." UBYTE NO_COMPU_METHOD 0 0 0 255 ECU_ADDRESS 0x40004A65 /end MEASUREMENT
/begin MEASUREMENT LEA_obd_ii_P0103_fail_counter "Learned/adaptive value: OBD-II P0103 fail counter." UBYTE NO_COMPU_METHOD 0 0 0 255 ECU_ADDRESS 0x40004A66 /end MEASUREMENT
/begin MEASUREMENT LEA_obd_ii_P0103_pass_counter "Learned/adaptive value: OBD-II P0103 pass counter." UBYTE NO_COMPU_METHOD 0 0 0 255 ECU_ADDRESS 0x40004A67 /end MEASUREMENT
/begin MEASUREMENT LEA_obd_ii_P0106_dtc_state "Learned/adaptive value: OBD-II P0106 DTC state." UBYTE NO_COMPU_METHOD 0 0 0 255 ECU_ADDRESS 0x40004A68 /end MEASUREMENT
/begin MEASUREMENT LEA_obd_ii_P0106_fail_counter "Learned/adaptive value: OBD-II P0106 fail counter." UBYTE NO_COMPU_METHOD 0 0 0 255 ECU_ADDRESS 0x40004A69 /end MEASUREMENT
/begin MEASUREMENT LEA_obd_ii_P0106_pass_counter "Learned/adaptive value: OBD-II P0106 pass counter." UBYTE NO_COMPU_METHOD 0 0 0 255 ECU_ADDRESS 0x40004A6A /end MEASUREMENT
/begin MEASUREMENT LEA_obd_ii_P0107_dtc_state "Learned/adaptive value: OBD-II P0107 DTC state." UBYTE NO_COMPU_METHOD 0 0 0 255 ECU_ADDRESS 0x40004A6B /end MEASUREMENT
/begin MEASUREMENT LEA_obd_ii_P0107_fail_counter "Learned/adaptive value: OBD-II P0107 fail counter." UBYTE NO_COMPU_METHOD 0 0 0 255 ECU_ADDRESS 0x40004A6C /end MEASUREMENT
/begin MEASUREMENT LEA_obd_ii_P0107_pass_counter "Learned/adaptive value: OBD-II P0107 pass counter." UBYTE NO_COMPU_METHOD 0 0 0 255 ECU_ADDRESS 0x40004A6D /end MEASUREMENT
/begin MEASUREMENT LEA_obd_ii_P0108_dtc_state "Learned/adaptive value: OBD-II P0108 DTC state." UBYTE NO_COMPU_METHOD 0 0 0 255 ECU_ADDRESS 0x40004A6E /end MEASUREMENT
/begin MEASUREMENT LEA_obd_ii_P0108_fail_counter "Learned/adaptive value: OBD-II P0108 fail counter." UBYTE NO_COMPU_METHOD 0 0 0 255 ECU_ADDRESS 0x40004A6F /end MEASUREMENT
/begin MEASUREMENT LEA_obd_ii_P0108_pass_counter "Learned/adaptive value: OBD-II P0108 pass counter." UBYTE NO_COMPU_METHOD 0 0 0 255 ECU_ADDRESS 0x40004A70 /end MEASUREMENT
/begin MEASUREMENT LEA_obd_ii_P0111_dtc_state "Learned/adaptive value: OBD-II P0111 DTC state." UBYTE NO_COMPU_METHOD 0 0 0 255 ECU_ADDRESS 0x40004A71 /end MEASUREMENT
/begin MEASUREMENT LEA_obd_ii_P0111_fail_counter "Learned/adaptive value: OBD-II P0111 fail counter." UBYTE NO_COMPU_METHOD 0 0 0 255 ECU_ADDRESS 0x40004A72 /end MEASUREMENT
/begin MEASUREMENT LEA_obd_ii_P0111_pass_counter "Learned/adaptive value: OBD-II P0111 pass counter." UBYTE NO_COMPU_METHOD 0 0 0 255 ECU_ADDRESS 0x40004A73 /end MEASUREMENT
/begin MEASUREMENT LEA_obd_ii_P0112_dtc_state "Learned/adaptive value: OBD-II P0112 DTC state." UBYTE NO_COMPU_METHOD 0 0 0 255 ECU_ADDRESS 0x40004A74 /end MEASUREMENT
/begin MEASUREMENT LEA_obd_ii_P0112_fail_counter "Learned/adaptive value: OBD-II P0112 fail counter." UBYTE NO_COMPU_METHOD 0 0 0 255 ECU_ADDRESS 0x40004A75 /end MEASUREMENT
/begin MEASUREMENT LEA_obd_ii_P0112_pass_counter "Learned/adaptive value: OBD-II P0112 pass counter." UBYTE NO_COMPU_METHOD 0 0 0 255 ECU_ADDRESS 0x40004A76 /end MEASUREMENT
/begin MEASUREMENT LEA_obd_ii_P0113_dtc_state "Learned/adaptive value: OBD-II P0113 DTC state." UBYTE NO_COMPU_METHOD 0 0 0 255 ECU_ADDRESS 0x40004A77 /end MEASUREMENT
/begin MEASUREMENT LEA_obd_ii_P0113_fail_counter "Learned/adaptive value: OBD-II P0113 fail counter." UBYTE NO_COMPU_METHOD 0 0 0 255 ECU_ADDRESS 0x40004A78 /end MEASUREMENT
/begin MEASUREMENT LEA_obd_ii_P0113_pass_counter "Learned/adaptive value: OBD-II P0113 pass counter." UBYTE NO_COMPU_METHOD 0 0 0 255 ECU_ADDRESS 0x40004A79 /end MEASUREMENT
/begin MEASUREMENT LEA_obd_ii_P0071_dtc_state "Learned/adaptive value: OBD-II P0071 DTC state." UBYTE NO_COMPU_METHOD 0 0 0 255 ECU_ADDRESS 0x40004A7A /end MEASUREMENT
/begin MEASUREMENT LEA_obd_ii_P0071_fail_counter "Learned/adaptive value: OBD-II P0071 fail counter." UBYTE NO_COMPU_METHOD 0 0 0 255 ECU_ADDRESS 0x40004A7B /end MEASUREMENT
/begin MEASUREMENT LEA_obd_ii_P0071_pass_counter "Learned/adaptive value: OBD-II P0071 pass counter." UBYTE NO_COMPU_METHOD 0 0 0 255 ECU_ADDRESS 0x40004A7C /end MEASUREMENT
/begin MEASUREMENT LEA_obd_ii_P0072_dtc_state "Learned/adaptive value: OBD-II P0072 DTC state." UBYTE NO_COMPU_METHOD 0 0 0 255 ECU_ADDRESS 0x40004A7D /end MEASUREMENT
/begin MEASUREMENT LEA_obd_ii_P0072_fail_counter "Learned/adaptive value: OBD-II P0072 fail counter." UBYTE NO_COMPU_METHOD 0 0 0 255 ECU_ADDRESS 0x40004A7E /end MEASUREMENT
/begin MEASUREMENT LEA_obd_ii_P0072_pass_counter "Learned/adaptive value: OBD-II P0072 pass counter." UBYTE NO_COMPU_METHOD 0 0 0 255 ECU_ADDRESS 0x40004A7F /end MEASUREMENT
/begin MEASUREMENT LEA_obd_ii_P0073_dtc_state "Learned/adaptive value: OBD-II P0073 DTC state." UBYTE NO_COMPU_METHOD 0 0 0 255 ECU_ADDRESS 0x40004A80 /end MEASUREMENT
/begin MEASUREMENT LEA_obd_ii_P0073_fail_counter "Learned/adaptive value: OBD-II P0073 fail counter." UBYTE NO_COMPU_METHOD 0 0 0 255 ECU_ADDRESS 0x40004A81 /end MEASUREMENT
/begin MEASUREMENT LEA_obd_ii_P0073_pass_counter "Learned/adaptive value: OBD-II P0073 pass counter." UBYTE NO_COMPU_METHOD 0 0 0 255 ECU_ADDRESS 0x40004A82 /end MEASUREMENT
/begin MEASUREMENT LEA_obd_ii_P0116_dtc_state "Learned/adaptive value: OBD-II P0116 DTC state." UBYTE NO_COMPU_METHOD 0 0 0 255 ECU_ADDRESS 0x40004A83 /end MEASUREMENT
/begin MEASUREMENT LEA_obd_ii_P0116_fail_counter "Learned/adaptive value: OBD-II P0116 fail counter." UBYTE NO_COMPU_METHOD 0 0 0 255 ECU_ADDRESS 0x40004A84 /end MEASUREMENT
/begin MEASUREMENT LEA_obd_ii_P0116_pass_counter "Learned/adaptive value: OBD-II P0116 pass counter." UBYTE NO_COMPU_METHOD 0 0 0 255 ECU_ADDRESS 0x40004A85 /end MEASUREMENT
/begin MEASUREMENT LEA_obd_ii_P0117_dtc_state "Learned/adaptive value: OBD-II P0117 DTC state." UBYTE NO_COMPU_METHOD 0 0 0 255 ECU_ADDRESS 0x40004A86 /end MEASUREMENT
/begin MEASUREMENT LEA_obd_ii_P0117_fail_counter "Learned/adaptive value: OBD-II P0117 fail counter." UBYTE NO_COMPU_METHOD 0 0 0 255 ECU_ADDRESS 0x40004A87 /end MEASUREMENT
/begin MEASUREMENT LEA_obd_ii_P0117_pass_counter "Learned/adaptive value: OBD-II P0117 pass counter." UBYTE NO_COMPU_METHOD 0 0 0 255 ECU_ADDRESS 0x40004A88 /end MEASUREMENT
/begin MEASUREMENT LEA_obd_ii_P0118_dtc_state "Learned/adaptive value: OBD-II P0118 DTC state." UBYTE NO_COMPU_METHOD 0 0 0 255 ECU_ADDRESS 0x40004A89 /end MEASUREMENT
/begin MEASUREMENT LEA_obd_ii_P0118_fail_counter "Learned/adaptive value: OBD-II P0118 fail counter." UBYTE NO_COMPU_METHOD 0 0 0 255 ECU_ADDRESS 0x40004A8A /end MEASUREMENT
/begin MEASUREMENT LEA_obd_ii_P0118_pass_counter "Learned/adaptive value: OBD-II P0118 pass counter." UBYTE NO_COMPU_METHOD 0 0 0 255 ECU_ADDRESS 0x40004A8B /end MEASUREMENT
/begin MEASUREMENT LEA_obd_ii_P0122_dtc_state "Learned/adaptive value: OBD-II P0122 DTC state." UBYTE NO_COMPU_METHOD 0 0 0 255 ECU_ADDRESS 0x40004A8C /end MEASUREMENT
/begin MEASUREMENT LEA_obd_ii_P0122_fail_counter "Learned/adaptive value: OBD-II P0122 fail counter." UBYTE NO_COMPU_METHOD 0 0 0 255 ECU_ADDRESS 0x40004A8D /end MEASUREMENT
/begin MEASUREMENT LEA_obd_ii_P0122_pass_counter "Learned/adaptive value: OBD-II P0122 pass counter." UBYTE NO_COMPU_METHOD 0 0 0 255 ECU_ADDRESS 0x40004A8E /end MEASUREMENT
/begin MEASUREMENT LEA_obd_ii_P0123_dtc_state "Learned/adaptive value: OBD-II P0123 DTC state." UBYTE NO_COMPU_METHOD 0 0 0 255 ECU_ADDRESS 0x40004A8F /end MEASUREMENT
/begin MEASUREMENT LEA_obd_ii_P0123_fail_counter "Learned/adaptive value: OBD-II P0123 fail counter." UBYTE NO_COMPU_METHOD 0 0 0 255 ECU_ADDRESS 0x40004A90 /end MEASUREMENT
/begin MEASUREMENT LEA_obd_ii_P0123_pass_counter "Learned/adaptive value: OBD-II P0123 pass counter." UBYTE NO_COMPU_METHOD 0 0 0 255 ECU_ADDRESS 0x40004A91 /end MEASUREMENT
/begin MEASUREMENT LEA_obd_ii_P0128_dtc_state "Learned/adaptive value: OBD-II P0128 DTC state." UBYTE NO_COMPU_METHOD 0 0 0 255 ECU_ADDRESS 0x40004A92 /end MEASUREMENT
/begin MEASUREMENT LEA_obd_ii_P0128_fail_counter "Learned/adaptive value: OBD-II P0128 fail counter." UBYTE NO_COMPU_METHOD 0 0 0 255 ECU_ADDRESS 0x40004A93 /end MEASUREMENT
/begin MEASUREMENT LEA_obd_ii_P0128_pass_counter "Learned/adaptive value: OBD-II P0128 pass counter." UBYTE NO_COMPU_METHOD 0 0 0 255 ECU_ADDRESS 0x40004A94 /end MEASUREMENT
/begin MEASUREMENT LEA_obd_ii_P0131_dtc_state "Learned/adaptive value: OBD-II P0131 DTC state." UBYTE NO_COMPU_METHOD 0 0 0 255 ECU_ADDRESS 0x40004A95 /end MEASUREMENT
/begin MEASUREMENT LEA_obd_ii_P0131_fail_counter "Learned/adaptive value: OBD-II P0131 fail counter." UBYTE NO_COMPU_METHOD 0 0 0 255 ECU_ADDRESS 0x40004A96 /end MEASUREMENT
/begin MEASUREMENT LEA_obd_ii_P0131_pass_counter "Learned/adaptive value: OBD-II P0131 pass counter." UBYTE NO_COMPU_METHOD 0 0 0 255 ECU_ADDRESS 0x40004A97 /end MEASUREMENT
/begin MEASUREMENT LEA_obd_ii_P0132_dtc_state "Learned/adaptive value: OBD-II P0132 DTC state." UBYTE NO_COMPU_METHOD 0 0 0 255 ECU_ADDRESS 0x40004A98 /end MEASUREMENT
/begin MEASUREMENT LEA_obd_ii_P0132_fail_counter "Learned/adaptive value: OBD-II P0132 fail counter." UBYTE NO_COMPU_METHOD 0 0 0 255 ECU_ADDRESS 0x40004A99 /end MEASUREMENT
/begin MEASUREMENT LEA_obd_ii_P0132_pass_counter "Learned/adaptive value: OBD-II P0132 pass counter." UBYTE NO_COMPU_METHOD 0 0 0 255 ECU_ADDRESS 0x40004A9A /end MEASUREMENT
/begin MEASUREMENT LEA_obd_ii_P0133_dtc_state "Learned/adaptive value: OBD-II P0133 DTC state." UBYTE NO_COMPU_METHOD 0 0 0 255 ECU_ADDRESS 0x40004A9B /end MEASUREMENT
/begin MEASUREMENT LEA_obd_ii_P0133_fail_counter "Learned/adaptive value: OBD-II P0133 fail counter." UBYTE NO_COMPU_METHOD 0 0 0 255 ECU_ADDRESS 0x40004A9C /end MEASUREMENT
/begin MEASUREMENT LEA_obd_ii_P0133_pass_counter "Learned/adaptive value: OBD-II P0133 pass counter." UBYTE NO_COMPU_METHOD 0 0 0 255 ECU_ADDRESS 0x40004A9D /end MEASUREMENT
/begin MEASUREMENT LEA_obd_ii_P0134_dtc_state "Learned/adaptive value: OBD-II P0134 DTC state." UBYTE NO_COMPU_METHOD 0 0 0 255 ECU_ADDRESS 0x40004A9E /end MEASUREMENT
/begin MEASUREMENT LEA_obd_ii_P0134_fail_counter "Learned/adaptive value: OBD-II P0134 fail counter." UBYTE NO_COMPU_METHOD 0 0 0 255 ECU_ADDRESS 0x40004A9F /end MEASUREMENT
/begin MEASUREMENT LEA_obd_ii_P0134_pass_counter "Learned/adaptive value: OBD-II P0134 pass counter." UBYTE NO_COMPU_METHOD 0 0 0 255 ECU_ADDRESS 0x40004AA0 /end MEASUREMENT
/begin MEASUREMENT LEA_obd_ii_P0135_dtc_state "Learned/adaptive value: OBD-II P0135 DTC state." UBYTE NO_COMPU_METHOD 0 0 0 255 ECU_ADDRESS 0x40004AA1 /end MEASUREMENT
/begin MEASUREMENT LEA_obd_ii_P0135_fail_counter "Learned/adaptive value: OBD-II P0135 fail counter." UBYTE NO_COMPU_METHOD 0 0 0 255 ECU_ADDRESS 0x40004AA2 /end MEASUREMENT
/begin MEASUREMENT LEA_obd_ii_P0135_pass_counter "Learned/adaptive value: OBD-II P0135 pass counter." UBYTE NO_COMPU_METHOD 0 0 0 255 ECU_ADDRESS 0x40004AA3 /end MEASUREMENT
/begin MEASUREMENT LEA_obd_ii_P0137_dtc_state "Learned/adaptive value: OBD-II P0137 DTC state." UBYTE NO_COMPU_METHOD 0 0 0 255 ECU_ADDRESS 0x40004AA4 /end MEASUREMENT
/begin MEASUREMENT LEA_obd_ii_P0137_fail_counter "Learned/adaptive value: OBD-II P0137 fail counter." UBYTE NO_COMPU_METHOD 0 0 0 255 ECU_ADDRESS 0x40004AA5 /end MEASUREMENT
/begin MEASUREMENT LEA_obd_ii_P0137_pass_counter "Learned/adaptive value: OBD-II P0137 pass counter." UBYTE NO_COMPU_METHOD 0 0 0 255 ECU_ADDRESS 0x40004AA6 /end MEASUREMENT
/begin MEASUREMENT LEA_obd_ii_P0138_dtc_state "Learned/adaptive value: OBD-II P0138 DTC state." UBYTE NO_COMPU_METHOD 0 0 0 255 ECU_ADDRESS 0x40004AA7 /end MEASUREMENT
/begin MEASUREMENT LEA_obd_ii_P0138_fail_counter "Learned/adaptive value: OBD-II P0138 fail counter." UBYTE NO_COMPU_METHOD 0 0 0 255 ECU_ADDRESS 0x40004AA8 /end MEASUREMENT
/begin MEASUREMENT LEA_obd_ii_P0138_pass_counter "Learned/adaptive value: OBD-II P0138 pass counter." UBYTE NO_COMPU_METHOD 0 0 0 255 ECU_ADDRESS 0x40004AA9 /end MEASUREMENT
/begin MEASUREMENT LEA_obd_ii_P0139_dtc_state "Learned/adaptive value: OBD-II P0139 DTC state." UBYTE NO_COMPU_METHOD 0 0 0 255 ECU_ADDRESS 0x40004AAA /end MEASUREMENT
/begin MEASUREMENT LEA_obd_ii_P0139_fail_counter "Learned/adaptive value: OBD-II P0139 fail counter." UBYTE NO_COMPU_METHOD 0 0 0 255 ECU_ADDRESS 0x40004AAB /end MEASUREMENT
/begin MEASUREMENT LEA_obd_ii_P0139_pass_counter "Learned/adaptive value: OBD-II P0139 pass counter." UBYTE NO_COMPU_METHOD 0 0 0 255 ECU_ADDRESS 0x40004AAC /end MEASUREMENT
/begin MEASUREMENT LEA_obd_ii_P0140_dtc_state "Learned/adaptive value: OBD-II P0140 DTC state." UBYTE NO_COMPU_METHOD 0 0 0 255 ECU_ADDRESS 0x40004AAD /end MEASUREMENT
/begin MEASUREMENT LEA_obd_ii_P0140_fail_counter "Learned/adaptive value: OBD-II P0140 fail counter." UBYTE NO_COMPU_METHOD 0 0 0 255 ECU_ADDRESS 0x40004AAE /end MEASUREMENT
/begin MEASUREMENT LEA_obd_ii_P0140_pass_counter "Learned/adaptive value: OBD-II P0140 pass counter." UBYTE NO_COMPU_METHOD 0 0 0 255 ECU_ADDRESS 0x40004AAF /end MEASUREMENT
/begin MEASUREMENT LEA_obd_ii_P0141_dtc_state "Learned/adaptive value: OBD-II P0141 DTC state." UBYTE NO_COMPU_METHOD 0 0 0 255 ECU_ADDRESS 0x40004AB0 /end MEASUREMENT
/begin MEASUREMENT LEA_obd_ii_P0141_fail_counter "Learned/adaptive value: OBD-II P0141 fail counter." UBYTE NO_COMPU_METHOD 0 0 0 255 ECU_ADDRESS 0x40004AB1 /end MEASUREMENT
/begin MEASUREMENT LEA_obd_ii_P0141_pass_counter "Learned/adaptive value: OBD-II P0141 pass counter." UBYTE NO_COMPU_METHOD 0 0 0 255 ECU_ADDRESS 0x40004AB2 /end MEASUREMENT
/begin MEASUREMENT LEA_obd_ii_P0151_dtc_state "Learned/adaptive value: OBD-II P0151 DTC state." UBYTE NO_COMPU_METHOD 0 0 0 255 ECU_ADDRESS 0x40004AB3 /end MEASUREMENT
/begin MEASUREMENT LEA_obd_ii_P0151_fail_counter "Learned/adaptive value: OBD-II P0151 fail counter." UBYTE NO_COMPU_METHOD 0 0 0 255 ECU_ADDRESS 0x40004AB4 /end MEASUREMENT
/begin MEASUREMENT LEA_obd_ii_P0151_pass_counter "Learned/adaptive value: OBD-II P0151 pass counter." UBYTE NO_COMPU_METHOD 0 0 0 255 ECU_ADDRESS 0x40004AB5 /end MEASUREMENT
/begin MEASUREMENT LEA_obd_ii_P0152_dtc_state "Learned/adaptive value: OBD-II P0152 DTC state." UBYTE NO_COMPU_METHOD 0 0 0 255 ECU_ADDRESS 0x40004AB6 /end MEASUREMENT
/begin MEASUREMENT LEA_obd_ii_P0152_fail_counter "Learned/adaptive value: OBD-II P0152 fail counter." UBYTE NO_COMPU_METHOD 0 0 0 255 ECU_ADDRESS 0x40004AB7 /end MEASUREMENT
/begin MEASUREMENT LEA_obd_ii_P0152_pass_counter "Learned/adaptive value: OBD-II P0152 pass counter." UBYTE NO_COMPU_METHOD 0 0 0 255 ECU_ADDRESS 0x40004AB8 /end MEASUREMENT
/begin MEASUREMENT LEA_obd_ii_P0153_dtc_state "Learned/adaptive value: OBD-II P0153 DTC state." UBYTE NO_COMPU_METHOD 0 0 0 255 ECU_ADDRESS 0x40004AB9 /end MEASUREMENT
/begin MEASUREMENT LEA_obd_ii_P0153_fail_counter "Learned/adaptive value: OBD-II P0153 fail counter." UBYTE NO_COMPU_METHOD 0 0 0 255 ECU_ADDRESS 0x40004ABA /end MEASUREMENT
/begin MEASUREMENT LEA_obd_ii_P0153_pass_counter "Learned/adaptive value: OBD-II P0153 pass counter." UBYTE NO_COMPU_METHOD 0 0 0 255 ECU_ADDRESS 0x40004ABB /end MEASUREMENT
/begin MEASUREMENT LEA_obd_ii_P0154_dtc_state "Learned/adaptive value: OBD-II P0154 DTC state." UBYTE NO_COMPU_METHOD 0 0 0 255 ECU_ADDRESS 0x40004ABC /end MEASUREMENT
/begin MEASUREMENT LEA_obd_ii_P0154_fail_counter "Learned/adaptive value: OBD-II P0154 fail counter." UBYTE NO_COMPU_METHOD 0 0 0 255 ECU_ADDRESS 0x40004ABD /end MEASUREMENT
/begin MEASUREMENT LEA_obd_ii_P0154_pass_counter "Learned/adaptive value: OBD-II P0154 pass counter." UBYTE NO_COMPU_METHOD 0 0 0 255 ECU_ADDRESS 0x40004ABE /end MEASUREMENT
/begin MEASUREMENT LEA_obd_ii_P0155_dtc_state "Learned/adaptive value: OBD-II P0155 DTC state." UBYTE NO_COMPU_METHOD 0 0 0 255 ECU_ADDRESS 0x40004ABF /end MEASUREMENT
/begin MEASUREMENT LEA_obd_ii_P0155_fail_counter "Learned/adaptive value: OBD-II P0155 fail counter." UBYTE NO_COMPU_METHOD 0 0 0 255 ECU_ADDRESS 0x40004AC0 /end MEASUREMENT
/begin MEASUREMENT LEA_obd_ii_P0155_pass_counter "Learned/adaptive value: OBD-II P0155 pass counter." UBYTE NO_COMPU_METHOD 0 0 0 255 ECU_ADDRESS 0x40004AC1 /end MEASUREMENT
/begin MEASUREMENT LEA_obd_ii_P0157_dtc_state "Learned/adaptive value: OBD-II P0157 DTC state." UBYTE NO_COMPU_METHOD 0 0 0 255 ECU_ADDRESS 0x40004AC2 /end MEASUREMENT
/begin MEASUREMENT LEA_obd_ii_P0157_fail_counter "Learned/adaptive value: OBD-II P0157 fail counter." UBYTE NO_COMPU_METHOD 0 0 0 255 ECU_ADDRESS 0x40004AC3 /end MEASUREMENT
/begin MEASUREMENT LEA_obd_ii_P0157_pass_counter "Learned/adaptive value: OBD-II P0157 pass counter." UBYTE NO_COMPU_METHOD 0 0 0 255 ECU_ADDRESS 0x40004AC4 /end MEASUREMENT
/begin MEASUREMENT LEA_obd_ii_P0158_dtc_state "Learned/adaptive value: OBD-II P0158 DTC state." UBYTE NO_COMPU_METHOD 0 0 0 255 ECU_ADDRESS 0x40004AC5 /end MEASUREMENT
/begin MEASUREMENT LEA_obd_ii_P0158_fail_counter "Learned/adaptive value: OBD-II P0158 fail counter." UBYTE NO_COMPU_METHOD 0 0 0 255 ECU_ADDRESS 0x40004AC6 /end MEASUREMENT
/begin MEASUREMENT LEA_obd_ii_P0158_pass_counter "Learned/adaptive value: OBD-II P0158 pass counter." UBYTE NO_COMPU_METHOD 0 0 0 255 ECU_ADDRESS 0x40004AC7 /end MEASUREMENT
/begin MEASUREMENT LEA_obd_ii_P0159_dtc_state "Learned/adaptive value: OBD-II P0159 DTC state." UBYTE NO_COMPU_METHOD 0 0 0 255 ECU_ADDRESS 0x40004AC8 /end MEASUREMENT
/begin MEASUREMENT LEA_obd_ii_P0159_fail_counter "Learned/adaptive value: OBD-II P0159 fail counter." UBYTE NO_COMPU_METHOD 0 0 0 255 ECU_ADDRESS 0x40004AC9 /end MEASUREMENT
/begin MEASUREMENT LEA_obd_ii_P0159_pass_counter "Learned/adaptive value: OBD-II P0159 pass counter." UBYTE NO_COMPU_METHOD 0 0 0 255 ECU_ADDRESS 0x40004ACA /end MEASUREMENT
/begin MEASUREMENT LEA_obd_ii_P0160_dtc_state "Learned/adaptive value: OBD-II P0160 DTC state." UBYTE NO_COMPU_METHOD 0 0 0 255 ECU_ADDRESS 0x40004ACB /end MEASUREMENT
/begin MEASUREMENT LEA_obd_ii_P0160_fail_counter "Learned/adaptive value: OBD-II P0160 fail counter." UBYTE NO_COMPU_METHOD 0 0 0 255 ECU_ADDRESS 0x40004ACC /end MEASUREMENT
/begin MEASUREMENT LEA_obd_ii_P0160_pass_counter "Learned/adaptive value: OBD-II P0160 pass counter." UBYTE NO_COMPU_METHOD 0 0 0 255 ECU_ADDRESS 0x40004ACD /end MEASUREMENT
/begin MEASUREMENT LEA_obd_ii_P0161_dtc_state "Learned/adaptive value: OBD-II P0161 DTC state." UBYTE NO_COMPU_METHOD 0 0 0 255 ECU_ADDRESS 0x40004ACE /end MEASUREMENT
/begin MEASUREMENT LEA_obd_ii_P0161_fail_counter "Learned/adaptive value: OBD-II P0161 fail counter." UBYTE NO_COMPU_METHOD 0 0 0 255 ECU_ADDRESS 0x40004ACF /end MEASUREMENT
/begin MEASUREMENT LEA_obd_ii_P0161_pass_counter "Learned/adaptive value: OBD-II P0161 pass counter." UBYTE NO_COMPU_METHOD 0 0 0 255 ECU_ADDRESS 0x40004AD0 /end MEASUREMENT
/begin MEASUREMENT LEA_obd_ii_P0171_dtc_state "Learned/adaptive value: OBD-II P0171 DTC state." UBYTE NO_COMPU_METHOD 0 0 0 255 ECU_ADDRESS 0x40004AD1 /end MEASUREMENT
/begin MEASUREMENT LEA_obd_ii_P0171_fail_counter "Learned/adaptive value: OBD-II P0171 fail counter." UBYTE NO_COMPU_METHOD 0 0 0 255 ECU_ADDRESS 0x40004AD2 /end MEASUREMENT
/begin MEASUREMENT LEA_obd_ii_P0171_pass_counter "Learned/adaptive value: OBD-II P0171 pass counter." UBYTE NO_COMPU_METHOD 0 0 0 255 ECU_ADDRESS 0x40004AD3 /end MEASUREMENT
/begin MEASUREMENT LEA_obd_ii_P0172_dtc_state "Learned/adaptive value: OBD-II P0172 DTC state." UBYTE NO_COMPU_METHOD 0 0 0 255 ECU_ADDRESS 0x40004AD4 /end MEASUREMENT
/begin MEASUREMENT LEA_obd_ii_P0172_fail_counter "Learned/adaptive value: OBD-II P0172 fail counter." UBYTE NO_COMPU_METHOD 0 0 0 255 ECU_ADDRESS 0x40004AD5 /end MEASUREMENT
/begin MEASUREMENT LEA_obd_ii_P0172_pass_counter "Learned/adaptive value: OBD-II P0172 pass counter." UBYTE NO_COMPU_METHOD 0 0 0 255 ECU_ADDRESS 0x40004AD6 /end MEASUREMENT
/begin MEASUREMENT LEA_obd_ii_P0174_dtc_state "Learned/adaptive value: OBD-II P0174 DTC state." UBYTE NO_COMPU_METHOD 0 0 0 255 ECU_ADDRESS 0x40004AD7 /end MEASUREMENT
/begin MEASUREMENT LEA_obd_ii_P0174_fail_counter "Learned/adaptive value: OBD-II P0174 fail counter." UBYTE NO_COMPU_METHOD 0 0 0 255 ECU_ADDRESS 0x40004AD8 /end MEASUREMENT
/begin MEASUREMENT LEA_obd_ii_P0174_pass_counter "Learned/adaptive value: OBD-II P0174 pass counter." UBYTE NO_COMPU_METHOD 0 0 0 255 ECU_ADDRESS 0x40004AD9 /end MEASUREMENT
/begin MEASUREMENT LEA_obd_ii_P0175_dtc_state "Learned/adaptive value: OBD-II P0175 DTC state." UBYTE NO_COMPU_METHOD 0 0 0 255 ECU_ADDRESS 0x40004ADA /end MEASUREMENT
/begin MEASUREMENT LEA_obd_ii_P0175_fail_counter "Learned/adaptive value: OBD-II P0175 fail counter." UBYTE NO_COMPU_METHOD 0 0 0 255 ECU_ADDRESS 0x40004ADB /end MEASUREMENT
/begin MEASUREMENT LEA_obd_ii_P0175_pass_counter "Learned/adaptive value: OBD-II P0175 pass counter." UBYTE NO_COMPU_METHOD 0 0 0 255 ECU_ADDRESS 0x40004ADC /end MEASUREMENT
/begin MEASUREMENT LEA_obd_ii_P0191_dtc_state "Learned/adaptive value: OBD-II P0191 DTC state." UBYTE NO_COMPU_METHOD 0 0 0 255 ECU_ADDRESS 0x40004ADD /end MEASUREMENT
/begin MEASUREMENT LEA_obd_ii_P0191_fail_counter "Learned/adaptive value: OBD-II P0191 fail counter." UBYTE NO_COMPU_METHOD 0 0 0 255 ECU_ADDRESS 0x40004ADE /end MEASUREMENT
/begin MEASUREMENT LEA_obd_ii_P0191_pass_counter "Learned/adaptive value: OBD-II P0191 pass counter." UBYTE NO_COMPU_METHOD 0 0 0 255 ECU_ADDRESS 0x40004ADF /end MEASUREMENT
/begin MEASUREMENT LEA_obd_ii_P0192_dtc_state "Learned/adaptive value: OBD-II P0192 DTC state." UBYTE NO_COMPU_METHOD 0 0 0 255 ECU_ADDRESS 0x40004AE0 /end MEASUREMENT
/begin MEASUREMENT LEA_obd_ii_P0192_fail_counter "Learned/adaptive value: OBD-II P0192 fail counter." UBYTE NO_COMPU_METHOD 0 0 0 255 ECU_ADDRESS 0x40004AE1 /end MEASUREMENT
/begin MEASUREMENT LEA_obd_ii_P0192_pass_counter "Learned/adaptive value: OBD-II P0192 pass counter." UBYTE NO_COMPU_METHOD 0 0 0 255 ECU_ADDRESS 0x40004AE2 /end MEASUREMENT
/begin MEASUREMENT LEA_obd_ii_P0193_dtc_state "Learned/adaptive value: OBD-II P0193 DTC state." UBYTE NO_COMPU_METHOD 0 0 0 255 ECU_ADDRESS 0x40004AE3 /end MEASUREMENT
/begin MEASUREMENT LEA_obd_ii_P0193_fail_counter "Learned/adaptive value: OBD-II P0193 fail counter." UBYTE NO_COMPU_METHOD 0 0 0 255 ECU_ADDRESS 0x40004AE4 /end MEASUREMENT
/begin MEASUREMENT LEA_obd_ii_P0193_pass_counter "Learned/adaptive value: OBD-II P0193 pass counter." UBYTE NO_COMPU_METHOD 0 0 0 255 ECU_ADDRESS 0x40004AE5 /end MEASUREMENT
/begin MEASUREMENT LEA_obd_ii_P0222_dtc_state "Learned/adaptive value: OBD-II P0222 DTC state." UBYTE NO_COMPU_METHOD 0 0 0 255 ECU_ADDRESS 0x40004AE6 /end MEASUREMENT
/begin MEASUREMENT LEA_obd_ii_P0222_fail_counter "Learned/adaptive value: OBD-II P0222 fail counter." UBYTE NO_COMPU_METHOD 0 0 0 255 ECU_ADDRESS 0x40004AE7 /end MEASUREMENT
/begin MEASUREMENT LEA_obd_ii_P0222_pass_counter "Learned/adaptive value: OBD-II P0222 pass counter." UBYTE NO_COMPU_METHOD 0 0 0 255 ECU_ADDRESS 0x40004AE8 /end MEASUREMENT
/begin MEASUREMENT LEA_obd_ii_P0223_dtc_state "Learned/adaptive value: OBD-II P0223 DTC state." UBYTE NO_COMPU_METHOD 0 0 0 255 ECU_ADDRESS 0x40004AE9 /end MEASUREMENT
/begin MEASUREMENT LEA_obd_ii_P0223_fail_counter "Learned/adaptive value: OBD-II P0223 fail counter." UBYTE NO_COMPU_METHOD 0 0 0 255 ECU_ADDRESS 0x40004AEA /end MEASUREMENT
/begin MEASUREMENT LEA_obd_ii_P0223_pass_counter "Learned/adaptive value: OBD-II P0223 pass counter." UBYTE NO_COMPU_METHOD 0 0 0 255 ECU_ADDRESS 0x40004AEB /end MEASUREMENT
/begin MEASUREMENT LEA_obd_ii_P025C_dtc_state "Learned/adaptive value: OBD-II P025C DTC state." UBYTE NO_COMPU_METHOD 0 0 0 255 ECU_ADDRESS 0x40004AEC /end MEASUREMENT
/begin MEASUREMENT LEA_obd_ii_P025C_fail_counter "Learned/adaptive value: OBD-II P025C fail counter." UBYTE NO_COMPU_METHOD 0 0 0 255 ECU_ADDRESS 0x40004AED /end MEASUREMENT
/begin MEASUREMENT LEA_obd_ii_P025C_pass_counter "Learned/adaptive value: OBD-II P025C pass counter." UBYTE NO_COMPU_METHOD 0 0 0 255 ECU_ADDRESS 0x40004AEE /end MEASUREMENT
/begin MEASUREMENT LEA_obd_ii_P025D_dtc_state "Learned/adaptive value: OBD-II P025D DTC state." UBYTE NO_COMPU_METHOD 0 0 0 255 ECU_ADDRESS 0x40004AEF /end MEASUREMENT
/begin MEASUREMENT LEA_obd_ii_P025D_fail_counter "Learned/adaptive value: OBD-II P025D fail counter." UBYTE NO_COMPU_METHOD 0 0 0 255 ECU_ADDRESS 0x40004AF0 /end MEASUREMENT
/begin MEASUREMENT LEA_obd_ii_P025D_pass_counter "Learned/adaptive value: OBD-II P025D pass counter." UBYTE NO_COMPU_METHOD 0 0 0 255 ECU_ADDRESS 0x40004AF1 /end MEASUREMENT
/begin MEASUREMENT LEA_obd_ii_P0261_dtc_state "Learned/adaptive value: OBD-II P0261 DTC state." UBYTE NO_COMPU_METHOD 0 0 0 255 ECU_ADDRESS 0x40004AF2 /end MEASUREMENT
/begin MEASUREMENT LEA_obd_ii_P0261_fail_counter "Learned/adaptive value: OBD-II P0261 fail counter." UBYTE NO_COMPU_METHOD 0 0 0 255 ECU_ADDRESS 0x40004AF3 /end MEASUREMENT
/begin MEASUREMENT LEA_obd_ii_P0261_pass_counter "Learned/adaptive value: OBD-II P0261 pass counter." UBYTE NO_COMPU_METHOD 0 0 0 255 ECU_ADDRESS 0x40004AF4 /end MEASUREMENT
/begin MEASUREMENT LEA_obd_ii_P0262_dtc_state "Learned/adaptive value: OBD-II P0262 DTC state." UBYTE NO_COMPU_METHOD 0 0 0 255 ECU_ADDRESS 0x40004AF5 /end MEASUREMENT
/begin MEASUREMENT LEA_obd_ii_P0262_fail_counter "Learned/adaptive value: OBD-II P0262 fail counter." UBYTE NO_COMPU_METHOD 0 0 0 255 ECU_ADDRESS 0x40004AF6 /end MEASUREMENT
/begin MEASUREMENT LEA_obd_ii_P0262_pass_counter "Learned/adaptive value: OBD-II P0262 pass counter." UBYTE NO_COMPU_METHOD 0 0 0 255 ECU_ADDRESS 0x40004AF7 /end MEASUREMENT
/begin MEASUREMENT LEA_obd_ii_P0264_dtc_state "Learned/adaptive value: OBD-II P0264 DTC state." UBYTE NO_COMPU_METHOD 0 0 0 255 ECU_ADDRESS 0x40004AF8 /end MEASUREMENT
/begin MEASUREMENT LEA_obd_ii_P0264_fail_counter "Learned/adaptive value: OBD-II P0264 fail counter." UBYTE NO_COMPU_METHOD 0 0 0 255 ECU_ADDRESS 0x40004AF9 /end MEASUREMENT
/begin MEASUREMENT LEA_obd_ii_P0264_pass_counter "Learned/adaptive value: OBD-II P0264 pass counter." UBYTE NO_COMPU_METHOD 0 0 0 255 ECU_ADDRESS 0x40004AFA /end MEASUREMENT
/begin MEASUREMENT LEA_obd_ii_P0265_dtc_state "Learned/adaptive value: OBD-II P0265 DTC state." UBYTE NO_COMPU_METHOD 0 0 0 255 ECU_ADDRESS 0x40004AFB /end MEASUREMENT
/begin MEASUREMENT LEA_obd_ii_P0265_fail_counter "Learned/adaptive value: OBD-II P0265 fail counter." UBYTE NO_COMPU_METHOD 0 0 0 255 ECU_ADDRESS 0x40004AFC /end MEASUREMENT
/begin MEASUREMENT LEA_obd_ii_P0265_pass_counter "Learned/adaptive value: OBD-II P0265 pass counter." UBYTE NO_COMPU_METHOD 0 0 0 255 ECU_ADDRESS 0x40004AFD /end MEASUREMENT
/begin MEASUREMENT LEA_obd_ii_P0267_dtc_state "Learned/adaptive value: OBD-II P0267 DTC state." UBYTE NO_COMPU_METHOD 0 0 0 255 ECU_ADDRESS 0x40004AFE /end MEASUREMENT
/begin MEASUREMENT LEA_obd_ii_P0267_fail_counter "Learned/adaptive value: OBD-II P0267 fail counter." UBYTE NO_COMPU_METHOD 0 0 0 255 ECU_ADDRESS 0x40004AFF /end MEASUREMENT
/begin MEASUREMENT LEA_obd_ii_P0267_pass_counter "Learned/adaptive value: OBD-II P0267 pass counter." UBYTE NO_COMPU_METHOD 0 0 0 255 ECU_ADDRESS 0x40004B00 /end MEASUREMENT
/begin MEASUREMENT LEA_obd_ii_P0268_dtc_state "Learned/adaptive value: OBD-II P0268 DTC state." UBYTE NO_COMPU_METHOD 0 0 0 255 ECU_ADDRESS 0x40004B01 /end MEASUREMENT
/begin MEASUREMENT LEA_obd_ii_P0268_fail_counter "Learned/adaptive value: OBD-II P0268 fail counter." UBYTE NO_COMPU_METHOD 0 0 0 255 ECU_ADDRESS 0x40004B02 /end MEASUREMENT
/begin MEASUREMENT LEA_obd_ii_P0268_pass_counter "Learned/adaptive value: OBD-II P0268 pass counter." UBYTE NO_COMPU_METHOD 0 0 0 255 ECU_ADDRESS 0x40004B03 /end MEASUREMENT
/begin MEASUREMENT LEA_obd_ii_P0270_dtc_state "Learned/adaptive value: OBD-II P0270 DTC state." UBYTE NO_COMPU_METHOD 0 0 0 255 ECU_ADDRESS 0x40004B04 /end MEASUREMENT
/begin MEASUREMENT LEA_obd_ii_P0270_fail_counter "Learned/adaptive value: OBD-II P0270 fail counter." UBYTE NO_COMPU_METHOD 0 0 0 255 ECU_ADDRESS 0x40004B05 /end MEASUREMENT
/begin MEASUREMENT LEA_obd_ii_P0270_pass_counter "Learned/adaptive value: OBD-II P0270 pass counter." UBYTE NO_COMPU_METHOD 0 0 0 255 ECU_ADDRESS 0x40004B06 /end MEASUREMENT
/begin MEASUREMENT LEA_obd_ii_P0271_dtc_state "Learned/adaptive value: OBD-II P0271 DTC state." UBYTE NO_COMPU_METHOD 0 0 0 255 ECU_ADDRESS 0x40004B07 /end MEASUREMENT
/begin MEASUREMENT LEA_obd_ii_P0271_fail_counter "Learned/adaptive value: OBD-II P0271 fail counter." UBYTE NO_COMPU_METHOD 0 0 0 255 ECU_ADDRESS 0x40004B08 /end MEASUREMENT
/begin MEASUREMENT LEA_obd_ii_P0271_pass_counter "Learned/adaptive value: OBD-II P0271 pass counter." UBYTE NO_COMPU_METHOD 0 0 0 255 ECU_ADDRESS 0x40004B09 /end MEASUREMENT
/begin MEASUREMENT LEA_obd_ii_P0273_dtc_state "Learned/adaptive value: OBD-II P0273 DTC state." UBYTE NO_COMPU_METHOD 0 0 0 255 ECU_ADDRESS 0x40004B0A /end MEASUREMENT
/begin MEASUREMENT LEA_obd_ii_P0273_fail_counter "Learned/adaptive value: OBD-II P0273 fail counter." UBYTE NO_COMPU_METHOD 0 0 0 255 ECU_ADDRESS 0x40004B0B /end MEASUREMENT
/begin MEASUREMENT LEA_obd_ii_P0273_pass_counter "Learned/adaptive value: OBD-II P0273 pass counter." UBYTE NO_COMPU_METHOD 0 0 0 255 ECU_ADDRESS 0x40004B0C /end MEASUREMENT
/begin MEASUREMENT LEA_obd_ii_P0274_dtc_state "Learned/adaptive value: OBD-II P0274 DTC state." UBYTE NO_COMPU_METHOD 0 0 0 255 ECU_ADDRESS 0x40004B0D /end MEASUREMENT
/begin MEASUREMENT LEA_obd_ii_P0274_fail_counter "Learned/adaptive value: OBD-II P0274 fail counter." UBYTE NO_COMPU_METHOD 0 0 0 255 ECU_ADDRESS 0x40004B0E /end MEASUREMENT
/begin MEASUREMENT LEA_obd_ii_P0274_pass_counter "Learned/adaptive value: OBD-II P0274 pass counter." UBYTE NO_COMPU_METHOD 0 0 0 255 ECU_ADDRESS 0x40004B0F /end MEASUREMENT
/begin MEASUREMENT LEA_obd_ii_P0276_dtc_state "Learned/adaptive value: OBD-II P0276 DTC state." UBYTE NO_COMPU_METHOD 0 0 0 255 ECU_ADDRESS 0x40004B10 /end MEASUREMENT
/begin MEASUREMENT LEA_obd_ii_P0276_fail_counter "Learned/adaptive value: OBD-II P0276 fail counter." UBYTE NO_COMPU_METHOD 0 0 0 255 ECU_ADDRESS 0x40004B11 /end MEASUREMENT
/begin MEASUREMENT LEA_obd_ii_P0276_pass_counter "Learned/adaptive value: OBD-II P0276 pass counter." UBYTE NO_COMPU_METHOD 0 0 0 255 ECU_ADDRESS 0x40004B12 /end MEASUREMENT
/begin MEASUREMENT LEA_obd_ii_P0277_dtc_state "Learned/adaptive value: OBD-II P0277 DTC state." UBYTE NO_COMPU_METHOD 0 0 0 255 ECU_ADDRESS 0x40004B13 /end MEASUREMENT
/begin MEASUREMENT LEA_obd_ii_P0277_fail_counter "Learned/adaptive value: OBD-II P0277 fail counter." UBYTE NO_COMPU_METHOD 0 0 0 255 ECU_ADDRESS 0x40004B14 /end MEASUREMENT
/begin MEASUREMENT LEA_obd_ii_P0277_pass_counter "Learned/adaptive value: OBD-II P0277 pass counter." UBYTE NO_COMPU_METHOD 0 0 0 255 ECU_ADDRESS 0x40004B15 /end MEASUREMENT
/begin MEASUREMENT LEA_obd_ii_P023B_dtc_state "Learned/adaptive value: OBD-II P023B DTC state." UBYTE NO_COMPU_METHOD 0 0 0 255 ECU_ADDRESS 0x40004B1C /end MEASUREMENT
/begin MEASUREMENT LEA_obd_ii_P023B_fail_counter "Learned/adaptive value: OBD-II P023B fail counter." UBYTE NO_COMPU_METHOD 0 0 0 255 ECU_ADDRESS 0x40004B1D /end MEASUREMENT
/begin MEASUREMENT LEA_obd_ii_P023B_pass_counter "Learned/adaptive value: OBD-II P023B pass counter." UBYTE NO_COMPU_METHOD 0 0 0 255 ECU_ADDRESS 0x40004B1E /end MEASUREMENT
/begin MEASUREMENT LEA_obd_ii_P023C_dtc_state "Learned/adaptive value: OBD-II P023C DTC state." UBYTE NO_COMPU_METHOD 0 0 0 255 ECU_ADDRESS 0x40004B1F /end MEASUREMENT
/begin MEASUREMENT LEA_obd_ii_P023C_fail_counter "Learned/adaptive value: OBD-II P023C fail counter." UBYTE NO_COMPU_METHOD 0 0 0 255 ECU_ADDRESS 0x40004B20 /end MEASUREMENT
/begin MEASUREMENT LEA_obd_ii_P023C_pass_counter "Learned/adaptive value: OBD-II P023C pass counter." UBYTE NO_COMPU_METHOD 0 0 0 255 ECU_ADDRESS 0x40004B21 /end MEASUREMENT
/begin MEASUREMENT LEA_obd_ii_P0300_dtc_state "Learned/adaptive value: OBD-II P0300 DTC state." UBYTE NO_COMPU_METHOD 0 0 0 255 ECU_ADDRESS 0x40004B22 /end MEASUREMENT
/begin MEASUREMENT LEA_obd_ii_P0300_fail_counter "Learned/adaptive value: OBD-II P0300 fail counter." UBYTE NO_COMPU_METHOD 0 0 0 255 ECU_ADDRESS 0x40004B23 /end MEASUREMENT
/begin MEASUREMENT LEA_obd_ii_P0300_pass_counter "Learned/adaptive value: OBD-II P0300 pass counter." UBYTE NO_COMPU_METHOD 0 0 0 255 ECU_ADDRESS 0x40004B24 /end MEASUREMENT
/begin MEASUREMENT LEA_obd_ii_P0301_dtc_state "Learned/adaptive value: OBD-II P0301 DTC state." UBYTE NO_COMPU_METHOD 0 0 0 255 ECU_ADDRESS 0x40004B25 /end MEASUREMENT
/begin MEASUREMENT LEA_obd_ii_P0301_fail_counter "Learned/adaptive value: OBD-II P0301 fail counter." UBYTE NO_COMPU_METHOD 0 0 0 255 ECU_ADDRESS 0x40004B26 /end MEASUREMENT
/begin MEASUREMENT LEA_obd_ii_P0301_pass_counter "Learned/adaptive value: OBD-II P0301 pass counter." UBYTE NO_COMPU_METHOD 0 0 0 255 ECU_ADDRESS 0x40004B27 /end MEASUREMENT
/begin MEASUREMENT LEA_obd_ii_P0302_dtc_state "Learned/adaptive value: OBD-II P0302 DTC state." UBYTE NO_COMPU_METHOD 0 0 0 255 ECU_ADDRESS 0x40004B28 /end MEASUREMENT
/begin MEASUREMENT LEA_obd_ii_P0302_fail_counter "Learned/adaptive value: OBD-II P0302 fail counter." UBYTE NO_COMPU_METHOD 0 0 0 255 ECU_ADDRESS 0x40004B29 /end MEASUREMENT
/begin MEASUREMENT LEA_obd_ii_P0302_pass_counter "Learned/adaptive value: OBD-II P0302 pass counter." UBYTE NO_COMPU_METHOD 0 0 0 255 ECU_ADDRESS 0x40004B2A /end MEASUREMENT
/begin MEASUREMENT LEA_obd_ii_P0303_dtc_state "Learned/adaptive value: OBD-II P0303 DTC state." UBYTE NO_COMPU_METHOD 0 0 0 255 ECU_ADDRESS 0x40004B2B /end MEASUREMENT
/begin MEASUREMENT LEA_obd_ii_P0303_fail_counter "Learned/adaptive value: OBD-II P0303 fail counter." UBYTE NO_COMPU_METHOD 0 0 0 255 ECU_ADDRESS 0x40004B2C /end MEASUREMENT
/begin MEASUREMENT LEA_obd_ii_P0303_pass_counter "Learned/adaptive value: OBD-II P0303 pass counter." UBYTE NO_COMPU_METHOD 0 0 0 255 ECU_ADDRESS 0x40004B2D /end MEASUREMENT
/begin MEASUREMENT LEA_obd_ii_P0304_dtc_state "Learned/adaptive value: OBD-II P0304 DTC state." UBYTE NO_COMPU_METHOD 0 0 0 255 ECU_ADDRESS 0x40004B2E /end MEASUREMENT
/begin MEASUREMENT LEA_obd_ii_P0304_fail_counter "Learned/adaptive value: OBD-II P0304 fail counter." UBYTE NO_COMPU_METHOD 0 0 0 255 ECU_ADDRESS 0x40004B2F /end MEASUREMENT
/begin MEASUREMENT LEA_obd_ii_P0304_pass_counter "Learned/adaptive value: OBD-II P0304 pass counter." UBYTE NO_COMPU_METHOD 0 0 0 255 ECU_ADDRESS 0x40004B30 /end MEASUREMENT
/begin MEASUREMENT LEA_obd_ii_P0305_dtc_state "Learned/adaptive value: OBD-II P0305 DTC state." UBYTE NO_COMPU_METHOD 0 0 0 255 ECU_ADDRESS 0x40004B31 /end MEASUREMENT
/begin MEASUREMENT LEA_obd_ii_P0305_fail_counter "Learned/adaptive value: OBD-II P0305 fail counter." UBYTE NO_COMPU_METHOD 0 0 0 255 ECU_ADDRESS 0x40004B32 /end MEASUREMENT
/begin MEASUREMENT LEA_obd_ii_P0305_pass_counter "Learned/adaptive value: OBD-II P0305 pass counter." UBYTE NO_COMPU_METHOD 0 0 0 255 ECU_ADDRESS 0x40004B33 /end MEASUREMENT
/begin MEASUREMENT LEA_obd_ii_P0306_dtc_state "Learned/adaptive value: OBD-II P0306 DTC state." UBYTE NO_COMPU_METHOD 0 0 0 255 ECU_ADDRESS 0x40004B34 /end MEASUREMENT
/begin MEASUREMENT LEA_obd_ii_P0306_fail_counter "Learned/adaptive value: OBD-II P0306 fail counter." UBYTE NO_COMPU_METHOD 0 0 0 255 ECU_ADDRESS 0x40004B35 /end MEASUREMENT
/begin MEASUREMENT LEA_obd_ii_P0306_pass_counter "Learned/adaptive value: OBD-II P0306 pass counter." UBYTE NO_COMPU_METHOD 0 0 0 255 ECU_ADDRESS 0x40004B36 /end MEASUREMENT
/begin MEASUREMENT LEA_obd_ii_P0327_dtc_state "Learned/adaptive value: OBD-II P0327 DTC state." UBYTE NO_COMPU_METHOD 0 0 0 255 ECU_ADDRESS 0x40004B37 /end MEASUREMENT
/begin MEASUREMENT LEA_obd_ii_P0327_fail_counter "Learned/adaptive value: OBD-II P0327 fail counter." UBYTE NO_COMPU_METHOD 0 0 0 255 ECU_ADDRESS 0x40004B38 /end MEASUREMENT
/begin MEASUREMENT LEA_obd_ii_P0327_pass_counter "Learned/adaptive value: OBD-II P0327 pass counter." UBYTE NO_COMPU_METHOD 0 0 0 255 ECU_ADDRESS 0x40004B39 /end MEASUREMENT
/begin MEASUREMENT LEA_obd_ii_P0328_dtc_state "Learned/adaptive value: OBD-II P0328 DTC state." UBYTE NO_COMPU_METHOD 0 0 0 255 ECU_ADDRESS 0x40004B3A /end MEASUREMENT
/begin MEASUREMENT LEA_obd_ii_P0328_fail_counter "Learned/adaptive value: OBD-II P0328 fail counter." UBYTE NO_COMPU_METHOD 0 0 0 255 ECU_ADDRESS 0x40004B3B /end MEASUREMENT
/begin MEASUREMENT LEA_obd_ii_P0328_pass_counter "Learned/adaptive value: OBD-II P0328 pass counter." UBYTE NO_COMPU_METHOD 0 0 0 255 ECU_ADDRESS 0x40004B3C /end MEASUREMENT
/begin MEASUREMENT LEA_obd_ii_P0332_dtc_state "Learned/adaptive value: OBD-II P0332 DTC state." UBYTE NO_COMPU_METHOD 0 0 0 255 ECU_ADDRESS 0x40004B3D /end MEASUREMENT
/begin MEASUREMENT LEA_obd_ii_P0332_fail_counter "Learned/adaptive value: OBD-II P0332 fail counter." UBYTE NO_COMPU_METHOD 0 0 0 255 ECU_ADDRESS 0x40004B3E /end MEASUREMENT
/begin MEASUREMENT LEA_obd_ii_P0332_pass_counter "Learned/adaptive value: OBD-II P0332 pass counter." UBYTE NO_COMPU_METHOD 0 0 0 255 ECU_ADDRESS 0x40004B3F /end MEASUREMENT
/begin MEASUREMENT LEA_obd_ii_P0333_dtc_state "Learned/adaptive value: OBD-II P0333 DTC state." UBYTE NO_COMPU_METHOD 0 0 0 255 ECU_ADDRESS 0x40004B40 /end MEASUREMENT
/begin MEASUREMENT LEA_obd_ii_P0333_fail_counter "Learned/adaptive value: OBD-II P0333 fail counter." UBYTE NO_COMPU_METHOD 0 0 0 255 ECU_ADDRESS 0x40004B41 /end MEASUREMENT
/begin MEASUREMENT LEA_obd_ii_P0333_pass_counter "Learned/adaptive value: OBD-II P0333 pass counter." UBYTE NO_COMPU_METHOD 0 0 0 255 ECU_ADDRESS 0x40004B42 /end MEASUREMENT
/begin MEASUREMENT LEA_obd_ii_P0335_dtc_state "Learned/adaptive value: OBD-II P0335 DTC state." UBYTE NO_COMPU_METHOD 0 0 0 255 ECU_ADDRESS 0x40004B43 /end MEASUREMENT
/begin MEASUREMENT LEA_obd_ii_P0335_fail_counter "Learned/adaptive value: OBD-II P0335 fail counter." UBYTE NO_COMPU_METHOD 0 0 0 255 ECU_ADDRESS 0x40004B44 /end MEASUREMENT
/begin MEASUREMENT LEA_obd_ii_P0335_pass_counter "Learned/adaptive value: OBD-II P0335 pass counter." UBYTE NO_COMPU_METHOD 0 0 0 255 ECU_ADDRESS 0x40004B45 /end MEASUREMENT
/begin MEASUREMENT LEA_obd_ii_P0341_dtc_state "Learned/adaptive value: OBD-II P0341 DTC state." UBYTE NO_COMPU_METHOD 0 0 0 255 ECU_ADDRESS 0x40004B46 /end MEASUREMENT
/begin MEASUREMENT LEA_obd_ii_P0341_fail_counter "Learned/adaptive value: OBD-II P0341 fail counter." UBYTE NO_COMPU_METHOD 0 0 0 255 ECU_ADDRESS 0x40004B47 /end MEASUREMENT
/begin MEASUREMENT LEA_obd_ii_P0341_pass_counter "Learned/adaptive value: OBD-II P0341 pass counter." UBYTE NO_COMPU_METHOD 0 0 0 255 ECU_ADDRESS 0x40004B48 /end MEASUREMENT
/begin MEASUREMENT LEA_obd_ii_P0346_dtc_state "Learned/adaptive value: OBD-II P0346 DTC state." UBYTE NO_COMPU_METHOD 0 0 0 255 ECU_ADDRESS 0x40004B49 /end MEASUREMENT
/begin MEASUREMENT LEA_obd_ii_P0346_fail_counter "Learned/adaptive value: OBD-II P0346 fail counter." UBYTE NO_COMPU_METHOD 0 0 0 255 ECU_ADDRESS 0x40004B4A /end MEASUREMENT
/begin MEASUREMENT LEA_obd_ii_P0346_pass_counter "Learned/adaptive value: OBD-II P0346 pass counter." UBYTE NO_COMPU_METHOD 0 0 0 255 ECU_ADDRESS 0x40004B4B /end MEASUREMENT
/begin MEASUREMENT LEA_obd_ii_P0366_dtc_state "Learned/adaptive value: OBD-II P0366 DTC state." UBYTE NO_COMPU_METHOD 0 0 0 255 ECU_ADDRESS 0x40004B4C /end MEASUREMENT
/begin MEASUREMENT LEA_obd_ii_P0366_fail_counter "Learned/adaptive value: OBD-II P0366 fail counter." UBYTE NO_COMPU_METHOD 0 0 0 255 ECU_ADDRESS 0x40004B4D /end MEASUREMENT
/begin MEASUREMENT LEA_obd_ii_P0366_pass_counter "Learned/adaptive value: OBD-II P0366 pass counter." UBYTE NO_COMPU_METHOD 0 0 0 255 ECU_ADDRESS 0x40004B4E /end MEASUREMENT
/begin MEASUREMENT LEA_obd_ii_P0391_dtc_state "Learned/adaptive value: OBD-II P0391 DTC state." UBYTE NO_COMPU_METHOD 0 0 0 255 ECU_ADDRESS 0x40004B4F /end MEASUREMENT
/begin MEASUREMENT LEA_obd_ii_P0391_fail_counter "Learned/adaptive value: OBD-II P0391 fail counter." UBYTE NO_COMPU_METHOD 0 0 0 255 ECU_ADDRESS 0x40004B50 /end MEASUREMENT
/begin MEASUREMENT LEA_obd_ii_P0391_pass_counter "Learned/adaptive value: OBD-II P0391 pass counter." UBYTE NO_COMPU_METHOD 0 0 0 255 ECU_ADDRESS 0x40004B51 /end MEASUREMENT
/begin MEASUREMENT LEA_obd_ii_P0351_dtc_state "Learned/adaptive value: OBD-II P0351 DTC state." UBYTE NO_COMPU_METHOD 0 0 0 255 ECU_ADDRESS 0x40004B52 /end MEASUREMENT
/begin MEASUREMENT LEA_obd_ii_P0351_fail_counter "Learned/adaptive value: OBD-II P0351 fail counter." UBYTE NO_COMPU_METHOD 0 0 0 255 ECU_ADDRESS 0x40004B53 /end MEASUREMENT
/begin MEASUREMENT LEA_obd_ii_P0351_pass_counter "Learned/adaptive value: OBD-II P0351 pass counter." UBYTE NO_COMPU_METHOD 0 0 0 255 ECU_ADDRESS 0x40004B54 /end MEASUREMENT
/begin MEASUREMENT LEA_obd_ii_P0352_dtc_state "Learned/adaptive value: OBD-II P0352 DTC state." UBYTE NO_COMPU_METHOD 0 0 0 255 ECU_ADDRESS 0x40004B55 /end MEASUREMENT
/begin MEASUREMENT LEA_obd_ii_P0352_fail_counter "Learned/adaptive value: OBD-II P0352 fail counter." UBYTE NO_COMPU_METHOD 0 0 0 255 ECU_ADDRESS 0x40004B56 /end MEASUREMENT
/begin MEASUREMENT LEA_obd_ii_P0352_pass_counter "Learned/adaptive value: OBD-II P0352 pass counter." UBYTE NO_COMPU_METHOD 0 0 0 255 ECU_ADDRESS 0x40004B57 /end MEASUREMENT
/begin MEASUREMENT LEA_obd_ii_P0353_dtc_state "Learned/adaptive value: OBD-II P0353 DTC state." UBYTE NO_COMPU_METHOD 0 0 0 255 ECU_ADDRESS 0x40004B58 /end MEASUREMENT
/begin MEASUREMENT LEA_obd_ii_P0353_fail_counter "Learned/adaptive value: OBD-II P0353 fail counter." UBYTE NO_COMPU_METHOD 0 0 0 255 ECU_ADDRESS 0x40004B59 /end MEASUREMENT
/begin MEASUREMENT LEA_obd_ii_P0353_pass_counter "Learned/adaptive value: OBD-II P0353 pass counter." UBYTE NO_COMPU_METHOD 0 0 0 255 ECU_ADDRESS 0x40004B5A /end MEASUREMENT
/begin MEASUREMENT LEA_obd_ii_P0354_dtc_state "Learned/adaptive value: OBD-II P0354 DTC state." UBYTE NO_COMPU_METHOD 0 0 0 255 ECU_ADDRESS 0x40004B5B /end MEASUREMENT
/begin MEASUREMENT LEA_obd_ii_P0354_fail_counter "Learned/adaptive value: OBD-II P0354 fail counter." UBYTE NO_COMPU_METHOD 0 0 0 255 ECU_ADDRESS 0x40004B5C /end MEASUREMENT
/begin MEASUREMENT LEA_obd_ii_P0354_pass_counter "Learned/adaptive value: OBD-II P0354 pass counter." UBYTE NO_COMPU_METHOD 0 0 0 255 ECU_ADDRESS 0x40004B5D /end MEASUREMENT
/begin MEASUREMENT LEA_obd_ii_P0355_dtc_state "Learned/adaptive value: OBD-II P0355 DTC state." UBYTE NO_COMPU_METHOD 0 0 0 255 ECU_ADDRESS 0x40004B5E /end MEASUREMENT
/begin MEASUREMENT LEA_obd_ii_P0355_fail_counter "Learned/adaptive value: OBD-II P0355 fail counter." UBYTE NO_COMPU_METHOD 0 0 0 255 ECU_ADDRESS 0x40004B5F /end MEASUREMENT
/begin MEASUREMENT LEA_obd_ii_P0355_pass_counter "Learned/adaptive value: OBD-II P0355 pass counter." UBYTE NO_COMPU_METHOD 0 0 0 255 ECU_ADDRESS 0x40004B60 /end MEASUREMENT
/begin MEASUREMENT LEA_obd_ii_P0356_dtc_state "Learned/adaptive value: OBD-II P0356 DTC state." UBYTE NO_COMPU_METHOD 0 0 0 255 ECU_ADDRESS 0x40004B61 /end MEASUREMENT
/begin MEASUREMENT LEA_obd_ii_P0356_fail_counter "Learned/adaptive value: OBD-II P0356 fail counter." UBYTE NO_COMPU_METHOD 0 0 0 255 ECU_ADDRESS 0x40004B62 /end MEASUREMENT
/begin MEASUREMENT LEA_obd_ii_P0356_pass_counter "Learned/adaptive value: OBD-II P0356 pass counter." UBYTE NO_COMPU_METHOD 0 0 0 255 ECU_ADDRESS 0x40004B63 /end MEASUREMENT
/begin MEASUREMENT LEA_obd_ii_P1301_dtc_state "Learned/adaptive value: OBD-II P1301 DTC state." UBYTE NO_COMPU_METHOD 0 0 0 255 ECU_ADDRESS 0x40004B64 /end MEASUREMENT
/begin MEASUREMENT LEA_obd_ii_P1301_fail_counter "Learned/adaptive value: OBD-II P1301 fail counter." UBYTE NO_COMPU_METHOD 0 0 0 255 ECU_ADDRESS 0x40004B65 /end MEASUREMENT
/begin MEASUREMENT LEA_obd_ii_P1301_pass_counter "Learned/adaptive value: OBD-II P1301 pass counter." UBYTE NO_COMPU_METHOD 0 0 0 255 ECU_ADDRESS 0x40004B66 /end MEASUREMENT
/begin MEASUREMENT LEA_obd_ii_P1302_dtc_state "Learned/adaptive value: OBD-II P1302 DTC state." UBYTE NO_COMPU_METHOD 0 0 0 255 ECU_ADDRESS 0x40004B67 /end MEASUREMENT
/begin MEASUREMENT LEA_obd_ii_P1302_fail_counter "Learned/adaptive value: OBD-II P1302 fail counter." UBYTE NO_COMPU_METHOD 0 0 0 255 ECU_ADDRESS 0x40004B68 /end MEASUREMENT
/begin MEASUREMENT LEA_obd_ii_P1302_pass_counter "Learned/adaptive value: OBD-II P1302 pass counter." UBYTE NO_COMPU_METHOD 0 0 0 255 ECU_ADDRESS 0x40004B69 /end MEASUREMENT
/begin MEASUREMENT LEA_obd_ii_P0420_dtc_state "Learned/adaptive value: OBD-II P0420 DTC state." UBYTE NO_COMPU_METHOD 0 0 0 255 ECU_ADDRESS 0x40004B6A /end MEASUREMENT
/begin MEASUREMENT LEA_obd_ii_P0420_fail_counter "Learned/adaptive value: OBD-II P0420 fail counter." UBYTE NO_COMPU_METHOD 0 0 0 255 ECU_ADDRESS 0x40004B6B /end MEASUREMENT
/begin MEASUREMENT LEA_obd_ii_P0420_pass_counter "Learned/adaptive value: OBD-II P0420 pass counter." UBYTE NO_COMPU_METHOD 0 0 0 255 ECU_ADDRESS 0x40004B6C /end MEASUREMENT
/begin MEASUREMENT LEA_obd_ii_P0430_dtc_state "Learned/adaptive value: OBD-II P0430 DTC state." UBYTE NO_COMPU_METHOD 0 0 0 255 ECU_ADDRESS 0x40004B6D /end MEASUREMENT
/begin MEASUREMENT LEA_obd_ii_P0430_fail_counter "Learned/adaptive value: OBD-II P0430 fail counter." UBYTE NO_COMPU_METHOD 0 0 0 255 ECU_ADDRESS 0x40004B6E /end MEASUREMENT
/begin MEASUREMENT LEA_obd_ii_P0430_pass_counter "Learned/adaptive value: OBD-II P0430 pass counter." UBYTE NO_COMPU_METHOD 0 0 0 255 ECU_ADDRESS 0x40004B6F /end MEASUREMENT
/begin MEASUREMENT LEA_obd_ii_P0441_dtc_state "Learned/adaptive value: OBD-II P0441 DTC state." UBYTE NO_COMPU_METHOD 0 0 0 255 ECU_ADDRESS 0x40004B70 /end MEASUREMENT
/begin MEASUREMENT LEA_obd_ii_P0441_fail_counter "Learned/adaptive value: OBD-II P0441 fail counter." UBYTE NO_COMPU_METHOD 0 0 0 255 ECU_ADDRESS 0x40004B71 /end MEASUREMENT
/begin MEASUREMENT LEA_obd_ii_P0441_pass_counter "Learned/adaptive value: OBD-II P0441 pass counter." UBYTE NO_COMPU_METHOD 0 0 0 255 ECU_ADDRESS 0x40004B72 /end MEASUREMENT
/begin MEASUREMENT LEA_obd_ii_P0442_dtc_state "Learned/adaptive value: OBD-II P0442 DTC state." UBYTE NO_COMPU_METHOD 0 0 0 255 ECU_ADDRESS 0x40004B73 /end MEASUREMENT
/begin MEASUREMENT LEA_obd_ii_P0442_fail_counter "Learned/adaptive value: OBD-II P0442 fail counter." UBYTE NO_COMPU_METHOD 0 0 0 255 ECU_ADDRESS 0x40004B74 /end MEASUREMENT
/begin MEASUREMENT LEA_obd_ii_P0442_pass_counter "Learned/adaptive value: OBD-II P0442 pass counter." UBYTE NO_COMPU_METHOD 0 0 0 255 ECU_ADDRESS 0x40004B75 /end MEASUREMENT
/begin MEASUREMENT LEA_obd_ii_P0444_dtc_state "Learned/adaptive value: OBD-II P0444 DTC state." UBYTE NO_COMPU_METHOD 0 0 0 255 ECU_ADDRESS 0x40004B76 /end MEASUREMENT
/begin MEASUREMENT LEA_obd_ii_P0444_fail_counter "Learned/adaptive value: OBD-II P0444 fail counter." UBYTE NO_COMPU_METHOD 0 0 0 255 ECU_ADDRESS 0x40004B77 /end MEASUREMENT
/begin MEASUREMENT LEA_obd_ii_P0444_pass_counter "Learned/adaptive value: OBD-II P0444 pass counter." UBYTE NO_COMPU_METHOD 0 0 0 255 ECU_ADDRESS 0x40004B78 /end MEASUREMENT
/begin MEASUREMENT LEA_obd_ii_P0445_dtc_state "Learned/adaptive value: OBD-II P0445 DTC state." UBYTE NO_COMPU_METHOD 0 0 0 255 ECU_ADDRESS 0x40004B79 /end MEASUREMENT
/begin MEASUREMENT LEA_obd_ii_P0445_fail_counter "Learned/adaptive value: OBD-II P0445 fail counter." UBYTE NO_COMPU_METHOD 0 0 0 255 ECU_ADDRESS 0x40004B7A /end MEASUREMENT
/begin MEASUREMENT LEA_obd_ii_P0445_pass_counter "Learned/adaptive value: OBD-II P0445 pass counter." UBYTE NO_COMPU_METHOD 0 0 0 255 ECU_ADDRESS 0x40004B7B /end MEASUREMENT
/begin MEASUREMENT LEA_obd_ii_P0446_dtc_state "Learned/adaptive value: OBD-II P0446 DTC state." UBYTE NO_COMPU_METHOD 0 0 0 255 ECU_ADDRESS 0x40004B7C /end MEASUREMENT
/begin MEASUREMENT LEA_obd_ii_P0446_fail_counter "Learned/adaptive value: OBD-II P0446 fail counter." UBYTE NO_COMPU_METHOD 0 0 0 255 ECU_ADDRESS 0x40004B7D /end MEASUREMENT
/begin MEASUREMENT LEA_obd_ii_P0446_pass_counter "Learned/adaptive value: OBD-II P0446 pass counter." UBYTE NO_COMPU_METHOD 0 0 0 255 ECU_ADDRESS 0x40004B7E /end MEASUREMENT
/begin MEASUREMENT LEA_obd_ii_P0447_dtc_state "Learned/adaptive value: OBD-II P0447 DTC state." UBYTE NO_COMPU_METHOD 0 0 0 255 ECU_ADDRESS 0x40004B7F /end MEASUREMENT
/begin MEASUREMENT LEA_obd_ii_P0447_fail_counter "Learned/adaptive value: OBD-II P0447 fail counter." UBYTE NO_COMPU_METHOD 0 0 0 255 ECU_ADDRESS 0x40004B80 /end MEASUREMENT
/begin MEASUREMENT LEA_obd_ii_P0447_pass_counter "Learned/adaptive value: OBD-II P0447 pass counter." UBYTE NO_COMPU_METHOD 0 0 0 255 ECU_ADDRESS 0x40004B81 /end MEASUREMENT
/begin MEASUREMENT LEA_obd_ii_P0448_dtc_state "Learned/adaptive value: OBD-II P0448 DTC state." UBYTE NO_COMPU_METHOD 0 0 0 255 ECU_ADDRESS 0x40004B82 /end MEASUREMENT
/begin MEASUREMENT LEA_obd_ii_P0448_fail_counter "Learned/adaptive value: OBD-II P0448 fail counter." UBYTE NO_COMPU_METHOD 0 0 0 255 ECU_ADDRESS 0x40004B83 /end MEASUREMENT
/begin MEASUREMENT LEA_obd_ii_P0448_pass_counter "Learned/adaptive value: OBD-II P0448 pass counter." UBYTE NO_COMPU_METHOD 0 0 0 255 ECU_ADDRESS 0x40004B84 /end MEASUREMENT
/begin MEASUREMENT LEA_obd_ii_P0451_dtc_state "Learned/adaptive value: OBD-II P0451 DTC state." UBYTE NO_COMPU_METHOD 0 0 0 255 ECU_ADDRESS 0x40004B85 /end MEASUREMENT
/begin MEASUREMENT LEA_obd_ii_P0451_fail_counter "Learned/adaptive value: OBD-II P0451 fail counter." UBYTE NO_COMPU_METHOD 0 0 0 255 ECU_ADDRESS 0x40004B86 /end MEASUREMENT
/begin MEASUREMENT LEA_obd_ii_P0451_pass_counter "Learned/adaptive value: OBD-II P0451 pass counter." UBYTE NO_COMPU_METHOD 0 0 0 255 ECU_ADDRESS 0x40004B87 /end MEASUREMENT
/begin MEASUREMENT LEA_obd_ii_P0452_dtc_state "Learned/adaptive value: OBD-II P0452 DTC state." UBYTE NO_COMPU_METHOD 0 0 0 255 ECU_ADDRESS 0x40004B88 /end MEASUREMENT
/begin MEASUREMENT LEA_obd_ii_P0452_fail_counter "Learned/adaptive value: OBD-II P0452 fail counter." UBYTE NO_COMPU_METHOD 0 0 0 255 ECU_ADDRESS 0x40004B89 /end MEASUREMENT
/begin MEASUREMENT LEA_obd_ii_P0452_pass_counter "Learned/adaptive value: OBD-II P0452 pass counter." UBYTE NO_COMPU_METHOD 0 0 0 255 ECU_ADDRESS 0x40004B8A /end MEASUREMENT
/begin MEASUREMENT LEA_obd_ii_P0453_dtc_state "Learned/adaptive value: OBD-II P0453 DTC state." UBYTE NO_COMPU_METHOD 0 0 0 255 ECU_ADDRESS 0x40004B8B /end MEASUREMENT
/begin MEASUREMENT LEA_obd_ii_P0453_fail_counter "Learned/adaptive value: OBD-II P0453 fail counter." UBYTE NO_COMPU_METHOD 0 0 0 255 ECU_ADDRESS 0x40004B8C /end MEASUREMENT
/begin MEASUREMENT LEA_obd_ii_P0453_pass_counter "Learned/adaptive value: OBD-II P0453 pass counter." UBYTE NO_COMPU_METHOD 0 0 0 255 ECU_ADDRESS 0x40004B8D /end MEASUREMENT
/begin MEASUREMENT LEA_obd_ii_P0455_dtc_state "Learned/adaptive value: OBD-II P0455 DTC state." UBYTE NO_COMPU_METHOD 0 0 0 255 ECU_ADDRESS 0x40004B8E /end MEASUREMENT
/begin MEASUREMENT LEA_obd_ii_P0455_fail_counter "Learned/adaptive value: OBD-II P0455 fail counter." UBYTE NO_COMPU_METHOD 0 0 0 255 ECU_ADDRESS 0x40004B8F /end MEASUREMENT
/begin MEASUREMENT LEA_obd_ii_P0455_pass_counter "Learned/adaptive value: OBD-II P0455 pass counter." UBYTE NO_COMPU_METHOD 0 0 0 255 ECU_ADDRESS 0x40004B90 /end MEASUREMENT
/begin MEASUREMENT LEA_obd_ii_P0456_dtc_state "Learned/adaptive value: OBD-II P0456 DTC state." UBYTE NO_COMPU_METHOD 0 0 0 255 ECU_ADDRESS 0x40004B91 /end MEASUREMENT
/begin MEASUREMENT LEA_obd_ii_P0456_fail_counter "Learned/adaptive value: OBD-II P0456 fail counter." UBYTE NO_COMPU_METHOD 0 0 0 255 ECU_ADDRESS 0x40004B92 /end MEASUREMENT
/begin MEASUREMENT LEA_obd_ii_P0456_pass_counter "Learned/adaptive value: OBD-II P0456 pass counter." UBYTE NO_COMPU_METHOD 0 0 0 255 ECU_ADDRESS 0x40004B93 /end MEASUREMENT
/begin MEASUREMENT LEA_obd_ii_P0461_dtc_state "Learned/adaptive value: OBD-II P0461 DTC state." UBYTE NO_COMPU_METHOD 0 0 0 255 ECU_ADDRESS 0x40004B94 /end MEASUREMENT
/begin MEASUREMENT LEA_obd_ii_P0461_fail_counter "Learned/adaptive value: OBD-II P0461 fail counter." UBYTE NO_COMPU_METHOD 0 0 0 255 ECU_ADDRESS 0x40004B95 /end MEASUREMENT
/begin MEASUREMENT LEA_obd_ii_P0461_pass_counter "Learned/adaptive value: OBD-II P0461 pass counter." UBYTE NO_COMPU_METHOD 0 0 0 255 ECU_ADDRESS 0x40004B96 /end MEASUREMENT
/begin MEASUREMENT LEA_obd_ii_P0462_dtc_state "Learned/adaptive value: OBD-II P0462 DTC state." UBYTE NO_COMPU_METHOD 0 0 0 255 ECU_ADDRESS 0x40004B97 /end MEASUREMENT
/begin MEASUREMENT LEA_obd_ii_P0462_fail_counter "Learned/adaptive value: OBD-II P0462 fail counter." UBYTE NO_COMPU_METHOD 0 0 0 255 ECU_ADDRESS 0x40004B98 /end MEASUREMENT
/begin MEASUREMENT LEA_obd_ii_P0462_pass_counter "Learned/adaptive value: OBD-II P0462 pass counter." UBYTE NO_COMPU_METHOD 0 0 0 255 ECU_ADDRESS 0x40004B99 /end MEASUREMENT
/begin MEASUREMENT LEA_obd_ii_P0463_dtc_state "Learned/adaptive value: OBD-II P0463 DTC state." UBYTE NO_COMPU_METHOD 0 0 0 255 ECU_ADDRESS 0x40004B9A /end MEASUREMENT
/begin MEASUREMENT LEA_obd_ii_P0463_fail_counter "Learned/adaptive value: OBD-II P0463 fail counter." UBYTE NO_COMPU_METHOD 0 0 0 255 ECU_ADDRESS 0x40004B9B /end MEASUREMENT
/begin MEASUREMENT LEA_obd_ii_P0463_pass_counter "Learned/adaptive value: OBD-II P0463 pass counter." UBYTE NO_COMPU_METHOD 0 0 0 255 ECU_ADDRESS 0x40004B9C /end MEASUREMENT
/begin MEASUREMENT LEA_obd_ii_P0480_dtc_state "Learned/adaptive value: OBD-II P0480 DTC state." UBYTE NO_COMPU_METHOD 0 0 0 255 ECU_ADDRESS 0x40004B9D /end MEASUREMENT
/begin MEASUREMENT LEA_obd_ii_P0480_fail_counter "Learned/adaptive value: OBD-II P0480 fail counter." UBYTE NO_COMPU_METHOD 0 0 0 255 ECU_ADDRESS 0x40004B9E /end MEASUREMENT
/begin MEASUREMENT LEA_obd_ii_P0480_pass_counter "Learned/adaptive value: OBD-II P0480 pass counter." UBYTE NO_COMPU_METHOD 0 0 0 255 ECU_ADDRESS 0x40004B9F /end MEASUREMENT
/begin MEASUREMENT LEA_obd_ii_P0482_dtc_state "Learned/adaptive value: OBD-II P0482 DTC state." UBYTE NO_COMPU_METHOD 0 0 0 255 ECU_ADDRESS 0x40004BA0 /end MEASUREMENT
/begin MEASUREMENT LEA_obd_ii_P0482_fail_counter "Learned/adaptive value: OBD-II P0482 fail counter." UBYTE NO_COMPU_METHOD 0 0 0 255 ECU_ADDRESS 0x40004BA1 /end MEASUREMENT
/begin MEASUREMENT LEA_obd_ii_P0482_pass_counter "Learned/adaptive value: OBD-II P0482 pass counter." UBYTE NO_COMPU_METHOD 0 0 0 255 ECU_ADDRESS 0x40004BA2 /end MEASUREMENT
/begin MEASUREMENT LEA_obd_ii_P0500_dtc_state "Learned/adaptive value: OBD-II P0500 DTC state." UBYTE NO_COMPU_METHOD 0 0 0 255 ECU_ADDRESS 0x40004BA3 /end MEASUREMENT
/begin MEASUREMENT LEA_obd_ii_P0500_fail_counter "Learned/adaptive value: OBD-II P0500 fail counter." UBYTE NO_COMPU_METHOD 0 0 0 255 ECU_ADDRESS 0x40004BA4 /end MEASUREMENT
/begin MEASUREMENT LEA_obd_ii_P0500_pass_counter "Learned/adaptive value: OBD-II P0500 pass counter." UBYTE NO_COMPU_METHOD 0 0 0 255 ECU_ADDRESS 0x40004BA5 /end MEASUREMENT
/begin MEASUREMENT LEA_obd_ii_P0506_dtc_state "Learned/adaptive value: OBD-II P0506 DTC state." UBYTE NO_COMPU_METHOD 0 0 0 255 ECU_ADDRESS 0x40004BA6 /end MEASUREMENT
/begin MEASUREMENT LEA_obd_ii_P0506_fail_counter "Learned/adaptive value: OBD-II P0506 fail counter." UBYTE NO_COMPU_METHOD 0 0 0 255 ECU_ADDRESS 0x40004BA7 /end MEASUREMENT
/begin MEASUREMENT LEA_obd_ii_P0506_pass_counter "Learned/adaptive value: OBD-II P0506 pass counter." UBYTE NO_COMPU_METHOD 0 0 0 255 ECU_ADDRESS 0x40004BA8 /end MEASUREMENT
/begin MEASUREMENT LEA_obd_ii_P0507_dtc_state "Learned/adaptive value: OBD-II P0507 DTC state." UBYTE NO_COMPU_METHOD 0 0 0 255 ECU_ADDRESS 0x40004BA9 /end MEASUREMENT
/begin MEASUREMENT LEA_obd_ii_P0507_fail_counter "Learned/adaptive value: OBD-II P0507 fail counter." UBYTE NO_COMPU_METHOD 0 0 0 255 ECU_ADDRESS 0x40004BAA /end MEASUREMENT
/begin MEASUREMENT LEA_obd_ii_P0507_pass_counter "Learned/adaptive value: OBD-II P0507 pass counter." UBYTE NO_COMPU_METHOD 0 0 0 255 ECU_ADDRESS 0x40004BAB /end MEASUREMENT
/begin MEASUREMENT LEA_obd_ii_P050A_dtc_state "Learned/adaptive value: OBD-II P050A DTC state." UBYTE NO_COMPU_METHOD 0 0 0 255 ECU_ADDRESS 0x40004BAC /end MEASUREMENT
/begin MEASUREMENT LEA_obd_ii_P050A_fail_counter "Learned/adaptive value: OBD-II P050A fail counter." UBYTE NO_COMPU_METHOD 0 0 0 255 ECU_ADDRESS 0x40004BAD /end MEASUREMENT
/begin MEASUREMENT LEA_obd_ii_P050A_pass_counter "Learned/adaptive value: OBD-II P050A pass counter." UBYTE NO_COMPU_METHOD 0 0 0 255 ECU_ADDRESS 0x40004BAE /end MEASUREMENT
/begin MEASUREMENT LEA_obd_ii_P050B_dtc_state "Learned/adaptive value: OBD-II P050B DTC state." UBYTE NO_COMPU_METHOD 0 0 0 255 ECU_ADDRESS 0x40004BAF /end MEASUREMENT
/begin MEASUREMENT LEA_obd_ii_P050B_fail_counter "Learned/adaptive value: OBD-II P050B fail counter." UBYTE NO_COMPU_METHOD 0 0 0 255 ECU_ADDRESS 0x40004BB0 /end MEASUREMENT
/begin MEASUREMENT LEA_obd_ii_P050B_pass_counter "Learned/adaptive value: OBD-II P050B pass counter." UBYTE NO_COMPU_METHOD 0 0 0 255 ECU_ADDRESS 0x40004BB1 /end MEASUREMENT
/begin MEASUREMENT LEA_obd_ii_P0522_dtc_state "Learned/adaptive value: OBD-II P0522 DTC state." UBYTE NO_COMPU_METHOD 0 0 0 255 ECU_ADDRESS 0x40004BB2 /end MEASUREMENT
/begin MEASUREMENT LEA_obd_ii_P0522_fail_counter "Learned/adaptive value: OBD-II P0522 fail counter." UBYTE NO_COMPU_METHOD 0 0 0 255 ECU_ADDRESS 0x40004BB3 /end MEASUREMENT
/begin MEASUREMENT LEA_obd_ii_P0522_pass_counter "Learned/adaptive value: OBD-II P0522 pass counter." UBYTE NO_COMPU_METHOD 0 0 0 255 ECU_ADDRESS 0x40004BB4 /end MEASUREMENT
/begin MEASUREMENT LEA_obd_ii_P0523_dtc_state "Learned/adaptive value: OBD-II P0523 DTC state." UBYTE NO_COMPU_METHOD 0 0 0 255 ECU_ADDRESS 0x40004BB5 /end MEASUREMENT
/begin MEASUREMENT LEA_obd_ii_P0523_fail_counter "Learned/adaptive value: OBD-II P0523 fail counter." UBYTE NO_COMPU_METHOD 0 0 0 255 ECU_ADDRESS 0x40004BB6 /end MEASUREMENT
/begin MEASUREMENT LEA_obd_ii_P0523_pass_counter "Learned/adaptive value: OBD-II P0523 pass counter." UBYTE NO_COMPU_METHOD 0 0 0 255 ECU_ADDRESS 0x40004BB7 /end MEASUREMENT
/begin MEASUREMENT LEA_obd_ii_P0524_dtc_state "Learned/adaptive value: OBD-II P0524 DTC state." UBYTE NO_COMPU_METHOD 0 0 0 255 ECU_ADDRESS 0x40004BB8 /end MEASUREMENT
/begin MEASUREMENT LEA_obd_ii_P0524_fail_counter "Learned/adaptive value: OBD-II P0524 fail counter." UBYTE NO_COMPU_METHOD 0 0 0 255 ECU_ADDRESS 0x40004BB9 /end MEASUREMENT
/begin MEASUREMENT LEA_obd_ii_P0524_pass_counter "Learned/adaptive value: OBD-II P0524 pass counter." UBYTE NO_COMPU_METHOD 0 0 0 255 ECU_ADDRESS 0x40004BBA /end MEASUREMENT
/begin MEASUREMENT LEA_obd_ii_P0537_dtc_state "Learned/adaptive value: OBD-II P0537 DTC state." UBYTE NO_COMPU_METHOD 0 0 0 255 ECU_ADDRESS 0x40004BBB /end MEASUREMENT
/begin MEASUREMENT LEA_obd_ii_P0537_fail_counter "Learned/adaptive value: OBD-II P0537 fail counter." UBYTE NO_COMPU_METHOD 0 0 0 255 ECU_ADDRESS 0x40004BBC /end MEASUREMENT
/begin MEASUREMENT LEA_obd_ii_P0537_pass_counter "Learned/adaptive value: OBD-II P0537 pass counter." UBYTE NO_COMPU_METHOD 0 0 0 255 ECU_ADDRESS 0x40004BBD /end MEASUREMENT
/begin MEASUREMENT LEA_obd_ii_P0538_dtc_state "Learned/adaptive value: OBD-II P0538 DTC state." UBYTE NO_COMPU_METHOD 0 0 0 255 ECU_ADDRESS 0x40004BBE /end MEASUREMENT
/begin MEASUREMENT LEA_obd_ii_P0538_fail_counter "Learned/adaptive value: OBD-II P0538 fail counter." UBYTE NO_COMPU_METHOD 0 0 0 255 ECU_ADDRESS 0x40004BBF /end MEASUREMENT
/begin MEASUREMENT LEA_obd_ii_P0538_pass_counter "Learned/adaptive value: OBD-II P0538 pass counter." UBYTE NO_COMPU_METHOD 0 0 0 255 ECU_ADDRESS 0x40004BC0 /end MEASUREMENT
/begin MEASUREMENT LEA_obd_ii_P0562_dtc_state "Learned/adaptive value: OBD-II P0562 DTC state." UBYTE NO_COMPU_METHOD 0 0 0 255 ECU_ADDRESS 0x40004BC1 /end MEASUREMENT
/begin MEASUREMENT LEA_obd_ii_P0562_fail_counter "Learned/adaptive value: OBD-II P0562 fail counter." UBYTE NO_COMPU_METHOD 0 0 0 255 ECU_ADDRESS 0x40004BC2 /end MEASUREMENT
/begin MEASUREMENT LEA_obd_ii_P0562_pass_counter "Learned/adaptive value: OBD-II P0562 pass counter." UBYTE NO_COMPU_METHOD 0 0 0 255 ECU_ADDRESS 0x40004BC3 /end MEASUREMENT
/begin MEASUREMENT LEA_obd_ii_P0563_dtc_state "Learned/adaptive value: OBD-II P0563 DTC state." UBYTE NO_COMPU_METHOD 0 0 0 255 ECU_ADDRESS 0x40004BC4 /end MEASUREMENT
/begin MEASUREMENT LEA_obd_ii_P0563_fail_counter "Learned/adaptive value: OBD-II P0563 fail counter." UBYTE NO_COMPU_METHOD 0 0 0 255 ECU_ADDRESS 0x40004BC5 /end MEASUREMENT
/begin MEASUREMENT LEA_obd_ii_P0563_pass_counter "Learned/adaptive value: OBD-II P0563 pass counter." UBYTE NO_COMPU_METHOD 0 0 0 255 ECU_ADDRESS 0x40004BC6 /end MEASUREMENT
/begin MEASUREMENT LEA_obd_ii_P0571_dtc_state "Learned/adaptive value: OBD-II P0571 DTC state." UBYTE NO_COMPU_METHOD 0 0 0 255 ECU_ADDRESS 0x40004BC7 /end MEASUREMENT
/begin MEASUREMENT LEA_obd_ii_P0571_fail_counter "Learned/adaptive value: OBD-II P0571 fail counter." UBYTE NO_COMPU_METHOD 0 0 0 255 ECU_ADDRESS 0x40004BC8 /end MEASUREMENT
/begin MEASUREMENT LEA_obd_ii_P0571_pass_counter "Learned/adaptive value: OBD-II P0571 pass counter." UBYTE NO_COMPU_METHOD 0 0 0 255 ECU_ADDRESS 0x40004BC9 /end MEASUREMENT
/begin MEASUREMENT LEA_obd_ii_P0578_dtc_state "Learned/adaptive value: OBD-II P0578 DTC state." UBYTE NO_COMPU_METHOD 0 0 0 255 ECU_ADDRESS 0x40004BCA /end MEASUREMENT
/begin MEASUREMENT LEA_obd_ii_P0578_fail_counter "Learned/adaptive value: OBD-II P0578 fail counter." UBYTE NO_COMPU_METHOD 0 0 0 255 ECU_ADDRESS 0x40004BCB /end MEASUREMENT
/begin MEASUREMENT LEA_obd_ii_P0578_pass_counter "Learned/adaptive value: OBD-II P0578 pass counter." UBYTE NO_COMPU_METHOD 0 0 0 255 ECU_ADDRESS 0x40004BCC /end MEASUREMENT
/begin MEASUREMENT LEA_obd_ii_P0579_dtc_state "Learned/adaptive value: OBD-II P0579 DTC state." UBYTE NO_COMPU_METHOD 0 0 0 255 ECU_ADDRESS 0x40004BCD /end MEASUREMENT
/begin MEASUREMENT LEA_obd_ii_P0579_fail_counter "Learned/adaptive value: OBD-II P0579 fail counter." UBYTE NO_COMPU_METHOD 0 0 0 255 ECU_ADDRESS 0x40004BCE /end MEASUREMENT
/begin MEASUREMENT LEA_obd_ii_P0579_pass_counter "Learned/adaptive value: OBD-II P0579 pass counter." UBYTE NO_COMPU_METHOD 0 0 0 255 ECU_ADDRESS 0x40004BCF /end MEASUREMENT
/begin MEASUREMENT LEA_obd_ii_P0564_dtc_state "Learned/adaptive value: OBD-II P0564 DTC state." UBYTE NO_COMPU_METHOD 0 0 0 255 ECU_ADDRESS 0x40004BD0 /end MEASUREMENT
/begin MEASUREMENT LEA_obd_ii_P0564_fail_counter "Learned/adaptive value: OBD-II P0564 fail counter." UBYTE NO_COMPU_METHOD 0 0 0 255 ECU_ADDRESS 0x40004BD1 /end MEASUREMENT
/begin MEASUREMENT LEA_obd_ii_P0564_pass_counter "Learned/adaptive value: OBD-II P0564 pass counter." UBYTE NO_COMPU_METHOD 0 0 0 255 ECU_ADDRESS 0x40004BD2 /end MEASUREMENT
/begin MEASUREMENT LEA_obd_ii_P0601_dtc_state "Learned/adaptive value: OBD-II P0601 DTC state." UBYTE NO_COMPU_METHOD 0 0 0 255 ECU_ADDRESS 0x40004BD3 /end MEASUREMENT
/begin MEASUREMENT LEA_obd_ii_P0601_fail_counter "Learned/adaptive value: OBD-II P0601 fail counter." UBYTE NO_COMPU_METHOD 0 0 0 255 ECU_ADDRESS 0x40004BD4 /end MEASUREMENT
/begin MEASUREMENT LEA_obd_ii_P0601_pass_counter "Learned/adaptive value: OBD-II P0601 pass counter." UBYTE NO_COMPU_METHOD 0 0 0 255 ECU_ADDRESS 0x40004BD5 /end MEASUREMENT
/begin MEASUREMENT LEA_obd_ii_P0606_dtc_state "Learned/adaptive value: OBD-II P0606 DTC state." UBYTE NO_COMPU_METHOD 0 0 0 255 ECU_ADDRESS 0x40004BD6 /end MEASUREMENT
/begin MEASUREMENT LEA_obd_ii_P0606_fail_counter "Learned/adaptive value: OBD-II P0606 fail counter." UBYTE NO_COMPU_METHOD 0 0 0 255 ECU_ADDRESS 0x40004BD7 /end MEASUREMENT
/begin MEASUREMENT LEA_obd_ii_P0606_pass_counter "Learned/adaptive value: OBD-II P0606 pass counter." UBYTE NO_COMPU_METHOD 0 0 0 255 ECU_ADDRESS 0x40004BD8 /end MEASUREMENT
/begin MEASUREMENT LEA_obd_ii_P0610_dtc_state "Learned/adaptive value: OBD-II P0610 DTC state." UBYTE NO_COMPU_METHOD 0 0 0 255 ECU_ADDRESS 0x40004BD9 /end MEASUREMENT
/begin MEASUREMENT LEA_obd_ii_P0610_fail_counter "Learned/adaptive value: OBD-II P0610 fail counter." UBYTE NO_COMPU_METHOD 0 0 0 255 ECU_ADDRESS 0x40004BDA /end MEASUREMENT
/begin MEASUREMENT LEA_obd_ii_P0610_pass_counter "Learned/adaptive value: OBD-II P0610 pass counter." UBYTE NO_COMPU_METHOD 0 0 0 255 ECU_ADDRESS 0x40004BDB /end MEASUREMENT
/begin MEASUREMENT LEA_obd_ii_U0141_dtc_state "Learned/adaptive value: OBD-II U0141 DTC state." UBYTE NO_COMPU_METHOD 0 0 0 255 ECU_ADDRESS 0x40004BDC /end MEASUREMENT
/begin MEASUREMENT LEA_obd_ii_U0141_fail_counter "Learned/adaptive value: OBD-II U0141 fail counter." UBYTE NO_COMPU_METHOD 0 0 0 255 ECU_ADDRESS 0x40004BDD /end MEASUREMENT
/begin MEASUREMENT LEA_obd_ii_U0141_pass_counter "Learned/adaptive value: OBD-II U0141 pass counter." UBYTE NO_COMPU_METHOD 0 0 0 255 ECU_ADDRESS 0x40004BDE /end MEASUREMENT
/begin MEASUREMENT LEA_obd_ii_P0627_dtc_state "Learned/adaptive value: OBD-II P0627 DTC state." UBYTE NO_COMPU_METHOD 0 0 0 255 ECU_ADDRESS 0x40004BDF /end MEASUREMENT
/begin MEASUREMENT LEA_obd_ii_P0627_fail_counter "Learned/adaptive value: OBD-II P0627 fail counter." UBYTE NO_COMPU_METHOD 0 0 0 255 ECU_ADDRESS 0x40004BE0 /end MEASUREMENT
/begin MEASUREMENT LEA_obd_ii_P0627_pass_counter "Learned/adaptive value: OBD-II P0627 pass counter." UBYTE NO_COMPU_METHOD 0 0 0 255 ECU_ADDRESS 0x40004BE1 /end MEASUREMENT
/begin MEASUREMENT LEA_obd_ii_P0630_dtc_state "Learned/adaptive value: OBD-II P0630 DTC state." UBYTE NO_COMPU_METHOD 0 0 0 255 ECU_ADDRESS 0x40004BE2 /end MEASUREMENT
/begin MEASUREMENT LEA_obd_ii_P0630_fail_counter "Learned/adaptive value: OBD-II P0630 fail counter." UBYTE NO_COMPU_METHOD 0 0 0 255 ECU_ADDRESS 0x40004BE3 /end MEASUREMENT
/begin MEASUREMENT LEA_obd_ii_P0630_pass_counter "Learned/adaptive value: OBD-II P0630 pass counter." UBYTE NO_COMPU_METHOD 0 0 0 255 ECU_ADDRESS 0x40004BE4 /end MEASUREMENT
/begin MEASUREMENT LEA_obd_ii_P0638_dtc_state "Learned/adaptive value: OBD-II P0638 DTC state." UBYTE NO_COMPU_METHOD 0 0 0 255 ECU_ADDRESS 0x40004BE5 /end MEASUREMENT
/begin MEASUREMENT LEA_obd_ii_P0638_fail_counter "Learned/adaptive value: OBD-II P0638 fail counter." UBYTE NO_COMPU_METHOD 0 0 0 255 ECU_ADDRESS 0x40004BE6 /end MEASUREMENT
/begin MEASUREMENT LEA_obd_ii_P0638_pass_counter "Learned/adaptive value: OBD-II P0638 pass counter." UBYTE NO_COMPU_METHOD 0 0 0 255 ECU_ADDRESS 0x40004BE7 /end MEASUREMENT
/begin MEASUREMENT LEA_obd_ii_P0647_dtc_state "Learned/adaptive value: OBD-II P0647 DTC state." UBYTE NO_COMPU_METHOD 0 0 0 255 ECU_ADDRESS 0x40004BE8 /end MEASUREMENT
/begin MEASUREMENT LEA_obd_ii_P0647_fail_counter "Learned/adaptive value: OBD-II P0647 fail counter." UBYTE NO_COMPU_METHOD 0 0 0 255 ECU_ADDRESS 0x40004BE9 /end MEASUREMENT
/begin MEASUREMENT LEA_obd_ii_P0647_pass_counter "Learned/adaptive value: OBD-II P0647 pass counter." UBYTE NO_COMPU_METHOD 0 0 0 255 ECU_ADDRESS 0x40004BEA /end MEASUREMENT
/begin MEASUREMENT LEA_obd_ii_P0646_dtc_state "Learned/adaptive value: OBD-II P0646 DTC state." UBYTE NO_COMPU_METHOD 0 0 0 255 ECU_ADDRESS 0x40004BEB /end MEASUREMENT
/begin MEASUREMENT LEA_obd_ii_P0646_fail_counter "Learned/adaptive value: OBD-II P0646 fail counter." UBYTE NO_COMPU_METHOD 0 0 0 255 ECU_ADDRESS 0x40004BEC /end MEASUREMENT
/begin MEASUREMENT LEA_obd_ii_P0646_pass_counter "Learned/adaptive value: OBD-II P0646 pass counter." UBYTE NO_COMPU_METHOD 0 0 0 255 ECU_ADDRESS 0x40004BED /end MEASUREMENT
/begin MEASUREMENT LEA_obd_ii_P0685_dtc_state "Learned/adaptive value: OBD-II P0685 DTC state." UBYTE NO_COMPU_METHOD 0 0 0 255 ECU_ADDRESS 0x40004BEE /end MEASUREMENT
/begin MEASUREMENT LEA_obd_ii_P0685_fail_counter "Learned/adaptive value: OBD-II P0685 fail counter." UBYTE NO_COMPU_METHOD 0 0 0 255 ECU_ADDRESS 0x40004BEF /end MEASUREMENT
/begin MEASUREMENT LEA_obd_ii_P0685_pass_counter "Learned/adaptive value: OBD-II P0685 pass counter." UBYTE NO_COMPU_METHOD 0 0 0 255 ECU_ADDRESS 0x40004BF0 /end MEASUREMENT
/begin MEASUREMENT LEA_obd_ii_P0700_dtc_state "Learned/adaptive value: OBD-II P0700 DTC state." UBYTE NO_COMPU_METHOD 0 0 0 255 ECU_ADDRESS 0x40004BF1 /end MEASUREMENT
/begin MEASUREMENT LEA_obd_ii_P0700_fail_counter "Learned/adaptive value: OBD-II P0700 fail counter." UBYTE NO_COMPU_METHOD 0 0 0 255 ECU_ADDRESS 0x40004BF2 /end MEASUREMENT
/begin MEASUREMENT LEA_obd_ii_P0700_pass_counter "Learned/adaptive value: OBD-II P0700 pass counter." UBYTE NO_COMPU_METHOD 0 0 0 255 ECU_ADDRESS 0x40004BF3 /end MEASUREMENT
/begin MEASUREMENT LEA_obd_ii_P0712_dtc_state "Learned/adaptive value: OBD-II P0712 DTC state." UBYTE NO_COMPU_METHOD 0 0 0 255 ECU_ADDRESS 0x40004BF4 /end MEASUREMENT
/begin MEASUREMENT LEA_obd_ii_P0712_fail_counter "Learned/adaptive value: OBD-II P0712 fail counter." UBYTE NO_COMPU_METHOD 0 0 0 255 ECU_ADDRESS 0x40004BF5 /end MEASUREMENT
/begin MEASUREMENT LEA_obd_ii_P0712_pass_counter "Learned/adaptive value: OBD-II P0712 pass counter." UBYTE NO_COMPU_METHOD 0 0 0 255 ECU_ADDRESS 0x40004BF6 /end MEASUREMENT
/begin MEASUREMENT LEA_obd_ii_P0713_dtc_state "Learned/adaptive value: OBD-II P0713 DTC state." UBYTE NO_COMPU_METHOD 0 0 0 255 ECU_ADDRESS 0x40004BF7 /end MEASUREMENT
/begin MEASUREMENT LEA_obd_ii_P0713_fail_counter "Learned/adaptive value: OBD-II P0713 fail counter." UBYTE NO_COMPU_METHOD 0 0 0 255 ECU_ADDRESS 0x40004BF8 /end MEASUREMENT
/begin MEASUREMENT LEA_obd_ii_P0713_pass_counter "Learned/adaptive value: OBD-II P0713 pass counter." UBYTE NO_COMPU_METHOD 0 0 0 255 ECU_ADDRESS 0x40004BF9 /end MEASUREMENT
/begin MEASUREMENT LEA_obd_ii_P0806_dtc_state "Learned/adaptive value: OBD-II P0806 DTC state." UBYTE NO_COMPU_METHOD 0 0 0 255 ECU_ADDRESS 0x40004BFA /end MEASUREMENT
/begin MEASUREMENT LEA_obd_ii_P0806_fail_counter "Learned/adaptive value: OBD-II P0806 fail counter." UBYTE NO_COMPU_METHOD 0 0 0 255 ECU_ADDRESS 0x40004BFB /end MEASUREMENT
/begin MEASUREMENT LEA_obd_ii_P0806_pass_counter "Learned/adaptive value: OBD-II P0806 pass counter." UBYTE NO_COMPU_METHOD 0 0 0 255 ECU_ADDRESS 0x40004BFC /end MEASUREMENT
/begin MEASUREMENT LEA_obd_ii_P1809_dtc_state "Learned/adaptive value: OBD-II P1809 DTC state." UBYTE NO_COMPU_METHOD 0 0 0 255 ECU_ADDRESS 0x40004BFD /end MEASUREMENT
/begin MEASUREMENT LEA_obd_ii_P1809_fail_counter "Learned/adaptive value: OBD-II P1809 fail counter." UBYTE NO_COMPU_METHOD 0 0 0 255 ECU_ADDRESS 0x40004BFE /end MEASUREMENT
/begin MEASUREMENT LEA_obd_ii_P1809_pass_counter "Learned/adaptive value: OBD-II P1809 pass counter." UBYTE NO_COMPU_METHOD 0 0 0 255 ECU_ADDRESS 0x40004BFF /end MEASUREMENT
/begin MEASUREMENT LEA_obd_ii_P0807_dtc_state "Learned/adaptive value: OBD-II P0807 DTC state." UBYTE NO_COMPU_METHOD 0 0 0 255 ECU_ADDRESS 0x40004C00 /end MEASUREMENT
/begin MEASUREMENT LEA_obd_ii_P0807_fail_counter "Learned/adaptive value: OBD-II P0807 fail counter." UBYTE NO_COMPU_METHOD 0 0 0 255 ECU_ADDRESS 0x40004C01 /end MEASUREMENT
/begin MEASUREMENT LEA_obd_ii_P0807_pass_counter "Learned/adaptive value: OBD-II P0807 pass counter." UBYTE NO_COMPU_METHOD 0 0 0 255 ECU_ADDRESS 0x40004C02 /end MEASUREMENT
/begin MEASUREMENT LEA_obd_ii_P0808_dtc_state "Learned/adaptive value: OBD-II P0808 DTC state." UBYTE NO_COMPU_METHOD 0 0 0 255 ECU_ADDRESS 0x40004C03 /end MEASUREMENT
/begin MEASUREMENT LEA_obd_ii_P0808_fail_counter "Learned/adaptive value: OBD-II P0808 fail counter." UBYTE NO_COMPU_METHOD 0 0 0 255 ECU_ADDRESS 0x40004C04 /end MEASUREMENT
/begin MEASUREMENT LEA_obd_ii_P0808_pass_counter "Learned/adaptive value: OBD-II P0808 pass counter." UBYTE NO_COMPU_METHOD 0 0 0 255 ECU_ADDRESS 0x40004C05 /end MEASUREMENT
/begin MEASUREMENT LEA_obd_ii_P1106_dtc_state "Learned/adaptive value: OBD-II P1106 DTC state." UBYTE NO_COMPU_METHOD 0 0 0 255 ECU_ADDRESS 0x40004C06 /end MEASUREMENT
/begin MEASUREMENT LEA_obd_ii_P1106_fail_counter "Learned/adaptive value: OBD-II P1106 fail counter." UBYTE NO_COMPU_METHOD 0 0 0 255 ECU_ADDRESS 0x40004C07 /end MEASUREMENT
/begin MEASUREMENT LEA_obd_ii_P1106_pass_counter "Learned/adaptive value: OBD-II P1106 pass counter." UBYTE NO_COMPU_METHOD 0 0 0 255 ECU_ADDRESS 0x40004C08 /end MEASUREMENT
/begin MEASUREMENT LEA_obd_ii_P123B_dtc_state "Learned/adaptive value: OBD-II P123B DTC state." UBYTE NO_COMPU_METHOD 0 0 0 255 ECU_ADDRESS 0x40004C09 /end MEASUREMENT
/begin MEASUREMENT LEA_obd_ii_P123B_fail_counter "Learned/adaptive value: OBD-II P123B fail counter." UBYTE NO_COMPU_METHOD 0 0 0 255 ECU_ADDRESS 0x40004C0A /end MEASUREMENT
/begin MEASUREMENT LEA_obd_ii_P123B_pass_counter "Learned/adaptive value: OBD-II P123B pass counter." UBYTE NO_COMPU_METHOD 0 0 0 255 ECU_ADDRESS 0x40004C0B /end MEASUREMENT
/begin MEASUREMENT LEA_obd_ii_P123C_dtc_state "Learned/adaptive value: OBD-II P123C DTC state." UBYTE NO_COMPU_METHOD 0 0 0 255 ECU_ADDRESS 0x40004C0C /end MEASUREMENT
/begin MEASUREMENT LEA_obd_ii_P123C_fail_counter "Learned/adaptive value: OBD-II P123C fail counter." UBYTE NO_COMPU_METHOD 0 0 0 255 ECU_ADDRESS 0x40004C0D /end MEASUREMENT
/begin MEASUREMENT LEA_obd_ii_P123C_pass_counter "Learned/adaptive value: OBD-II P123C pass counter." UBYTE NO_COMPU_METHOD 0 0 0 255 ECU_ADDRESS 0x40004C0E /end MEASUREMENT
/begin MEASUREMENT LEA_obd_ii_P1562_dtc_state "Learned/adaptive value: OBD-II P1562 DTC state." UBYTE NO_COMPU_METHOD 0 0 0 255 ECU_ADDRESS 0x40004C0F /end MEASUREMENT
/begin MEASUREMENT LEA_obd_ii_P1562_fail_counter "Learned/adaptive value: OBD-II P1562 fail counter." UBYTE NO_COMPU_METHOD 0 0 0 255 ECU_ADDRESS 0x40004C10 /end MEASUREMENT
/begin MEASUREMENT LEA_obd_ii_P1562_pass_counter "Learned/adaptive value: OBD-II P1562 pass counter." UBYTE NO_COMPU_METHOD 0 0 0 255 ECU_ADDRESS 0x40004C11 /end MEASUREMENT
/begin MEASUREMENT LEA_obd_ii_P2122_dtc_state "Learned/adaptive value: OBD-II P2122 DTC state." UBYTE NO_COMPU_METHOD 0 0 0 255 ECU_ADDRESS 0x40004C12 /end MEASUREMENT
/begin MEASUREMENT LEA_obd_ii_P2122_fail_counter "Learned/adaptive value: OBD-II P2122 fail counter." UBYTE NO_COMPU_METHOD 0 0 0 255 ECU_ADDRESS 0x40004C13 /end MEASUREMENT
/begin MEASUREMENT LEA_obd_ii_P2122_pass_counter "Learned/adaptive value: OBD-II P2122 pass counter." UBYTE NO_COMPU_METHOD 0 0 0 255 ECU_ADDRESS 0x40004C14 /end MEASUREMENT
/begin MEASUREMENT LEA_obd_ii_P2123_dtc_state "Learned/adaptive value: OBD-II P2123 DTC state." UBYTE NO_COMPU_METHOD 0 0 0 255 ECU_ADDRESS 0x40004C15 /end MEASUREMENT
/begin MEASUREMENT LEA_obd_ii_P2123_fail_counter "Learned/adaptive value: OBD-II P2123 fail counter." UBYTE NO_COMPU_METHOD 0 0 0 255 ECU_ADDRESS 0x40004C16 /end MEASUREMENT
/begin MEASUREMENT LEA_obd_ii_P2123_pass_counter "Learned/adaptive value: OBD-II P2123 pass counter." UBYTE NO_COMPU_METHOD 0 0 0 255 ECU_ADDRESS 0x40004C17 /end MEASUREMENT
/begin MEASUREMENT LEA_obd_ii_P2127_dtc_state "Learned/adaptive value: OBD-II P2127 DTC state." UBYTE NO_COMPU_METHOD 0 0 0 255 ECU_ADDRESS 0x40004C18 /end MEASUREMENT
/begin MEASUREMENT LEA_obd_ii_P2127_fail_counter "Learned/adaptive value: OBD-II P2127 fail counter." UBYTE NO_COMPU_METHOD 0 0 0 255 ECU_ADDRESS 0x40004C19 /end MEASUREMENT
/begin MEASUREMENT LEA_obd_ii_P2127_pass_counter "Learned/adaptive value: OBD-II P2127 pass counter." UBYTE NO_COMPU_METHOD 0 0 0 255 ECU_ADDRESS 0x40004C1A /end MEASUREMENT
/begin MEASUREMENT LEA_obd_ii_P2128_dtc_state "Learned/adaptive value: OBD-II P2128 DTC state." UBYTE NO_COMPU_METHOD 0 0 0 255 ECU_ADDRESS 0x40004C1B /end MEASUREMENT
/begin MEASUREMENT LEA_obd_ii_P2128_fail_counter "Learned/adaptive value: OBD-II P2128 fail counter." UBYTE NO_COMPU_METHOD 0 0 0 255 ECU_ADDRESS 0x40004C1C /end MEASUREMENT
/begin MEASUREMENT LEA_obd_ii_P2128_pass_counter "Learned/adaptive value: OBD-II P2128 pass counter." UBYTE NO_COMPU_METHOD 0 0 0 255 ECU_ADDRESS 0x40004C1D /end MEASUREMENT
/begin MEASUREMENT LEA_obd_ii_P2135_dtc_state "Learned/adaptive value: OBD-II P2135 DTC state." UBYTE NO_COMPU_METHOD 0 0 0 255 ECU_ADDRESS 0x40004C1E /end MEASUREMENT
/begin MEASUREMENT LEA_obd_ii_P2135_fail_counter "Learned/adaptive value: OBD-II P2135 fail counter." UBYTE NO_COMPU_METHOD 0 0 0 255 ECU_ADDRESS 0x40004C1F /end MEASUREMENT
/begin MEASUREMENT LEA_obd_ii_P2135_pass_counter "Learned/adaptive value: OBD-II P2135 pass counter." UBYTE NO_COMPU_METHOD 0 0 0 255 ECU_ADDRESS 0x40004C20 /end MEASUREMENT
/begin MEASUREMENT LEA_obd_ii_P2138_dtc_state "Learned/adaptive value: OBD-II P2138 DTC state." UBYTE NO_COMPU_METHOD 0 0 0 255 ECU_ADDRESS 0x40004C21 /end MEASUREMENT
/begin MEASUREMENT LEA_obd_ii_P2138_fail_counter "Learned/adaptive value: OBD-II P2138 fail counter." UBYTE NO_COMPU_METHOD 0 0 0 255 ECU_ADDRESS 0x40004C22 /end MEASUREMENT
/begin MEASUREMENT LEA_obd_ii_P2138_pass_counter "Learned/adaptive value: OBD-II P2138 pass counter." UBYTE NO_COMPU_METHOD 0 0 0 255 ECU_ADDRESS 0x40004C23 /end MEASUREMENT
/begin MEASUREMENT LEA_obd_ii_P2173_dtc_state "Learned/adaptive value: OBD-II P2173 DTC state." UBYTE NO_COMPU_METHOD 0 0 0 255 ECU_ADDRESS 0x40004C24 /end MEASUREMENT
/begin MEASUREMENT LEA_obd_ii_P2173_fail_counter "Learned/adaptive value: OBD-II P2173 fail counter." UBYTE NO_COMPU_METHOD 0 0 0 255 ECU_ADDRESS 0x40004C25 /end MEASUREMENT
/begin MEASUREMENT LEA_obd_ii_P2173_pass_counter "Learned/adaptive value: OBD-II P2173 pass counter." UBYTE NO_COMPU_METHOD 0 0 0 255 ECU_ADDRESS 0x40004C26 /end MEASUREMENT
/begin MEASUREMENT LEA_obd_ii_P2602_dtc_state "Learned/adaptive value: OBD-II P2602 DTC state." UBYTE NO_COMPU_METHOD 0 0 0 255 ECU_ADDRESS 0x40004C27 /end MEASUREMENT
/begin MEASUREMENT LEA_obd_ii_P2602_fail_counter "Learned/adaptive value: OBD-II P2602 fail counter." UBYTE NO_COMPU_METHOD 0 0 0 255 ECU_ADDRESS 0x40004C28 /end MEASUREMENT
/begin MEASUREMENT LEA_obd_ii_P2602_pass_counter "Learned/adaptive value: OBD-II P2602 pass counter." UBYTE NO_COMPU_METHOD 0 0 0 255 ECU_ADDRESS 0x40004C29 /end MEASUREMENT
/begin MEASUREMENT LEA_obd_ii_P2603_dtc_state "Learned/adaptive value: OBD-II P2603 DTC state." UBYTE NO_COMPU_METHOD 0 0 0 255 ECU_ADDRESS 0x40004C2A /end MEASUREMENT
/begin MEASUREMENT LEA_obd_ii_P2603_fail_counter "Learned/adaptive value: OBD-II P2603 fail counter." UBYTE NO_COMPU_METHOD 0 0 0 255 ECU_ADDRESS 0x40004C2B /end MEASUREMENT
/begin MEASUREMENT LEA_obd_ii_P2603_pass_counter "Learned/adaptive value: OBD-II P2603 pass counter." UBYTE NO_COMPU_METHOD 0 0 0 255 ECU_ADDRESS 0x40004C2C /end MEASUREMENT
/begin MEASUREMENT LEA_unused_byte6 "Learned/adaptive value: unused byte6." UBYTE NO_COMPU_METHOD 0 0 0 255 ECU_ADDRESS 0x40004C33 /end MEASUREMENT
/begin MEASUREMENT LEA_unused_byte5 "Learned/adaptive value: unused byte5." UBYTE NO_COMPU_METHOD 0 0 0 255 ECU_ADDRESS 0x40004C34 /end MEASUREMENT
/begin MEASUREMENT LEA_unused_byte4 "Learned/adaptive value: unused byte4." UBYTE NO_COMPU_METHOD 0 0 0 255 ECU_ADDRESS 0x40004C35 /end MEASUREMENT
/begin MEASUREMENT LEA_unused_byte3 "Learned/adaptive value: unused byte3." UBYTE NO_COMPU_METHOD 0 0 0 255 ECU_ADDRESS 0x40004C36 /end MEASUREMENT
/begin MEASUREMENT LEA_unused_byte3_40004C37 "Learned/adaptive value: unused byte3." UBYTE NO_COMPU_METHOD 0 0 0 255 ECU_ADDRESS 0x40004C37 /end MEASUREMENT
/begin MEASUREMENT LEA_unused_byte2 "Learned/adaptive value: unused byte2." UBYTE NO_COMPU_METHOD 0 0 0 255 ECU_ADDRESS 0x40004C38 /end MEASUREMENT
/begin MEASUREMENT LEA_obd_ii_P2104_dtc_state "Learned/adaptive value: OBD-II P2104 DTC state." UBYTE NO_COMPU_METHOD 0 0 0 255 ECU_ADDRESS 0x40004C39 /end MEASUREMENT
/begin MEASUREMENT LEA_obd_ii_P2104_fail_counter "Learned/adaptive value: OBD-II P2104 fail counter." UBYTE NO_COMPU_METHOD 0 0 0 255 ECU_ADDRESS 0x40004C3A /end MEASUREMENT
/begin MEASUREMENT LEA_obd_ii_P2104_pass_counter "Learned/adaptive value: OBD-II P2104 pass counter." UBYTE NO_COMPU_METHOD 0 0 0 255 ECU_ADDRESS 0x40004C3B /end MEASUREMENT
/begin MEASUREMENT LEA_obd_ii_P1104_dtc_state "Learned/adaptive value: OBD-II P1104 DTC state." UBYTE NO_COMPU_METHOD 0 0 0 255 ECU_ADDRESS 0x40004C3C /end MEASUREMENT
/begin MEASUREMENT LEA_obd_ii_P1104_fail_counter "Learned/adaptive value: OBD-II P1104 fail counter." UBYTE NO_COMPU_METHOD 0 0 0 255 ECU_ADDRESS 0x40004C3D /end MEASUREMENT
/begin MEASUREMENT LEA_obd_ii_P1104_pass_counter "Learned/adaptive value: OBD-II P1104 pass counter." UBYTE NO_COMPU_METHOD 0 0 0 255 ECU_ADDRESS 0x40004C3E /end MEASUREMENT
/begin MEASUREMENT LEA_obd_ii_P2105_dtc_state "Learned/adaptive value: OBD-II P2105 DTC state." UBYTE NO_COMPU_METHOD 0 0 0 255 ECU_ADDRESS 0x40004C3F /end MEASUREMENT
/begin MEASUREMENT LEA_obd_ii_P2105_fail_counter "Learned/adaptive value: OBD-II P2105 fail counter." UBYTE NO_COMPU_METHOD 0 0 0 255 ECU_ADDRESS 0x40004C40 /end MEASUREMENT
/begin MEASUREMENT LEA_obd_ii_P2105_pass_counter "Learned/adaptive value: OBD-II P2105 pass counter." UBYTE NO_COMPU_METHOD 0 0 0 255 ECU_ADDRESS 0x40004C41 /end MEASUREMENT
/begin MEASUREMENT LEA_obd_ii_P2106_dtc_state "Learned/adaptive value: OBD-II P2106 DTC state." UBYTE NO_COMPU_METHOD 0 0 0 255 ECU_ADDRESS 0x40004C42 /end MEASUREMENT
/begin MEASUREMENT LEA_obd_ii_P2106_fail_counter "Learned/adaptive value: OBD-II P2106 fail counter." UBYTE NO_COMPU_METHOD 0 0 0 255 ECU_ADDRESS 0x40004C43 /end MEASUREMENT
/begin MEASUREMENT LEA_obd_ii_P2106_pass_counter "Learned/adaptive value: OBD-II P2106 pass counter." UBYTE NO_COMPU_METHOD 0 0 0 255 ECU_ADDRESS 0x40004C44 /end MEASUREMENT
/begin MEASUREMENT LEA_obd_ii_P2107_dtc_state "Learned/adaptive value: OBD-II P2107 DTC state." UBYTE NO_COMPU_METHOD 0 0 0 255 ECU_ADDRESS 0x40004C45 /end MEASUREMENT
/begin MEASUREMENT LEA_obd_ii_P2107_fail_counter "Learned/adaptive value: OBD-II P2107 fail counter." UBYTE NO_COMPU_METHOD 0 0 0 255 ECU_ADDRESS 0x40004C46 /end MEASUREMENT
/begin MEASUREMENT LEA_obd_ii_P2107_pass_counter "Learned/adaptive value: OBD-II P2107 pass counter." UBYTE NO_COMPU_METHOD 0 0 0 255 ECU_ADDRESS 0x40004C47 /end MEASUREMENT
/begin MEASUREMENT LEA_obd_ii_P2100_dtc_state "Learned/adaptive value: OBD-II P2100 DTC state." UBYTE NO_COMPU_METHOD 0 0 0 255 ECU_ADDRESS 0x40004C48 /end MEASUREMENT
/begin MEASUREMENT LEA_obd_ii_P2100_fail_counter "Learned/adaptive value: OBD-II P2100 fail counter." UBYTE NO_COMPU_METHOD 0 0 0 255 ECU_ADDRESS 0x40004C49 /end MEASUREMENT
/begin MEASUREMENT LEA_obd_ii_P2100_pass_counter "Learned/adaptive value: OBD-II P2100 pass counter." UBYTE NO_COMPU_METHOD 0 0 0 255 ECU_ADDRESS 0x40004C4A /end MEASUREMENT
/begin MEASUREMENT LEA_obd_ii_P2102_dtc_state "Learned/adaptive value: OBD-II P2102 DTC state." UBYTE NO_COMPU_METHOD 0 0 0 255 ECU_ADDRESS 0x40004C4B /end MEASUREMENT
/begin MEASUREMENT LEA_obd_ii_P2102_fail_counter "Learned/adaptive value: OBD-II P2102 fail counter." UBYTE NO_COMPU_METHOD 0 0 0 255 ECU_ADDRESS 0x40004C4C /end MEASUREMENT
/begin MEASUREMENT LEA_obd_ii_P2102_pass_counter "Learned/adaptive value: OBD-II P2102 pass counter." UBYTE NO_COMPU_METHOD 0 0 0 255 ECU_ADDRESS 0x40004C4D /end MEASUREMENT
/begin MEASUREMENT LEA_obd_ii_P2103_dtc_state "Learned/adaptive value: OBD-II P2103 DTC state." UBYTE NO_COMPU_METHOD 0 0 0 255 ECU_ADDRESS 0x40004C4E /end MEASUREMENT
/begin MEASUREMENT LEA_obd_ii_P2103_fail_counter "Learned/adaptive value: OBD-II P2103 fail counter." UBYTE NO_COMPU_METHOD 0 0 0 255 ECU_ADDRESS 0x40004C4F /end MEASUREMENT
/begin MEASUREMENT LEA_obd_ii_P2103_pass_counter "Learned/adaptive value: OBD-II P2103 pass counter." UBYTE NO_COMPU_METHOD 0 0 0 255 ECU_ADDRESS 0x40004C50 /end MEASUREMENT
/begin MEASUREMENT LEA_obd_ii_P2108_dtc_state "Learned/adaptive value: OBD-II P2108 DTC state." UBYTE NO_COMPU_METHOD 0 0 0 255 ECU_ADDRESS 0x40004C51 /end MEASUREMENT
/begin MEASUREMENT LEA_obd_ii_P2108_fail_counter "Learned/adaptive value: OBD-II P2108 fail counter." UBYTE NO_COMPU_METHOD 0 0 0 255 ECU_ADDRESS 0x40004C52 /end MEASUREMENT
/begin MEASUREMENT LEA_obd_ii_P2108_pass_counter "Learned/adaptive value: OBD-II P2108 pass counter." UBYTE NO_COMPU_METHOD 0 0 0 255 ECU_ADDRESS 0x40004C53 /end MEASUREMENT
/begin MEASUREMENT LEA_obd_ii_P2612_dtc_state "Learned/adaptive value: OBD-II P2612 DTC state." UBYTE NO_COMPU_METHOD 0 0 0 255 ECU_ADDRESS 0x40004C54 /end MEASUREMENT
/begin MEASUREMENT LEA_obd_ii_P2612_fail_counter "Learned/adaptive value: OBD-II P2612 fail counter." UBYTE NO_COMPU_METHOD 0 0 0 255 ECU_ADDRESS 0x40004C55 /end MEASUREMENT
/begin MEASUREMENT LEA_obd_ii_P2612_pass_counter "Learned/adaptive value: OBD-II P2612 pass counter." UBYTE NO_COMPU_METHOD 0 0 0 255 ECU_ADDRESS 0x40004C56 /end MEASUREMENT
/begin MEASUREMENT LEA_obd_ii_P2613_dtc_state "Learned/adaptive value: OBD-II P2613 DTC state." UBYTE NO_COMPU_METHOD 0 0 0 255 ECU_ADDRESS 0x40004C57 /end MEASUREMENT
/begin MEASUREMENT LEA_obd_ii_P2613_fail_counter "Learned/adaptive value: OBD-II P2613 fail counter." UBYTE NO_COMPU_METHOD 0 0 0 255 ECU_ADDRESS 0x40004C58 /end MEASUREMENT
/begin MEASUREMENT LEA_obd_ii_P2613_pass_counter "Learned/adaptive value: OBD-II P2613 pass counter." UBYTE NO_COMPU_METHOD 0 0 0 255 ECU_ADDRESS 0x40004C59 /end MEASUREMENT
/begin MEASUREMENT LEA_obd_ii_P0616_dtc_state "Learned/adaptive value: OBD-II P0616 DTC state." UBYTE NO_COMPU_METHOD 0 0 0 255 ECU_ADDRESS 0x40004C5A /end MEASUREMENT
/begin MEASUREMENT LEA_obd_ii_P0616_fail_counter "Learned/adaptive value: OBD-II P0616 fail counter." UBYTE NO_COMPU_METHOD 0 0 0 255 ECU_ADDRESS 0x40004C5B /end MEASUREMENT
/begin MEASUREMENT LEA_obd_ii_P0616_pass_counter "Learned/adaptive value: OBD-II P0616 pass counter." UBYTE NO_COMPU_METHOD 0 0 0 255 ECU_ADDRESS 0x40004C5C /end MEASUREMENT
/begin MEASUREMENT LEA_obd_ii_P0617_dtc_state "Learned/adaptive value: OBD-II P0617 DTC state." UBYTE NO_COMPU_METHOD 0 0 0 255 ECU_ADDRESS 0x40004C5D /end MEASUREMENT
/begin MEASUREMENT LEA_obd_ii_P0617_fail_counter "Learned/adaptive value: OBD-II P0617 fail counter." UBYTE NO_COMPU_METHOD 0 0 0 255 ECU_ADDRESS 0x40004C5E /end MEASUREMENT
/begin MEASUREMENT LEA_obd_ii_P0617_pass_counter "Learned/adaptive value: OBD-II P0617 pass counter." UBYTE NO_COMPU_METHOD 0 0 0 255 ECU_ADDRESS 0x40004C5F /end MEASUREMENT
/begin MEASUREMENT LEA_obd_ii_P2119_dtc_state "Learned/adaptive value: OBD-II P2119 DTC state." UBYTE NO_COMPU_METHOD 0 0 0 255 ECU_ADDRESS 0x40004C60 /end MEASUREMENT
/begin MEASUREMENT LEA_obd_ii_P2119_fail_counter "Learned/adaptive value: OBD-II P2119 fail counter." UBYTE NO_COMPU_METHOD 0 0 0 255 ECU_ADDRESS 0x40004C61 /end MEASUREMENT
/begin MEASUREMENT LEA_obd_ii_P2119_pass_counter "Learned/adaptive value: OBD-II P2119 pass counter." UBYTE NO_COMPU_METHOD 0 0 0 255 ECU_ADDRESS 0x40004C62 /end MEASUREMENT
/begin MEASUREMENT LEA_obd_ii_P2170_dtc_state "Learned/adaptive value: OBD-II P2170 DTC state." UBYTE NO_COMPU_METHOD 0 0 0 255 ECU_ADDRESS 0x40004C63 /end MEASUREMENT
/begin MEASUREMENT LEA_obd_ii_P2170_fail_counter "Learned/adaptive value: OBD-II P2170 fail counter." UBYTE NO_COMPU_METHOD 0 0 0 255 ECU_ADDRESS 0x40004C64 /end MEASUREMENT
/begin MEASUREMENT LEA_obd_ii_P2170_pass_counter "Learned/adaptive value: OBD-II P2170 pass counter." UBYTE NO_COMPU_METHOD 0 0 0 255 ECU_ADDRESS 0x40004C65 /end MEASUREMENT
/begin MEASUREMENT LEA_obd_ii_P2171_dtc_state "Learned/adaptive value: OBD-II P2171 DTC state." UBYTE NO_COMPU_METHOD 0 0 0 255 ECU_ADDRESS 0x40004C66 /end MEASUREMENT
/begin MEASUREMENT LEA_obd_ii_P2171_fail_counter "Learned/adaptive value: OBD-II P2171 fail counter." UBYTE NO_COMPU_METHOD 0 0 0 255 ECU_ADDRESS 0x40004C67 /end MEASUREMENT
/begin MEASUREMENT LEA_obd_ii_P2171_pass_counter "Learned/adaptive value: OBD-II P2171 pass counter." UBYTE NO_COMPU_METHOD 0 0 0 255 ECU_ADDRESS 0x40004C68 /end MEASUREMENT
/begin MEASUREMENT LEA_obd_ii_P0826_dtc_state "Learned/adaptive value: OBD-II P0826 DTC state." UBYTE NO_COMPU_METHOD 0 0 0 255 ECU_ADDRESS 0x40004C69 /end MEASUREMENT
/begin MEASUREMENT LEA_obd_ii_P0826_fail_counter "Learned/adaptive value: OBD-II P0826 fail counter." UBYTE NO_COMPU_METHOD 0 0 0 255 ECU_ADDRESS 0x40004C6A /end MEASUREMENT
/begin MEASUREMENT LEA_obd_ii_P0826_pass_counter "Learned/adaptive value: OBD-II P0826 pass counter." UBYTE NO_COMPU_METHOD 0 0 0 255 ECU_ADDRESS 0x40004C6B /end MEASUREMENT
/begin MEASUREMENT LEA_obd_ii_P0827_dtc_state "Learned/adaptive value: OBD-II P0827 DTC state." UBYTE NO_COMPU_METHOD 0 0 0 255 ECU_ADDRESS 0x40004C6C /end MEASUREMENT
/begin MEASUREMENT LEA_obd_ii_P0827_fail_counter "Learned/adaptive value: OBD-II P0827 fail counter." UBYTE NO_COMPU_METHOD 0 0 0 255 ECU_ADDRESS 0x40004C6D /end MEASUREMENT
/begin MEASUREMENT LEA_obd_ii_P0827_pass_counter "Learned/adaptive value: OBD-II P0827 pass counter." UBYTE NO_COMPU_METHOD 0 0 0 255 ECU_ADDRESS 0x40004C6E /end MEASUREMENT
/begin MEASUREMENT LEA_obd_ii_P0828_dtc_state "Learned/adaptive value: OBD-II P0828 DTC state." UBYTE NO_COMPU_METHOD 0 0 0 255 ECU_ADDRESS 0x40004C6F /end MEASUREMENT
/begin MEASUREMENT LEA_obd_ii_P0828_fail_counter "Learned/adaptive value: OBD-II P0828 fail counter." UBYTE NO_COMPU_METHOD 0 0 0 255 ECU_ADDRESS 0x40004C70 /end MEASUREMENT
/begin MEASUREMENT LEA_obd_ii_P0828_pass_counter "Learned/adaptive value: OBD-II P0828 pass counter." UBYTE NO_COMPU_METHOD 0 0 0 255 ECU_ADDRESS 0x40004C71 /end MEASUREMENT
/begin MEASUREMENT LEA_obd_ii_P2191_dtc_state "Learned/adaptive value: OBD-II P2191 DTC state." UBYTE NO_COMPU_METHOD 0 0 0 255 ECU_ADDRESS 0x40004C72 /end MEASUREMENT
/begin MEASUREMENT LEA_obd_ii_P2191_fail_counter "Learned/adaptive value: OBD-II P2191 fail counter." UBYTE NO_COMPU_METHOD 0 0 0 255 ECU_ADDRESS 0x40004C73 /end MEASUREMENT
/begin MEASUREMENT LEA_obd_ii_P2191_pass_counter "Learned/adaptive value: OBD-II P2191 pass counter." UBYTE NO_COMPU_METHOD 0 0 0 255 ECU_ADDRESS 0x40004C74 /end MEASUREMENT
/begin MEASUREMENT LEA_obd_ii_P2193_dtc_state "Learned/adaptive value: OBD-II P2193 DTC state." UBYTE NO_COMPU_METHOD 0 0 0 255 ECU_ADDRESS 0x40004C75 /end MEASUREMENT
/begin MEASUREMENT LEA_obd_ii_P2193_fail_counter "Learned/adaptive value: OBD-II P2193 fail counter." UBYTE NO_COMPU_METHOD 0 0 0 255 ECU_ADDRESS 0x40004C76 /end MEASUREMENT
/begin MEASUREMENT LEA_obd_ii_P2193_pass_counter "Learned/adaptive value: OBD-II P2193 pass counter." UBYTE NO_COMPU_METHOD 0 0 0 255 ECU_ADDRESS 0x40004C77 /end MEASUREMENT
/begin MEASUREMENT LEA_obd_ii_P219A_dtc_state "Learned/adaptive value: OBD-II P219A DTC state." UBYTE NO_COMPU_METHOD 0 0 0 255 ECU_ADDRESS 0x40004C78 /end MEASUREMENT
/begin MEASUREMENT LEA_obd_ii_P219A_fail_counter "Learned/adaptive value: OBD-II P219A fail counter." UBYTE NO_COMPU_METHOD 0 0 0 255 ECU_ADDRESS 0x40004C79 /end MEASUREMENT
/begin MEASUREMENT LEA_obd_ii_P219A_pass_counter "Learned/adaptive value: OBD-II P219A pass counter." UBYTE NO_COMPU_METHOD 0 0 0 255 ECU_ADDRESS 0x40004C7A /end MEASUREMENT
/begin MEASUREMENT LEA_obd_ii_P219B_dtc_state "Learned/adaptive value: OBD-II P219B DTC state." UBYTE NO_COMPU_METHOD 0 0 0 255 ECU_ADDRESS 0x40004C7B /end MEASUREMENT
/begin MEASUREMENT LEA_obd_ii_P219B_fail_counter "Learned/adaptive value: OBD-II P219B fail counter." UBYTE NO_COMPU_METHOD 0 0 0 255 ECU_ADDRESS 0x40004C7C /end MEASUREMENT
/begin MEASUREMENT LEA_obd_ii_P219B_pass_counter "Learned/adaptive value: OBD-II P219B pass counter." UBYTE NO_COMPU_METHOD 0 0 0 255 ECU_ADDRESS 0x40004C7D /end MEASUREMENT
/begin MEASUREMENT LEA_obd_ii_P2336_dtc_state "Learned/adaptive value: OBD-II P2336 DTC state." UBYTE NO_COMPU_METHOD 0 0 0 255 ECU_ADDRESS 0x40004C7E /end MEASUREMENT
/begin MEASUREMENT LEA_obd_ii_P2336_fail_counter "Learned/adaptive value: OBD-II P2336 fail counter." UBYTE NO_COMPU_METHOD 0 0 0 255 ECU_ADDRESS 0x40004C7F /end MEASUREMENT
/begin MEASUREMENT LEA_obd_ii_P2336_pass_counter "Learned/adaptive value: OBD-II P2336 pass counter." UBYTE NO_COMPU_METHOD 0 0 0 255 ECU_ADDRESS 0x40004C80 /end MEASUREMENT
/begin MEASUREMENT LEA_obd_ii_P2337_dtc_state "Learned/adaptive value: OBD-II P2337 DTC state." UBYTE NO_COMPU_METHOD 0 0 0 255 ECU_ADDRESS 0x40004C81 /end MEASUREMENT
/begin MEASUREMENT LEA_obd_ii_P2337_fail_counter "Learned/adaptive value: OBD-II P2337 fail counter." UBYTE NO_COMPU_METHOD 0 0 0 255 ECU_ADDRESS 0x40004C82 /end MEASUREMENT
/begin MEASUREMENT LEA_obd_ii_P2337_pass_counter "Learned/adaptive value: OBD-II P2337 pass counter." UBYTE NO_COMPU_METHOD 0 0 0 255 ECU_ADDRESS 0x40004C83 /end MEASUREMENT
/begin MEASUREMENT LEA_obd_ii_P2338_dtc_state "Learned/adaptive value: OBD-II P2338 DTC state." UBYTE NO_COMPU_METHOD 0 0 0 255 ECU_ADDRESS 0x40004C84 /end MEASUREMENT
/begin MEASUREMENT LEA_obd_ii_P2338_fail_counter "Learned/adaptive value: OBD-II P2338 fail counter." UBYTE NO_COMPU_METHOD 0 0 0 255 ECU_ADDRESS 0x40004C85 /end MEASUREMENT
/begin MEASUREMENT LEA_obd_ii_P2338_pass_counter "Learned/adaptive value: OBD-II P2338 pass counter." UBYTE NO_COMPU_METHOD 0 0 0 255 ECU_ADDRESS 0x40004C86 /end MEASUREMENT
/begin MEASUREMENT LEA_obd_ii_P2339_dtc_state "Learned/adaptive value: OBD-II P2339 DTC state." UBYTE NO_COMPU_METHOD 0 0 0 255 ECU_ADDRESS 0x40004C87 /end MEASUREMENT
/begin MEASUREMENT LEA_obd_ii_P2339_fail_counter "Learned/adaptive value: OBD-II P2339 fail counter." UBYTE NO_COMPU_METHOD 0 0 0 255 ECU_ADDRESS 0x40004C88 /end MEASUREMENT
/begin MEASUREMENT LEA_obd_ii_P2339_pass_counter "Learned/adaptive value: OBD-II P2339 pass counter." UBYTE NO_COMPU_METHOD 0 0 0 255 ECU_ADDRESS 0x40004C89 /end MEASUREMENT
/begin MEASUREMENT LEA_obd_ii_P2340_dtc_state "Learned/adaptive value: OBD-II P2340 DTC state." UBYTE NO_COMPU_METHOD 0 0 0 255 ECU_ADDRESS 0x40004C8A /end MEASUREMENT
/begin MEASUREMENT LEA_obd_ii_P2340_fail_counter "Learned/adaptive value: OBD-II P2340 fail counter." UBYTE NO_COMPU_METHOD 0 0 0 255 ECU_ADDRESS 0x40004C8B /end MEASUREMENT
/begin MEASUREMENT LEA_obd_ii_P2340_pass_counter "Learned/adaptive value: OBD-II P2340 pass counter." UBYTE NO_COMPU_METHOD 0 0 0 255 ECU_ADDRESS 0x40004C8C /end MEASUREMENT
/begin MEASUREMENT LEA_obd_ii_P2341_dtc_state "Learned/adaptive value: OBD-II P2341 DTC state." UBYTE NO_COMPU_METHOD 0 0 0 255 ECU_ADDRESS 0x40004C8D /end MEASUREMENT
/begin MEASUREMENT LEA_obd_ii_P2341_fail_counter "Learned/adaptive value: OBD-II P2341 fail counter." UBYTE NO_COMPU_METHOD 0 0 0 255 ECU_ADDRESS 0x40004C8E /end MEASUREMENT
/begin MEASUREMENT LEA_obd_ii_P2341_pass_counter "Learned/adaptive value: OBD-II P2341 pass counter." UBYTE NO_COMPU_METHOD 0 0 0 255 ECU_ADDRESS 0x40004C8F /end MEASUREMENT
/begin MEASUREMENT LEA_obd_ii_P1107_dtc_state "Learned/adaptive value: OBD-II P1107 DTC state." UBYTE NO_COMPU_METHOD 0 0 0 255 ECU_ADDRESS 0x40004C90 /end MEASUREMENT
/begin MEASUREMENT LEA_obd_ii_P1107_fail_counter "Learned/adaptive value: OBD-II P1107 fail counter." UBYTE NO_COMPU_METHOD 0 0 0 255 ECU_ADDRESS 0x40004C91 /end MEASUREMENT
/begin MEASUREMENT LEA_obd_ii_P1107_pass_counter "Learned/adaptive value: OBD-II P1107 pass counter." UBYTE NO_COMPU_METHOD 0 0 0 255 ECU_ADDRESS 0x40004C92 /end MEASUREMENT
/begin MEASUREMENT LEA_obd_ii_P1108_dtc_state "Learned/adaptive value: OBD-II P1108 DTC state." UBYTE NO_COMPU_METHOD 0 0 0 255 ECU_ADDRESS 0x40004C93 /end MEASUREMENT
/begin MEASUREMENT LEA_obd_ii_P1108_fail_counter "Learned/adaptive value: OBD-II P1108 fail counter." UBYTE NO_COMPU_METHOD 0 0 0 255 ECU_ADDRESS 0x40004C94 /end MEASUREMENT
/begin MEASUREMENT LEA_obd_ii_P1108_pass_counter "Learned/adaptive value: OBD-II P1108 pass counter." UBYTE NO_COMPU_METHOD 0 0 0 255 ECU_ADDRESS 0x40004C95 /end MEASUREMENT
/begin MEASUREMENT LEA_obd_ii_P1109_dtc_state "Learned/adaptive value: OBD-II P1109 DTC state." UBYTE NO_COMPU_METHOD 0 0 0 255 ECU_ADDRESS 0x40004C96 /end MEASUREMENT
/begin MEASUREMENT LEA_obd_ii_P1109_fail_counter "Learned/adaptive value: OBD-II P1109 fail counter." UBYTE NO_COMPU_METHOD 0 0 0 255 ECU_ADDRESS 0x40004C97 /end MEASUREMENT
/begin MEASUREMENT LEA_obd_ii_P1109_pass_counter "Learned/adaptive value: OBD-II P1109 pass counter." UBYTE NO_COMPU_METHOD 0 0 0 255 ECU_ADDRESS 0x40004C98 /end MEASUREMENT
/begin MEASUREMENT LEA_obd_ii_P2754_dtc_state "Learned/adaptive value: OBD-II P2754 DTC state." UBYTE NO_COMPU_METHOD 0 0 0 255 ECU_ADDRESS 0x40004C99 /end MEASUREMENT
/begin MEASUREMENT LEA_obd_ii_P2754_fail_counter "Learned/adaptive value: OBD-II P2754 fail counter." UBYTE NO_COMPU_METHOD 0 0 0 255 ECU_ADDRESS 0x40004C9A /end MEASUREMENT
/begin MEASUREMENT LEA_obd_ii_P2754_pass_counter "Learned/adaptive value: OBD-II P2754 pass counter." UBYTE NO_COMPU_METHOD 0 0 0 255 ECU_ADDRESS 0x40004C9B /end MEASUREMENT
/begin MEASUREMENT LEA_obd_ii_P2755_dtc_state "Learned/adaptive value: OBD-II P2755 DTC state." UBYTE NO_COMPU_METHOD 0 0 0 255 ECU_ADDRESS 0x40004C9C /end MEASUREMENT
/begin MEASUREMENT LEA_obd_ii_P2755_fail_counter "Learned/adaptive value: OBD-II P2755 fail counter." UBYTE NO_COMPU_METHOD 0 0 0 255 ECU_ADDRESS 0x40004C9D /end MEASUREMENT
/begin MEASUREMENT LEA_obd_ii_P2755_pass_counter "Learned/adaptive value: OBD-II P2755 pass counter." UBYTE NO_COMPU_METHOD 0 0 0 255 ECU_ADDRESS 0x40004C9E /end MEASUREMENT
/begin MEASUREMENT LEA_obd_ii_P0897_dtc_state "Learned/adaptive value: OBD-II P0897 DTC state." UBYTE NO_COMPU_METHOD 0 0 0 255 ECU_ADDRESS 0x40004C9F /end MEASUREMENT
/begin MEASUREMENT LEA_obd_ii_P0897_fail_counter "Learned/adaptive value: OBD-II P0897 fail counter." UBYTE NO_COMPU_METHOD 0 0 0 255 ECU_ADDRESS 0x40004CA0 /end MEASUREMENT
/begin MEASUREMENT LEA_obd_ii_P0897_pass_counter "Learned/adaptive value: OBD-II P0897 pass counter." UBYTE NO_COMPU_METHOD 0 0 0 255 ECU_ADDRESS 0x40004CA1 /end MEASUREMENT
/begin MEASUREMENT LEA_obd_ii_P2797_dtc_state "Learned/adaptive value: OBD-II P2797 DTC state." UBYTE NO_COMPU_METHOD 0 0 0 255 ECU_ADDRESS 0x40004CA2 /end MEASUREMENT
/begin MEASUREMENT LEA_obd_ii_P2797_fail_counter "Learned/adaptive value: OBD-II P2797 fail counter." UBYTE NO_COMPU_METHOD 0 0 0 255 ECU_ADDRESS 0x40004CA3 /end MEASUREMENT
/begin MEASUREMENT LEA_obd_ii_P2797_pass_counter "Learned/adaptive value: OBD-II P2797 pass counter." UBYTE NO_COMPU_METHOD 0 0 0 255 ECU_ADDRESS 0x40004CA4 /end MEASUREMENT
/begin MEASUREMENT LEA_obd_ii_B1422_dtc_state "Learned/adaptive value: OBD-II B1422 DTC state." UBYTE NO_COMPU_METHOD 0 0 0 255 ECU_ADDRESS 0x40004CA5 /end MEASUREMENT
/begin MEASUREMENT LEA_obd_ii_B1422_fail_counter "Learned/adaptive value: OBD-II B1422 fail counter." UBYTE NO_COMPU_METHOD 0 0 0 255 ECU_ADDRESS 0x40004CA6 /end MEASUREMENT
/begin MEASUREMENT LEA_obd_ii_B1422_pass_counter "Learned/adaptive value: OBD-II B1422 pass counter." UBYTE NO_COMPU_METHOD 0 0 0 255 ECU_ADDRESS 0x40004CA7 /end MEASUREMENT
/begin MEASUREMENT LEA_obd_ii_U0101_dtc_state "Learned/adaptive value: OBD-II U0101 DTC state." UBYTE NO_COMPU_METHOD 0 0 0 255 ECU_ADDRESS 0x40004CA8 /end MEASUREMENT
/begin MEASUREMENT LEA_obd_ii_U0101_fail_counter "Learned/adaptive value: OBD-II U0101 fail counter." UBYTE NO_COMPU_METHOD 0 0 0 255 ECU_ADDRESS 0x40004CA9 /end MEASUREMENT
/begin MEASUREMENT LEA_obd_ii_U0101_pass_counter "Learned/adaptive value: OBD-II U0101 pass counter." UBYTE NO_COMPU_METHOD 0 0 0 255 ECU_ADDRESS 0x40004CAA /end MEASUREMENT
/begin MEASUREMENT LEA_obd_ii_U0109_dtc_state "Learned/adaptive value: OBD-II U0109 DTC state." UBYTE NO_COMPU_METHOD 0 0 0 255 ECU_ADDRESS 0x40004CAB /end MEASUREMENT
/begin MEASUREMENT LEA_obd_ii_U0109_fail_counter "Learned/adaptive value: OBD-II U0109 fail counter." UBYTE NO_COMPU_METHOD 0 0 0 255 ECU_ADDRESS 0x40004CAC /end MEASUREMENT
/begin MEASUREMENT LEA_obd_ii_U0109_pass_counter "Learned/adaptive value: OBD-II U0109 pass counter." UBYTE NO_COMPU_METHOD 0 0 0 255 ECU_ADDRESS 0x40004CAD /end MEASUREMENT
/begin MEASUREMENT LEA_obd_ii_U0122_dtc_state "Learned/adaptive value: OBD-II U0122 DTC state." UBYTE NO_COMPU_METHOD 0 0 0 255 ECU_ADDRESS 0x40004CAE /end MEASUREMENT
/begin MEASUREMENT LEA_obd_ii_U0122_fail_counter "Learned/adaptive value: OBD-II U0122 fail counter." UBYTE NO_COMPU_METHOD 0 0 0 255 ECU_ADDRESS 0x40004CAF /end MEASUREMENT
/begin MEASUREMENT LEA_obd_ii_U0122_pass_counter "Learned/adaptive value: OBD-II U0122 pass counter." UBYTE NO_COMPU_METHOD 0 0 0 255 ECU_ADDRESS 0x40004CB0 /end MEASUREMENT
/begin MEASUREMENT LEA_obd_ii_U0123_dtc_state "Learned/adaptive value: OBD-II U0123 DTC state." UBYTE NO_COMPU_METHOD 0 0 0 255 ECU_ADDRESS 0x40004CB1 /end MEASUREMENT
/begin MEASUREMENT LEA_obd_ii_U0123_fail_counter "Learned/adaptive value: OBD-II U0123 fail counter." UBYTE NO_COMPU_METHOD 0 0 0 255 ECU_ADDRESS 0x40004CB2 /end MEASUREMENT
/begin MEASUREMENT LEA_obd_ii_U0123_pass_counter "Learned/adaptive value: OBD-II U0123 pass counter." UBYTE NO_COMPU_METHOD 0 0 0 255 ECU_ADDRESS 0x40004CB3 /end MEASUREMENT
/begin MEASUREMENT LEA_obd_ii_U0155_dtc_state "Learned/adaptive value: OBD-II U0155 DTC state." UBYTE NO_COMPU_METHOD 0 0 0 255 ECU_ADDRESS 0x40004CB4 /end MEASUREMENT
/begin MEASUREMENT LEA_obd_ii_U0155_fail_counter "Learned/adaptive value: OBD-II U0155 fail counter." UBYTE NO_COMPU_METHOD 0 0 0 255 ECU_ADDRESS 0x40004CB5 /end MEASUREMENT
/begin MEASUREMENT LEA_obd_ii_U0155_pass_counter "Learned/adaptive value: OBD-II U0155 pass counter." UBYTE NO_COMPU_METHOD 0 0 0 255 ECU_ADDRESS 0x40004CB6 /end MEASUREMENT
/begin MEASUREMENT LEA_obd_ii_U0302_dtc_state "Learned/adaptive value: OBD-II U0302 DTC state." UBYTE NO_COMPU_METHOD 0 0 0 255 ECU_ADDRESS 0x40004CB7 /end MEASUREMENT
/begin MEASUREMENT LEA_obd_ii_U0302_fail_counter "Learned/adaptive value: OBD-II U0302 fail counter." UBYTE NO_COMPU_METHOD 0 0 0 255 ECU_ADDRESS 0x40004CB8 /end MEASUREMENT
/begin MEASUREMENT LEA_obd_ii_U0302_pass_counter "Learned/adaptive value: OBD-II U0302 pass counter." UBYTE NO_COMPU_METHOD 0 0 0 255 ECU_ADDRESS 0x40004CB9 /end MEASUREMENT
/begin MEASUREMENT LEA_obd_ii_U0316_dtc_state "Learned/adaptive value: OBD-II U0316 DTC state." UBYTE NO_COMPU_METHOD 0 0 0 255 ECU_ADDRESS 0x40004CBA /end MEASUREMENT
/begin MEASUREMENT LEA_obd_ii_U0316_fail_counter "Learned/adaptive value: OBD-II U0316 fail counter." UBYTE NO_COMPU_METHOD 0 0 0 255 ECU_ADDRESS 0x40004CBB /end MEASUREMENT
/begin MEASUREMENT LEA_obd_ii_U0316_pass_counter "Learned/adaptive value: OBD-II U0316 pass counter." UBYTE NO_COMPU_METHOD 0 0 0 255 ECU_ADDRESS 0x40004CBC /end MEASUREMENT
/begin MEASUREMENT LEA_obd_ii_U0416_dtc_state "Learned/adaptive value: OBD-II U0416 DTC state." UBYTE NO_COMPU_METHOD 0 0 0 255 ECU_ADDRESS 0x40004CBD /end MEASUREMENT
/begin MEASUREMENT LEA_obd_ii_U0416_fail_counter "Learned/adaptive value: OBD-II U0416 fail counter." UBYTE NO_COMPU_METHOD 0 0 0 255 ECU_ADDRESS 0x40004CBE /end MEASUREMENT
/begin MEASUREMENT LEA_obd_ii_U0416_pass_counter "Learned/adaptive value: OBD-II U0416 pass counter." UBYTE NO_COMPU_METHOD 0 0 0 255 ECU_ADDRESS 0x40004CBF /end MEASUREMENT
/begin MEASUREMENT LEA_obd_ii_U0513_dtc_state "Learned/adaptive value: OBD-II U0513 DTC state." UBYTE NO_COMPU_METHOD 0 0 0 255 ECU_ADDRESS 0x40004CC0 /end MEASUREMENT
/begin MEASUREMENT LEA_obd_ii_U0513_fail_counter "Learned/adaptive value: OBD-II U0513 fail counter." UBYTE NO_COMPU_METHOD 0 0 0 255 ECU_ADDRESS 0x40004CC1 /end MEASUREMENT
/begin MEASUREMENT LEA_obd_ii_U0513_pass_counter "Learned/adaptive value: OBD-II U0513 pass counter." UBYTE NO_COMPU_METHOD 0 0 0 255 ECU_ADDRESS 0x40004CC2 /end MEASUREMENT
/begin MEASUREMENT LEA_unused_byte1 "Learned/adaptive value: unused byte1." UBYTE NO_COMPU_METHOD 0 0 0 255 ECU_ADDRESS 0x40004CC3 /end MEASUREMENT
/begin MEASUREMENT lea_write_size "Lea write size." ULONG NO_COMPU_METHOD 0 0 0 4294967295 ECU_ADDRESS 0x40004CC4 /end MEASUREMENT
/begin MEASUREMENT lea_crc_full "Lea crc full." ULONG NO_COMPU_METHOD 0 0 0 4294967295 ECU_ADDRESS 0x40004CC8 /end MEASUREMENT
/begin MEASUREMENT obd_ii_similar_cond_debounce_timer "undefined2" UWORD NO_COMPU_METHOD 0 0 0 65535 ECU_ADDRESS 0x40004D58 /end MEASUREMENT
/begin MEASUREMENT hc08_crc16 "undefined2" UWORD NO_COMPU_METHOD 0 0 0 65535 ECU_ADDRESS 0x40004F30 /end MEASUREMENT
/begin MEASUREMENT throttle_actuator_state "Throttle actuator state (enumerated state)." UBYTE NO_COMPU_METHOD 0 0 0 255 ECU_ADDRESS 0x40004F32 /end MEASUREMENT
/begin MEASUREMENT hc08_obd_flags "undefined1" UBYTE NO_COMPU_METHOD 0 0 0 255 ECU_ADDRESS 0x40004F33 /end MEASUREMENT
/begin MEASUREMENT misfire_seg_period_prev "undefined" ULONG NO_COMPU_METHOD 0 0 0 4294967295 ECU_ADDRESS 0x40005D38 /end MEASUREMENT
/begin MEASUREMENT LEA_obd_ii_J1979_O2SCOND1 "Learned/adaptive value: OBD-II J1979 O2SCOND1." UWORD NO_COMPU_METHOD 0 0 0 65535 ECU_ADDRESS 0x40005FD2 /end MEASUREMENT
/begin MEASUREMENT LEA_obd_ii_J1979_O2SCOMP1 "Learned/adaptive value: OBD-II J1979 O2SCOMP1." UWORD NO_COMPU_METHOD 0 0 0 65535 ECU_ADDRESS 0x40005FD4 /end MEASUREMENT
/begin MEASUREMENT LEA_obd_ii_J1979_O2SCOND2 "Learned/adaptive value: OBD-II J1979 O2SCOND2." UWORD NO_COMPU_METHOD 0 0 0 65535 ECU_ADDRESS 0x40005FDA /end MEASUREMENT
/begin MEASUREMENT LEA_obd_ii_J1979_O2SCOMP2 "Learned/adaptive value: OBD-II J1979 O2SCOMP2." UWORD NO_COMPU_METHOD 0 0 0 65535 ECU_ADDRESS 0x40005FDC /end MEASUREMENT
/begin MEASUREMENT LEA_obd_ii_J1979_CATCOND1 "Learned/adaptive value: OBD-II J1979 CATCOND1." UWORD NO_COMPU_METHOD 0 0 0 65535 ECU_ADDRESS 0x40005FE2 /end MEASUREMENT
/begin MEASUREMENT LEA_obd_ii_J1979_CAT_COMP1 "Learned/adaptive value: OBD-II J1979 CAT COMP1." UWORD NO_COMPU_METHOD 0 0 0 65535 ECU_ADDRESS 0x40005FE4 /end MEASUREMENT
/begin MEASUREMENT LEA_obd_ii_J1979_CATCOND2 "Learned/adaptive value: OBD-II J1979 CATCOND2." UWORD NO_COMPU_METHOD 0 0 0 65535 ECU_ADDRESS 0x40005FEA /end MEASUREMENT
/begin MEASUREMENT LEA_obd_ii_J1979_CATCOMP2 "Learned/adaptive value: OBD-II J1979 CATCOMP2." UWORD NO_COMPU_METHOD 0 0 0 65535 ECU_ADDRESS 0x40005FEC /end MEASUREMENT
/begin MEASUREMENT LEA_obd_ii_J1979_EGRCOND "Learned/adaptive value: OBD-II J1979 EGRCOND." UWORD NO_COMPU_METHOD 0 0 0 65535 ECU_ADDRESS 0x40005FF2 /end MEASUREMENT
/begin MEASUREMENT LEA_obd_ii_J1979_EGRCOMP "Learned/adaptive value: OBD-II J1979 EGRCOMP." UWORD NO_COMPU_METHOD 0 0 0 65535 ECU_ADDRESS 0x40005FF4 /end MEASUREMENT
/begin MEASUREMENT LEA_obd_ii_J1979_EVAPCOND "Learned/adaptive value: OBD-II J1979 EVAPCOND." UWORD NO_COMPU_METHOD 0 0 0 65535 ECU_ADDRESS 0x40005FFA /end MEASUREMENT
/begin MEASUREMENT LEA_obd_ii_J1979_EVAPCOMP "Learned/adaptive value: OBD-II J1979 EVAPCOMP." UWORD NO_COMPU_METHOD 0 0 0 65535 ECU_ADDRESS 0x40005FFC /end MEASUREMENT
/begin MEASUREMENT LEA_obd_ii_J1979_SO2SCOND1 "Learned/adaptive value: OBD-II J1979 SO2SCOND1." UWORD NO_COMPU_METHOD 0 0 0 65535 ECU_ADDRESS 0x40006002 /end MEASUREMENT
/begin MEASUREMENT LEA_obd_ii_J1979_SO2SCOMP1 "Learned/adaptive value: OBD-II J1979 SO2SCOMP1." UWORD NO_COMPU_METHOD 0 0 0 65535 ECU_ADDRESS 0x40006004 /end MEASUREMENT
/begin MEASUREMENT LEA_obd_ii_J1979_S02SCOND2 "Learned/adaptive value: OBD-II J1979 S02SCOND2." UWORD NO_COMPU_METHOD 0 0 0 65535 ECU_ADDRESS 0x4000600A /end MEASUREMENT
/begin MEASUREMENT LEA_obd_ii_J1979_SO2SCOMP2 "Learned/adaptive value: OBD-II J1979 SO2SCOMP2." UWORD NO_COMPU_METHOD 0 0 0 65535 ECU_ADDRESS 0x4000600C /end MEASUREMENT
/begin MEASUREMENT tps_unknown_history "Throttle position history (structure)." ULONG NO_COMPU_METHOD 0 0 0 4294967295 ECU_ADDRESS 0x400061D4 /end MEASUREMENT
/begin MEASUREMENT tps_smooth_filter_state "Throttle position smooth filter state (structure)." ULONG NO_COMPU_METHOD 0 0 0 4294967295 ECU_ADDRESS 0x400061F8 /end MEASUREMENT
/begin MEASUREMENT knock_freq_bin_index "undefined1" UBYTE NO_COMPU_METHOD 0 0 0 255 ECU_ADDRESS 0x40006620 /end MEASUREMENT
/begin MEASUREMENT knock_bin_energy "undefined4" ULONG NO_COMPU_METHOD 0 0 0 4294967295 ECU_ADDRESS 0x40006874 /end MEASUREMENT
/begin MEASUREMENT flexcan_tx_queue_state_flags "undefined1" UBYTE NO_COMPU_METHOD 0 0 0 255 ECU_ADDRESS 0x400068A8 /end MEASUREMENT
/begin MEASUREMENT queue_len "Queue len." UBYTE NO_COMPU_METHOD 0 0 0 255 ECU_ADDRESS 0x400068B4 /end MEASUREMENT
/begin MEASUREMENT queue_head "undefined1" UBYTE NO_COMPU_METHOD 0 0 0 255 ECU_ADDRESS 0x400068B5 /end MEASUREMENT
/begin MEASUREMENT queue_buffer "Queue buffer (pointer)." ULONG NO_COMPU_METHOD 0 0 0 4294967295 ECU_ADDRESS 0x400068B6 /end MEASUREMENT
/begin MEASUREMENT etb_driver_fault_debounce "struct_tps_shaping_flags" ULONG NO_COMPU_METHOD 0 0 0 4294967295 ECU_ADDRESS 0x40007FE8 /end MEASUREMENT
/begin MEASUREMENT accel_pedal_pos_d_clipped "Accelerator pedal position d clipped (structure)." ULONG NO_COMPU_METHOD 0 0 0 4294967295 ECU_ADDRESS 0x40007FFC /end MEASUREMENT
/begin MEASUREMENT accel_pedal_pos_e_clipped "Accelerator pedal position e clipped (structure)." ULONG NO_COMPU_METHOD 0 0 0 4294967295 ECU_ADDRESS 0x40008010 /end MEASUREMENT
/begin MEASUREMENT adc37_threshold "Adc37 threshold (structure)." ULONG NO_COMPU_METHOD 0 0 0 4294967295 ECU_ADDRESS 0x40008038 /end MEASUREMENT
/begin MEASUREMENT COD_base "COD base (structure)." ULONG NO_COMPU_METHOD 0 0 0 4294967295 ECU_ADDRESS 0x40008060 /end MEASUREMENT
/begin MEASUREMENT COD_VIN "char" UBYTE NO_COMPU_METHOD 0 0 0 255 ECU_ADDRESS 0x40008068 /end MEASUREMENT
/begin MEASUREMENT COD_model_name "char" UBYTE NO_COMPU_METHOD 0 0 0 255 ECU_ADDRESS 0x40008080 /end MEASUREMENT
/begin MEASUREMENT coding_crc "uint16_t" UWORD NO_COMPU_METHOD 0 0 0 65535 ECU_ADDRESS 0x400080A0 /end MEASUREMENT
/begin MEASUREMENT ips_shift_state "undefined" ULONG NO_COMPU_METHOD 0 0 0 4294967295 ECU_ADDRESS 0x400080A8 /end MEASUREMENT
/begin MEASUREMENT V_CAL_fuel_pump_command_X_pressure "Input of CAL_fuel_pump_command_X_pressure: fuel_pressure_target_clamped * 0x32" SLONG CM_V_CAL_fuel_pump_command_X_pressure 0 0 -2147483648 2147483647 /begin VIRTUAL fuel_pressure_target_clamped /end VIRTUAL /end MEASUREMENT
/begin COMPU_METHOD CM_V_CAL_fuel_pump_command_X_pressure "raw input of CAL_fuel_pump_command_X_pressure" FORM "%8.0" "" /begin FORMULA "X1 * 0x32" /end FORMULA /end COMPU_METHOD
/begin MEASUREMENT V_CAL_idle_air_control_proportional_X_speed_error "Input of CAL_idle_air_control_proportional_X_speed_error: (obd_ii_idle_speed_error + 0x8000) & 0xffff" SLONG CM_V_CAL_idle_air_control_proportional_X_speed_error 0 0 -2147483648 2147483647 /begin VIRTUAL obd_ii_idle_speed_error /end VIRTUAL /end MEASUREMENT
/begin COMPU_METHOD CM_V_CAL_idle_air_control_proportional_X_speed_error "raw input of CAL_idle_air_control_proportional_X_speed_error" FORM "%8.0" "" /begin FORMULA "(X1 + 0x8000) & 0xffff" /end FORMULA /end COMPU_METHOD
/begin MEASUREMENT V_CAL_idle_comp_accel_pedal_pos_X_pps "Input of CAL_idle_comp_accel_pedal_pos_X_pps: (accel_pedal_latched >> 2) & 0xff" SLONG CM_V_CAL_idle_comp_accel_pedal_pos_X_pps 0 0 -2147483648 2147483647 /begin VIRTUAL accel_pedal_latched /end VIRTUAL /end MEASUREMENT
/begin COMPU_METHOD CM_V_CAL_idle_comp_accel_pedal_pos_X_pps "raw input of CAL_idle_comp_accel_pedal_pos_X_pps" FORM "%8.0" "" /begin FORMULA "(X1 >> 2) & 0xff" /end FORMULA /end COMPU_METHOD
/begin MEASUREMENT V_CAL_idle_error_correction_unknown_X_speed_error "Input of CAL_idle_error_correction_unknown_X_speed_error: (obd_ii_idle_speed_error + 0x8000) & 0xffff" SLONG CM_V_CAL_idle_error_correction_unknown_X_speed_error 0 0 -2147483648 2147483647 /begin VIRTUAL obd_ii_idle_speed_error /end VIRTUAL /end MEASUREMENT
/begin COMPU_METHOD CM_V_CAL_idle_error_correction_unknown_X_speed_error "raw input of CAL_idle_error_correction_unknown_X_speed_error" FORM "%8.0" "" /begin FORMULA "(X1 + 0x8000) & 0xffff" /end FORMULA /end COMPU_METHOD
/begin MEASUREMENT V_CAL_ign_dwell_time_Y_ecu_voltage "Input of CAL_ign_dwell_time_Y_ecu_voltage: (sensor_adc_ecu_voltage >> 2) & 0xff" SLONG CM_V_CAL_ign_dwell_time_Y_ecu_voltage 0 0 -2147483648 2147483647 /begin VIRTUAL sensor_adc_ecu_voltage /end VIRTUAL /end MEASUREMENT
/begin COMPU_METHOD CM_V_CAL_ign_dwell_time_Y_ecu_voltage "raw input of CAL_ign_dwell_time_Y_ecu_voltage" FORM "%8.0" "" /begin FORMULA "(X1 >> 2) & 0xff" /end FORMULA /end COMPU_METHOD
/begin MEASUREMENT V_CAL_inj_coldstart_enrichment_Y_maf_accum "Input of CAL_inj_coldstart_enrichment_Y_maf_accum: (maf_accumulated_since_start_raw >> 4) & 0xff" SLONG CM_V_CAL_inj_coldstart_enrichment_Y_maf_accum 0 0 -2147483648 2147483647 /begin VIRTUAL maf_accumulated_since_start_raw /end VIRTUAL /end MEASUREMENT
/begin COMPU_METHOD CM_V_CAL_inj_coldstart_enrichment_Y_maf_accum "raw input of CAL_inj_coldstart_enrichment_Y_maf_accum" FORM "%8.0" "" /begin FORMULA "(X1 >> 4) & 0xff" /end FORMULA /end COMPU_METHOD
/begin MEASUREMENT V_CAL_inj_cranking_enrichment_mass_accum_X_maf_accum "Input of CAL_inj_cranking_enrichment_mass_accum_X_maf_accum: (maf_accum_since_start_scaled >> 3) & 0xff" SLONG CM_V_CAL_inj_cranking_enrichment_mass_accum_X_maf_accum 0 0 -2147483648 2147483647 /begin VIRTUAL maf_accum_since_start_scaled /end VIRTUAL /end MEASUREMENT
/begin COMPU_METHOD CM_V_CAL_inj_cranking_enrichment_mass_accum_X_maf_accum "raw input of CAL_inj_cranking_enrichment_mass_accum_X_maf_accum" FORM "%8.0" "" /begin FORMULA "(X1 >> 3) & 0xff" /end FORMULA /end COMPU_METHOD
/begin MEASUREMENT V_CAL_inj_cranking_enrichment_soak_time_X_engine_off_time "Input of CAL_inj_cranking_enrichment_soak_time_X_engine_off_time: (engine_off_time_100ms >> 8) & 0xff" SLONG CM_V_CAL_inj_cranking_enrichment_soak_time_X_engine_off_time 0 0 -2147483648 2147483647 /begin VIRTUAL engine_off_time_100ms /end VIRTUAL /end MEASUREMENT
/begin COMPU_METHOD CM_V_CAL_inj_cranking_enrichment_soak_time_X_engine_off_time "raw input of CAL_inj_cranking_enrichment_soak_time_X_engine_off_time" FORM "%8.0" "" /begin FORMULA "(X1 >> 8) & 0xff" /end FORMULA /end COMPU_METHOD
/begin MEASUREMENT V_CAL_injtip_dfco_pedal_ramp_target_X_pps "Input of CAL_injtip_dfco_pedal_ramp_target_X_pps: (accel_pedal_latched >> 2) & 0xff" SLONG CM_V_CAL_injtip_dfco_pedal_ramp_target_X_pps 0 0 -2147483648 2147483647 /begin VIRTUAL accel_pedal_latched /end VIRTUAL /end MEASUREMENT
/begin COMPU_METHOD CM_V_CAL_injtip_dfco_pedal_ramp_target_X_pps "raw input of CAL_injtip_dfco_pedal_ramp_target_X_pps" FORM "%8.0" "" /begin FORMULA "(X1 >> 2) & 0xff" /end FORMULA /end COMPU_METHOD
/begin MEASUREMENT V_CAL_misfire_base_threshold_ips_Y_load "Input of CAL_misfire_base_threshold_ips_Y_load: load_mass_per_stroke_raw & 0xffff" SLONG CM_V_CAL_misfire_base_threshold_ips_Y_load 0 0 -2147483648 2147483647 /begin VIRTUAL load_mass_per_stroke_raw /end VIRTUAL /end MEASUREMENT
/begin COMPU_METHOD CM_V_CAL_misfire_base_threshold_ips_Y_load "raw input of CAL_misfire_base_threshold_ips_Y_load" FORM "%8.0" "" /begin FORMULA "X1 & 0xffff" /end FORMULA /end COMPU_METHOD
/begin MEASUREMENT V_CAL_misfire_base_threshold_manual_Y_load "Input of CAL_misfire_base_threshold_manual_Y_load: load_mass_per_stroke_raw & 0xffff" SLONG CM_V_CAL_misfire_base_threshold_manual_Y_load 0 0 -2147483648 2147483647 /begin VIRTUAL load_mass_per_stroke_raw /end VIRTUAL /end MEASUREMENT
/begin COMPU_METHOD CM_V_CAL_misfire_base_threshold_manual_Y_load "raw input of CAL_misfire_base_threshold_manual_Y_load" FORM "%8.0" "" /begin FORMULA "X1 & 0xffff" /end FORMULA /end COMPU_METHOD
/begin MEASUREMENT V_CAL_misfire_sensitivity_ips_Y_load "Input of CAL_misfire_sensitivity_ips_Y_load: load_mass_per_stroke_raw & 0xffff" SLONG CM_V_CAL_misfire_sensitivity_ips_Y_load 0 0 -2147483648 2147483647 /begin VIRTUAL load_mass_per_stroke_raw /end VIRTUAL /end MEASUREMENT
/begin COMPU_METHOD CM_V_CAL_misfire_sensitivity_ips_Y_load "raw input of CAL_misfire_sensitivity_ips_Y_load" FORM "%8.0" "" /begin FORMULA "X1 & 0xffff" /end FORMULA /end COMPU_METHOD
/begin MEASUREMENT V_CAL_misfire_sensitivity_manual_Y_load "Input of CAL_misfire_sensitivity_manual_Y_load: load_mass_per_stroke_raw & 0xffff" SLONG CM_V_CAL_misfire_sensitivity_manual_Y_load 0 0 -2147483648 2147483647 /begin VIRTUAL load_mass_per_stroke_raw /end VIRTUAL /end MEASUREMENT
/begin COMPU_METHOD CM_V_CAL_misfire_sensitivity_manual_Y_load "raw input of CAL_misfire_sensitivity_manual_Y_load" FORM "%8.0" "" /begin FORMULA "X1 & 0xffff" /end FORMULA /end COMPU_METHOD
/begin MEASUREMENT V_CAL_sensor_obd_ii_p0106_maf_pressure_correction_X_maf_flow "Input of CAL_sensor_obd_ii_p0106_maf_pressure_correction_X_maf_flow: (obd_ii_maf_flow / 200) & 0xff" SLONG CM_V_CAL_sensor_obd_ii_p0106_maf_pressure_correction_X_maf_flow 0 0 -2147483648 2147483647 /begin VIRTUAL obd_ii_maf_flow /end VIRTUAL /end MEASUREMENT
/begin COMPU_METHOD CM_V_CAL_sensor_obd_ii_p0106_maf_pressure_correction_X_maf_flow "raw input of CAL_sensor_obd_ii_p0106_maf_pressure_correction_X_maf_flow" FORM "%8.0" "" /begin FORMULA "(X1 / 200) & 0xff" /end FORMULA /end COMPU_METHOD
/end MODULE
/end PROJECT
