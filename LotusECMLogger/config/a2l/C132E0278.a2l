ASAP2_VERSION 1 61
/begin PROJECT C132E0278 "Lotus T6 C132E0278"
/begin HEADER "" VERSION "generated v1" /end HEADER
/begin MODULE C132E0278 ""
/begin MOD_COMMON "" BYTE_ORDER MSB_FIRST ALIGNMENT_BYTE 1 ALIGNMENT_WORD 2 ALIGNMENT_LONG 4 /end MOD_COMMON
/begin RECORD_LAYOUT RL_VALUE_UBYTE FNC_VALUES 1 UBYTE ROW_DIR DIRECT /end RECORD_LAYOUT
/begin RECORD_LAYOUT RL_AXIS_UBYTE AXIS_PTS_X 1 UBYTE INDEX_INCR DIRECT /end RECORD_LAYOUT
/begin RECORD_LAYOUT RL_AXIS_SBYTE AXIS_PTS_X 1 SBYTE INDEX_INCR DIRECT /end RECORD_LAYOUT
/begin RECORD_LAYOUT RL_VALUE_UWORD FNC_VALUES 1 UWORD ROW_DIR DIRECT /end RECORD_LAYOUT
/begin RECORD_LAYOUT RL_AXIS_UWORD AXIS_PTS_X 1 UWORD INDEX_INCR DIRECT /end RECORD_LAYOUT
/begin RECORD_LAYOUT RL_VALUE_SWORD FNC_VALUES 1 SWORD ROW_DIR DIRECT /end RECORD_LAYOUT
/begin COMPU_METHOD CM_i16_pressure_mbar "i16_pressure_mbar" RAT_FUNC "%8.0" "mbar" COEFFS 0 1 0 0 0 1 /end COMPU_METHOD
/begin COMPU_METHOD CM_i32_accel_1_25600g "i32_accel_1/25600g" RAT_FUNC "%12.4" "g" COEFFS 0 1 0 0 0 3.90625E-05 /end COMPU_METHOD
/begin COMPU_METHOD CM_u16_afr_1_100 "u16_afr_1/100" RAT_FUNC "%10.2" "AFR" COEFFS 0 1 0 0 0 0.01 /end COMPU_METHOD
/begin COMPU_METHOD CM_u16_angle_1_10deg "u16_angle_1/10deg" RAT_FUNC "%9.1" "deg" COEFFS 0 1 0 0 0 0.1 /end COMPU_METHOD
/begin COMPU_METHOD CM_u16_current_mA "u16_current_mA" RAT_FUNC "%8.0" "mA" COEFFS 0 1 0 0 0 1 /end COMPU_METHOD
/begin COMPU_METHOD CM_u16_distance_km "u16_distance_km" RAT_FUNC "%8.0" "km" COEFFS 0 1 0 0 0 1 /end COMPU_METHOD
/begin COMPU_METHOD CM_u16_economy_1_10ml_per_km "u16_economy_1/10ml_per_km" RAT_FUNC "%9.1" "ml/km" COEFFS 0 1 0 0 0 0.1 /end COMPU_METHOD
/begin COMPU_METHOD CM_u16_factor_1_1000 "u16_factor_1/1000" RAT_FUNC "%9.1" "%" COEFFS 0 1 0 0 0 0.1 /end COMPU_METHOD
/begin COMPU_METHOD CM_u16_factor_1_10000 "u16_factor_1/10000" RAT_FUNC "%10.2" "%" COEFFS 0 1 0 0 0 0.01 /end COMPU_METHOD
/begin COMPU_METHOD CM_u16_factor_1_1023 "u16_factor_1/1023" RAT_FUNC "%12.4" "%" COEFFS 0 1 0 0 0 0.0977517106549365 /end COMPU_METHOD
/begin COMPU_METHOD CM_u16_factor_1_20000 "u16_factor_1/20000" RAT_FUNC "%11.3" "%" COEFFS 0 1 0 0 0 0.005 /end COMPU_METHOD
/begin COMPU_METHOD CM_u16_factor_1_4095 "u16_factor_1/4095" RAT_FUNC "%12.4" "%" COEFFS 0 1 0 0 0 0.0244200244200244 /end COMPU_METHOD
/begin COMPU_METHOD CM_u16_flow_10mg_s "u16_flow_10mg/s" RAT_FUNC "%8.0" "mg/s" COEFFS 0 1 0 0 0 10 /end COMPU_METHOD
/begin COMPU_METHOD CM_u16_flow_1_100ml_s "u16_flow_1/100ml/s" RAT_FUNC "%10.2" "ml/s" COEFFS 0 1 0 0 0 0.01 /end COMPU_METHOD
/begin COMPU_METHOD CM_u16_flow_mg_s "u16_flow_mg/s" RAT_FUNC "%8.0" "mg/s" COEFFS 0 1 0 0 0 1 /end COMPU_METHOD
/begin COMPU_METHOD CM_u16_freq_hz "u16_freq_hz" RAT_FUNC "%8.0" "Hz" COEFFS 0 1 0 0 0 1 /end COMPU_METHOD
/begin COMPU_METHOD CM_u16_mass_10ug "u16_mass_10ug" RAT_FUNC "%8.0" "ug" COEFFS 0 1 0 0 0 10 /end COMPU_METHOD
/begin COMPU_METHOD CM_u16_mass_g "u16_mass_g" RAT_FUNC "%8.0" "g" COEFFS 0 1 0 0 0 1 /end COMPU_METHOD
/begin COMPU_METHOD CM_u16_mass_mg "u16_mass_mg" RAT_FUNC "%8.0" "mg" COEFFS 0 1 0 0 0 1 /end COMPU_METHOD
/begin COMPU_METHOD CM_u16_ratio_1_10rpm_kph "u16_ratio_1/10rpm/kph" RAT_FUNC "%9.1" "rpm/kph" COEFFS 0 1 0 0 0 0.1 /end COMPU_METHOD
/begin COMPU_METHOD CM_u16_rspeed_1_4rpm "u16_rspeed_1/4rpm" RAT_FUNC "%10.2" "rpm" COEFFS 0 1 0 0 0 0.25 /end COMPU_METHOD
/begin COMPU_METHOD CM_u16_time_4us "u16_time_4us" RAT_FUNC "%8.0" "us" COEFFS 0 1 0 0 0 4 /end COMPU_METHOD
/begin COMPU_METHOD CM_u16_voltage_18_1023v "u16_voltage_18/1023v" RAT_FUNC "%12.4" "V" COEFFS 0 1 0 0 0 0.0175953079178886 /end COMPU_METHOD
/begin COMPU_METHOD CM_u16_voltage_5_1023v "u16_voltage_5/1023v" RAT_FUNC "%12.4" "V" COEFFS 0 1 0 0 0 0.00488758553274682 /end COMPU_METHOD
/begin COMPU_METHOD CM_u32_time_100ns "u32_time_100ns" RAT_FUNC "%8.0" "ns" COEFFS 0 1 0 0 0 100 /end COMPU_METHOD
/begin COMPU_METHOD CM_u32_time_ns "u32_time_ns" RAT_FUNC "%8.0" "ns" COEFFS 0 1 0 0 0 1 /end COMPU_METHOD
/begin COMPU_METHOD CM_u8_accel_1_100g "u8_accel_1/100g" RAT_FUNC "%10.2" "g" COEFFS 0 1 0 0 0 0.01 /end COMPU_METHOD
/begin COMPU_METHOD CM_u8_angle_1_4_10deg "u8_angle_1/4-10deg" RAT_FUNC "%10.2" "deg" COEFFS 0 1 10 0 0 0.25 /end COMPU_METHOD
/begin COMPU_METHOD CM_u8_angle_1_4_32deg "u8_angle_1/4-32deg" RAT_FUNC "%10.2" "deg" COEFFS 0 1 32 0 0 0.25 /end COMPU_METHOD
/begin COMPU_METHOD CM_u8_angle_1_4deg "u8_angle_1/4deg" RAT_FUNC "%10.2" "deg" COEFFS 0 1 0 0 0 0.25 /end COMPU_METHOD
/begin COMPU_METHOD CM_u8_angle_720_256deg "u8_angle_720/256deg" RAT_FUNC "%12.4" "deg" COEFFS 0 1 0 0 0 2.8125 /end COMPU_METHOD
/begin COMPU_METHOD CM_u8_factor_1_10 "u8_factor_1/10" RAT_FUNC "%8.0" "%" COEFFS 0 1 0 0 0 10 /end COMPU_METHOD
/begin COMPU_METHOD CM_u8_factor_1_100 "u8_factor_1/100" RAT_FUNC "%8.0" "%" COEFFS 0 1 0 0 0 1 /end COMPU_METHOD
/begin COMPU_METHOD CM_u8_factor_1_128 "u8_factor_1/128" RAT_FUNC "%12.4" "%" COEFFS 0 1 0 0 0 0.78125 /end COMPU_METHOD
/begin COMPU_METHOD CM_u8_factor_1_200 "u8_factor_1/200" RAT_FUNC "%9.1" "%" COEFFS 0 1 0 0 0 0.5 /end COMPU_METHOD
/begin COMPU_METHOD CM_u8_factor_1_255 "u8_factor_1/255" RAT_FUNC "%12.4" "%" COEFFS 0 1 0 0 0 0.392156862745098 /end COMPU_METHOD
/begin COMPU_METHOD CM_u8_factor_1_256 "u8_factor_1/256" RAT_FUNC "%12.4" "%" COEFFS 0 1 0 0 0 0.390625 /end COMPU_METHOD
/begin COMPU_METHOD CM_u8_factor_1_2560 "u8_factor_1/2560" RAT_FUNC "%12.4" "%" COEFFS 0 1 0 0 0 0.0390625 /end COMPU_METHOD
/begin COMPU_METHOD CM_u8_factor_1_32 "u8_factor_1/32" RAT_FUNC "%11.3" "%" COEFFS 0 1 0 0 0 3.125 /end COMPU_METHOD
/begin COMPU_METHOD CM_u8_factor_1_64 "u8_factor_1/64" RAT_FUNC "%12.4" "%" COEFFS 0 1 0 0 0 1.5625 /end COMPU_METHOD
/begin COMPU_METHOD CM_u8_flow_g_s "u8_flow_g/s" RAT_FUNC "%8.0" "g/s" COEFFS 0 1 0 0 0 1 /end COMPU_METHOD
/begin COMPU_METHOD CM_u8_load_4mg_stroke "u8_load_4mg/stroke" RAT_FUNC "%8.0" "mg/stroke" COEFFS 0 1 0 0 0 4 /end COMPU_METHOD
/begin COMPU_METHOD CM_u8_load_mg_stroke "u8_load_mg/stroke" RAT_FUNC "%8.0" "mg/stroke" COEFFS 0 1 0 0 0 1 /end COMPU_METHOD
/begin COMPU_METHOD CM_u8_percent_100_128_100 "u8_percent_100/128-100" RAT_FUNC "%12.4" "%" COEFFS 0 1 100 0 0 0.78125 /end COMPU_METHOD
/begin COMPU_METHOD CM_u8_raw_128 "u8_raw-128" RAT_FUNC "%8.0" "" COEFFS 0 1 128 0 0 1 /end COMPU_METHOD
/begin COMPU_METHOD CM_u8_rspeed_125_4_500rpm "u8_rspeed_125/4+500rpm" RAT_FUNC "%10.2" "rpm" COEFFS 0 1 -500 0 0 31.25 /end COMPU_METHOD
/begin COMPU_METHOD CM_u8_rspeed_4rpm "u8_rspeed_4rpm" RAT_FUNC "%8.0" "rpm" COEFFS 0 1 0 0 0 4 /end COMPU_METHOD
/begin COMPU_METHOD CM_u8_rspeed_50rpm "u8_rspeed_50rpm" RAT_FUNC "%8.0" "rpm" COEFFS 0 1 0 0 0 50 /end COMPU_METHOD
/begin COMPU_METHOD CM_u8_rspeed_8rpm "u8_rspeed_8rpm" RAT_FUNC "%8.0" "rpm" COEFFS 0 1 0 0 0 8 /end COMPU_METHOD
/begin COMPU_METHOD CM_u8_rspeed_rpm "u8_rspeed_rpm" RAT_FUNC "%8.0" "rpm" COEFFS 0 1 0 0 0 1 /end COMPU_METHOD
/begin COMPU_METHOD CM_u8_speed_1_100kph "u8_speed_1/100kph" RAT_FUNC "%10.2" "km/h" COEFFS 0 1 0 0 0 0.01 /end COMPU_METHOD
/begin COMPU_METHOD CM_u8_speed_1_10kph "u8_speed_1/10kph" RAT_FUNC "%9.1" "km/h" COEFFS 0 1 0 0 0 0.1 /end COMPU_METHOD
/begin COMPU_METHOD CM_u8_speed_2kph "u8_speed_2kph" RAT_FUNC "%8.0" "km/h" COEFFS 0 1 0 0 0 2 /end COMPU_METHOD
/begin COMPU_METHOD CM_u8_speed_kph "u8_speed_kph" RAT_FUNC "%8.0" "km/h" COEFFS 0 1 0 0 0 1 /end COMPU_METHOD
/begin COMPU_METHOD CM_u8_temp_1_10C "u8_temp_1/10C" RAT_FUNC "%9.1" "°C" COEFFS 0 1 0 0 0 0.1 /end COMPU_METHOD
/begin COMPU_METHOD CM_u8_temp_5_8_40c "u8_temp_5/8-40c" RAT_FUNC "%11.3" "°C" COEFFS 0 1 40 0 0 0.625 /end COMPU_METHOD
/begin COMPU_METHOD CM_u8_time_100ms "u8_time_100ms" RAT_FUNC "%8.0" "ms" COEFFS 0 1 0 0 0 100 /end COMPU_METHOD
/begin COMPU_METHOD CM_u8_time_10ms "u8_time_10ms" RAT_FUNC "%8.0" "ms" COEFFS 0 1 0 0 0 10 /end COMPU_METHOD
/begin COMPU_METHOD CM_u8_time_20ms "u8_time_20ms" RAT_FUNC "%8.0" "ms" COEFFS 0 1 0 0 0 20 /end COMPU_METHOD
/begin COMPU_METHOD CM_u8_time_500us "u8_time_500us" RAT_FUNC "%8.0" "us" COEFFS 0 1 0 0 0 500 /end COMPU_METHOD
/begin COMPU_METHOD CM_u8_time_50ms "u8_time_50ms" RAT_FUNC "%8.0" "ms" COEFFS 0 1 0 0 0 50 /end COMPU_METHOD
/begin COMPU_METHOD CM_u8_time_5ms "u8_time_5ms" RAT_FUNC "%8.0" "ms" COEFFS 0 1 0 0 0 5 /end COMPU_METHOD
/begin COMPU_METHOD CM_u8_time_ms "u8_time_ms" RAT_FUNC "%8.0" "ms" COEFFS 0 1 0 0 0 1 /end COMPU_METHOD
/begin COMPU_METHOD CM_u8_time_s "u8_time_s" RAT_FUNC "%8.0" "s" COEFFS 0 1 0 0 0 1 /end COMPU_METHOD
/begin COMPU_METHOD CM_u8_time_us "u8_time_us" RAT_FUNC "%8.0" "us" COEFFS 0 1 0 0 0 1 /end COMPU_METHOD
/begin COMPU_METHOD CM_u8_torque_2nm "u8_torque_2nm" RAT_FUNC "%8.0" "Nm" COEFFS 0 1 0 0 0 2 /end COMPU_METHOD
/begin COMPU_METHOD CM_u8_torque_nm "u8_torque_nm" RAT_FUNC "%8.0" "Nm" COEFFS 0 1 0 0 0 1 /end COMPU_METHOD
/begin COMPU_METHOD CM_u8_voltage_5_255v "u8_voltage_5/255v" RAT_FUNC "%12.4" "V" COEFFS 0 1 0 0 0 0.0196078431372549 /end COMPU_METHOD
/begin COMPU_METHOD CM_u8_volume_1_10gallon "u8_volume_1/10gallon" RAT_FUNC "%9.1" "gallon" COEFFS 0 1 0 0 0 0.1 /end COMPU_METHOD
/begin CHARACTERISTIC CAL_base "T6-EVORA-GT430-V000E#ROW#Lotus#Evora GT430#2019#MT#64kb#MPC5534#CRP#0x59D4#LOTUS EVORA GT430 MAN MY19 ROW" ASCII 0x40008654 RL_VALUE_UBYTE 0 NO_COMPU_METHOD 0 255 NUMBER 32 /end CHARACTERISTIC
/begin CHARACTERISTIC CAL_ecu_data_base "Calibration: ECU data base (val/1023)." VALUE 0x40008674 RL_VALUE_UWORD 0 CM_u16_factor_1_1023 0 6406.15835777126 /end CHARACTERISTIC
/begin CHARACTERISTIC CAL_ecu_ips_calibration_version "Calibration: ECU IPS calibration version." VALUE 0x4000867B RL_VALUE_UBYTE 0 NO_COMPU_METHOD 0 255 /end CHARACTERISTIC
/begin CHARACTERISTIC CAL_hc08_status_mode_flag_bit7 "Calibration: sets bit 7 of the HC08 status mode byte." VALUE 0x40008688 RL_VALUE_UBYTE 0 NO_COMPU_METHOD 0 255 /end CHARACTERISTIC
/begin CHARACTERISTIC CAL_unused_40008694 "Unused: no references in 0278." VALUE 0x40008694 RL_VALUE_UBYTE 0 NO_COMPU_METHOD 0 255 /end CHARACTERISTIC
/begin CHARACTERISTIC CAL_ecu_abs_ring_teeth_count "Calibration: ECU ABS ring teeth count." VALUE 0x4000869E RL_VALUE_UBYTE 0 NO_COMPU_METHOD 0 255 /end CHARACTERISTIC
/begin CHARACTERISTIC CAL_ac_compressor_max_coolant_temp_max "Calibration: A/C compressor inhibit coolant temperature, inhibit above (°C = val*5/8−40)." VALUE 0x400086B4 RL_VALUE_UBYTE 0 CM_u8_temp_5_8_40c -40 119.375 /end CHARACTERISTIC
/begin CHARACTERISTIC CAL_ac_compressor_max_coolant_temp_min "Calibration: A/C compressor inhibit coolant temperature, re-enable below (°C = val*5/8−40)." VALUE 0x400086B5 RL_VALUE_UBYTE 0 CM_u8_temp_5_8_40c -40 119.375 /end CHARACTERISTIC
/begin CHARACTERISTIC CAL_ac_inhibit_tps "Calibration: A/C pedal inhibit hysteresis [0]=inhibit above, [1]=re-enable below (pedal>>2, /255). (0091 0x40008e86)" VAL_BLK 0x400086B6 RL_VALUE_UBYTE 0 CM_u8_factor_1_255 0 100 NUMBER 2 /end CHARACTERISTIC
/begin CHARACTERISTIC CAL_ac_ign_comp_delay "u8_time_100ms" VALUE 0x400086B8 RL_VALUE_UBYTE 0 CM_u8_time_100ms 0 25500 /end CHARACTERISTIC
/begin CHARACTERISTIC CAL_ac_inhibit_rpm_min_hold "Calibration: ac_rpm_inhibit_delay_timer reload when rpm drops below CAL_ac_compressor_engine_speed_min (bit 0x04). (0091 0x40008e96)" VALUE 0x400086C6 RL_VALUE_UBYTE 0 CM_u8_time_50ms 0 12750 /end CHARACTERISTIC
/begin CHARACTERISTIC CAL_ac_compressor_engine_speed_max "Calibration: A/C compressor engine speed maximum (RPM = val*125/4+500)." VALUE 0x400086C8 RL_VALUE_UBYTE 0 CM_u8_rspeed_125_4_500rpm 500 8468.75 /end CHARACTERISTIC
/begin CHARACTERISTIC CAL_ac_compressor_engine_speed_min "Calibration: A/C compressor engine speed minimum (RPM = val*125/4+500)." VALUE 0x400086C9 RL_VALUE_UBYTE 0 CM_u8_rspeed_125_4_500rpm 500 8468.75 /end CHARACTERISTIC
/begin CHARACTERISTIC CAL_ac_tps_inhibit_timer "Calibration: ac_tps_inhibit_timer reload while pedal inhibit is clear. (0091 0x40008e9a)" VALUE 0x400086CA RL_VALUE_UBYTE 0 NO_COMPU_METHOD 0 255 /end CHARACTERISTIC
/begin CHARACTERISTIC CAL_misc_engine_running_confirm_delay "Calibration: engine_running_confirm_timer reload. (0091 0x40008e9b)" VALUE 0x400086CB RL_VALUE_UBYTE 0 NO_COMPU_METHOD 0 255 /end CHARACTERISTIC
/begin CHARACTERISTIC CAL_ac_shutdown_delay "uint8_t" VALUE 0x400086CC RL_VALUE_UBYTE 0 NO_COMPU_METHOD 0 255 /end CHARACTERISTIC
/begin CHARACTERISTIC CAL_ecu_learning_x_axis_stability_threshold "Calibration: ECU learning x axis stability threshold." VALUE 0x400086D1 RL_VALUE_UBYTE 0 NO_COMPU_METHOD 0 255 /end CHARACTERISTIC
/begin CHARACTERISTIC CAL_ecu_learning_y_axis_stability_threshold "Calibration: ECU learning y axis stability threshold." VALUE 0x400086D2 RL_VALUE_UBYTE 0 NO_COMPU_METHOD 0 255 /end CHARACTERISTIC
/begin CHARACTERISTIC CAL_ac_fan_startup_hold_time "Calibration: A/C cooling-fan startup hold (ac_fan_startup_hold_timer = cal*10). (0091 0x40008ea5)" VALUE 0x400086D5 RL_VALUE_UBYTE 0 CM_u8_time_s 0 255 /end CHARACTERISTIC
/begin CHARACTERISTIC CAL_ac_compressor_deactivate_car_speed "Calibration: A/C compressor deactivate car speed (km/h; 2-element array)." VAL_BLK 0x400086DC RL_VALUE_UBYTE 0 CM_u8_speed_kph 0 255 NUMBER 2 /end CHARACTERISTIC
/begin CHARACTERISTIC CAL_ecu_ign_threshold "Calibration: ECU ignition threshold (V = val*5/255)." VALUE 0x400086DF RL_VALUE_UBYTE 0 CM_u8_voltage_5_255v 0 5 /end CHARACTERISTIC
/begin CHARACTERISTIC CAL_unused_400086f3 "Unused: no references in 0278." VALUE 0x400086F3 RL_VALUE_UBYTE 0 NO_COMPU_METHOD 0 255 /end CHARACTERISTIC
/begin CHARACTERISTIC CAL_ac_inhibit_evap_temp "Calibration: A/C evaporator freeze inhibit temperature hysteresis [2]. (0091 0x40008ed7)" VAL_BLK 0x40008707 RL_VALUE_UBYTE 0 CM_u8_temp_1_10C 0 25.5 NUMBER 2 /end CHARACTERISTIC
/begin CHARACTERISTIC CAL_ac_evap_timer_ticks_5ms "Calibration: A/C evaporative timer ticks 5ms." VALUE 0x40008709 RL_VALUE_UBYTE 0 NO_COMPU_METHOD 0 255 /end CHARACTERISTIC
/begin CHARACTERISTIC CAL_ac_evap_pid_d_period "Calibration: A/C evap PID derivative sample period (counter reload). (0091 0x40008eda CAL_ac_evap_timer_ticks_5ms2)" VALUE 0x4000870A RL_VALUE_UBYTE 0 NO_COMPU_METHOD 0 255 /end CHARACTERISTIC
/begin CHARACTERISTIC CAL_ac_evap_pid_derivative_filter_alpha "u8_factor_1/256" VALUE 0x4000870B RL_VALUE_UBYTE 0 CM_u8_factor_1_256 0 99.609375 /end CHARACTERISTIC
/begin CHARACTERISTIC CAL_cruise_override_coast_cancel_time "uint8_t" VALUE 0x40008716 RL_VALUE_UBYTE 0 NO_COMPU_METHOD 0 255 /end CHARACTERISTIC
/begin CHARACTERISTIC CAL_ac_evap_freeze_inhibit_delay "uint8_t" VALUE 0x40008718 RL_VALUE_UBYTE 0 NO_COMPU_METHOD 0 255 /end CHARACTERISTIC
/begin CHARACTERISTIC CAL_ac_evap_temp_trend_period2 "Calibration: A/C evap temp trend period. (0091 u8_time_5ms)" VALUE 0x40008719 RL_VALUE_UBYTE 0 CM_u8_time_5ms 0 1275 /end CHARACTERISTIC
/begin CHARACTERISTIC CAL_ac_load_ramp_steps "u8_count" VALUE 0x4000871E RL_VALUE_UBYTE 0 NO_COMPU_METHOD 0 255 /end CHARACTERISTIC
/begin CHARACTERISTIC CAL_ac_evap_target_temp "Calibration: A/C evaporative target temperature (°C = val/10)." VALUE 0x4000871F RL_VALUE_UBYTE 0 CM_u8_temp_1_10C 0 25.5 /end CHARACTERISTIC
/begin CHARACTERISTIC CAL_ac_evap_pid_kd "uint8_t" VALUE 0x40008720 RL_VALUE_UBYTE 0 NO_COMPU_METHOD 0 255 /end CHARACTERISTIC
/begin CHARACTERISTIC CAL_ac_evap_pid_ki_warm "uint8_t" VALUE 0x40008721 RL_VALUE_UBYTE 0 NO_COMPU_METHOD 0 255 /end CHARACTERISTIC
/begin CHARACTERISTIC CAL_ac_evap_pid_integrator_limit "uint8_t" VALUE 0x40008722 RL_VALUE_UBYTE 0 NO_COMPU_METHOD 0 255 /end CHARACTERISTIC
/begin CHARACTERISTIC CAL_ac_load_ramp_down_step "Calibration: A/C load model ramp-down step in AC_SHUTDOWN (ac_load -= cal*10 per 5 ms). (0091 0x40008ef3, misnamed CAL_ac_output_pwm_freq there)" VALUE 0x40008723 RL_VALUE_UBYTE 0 NO_COMPU_METHOD 0 255 /end CHARACTERISTIC
/begin CHARACTERISTIC CAL_ac_output_pwm_freq "Calibration: A/C compressor control valve PWM frequency (Hz; stock 500), passed straight to eTPU_init_pwm_channel." VALUE 0x40008724 RL_VALUE_UWORD 0 CM_u16_freq_hz 0 65535 /end CHARACTERISTIC
/begin CHARACTERISTIC CAL_ac_compressor_soft_engage_time "uint8_t" VALUE 0x40008727 RL_VALUE_UBYTE 0 NO_COMPU_METHOD 0 255 /end CHARACTERISTIC
/begin CHARACTERISTIC CAL_ac_unknown3 "uint8_t" VALUE 0x40008729 RL_VALUE_UBYTE 0 NO_COMPU_METHOD 0 255 /end CHARACTERISTIC
/begin CHARACTERISTIC CAL_ac_compressor_power_offset "uint8_t" VALUE 0x40008736 RL_VALUE_UBYTE 0 NO_COMPU_METHOD 0 255 /end CHARACTERISTIC
/begin CHARACTERISTIC CAL_ac_load_slew_up_period "u8_count" VALUE 0x4000873C RL_VALUE_UBYTE 0 NO_COMPU_METHOD 0 255 /end CHARACTERISTIC
/begin CHARACTERISTIC CAL_ac_load_slew_down_period "u8_count" VALUE 0x4000873D RL_VALUE_UBYTE 0 NO_COMPU_METHOD 0 255 /end CHARACTERISTIC
/begin CHARACTERISTIC CAL_ac_load_slew_up_step "uint8_t" VALUE 0x40008740 RL_VALUE_UBYTE 0 NO_COMPU_METHOD 0 255 /end CHARACTERISTIC
/begin CHARACTERISTIC CAL_ac_load_slew_down_step "uint8_t" VALUE 0x40008741 RL_VALUE_UBYTE 0 NO_COMPU_METHOD 0 255 /end CHARACTERISTIC
/begin CHARACTERISTIC CAL_ac_evap_pid_ki_cold "uint8_t" VALUE 0x40008747 RL_VALUE_UBYTE 0 NO_COMPU_METHOD 0 255 /end CHARACTERISTIC
/begin CHARACTERISTIC CAL_ac_evap_pid_update_period_cold "Calibration: A/C evap PID update period (cold). (0091 0x40008f18)" VALUE 0x40008748 RL_VALUE_UBYTE 0 CM_u8_time_5ms 0 1275 /end CHARACTERISTIC
/begin CHARACTERISTIC CAL_ecu_starter_max_engage_after_run "Calibration: starter/brake-clutch input window after start (runtime_since_start limit). (0091 0x40008f44)" VALUE 0x40008774 RL_VALUE_UWORD 0 CM_u8_time_5ms 0 327675 /end CHARACTERISTIC
/begin CHARACTERISTIC CAL_ac_evap_pid_ki_cold_boost_delay "Calibration: A/C evap PID cold Ki boost delay. (0091 0x40008f48)" VALUE 0x40008778 RL_VALUE_UBYTE 0 NO_COMPU_METHOD 0 255 /end CHARACTERISTIC
/begin CHARACTERISTIC CAL_ac_evap_pid_ki_cold_boost_factor "Calibration: A/C evap PID cold Ki boost factor (/10). (0091 0x40008f49)" VALUE 0x40008779 RL_VALUE_UBYTE 0 CM_u8_factor_1_10 0 2550 /end CHARACTERISTIC
/begin CHARACTERISTIC CAL_unused_4000877c "Unused: no references in 0278." VAL_BLK 0x4000877C RL_VALUE_UBYTE 0 NO_COMPU_METHOD 0 255 NUMBER 2 /end CHARACTERISTIC
/begin CHARACTERISTIC CAL_ecu_engine_running_threshold_unknown "Calibration: ECU engine running threshold (2-element array)." VAL_BLK 0x4000877E RL_VALUE_UBYTE 0 NO_COMPU_METHOD 0 255 NUMBER 2 /end CHARACTERISTIC
/begin CHARACTERISTIC CAL_misc_engine_detection_off "u16_time_4us" VALUE 0x40008780 RL_VALUE_UWORD 0 CM_u16_time_4us 0 262140 /end CHARACTERISTIC
/begin CHARACTERISTIC CAL_ecu_vehicle_mode_button_time "Calibration: ECU vehicle mode button time (ms = val*10)." VALUE 0x40008782 RL_VALUE_UWORD 0 CM_u8_time_10ms 0 655350 /end CHARACTERISTIC
/begin CHARACTERISTIC CAL_ac_inhibit_rpm_cutoff_on_delay "Calibration: A/C rpm-cutoff (bit 0x40) on-delay (cal*10). (0091 0x40008f56)" VALUE 0x40008786 RL_VALUE_UBYTE 0 CM_u8_time_50ms 0 12750 /end CHARACTERISTIC
/begin CHARACTERISTIC CAL_ac_inhibit_rpm_cutoff_min_hold "Calibration: A/C rpm-cutoff (bit 0x40) minimum hold (cal*10). (0091 0x40008f57)" VALUE 0x40008787 RL_VALUE_UBYTE 0 CM_u8_time_50ms 0 12750 /end CHARACTERISTIC
/begin CHARACTERISTIC CAL_trans_gear_ratio_tour "Calibration: gear detection rpm/kph bands, tour (x10; 1st gear 79.6-255)." VAL_BLK 0x40008788 RL_VALUE_UWORD 0 CM_u16_ratio_1_10rpm_kph 0 6553.5 NUMBER 10 /end CHARACTERISTIC
/begin CHARACTERISTIC CAL_ecu_standing_start_threshold "Calibration: perf-stats standing start armed above this rpm (stock 3500). (0091 0x40008f7a)" VALUE 0x400087AA RL_VALUE_UWORD 0 CM_u8_rspeed_rpm 0 65535 /end CHARACTERISTIC
/begin CHARACTERISTIC CAL_ac_compressor_engine_speed2 "Calibration: A/C compressor engine speed2 (RPM = val*125/4+500; 2-element array)." VAL_BLK 0x400087AE RL_VALUE_UBYTE 0 CM_u8_rspeed_125_4_500rpm 500 8468.75 NUMBER 2 /end CHARACTERISTIC
/begin CHARACTERISTIC CAL_ac_compressor_runtime_min "Calibration: A/C compressor runtime minimum (ms = val*5)." VALUE 0x400087B0 RL_VALUE_UWORD 0 CM_u8_time_5ms 0 327675 /end CHARACTERISTIC
/begin CHARACTERISTIC CAL_cruise_accel_pedal_override_threshold_exit "Calibration: cruise accelerator pedal override threshold exit (val/1023)." VALUE 0x400087BC RL_VALUE_UBYTE 0 CM_u16_factor_1_1023 0 24.9266862170088 /end CHARACTERISTIC
/begin CHARACTERISTIC CAL_cruise_accel_pedal_override_threshold_enter "Calibration: cruise accelerator pedal override threshold enter (val/1023)." VALUE 0x400087BD RL_VALUE_UBYTE 0 CM_u16_factor_1_1023 0 24.9266862170088 /end CHARACTERISTIC
/begin CHARACTERISTIC CAL_ecu_2gr_cylinder_air_mass_mg "Calibration: ECU 2gr cylinder air mass mg (mg)." VALUE 0x400087BE RL_VALUE_UWORD 0 CM_u16_mass_mg 0 65535 /end CHARACTERISTIC
/begin CHARACTERISTIC CAL_ecu_2gr_cylinder_air_mass_mg_obd_ii "Calibration: ECU 2gr cylinder air mass mg OBD-II (mg)." VALUE 0x400087C0 RL_VALUE_UWORD 0 CM_u16_mass_mg 0 65535 /end CHARACTERISTIC
/begin CHARACTERISTIC CAL_vehicle_moving_speed_min "Calibration: vehicle moving speed minimum (km/h)." VALUE 0x400087C5 RL_VALUE_UBYTE 0 CM_u8_speed_kph 0 255 /end CHARACTERISTIC
/begin CHARACTERISTIC CAL_cruise_resume_timer "Calibration: cruise resume timer (ms = val*10)." VALUE 0x400087CD RL_VALUE_UBYTE 0 CM_u8_time_10ms 0 2550 /end CHARACTERISTIC
/begin CHARACTERISTIC CAL_cluster_shift_light_deadband_rpm "Calibration: cluster shift light deadband RPM (RPM)." VALUE 0x400087DE RL_VALUE_UWORD 0 CM_u8_rspeed_rpm 0 65535 /end CHARACTERISTIC
/begin CHARACTERISTIC CAL_cluster_fuel_level_zero_clip_threshold "Calibration: cluster fuel level zero clip threshold (gal = val/10)." VALUE 0x400087E8 RL_VALUE_UBYTE 0 CM_u8_volume_1_10gallon 0 25.5 /end CHARACTERISTIC
/begin CHARACTERISTIC CAL_cruise_integrator_clamp "uint8_t" VALUE 0x400087EA RL_VALUE_UBYTE 0 NO_COMPU_METHOD 0 255 /end CHARACTERISTIC
/begin CHARACTERISTIC CAL_cruise_derivative_clamp "uint8_t" VALUE 0x400087EB RL_VALUE_UBYTE 0 NO_COMPU_METHOD 0 255 /end CHARACTERISTIC
/begin CHARACTERISTIC CAL_cruise_airflow_fast_slew_time "Calibration: cruise transition lockout = cal*5. (0091 0x40008fdd)" VALUE 0x4000880D RL_VALUE_UBYTE 0 NO_COMPU_METHOD 0 255 /end CHARACTERISTIC
/begin CHARACTERISTIC CAL_cruise_speed_error_limit "Calibration: cruise speed error limit (km/h)." VALUE 0x4000880E RL_VALUE_UBYTE 0 CM_u8_speed_kph 0 255 /end CHARACTERISTIC
/begin CHARACTERISTIC CAL_cruise_integral_term_limit "Calibration: cruise integral term limit (val/100)." VALUE 0x4000880F RL_VALUE_UBYTE 0 CM_u8_factor_1_100 0 255 /end CHARACTERISTIC
/begin CHARACTERISTIC CAL_cruise_derivative_term_limit "Calibration: cruise derivative term limit (val/100)." VALUE 0x40008810 RL_VALUE_UBYTE 0 CM_u8_factor_1_100 0 255 /end CHARACTERISTIC
/begin CHARACTERISTIC CAL_unused_40008819 "Unused: no references in 0278." VALUE 0x40008819 RL_VALUE_UBYTE 0 NO_COMPU_METHOD 0 255 /end CHARACTERISTIC
/begin CHARACTERISTIC CAL_trans_gear_ratio_tour_6th "Calibration: gear detection rpm/kph band for 6th gear, tour cal [min,max] (x10; stock 10.0-18.5). Completes CAL_trans_gear_ratio_tour (gears 1-5). Was CAL_trans_gear_lookup_unknown2." VAL_BLK 0x40008824 RL_VALUE_UWORD 0 CM_u16_ratio_1_10rpm_kph 0 6553.5 NUMBER 2 /end CHARACTERISTIC
/begin CHARACTERISTIC CAL_cruise_speed_limit "Calibration: cruise speed limit (km/h; 2-element array)." VAL_BLK 0x40008860 RL_VALUE_UBYTE 0 CM_u8_speed_kph 0 255 NUMBER 2 /end CHARACTERISTIC
/begin CHARACTERISTIC CAL_cruise_rpm_max_manual "Calibration: cruise max rpm, manual. (0091 0x40009032)" VALUE 0x40008862 RL_VALUE_UBYTE 0 CM_u8_rspeed_50rpm 0 12750 /end CHARACTERISTIC
/begin CHARACTERISTIC CAL_cruise_rpm_min_manual "Calibration: cruise min rpm, manual. (0091 0x40009033)" VALUE 0x40008863 RL_VALUE_UBYTE 0 CM_u8_rspeed_50rpm 0 12750 /end CHARACTERISTIC
/begin CHARACTERISTIC CAL_cruise_speed_deadband "Calibration: cruise speed deadband (km/h)." VALUE 0x40008864 RL_VALUE_UBYTE 0 CM_u8_speed_kph 0 255 /end CHARACTERISTIC
/begin CHARACTERISTIC CAL_cruise_speed_increment "Calibration: cruise speed increment (km/h = val/100)." VALUE 0x40008865 RL_VALUE_UBYTE 0 CM_u8_speed_1_100kph 0 2.55 /end CHARACTERISTIC
/begin CHARACTERISTIC CAL_cruise_speed_decrement "Calibration: cruise speed decrement (km/h = val/100)." VALUE 0x40008866 RL_VALUE_UBYTE 0 CM_u8_speed_1_100kph 0 2.55 /end CHARACTERISTIC
/begin CHARACTERISTIC CAL_cruise_override_timeout "Calibration: cruise override timeout (<<2). (0091 0x4000903a)" VALUE 0x4000886A RL_VALUE_UWORD 0 NO_COMPU_METHOD 0 65535 /end CHARACTERISTIC
/begin CHARACTERISTIC CAL_cruise_speed_increment2 "Calibration: cruise speed increment2 (km/h = val/10)." VALUE 0x4000886C RL_VALUE_UBYTE 0 CM_u8_speed_1_10kph 0 25.5 /end CHARACTERISTIC
/begin CHARACTERISTIC CAL_cruise_airflow_slew_step "u8_flow_10mg/s" VALUE 0x4000886D RL_VALUE_UBYTE 0 CM_u16_flow_10mg_s 0 2550 /end CHARACTERISTIC
/begin CHARACTERISTIC CAL_cruise_speed_filter_coeff "Calibration: cruise speed IIR filter coefficient. (0091 0x4000903e)" VALUE 0x4000886E RL_VALUE_UBYTE 0 CM_u8_factor_1_255 0 100 /end CHARACTERISTIC
/begin CHARACTERISTIC CAL_ecu_brake_or_clutch_inactive_timer "Calibration: ECU brake or clutch inactive timer (ms = val*5)." VALUE 0x40008875 RL_VALUE_UBYTE 0 CM_u8_time_5ms 0 1275 /end CHARACTERISTIC
/begin CHARACTERISTIC CAL_ac_compressor_speed_filter_coeff "Calibration: A/C compressor speed IIR weight (/256)." VALUE 0x4000887B RL_VALUE_UBYTE 0 CM_u8_factor_1_256 0 99.609375 /end CHARACTERISTIC
/begin CHARACTERISTIC CAL_cruise_rpm_max_ips "Calibration: cruise max rpm, IPS. (0091 0x40009061)" VALUE 0x40008891 RL_VALUE_UBYTE 0 CM_u8_rspeed_50rpm 0 12750 /end CHARACTERISTIC
/begin CHARACTERISTIC CAL_cruise_rpm_min_ips "Calibration: cruise min rpm, IPS. (0091 0x40009062)" VALUE 0x40008892 RL_VALUE_UBYTE 0 CM_u8_rspeed_50rpm 0 12750 /end CHARACTERISTIC
/begin CHARACTERISTIC CAL_ecu_wheelspeed_update_timer "Calibration: ECU wheelspeed update timer (ms = val*5)." VALUE 0x400088AE RL_VALUE_UBYTE 0 CM_u8_time_5ms 0 1275 /end CHARACTERISTIC
/begin CHARACTERISTIC CAL_cruise_integral_gearchange_retain "u8_factor_1/255" VALUE 0x400088AF RL_VALUE_UBYTE 0 CM_u8_factor_1_255 0 100 /end CHARACTERISTIC
/begin CHARACTERISTIC CAL_cruise_integral_freeze_accel "uint8_t" VALUE 0x400088B0 RL_VALUE_UBYTE 0 NO_COMPU_METHOD 0 255 /end CHARACTERISTIC
/begin CHARACTERISTIC CAL_vehicle_speed_limit "Vehicle speed limit (km/h = val*2; x200 into 1/100 km/h; stock 104 = 208 km/h). Was typed u8_speed_kph." VALUE 0x400088B6 RL_VALUE_UBYTE 0 CM_u8_speed_2kph 0 510 /end CHARACTERISTIC
/begin CHARACTERISTIC CAL_vehicle_speed_limit_enforce "Calibration: vehicle speed limit enforce (boolean flag)." VALUE 0x400088B8 RL_VALUE_UBYTE 0 NO_COMPU_METHOD 0 255 /end CHARACTERISTIC
/begin CHARACTERISTIC CAL_vehicle_speed_limit_enforce_margin "Calibration: speed limiter enforce margin (vs speed_limit_target_ramped, 1/100 kph)." VALUE 0x400088B9 RL_VALUE_UBYTE 0 CM_u8_speed_1_100kph 0 2.55 /end CHARACTERISTIC
/begin CHARACTERISTIC CAL_vehicle_standing_start_throttle_threshold "Calibration: vehicle standing start throttle threshold (val/1023)." VALUE 0x400088BA RL_VALUE_UWORD 0 CM_u16_factor_1_1023 0 6406.15835777126 /end CHARACTERISTIC
/begin CHARACTERISTIC CAL_ecu_engine_breakin_distance "Calibration: ECU engine breakin distance (km)." VALUE 0x400088BC RL_VALUE_UWORD 0 CM_u16_distance_km 0 65535 /end CHARACTERISTIC
/begin CHARACTERISTIC CAL_cruise_tps_accelerating_threshold "Calibration: cruise throttle position accelerating threshold (val/1023)." VALUE 0x400088BF RL_VALUE_UBYTE 0 CM_u16_factor_1_1023 0 24.9266862170088 /end CHARACTERISTIC
/begin CHARACTERISTIC CAL_cluster_brake_switch_max_speed_ips_unknown "Calibration: cluster brake switch maximum speed IPS (km/h)." VALUE 0x400088C0 RL_VALUE_UBYTE 0 CM_u8_speed_kph 0 255 /end CHARACTERISTIC
/begin CHARACTERISTIC CAL_driver_input_mode_coolant_min "Calibration: driver-input/vehicle-mode coolant window low. 0278-only (0091 slot unused)." VALUE 0x400088DA RL_VALUE_UBYTE 0 CM_u8_temp_5_8_40c -40 119.375 /end CHARACTERISTIC
/begin CHARACTERISTIC CAL_driver_input_mode_coolant_max "Calibration: driver-input/vehicle-mode coolant window high. 0278-only." VALUE 0x400088DB RL_VALUE_UBYTE 0 CM_u8_temp_5_8_40c -40 119.375 /end CHARACTERISTIC
/begin CHARACTERISTIC CAL_cruise_torque_request_factor "Calibration: cruise torque request = (cal<<8)/x after brake-cancel timer. (0091 0x400090ac, misnamed CAL_tps_brake_wheeldecel_tps_cut_threshold)" VALUE 0x400088DC RL_VALUE_UBYTE 0 NO_COMPU_METHOD 0 255 /end CHARACTERISTIC
/begin CHARACTERISTIC CAL_cruise_torque_request_braking "Calibration: cruise torque request while brake-cancel timer runs. (0091 0x400090ad)" VALUE 0x400088DD RL_VALUE_UBYTE 0 CM_u8_torque_2nm 0 510 /end CHARACTERISTIC
/begin CHARACTERISTIC CAL_cruise_brake_cancel_time "Calibration: cruise brake cancel time (ms = val*10)." VALUE 0x400088DE RL_VALUE_UWORD 0 CM_u8_time_10ms 0 655350 /end CHARACTERISTIC
/begin CHARACTERISTIC CAL_dca_enable_untested "Drive Cycle Assist is a disabled throttle control mechanism in the T6E firmware. It has not been tested in the aftermarket and requires a special VIN in addition to this flag for activation. As of now, there is no reason to change it. The current the" VALUE 0x400088E3 RL_VALUE_UBYTE 0 NO_COMPU_METHOD 0 255 /end CHARACTERISTIC
/begin CHARACTERISTIC CAL_ecu_engine_speed_reference_enable "Calibration: ECU engine speed reference enable (boolean flag)." VALUE 0x400088E4 RL_VALUE_UBYTE 0 NO_COMPU_METHOD 0 255 /end CHARACTERISTIC
/begin CHARACTERISTIC CAL_logger_high_speed_logger_enable "To enable the built-in highspeed data logger, set this configuration option." VALUE 0x400088EC RL_VALUE_UBYTE 0 NO_COMPU_METHOD 0 255 /end CHARACTERISTIC
/begin CHARACTERISTIC CAL_ips_speed_match_p_gain "uint16_t" VALUE 0x400088F2 RL_VALUE_UWORD 0 NO_COMPU_METHOD 0 65535 /end CHARACTERISTIC
/begin CHARACTERISTIC CAL_ips_speed_match_i_gain "Calibration: IPS speed-match PID I gain. (0091 0x400090c6)" VALUE 0x400088F6 RL_VALUE_UWORD 0 NO_COMPU_METHOD 0 65535 /end CHARACTERISTIC
/begin CHARACTERISTIC CAL_ips_speed_match_i_error_window "Calibration: IPS speed-match I error window. (0091 0x400090c8)" VALUE 0x400088F8 RL_VALUE_UWORD 0 CM_u8_rspeed_rpm 0 65535 /end CHARACTERISTIC
/begin CHARACTERISTIC CAL_ips_speed_match_i_reset "Calibration: IPS speed-match I reset value. (0091 0x400090ca)" VALUE 0x400088FA RL_VALUE_SWORD 0 CM_u8_torque_nm -32768 32767 /end CHARACTERISTIC
/begin CHARACTERISTIC CAL_ips_speed_match_d_gain "Calibration: IPS speed-match PID D gain. (0091 0x400090cc)" VALUE 0x400088FC RL_VALUE_UWORD 0 NO_COMPU_METHOD 0 65535 /end CHARACTERISTIC
/begin CHARACTERISTIC CAL_ips_speed_match_d_sample_ticks "Calibration: IPS speed-match D sample period. (0091 0x400090ce)" VALUE 0x400088FE RL_VALUE_UBYTE 0 CM_u8_time_ms 0 255 /end CHARACTERISTIC
/begin CHARACTERISTIC CAL_unused_400088ff "Unused: no references in 0278 (alignment pad before u16)." VALUE 0x400088FF RL_VALUE_UBYTE 0 NO_COMPU_METHOD 0 255 /end CHARACTERISTIC
/begin CHARACTERISTIC CAL_ips_speed_match_p_term_max "Calibration: IPS speed-match P term max. (0091 0x400090d0)" VALUE 0x40008900 RL_VALUE_SWORD 0 CM_u8_torque_nm -32768 32767 /end CHARACTERISTIC
/begin CHARACTERISTIC CAL_ips_speed_match_p_term_min "Calibration: IPS speed-match P term min. (0091 0x400090d2)" VALUE 0x40008902 RL_VALUE_SWORD 0 CM_u8_torque_nm -32768 32767 /end CHARACTERISTIC
/begin CHARACTERISTIC CAL_ips_speed_match_i_term_max "Calibration: IPS speed-match I term max. (0091 0x400090d4)" VALUE 0x40008904 RL_VALUE_SWORD 0 CM_u8_torque_nm -32768 32767 /end CHARACTERISTIC
/begin CHARACTERISTIC CAL_ips_speed_match_i_term_min "Calibration: IPS speed-match I term min. (0091 0x400090d6)" VALUE 0x40008906 RL_VALUE_SWORD 0 CM_u8_torque_nm -32768 32767 /end CHARACTERISTIC
/begin CHARACTERISTIC CAL_ips_speed_match_d_term_max "Calibration: IPS speed-match D term max. (0091 0x400090d8)" VALUE 0x40008908 RL_VALUE_SWORD 0 CM_u8_torque_nm -32768 32767 /end CHARACTERISTIC
/begin CHARACTERISTIC CAL_ips_speed_match_d_term_min "Calibration: IPS speed-match D term min. (0091 0x400090da)" VALUE 0x4000890A RL_VALUE_SWORD 0 CM_u8_torque_nm -32768 32767 /end CHARACTERISTIC
/begin CHARACTERISTIC CAL_ips_speed_match_torque_max "Calibration: IPS speed-match torque max. (0091 0x400090dc)" VALUE 0x4000890C RL_VALUE_UWORD 0 CM_u8_torque_nm 0 65535 /end CHARACTERISTIC
/begin CHARACTERISTIC CAL_ips_torque_reduction_slow_scale_pct "u8_factor_1/255" VALUE 0x40008910 RL_VALUE_UBYTE 0 CM_u8_factor_1_255 0 100 /end CHARACTERISTIC
/begin CHARACTERISTIC CAL_ips_torque_reduction_slow_floor_nm "u8_torque_nm" VALUE 0x40008911 RL_VALUE_UBYTE 0 CM_u8_torque_nm 0 255 /end CHARACTERISTIC
/begin CHARACTERISTIC CAL_dca_enable_steering_max "Calibration: drive-cycle-assist enable steering maximum." VALUE 0x40008915 RL_VALUE_UBYTE 0 NO_COMPU_METHOD 0 255 /end CHARACTERISTIC
/begin CHARACTERISTIC CAL_dca_enable_carspeed "Calibration: drive-cycle-assist enable carspeed (km/h; 2-element array)." VAL_BLK 0x40008916 RL_VALUE_UBYTE 0 CM_u8_speed_kph 0 255 NUMBER 2 /end CHARACTERISTIC
/begin CHARACTERISTIC CAL_dca_stationary_wait_time "Calibration: drive-cycle-assist stationary wait time (ms = val*100)." VALUE 0x40008918 RL_VALUE_UBYTE 0 CM_u8_time_100ms 0 25500 /end CHARACTERISTIC
/begin CHARACTERISTIC CAL_dca_tps_initial_offset "Calibration: DCA TPS initial offset. (0091 0x400090e9)" VALUE 0x40008919 RL_VALUE_UBYTE 0 CM_u16_factor_1_1023 0 24.9266862170088 /end CHARACTERISTIC
/begin CHARACTERISTIC CAL_dca_enable_tps_margin "Calibration: drive-cycle-assist enable throttle position margin (val/1023)." VALUE 0x4000891A RL_VALUE_UBYTE 0 CM_u16_factor_1_1023 0 24.9266862170088 /end CHARACTERISTIC
/begin CHARACTERISTIC CAL_dca_activate_timer "Calibration: drive-cycle-assist activate timer (ms = val*5)." VALUE 0x4000891B RL_VALUE_UBYTE 0 CM_u8_time_5ms 0 1275 /end CHARACTERISTIC
/begin CHARACTERISTIC CAL_dca_activate_tps_threshold "Calibration: drive-cycle-assist activate throttle position threshold (val/1023)." VALUE 0x4000891C RL_VALUE_UWORD 0 CM_u16_factor_1_1023 0 6406.15835777126 /end CHARACTERISTIC
/begin CHARACTERISTIC CAL_dca_freerev_wait_time "Calibration: DCA free-rev wait; dca_active_timer (5 ms) > cal*20." VALUE 0x4000891F RL_VALUE_UBYTE 0 CM_u8_time_100ms 0 25500 /end CHARACTERISTIC
/begin CHARACTERISTIC CAL_dca_ramp_timer_unknown "Calibration: drive-cycle-assist ramp timer (ms = val*20)." VALUE 0x40008920 RL_VALUE_UBYTE 0 CM_u8_time_20ms 0 5100 /end CHARACTERISTIC
/begin CHARACTERISTIC CAL_ecu_rpm_600 "Calibration: ECU RPM 600 (RPM = val*4)." VALUE 0x40008921 RL_VALUE_UBYTE 0 CM_u8_rspeed_4rpm 0 1020 /end CHARACTERISTIC
/begin CHARACTERISTIC CAL_ecu_engine_speed_decel_hysteresis_rpm "Calibration: ECU engine speed decel hysteresis RPM (RPM = val/4)." VALUE 0x40008924 RL_VALUE_UWORD 0 CM_u16_rspeed_1_4rpm 0 16383.75 /end CHARACTERISTIC
/begin CHARACTERISTIC CAL_ecu_rpm_5250 "Calibration: ECU RPM 5250 (RPM)." VALUE 0x40008928 RL_VALUE_UWORD 0 CM_u8_rspeed_rpm 0 65535 /end CHARACTERISTIC
/begin CHARACTERISTIC CAL_cruise_resume_pedal_handoff_threshold "Calibration: cruise pedal handoff threshold. (0091 0x4000910c)" VALUE 0x4000893C RL_VALUE_UWORD 0 CM_u16_factor_1_1023 0 6406.15835777126 /end CHARACTERISTIC
/begin CHARACTERISTIC CAL_cruise_feedforward_blend_threshold "u8_factor_1/255" VALUE 0x4000893E RL_VALUE_UBYTE 0 CM_u8_factor_1_255 0 100 /end CHARACTERISTIC
/begin CHARACTERISTIC CAL_ac_compressor_engine_speed3 "Calibration: A/C compressor engine speed3 (RPM = val*4; 2-element array)." VAL_BLK 0x40008950 RL_VALUE_UBYTE 0 CM_u8_rspeed_4rpm 0 1020 NUMBER 2 /end CHARACTERISTIC
/begin CHARACTERISTIC CAL_cluster_fuel_economy_factory_stepsize "Calibration: cluster fuel economy factory stepsize." VALUE 0x40008979 RL_VALUE_UBYTE 0 NO_COMPU_METHOD 0 255 /end CHARACTERISTIC
/begin CHARACTERISTIC CAL_cluster_dte_min_distance_threshold "Calibration: cluster dte minimum distance threshold (km)." VALUE 0x4000898E RL_VALUE_UBYTE 0 CM_u16_distance_km 0 255 /end CHARACTERISTIC
/begin CHARACTERISTIC CAL_cluster_fuel_range_remaining_smoothing_factor "Calibration: cluster fuel range remaining smoothing factor." VALUE 0x4000898F RL_VALUE_UBYTE 0 NO_COMPU_METHOD 0 255 /end CHARACTERISTIC
/begin CHARACTERISTIC CAL_cluster_fuel_mileage_update_timer "Calibration: cluster fuel mileage update timer (ms = val*100)." VALUE 0x40008991 RL_VALUE_UBYTE 0 CM_u8_time_100ms 0 25500 /end CHARACTERISTIC
/begin CHARACTERISTIC CAL_cluster_fuel_economy_factor_limit "This is a fuel economy limit for calculating avaiable range." VAL_BLK 0x400089C6 RL_VALUE_UBYTE 0 NO_COMPU_METHOD 0 255 NUMBER 2 /end CHARACTERISTIC
/begin CHARACTERISTIC CAL_cluster_fuel_range_smoothing_interval "Calibration: cluster fuel range smoothing interval (ms = val*100)." VALUE 0x400089C8 RL_VALUE_UBYTE 0 CM_u8_time_100ms 0 25500 /end CHARACTERISTIC
/begin CHARACTERISTIC CAL_cluster_fuel_usage_reset_request_timer "Calibration: cluster fuel usage reset request timer (ms = val*100)." VALUE 0x400089C9 RL_VALUE_UBYTE 0 CM_u8_time_100ms 0 25500 /end CHARACTERISTIC
/begin AXIS_PTS CAL_cruise_proportional_gain_ips_X_gear "Calibration: X-axis (gear) for the cruise proportional gain IPS table (4-element array)." 0x40008BD6 car_current_gear RL_AXIS_UBYTE 0 NO_COMPU_METHOD 4 0 255 /end AXIS_PTS
/begin CHARACTERISTIC CAL_cruise_proportional_gain_ips "Calibration: cruise proportional gain IPS (4-element array)." CURVE 0x40008BDA RL_VALUE_UBYTE 0 NO_COMPU_METHOD 0 255
 /begin AXIS_DESCR COM_AXIS car_current_gear NO_COMPU_METHOD 4 0 255 AXIS_PTS_REF CAL_cruise_proportional_gain_ips_X_gear /end AXIS_DESCR
/end CHARACTERISTIC
/begin AXIS_PTS CAL_cruise_integral_gain_ips_X_gear "Calibration: X-axis (gear) for the cruise integral gain IPS table (4-element array)." 0x40008BDE NO_INPUT_QUANTITY RL_AXIS_UBYTE 0 NO_COMPU_METHOD 4 0 255 /end AXIS_PTS
/begin CHARACTERISTIC CAL_cruise_integral_gain_ips "Calibration: cruise integral gain IPS (val/100; 4-element array)." CURVE 0x40008BE2 RL_VALUE_UBYTE 0 CM_u8_factor_1_100 0 255
 /begin AXIS_DESCR COM_AXIS NO_INPUT_QUANTITY NO_COMPU_METHOD 4 0 255 AXIS_PTS_REF CAL_cruise_integral_gain_ips_X_gear /end AXIS_DESCR
/end CHARACTERISTIC
/begin AXIS_PTS CAL_cruise_derivative_gain_ips_X_gear "Calibration: X-axis (gear) for the cruise derivative gain IPS table (4-element array)." 0x40008BE6 car_current_gear RL_AXIS_UBYTE 0 NO_COMPU_METHOD 4 0 255 /end AXIS_PTS
/begin CHARACTERISTIC CAL_cruise_derivative_gain_ips "Calibration: cruise derivative gain IPS (4-element array)." CURVE 0x40008BEA RL_VALUE_UBYTE 0 NO_COMPU_METHOD 0 255
 /begin AXIS_DESCR COM_AXIS car_current_gear NO_COMPU_METHOD 4 0 255 AXIS_PTS_REF CAL_cruise_derivative_gain_ips_X_gear /end AXIS_DESCR
/end CHARACTERISTIC
/begin AXIS_PTS CAL_ips_revmatch_p_gain_X_rpm "Calibration: X axis (rpm) of CAL_ips_revmatch_p_gain. (0091 0x400094fe)" 0x40008D2E NO_INPUT_QUANTITY RL_AXIS_UWORD 0 CM_u8_rspeed_rpm 4 0 65535 /end AXIS_PTS
/begin CHARACTERISTIC CAL_ips_revmatch_p_gain "Calibration: IPS rev-match P gain vs requested rpm. (0091 0x40009506)" CURVE 0x40008D36 RL_VALUE_UWORD 0 NO_COMPU_METHOD 0 65535
 /begin AXIS_DESCR COM_AXIS NO_INPUT_QUANTITY CM_u8_rspeed_rpm 4 0 65535 AXIS_PTS_REF CAL_ips_revmatch_p_gain_X_rpm /end AXIS_DESCR
/end CHARACTERISTIC
/begin CHARACTERISTIC CAL_unused_40008d46 "No references. Was 'unused????'." VALUE 0x40008D46 RL_VALUE_UWORD 0 NO_COMPU_METHOD 0 65535 /end CHARACTERISTIC
/begin AXIS_PTS CAL_ac_load_limit_X_rpm "Calibration: X-axis (rpm) for the A/C load limit table (RPM = val*125/4+500; 4-element array)." 0x40008D48 engine_speed_8bit RL_AXIS_UBYTE 0 CM_u8_rspeed_125_4_500rpm 4 500 8468.75 /end AXIS_PTS
/begin CHARACTERISTIC CAL_ac_load_limit "Calibration: A/C load limit (4-element array)." CURVE 0x40008D4C RL_VALUE_UBYTE 0 NO_COMPU_METHOD 0 255
 /begin AXIS_DESCR COM_AXIS engine_speed_8bit CM_u8_rspeed_125_4_500rpm 4 500 8468.75 AXIS_PTS_REF CAL_ac_load_limit_X_rpm /end AXIS_DESCR
/end CHARACTERISTIC
/begin CHARACTERISTIC CAL_unused_40008d50 "Unused: no references in 0278." VAL_BLK 0x40008D50 RL_VALUE_UBYTE 0 NO_COMPU_METHOD 0 255 NUMBER 6 /end CHARACTERISTIC
/begin AXIS_PTS CAL_cruise_proportional_gain_manual_longbox_X_gear "Calibration: X-axis (gear) for the cruise proportional gain manual longbox table (4-element array)." 0x40008D66 car_current_gear RL_AXIS_UBYTE 0 NO_COMPU_METHOD 4 0 255 /end AXIS_PTS
/begin CHARACTERISTIC CAL_cruise_proportional_gain_manual_longbox "Calibration: cruise proportional gain manual longbox (4-element array)." CURVE 0x40008D6A RL_VALUE_UBYTE 0 NO_COMPU_METHOD 0 255
 /begin AXIS_DESCR COM_AXIS car_current_gear NO_COMPU_METHOD 4 0 255 AXIS_PTS_REF CAL_cruise_proportional_gain_manual_longbox_X_gear /end AXIS_DESCR
/end CHARACTERISTIC
/begin AXIS_PTS CAL_cruise_integral_gain_manual_longbox_X_gear "Calibration: X-axis (gear) for the cruise integral gain manual longbox table (4-element array)." 0x40008D6E car_current_gear RL_AXIS_UBYTE 0 NO_COMPU_METHOD 4 0 255 /end AXIS_PTS
/begin CHARACTERISTIC CAL_cruise_integral_gain_manual_longbox "Calibration: cruise integral gain manual longbox (val/100; 4-element array)." CURVE 0x40008D72 RL_VALUE_UBYTE 0 CM_u8_factor_1_100 0 255
 /begin AXIS_DESCR COM_AXIS car_current_gear NO_COMPU_METHOD 4 0 255 AXIS_PTS_REF CAL_cruise_integral_gain_manual_longbox_X_gear /end AXIS_DESCR
/end CHARACTERISTIC
/begin AXIS_PTS CAL_cruise_derivative_gain_manual_longbox_X_gear "Calibration: X-axis (gear) for the cruise derivative gain manual longbox table (4-element array)." 0x40008D76 car_current_gear RL_AXIS_UBYTE 0 NO_COMPU_METHOD 4 0 255 /end AXIS_PTS
/begin CHARACTERISTIC CAL_cruise_derivative_gain_manual_longbox "Calibration: cruise derivative gain manual longbox (4-element array)." CURVE 0x40008D7A RL_VALUE_UBYTE 0 NO_COMPU_METHOD 0 255
 /begin AXIS_DESCR COM_AXIS car_current_gear NO_COMPU_METHOD 4 0 255 AXIS_PTS_REF CAL_cruise_derivative_gain_manual_longbox_X_gear /end AXIS_DESCR
/end CHARACTERISTIC
/begin CHARACTERISTIC CAL_unused_40008e47 "Unused: no references in 0278." VALUE 0x40008E47 RL_VALUE_UBYTE 0 NO_COMPU_METHOD 0 255 /end CHARACTERISTIC
/begin AXIS_PTS CAL_ecu_engine_speed_target_dec_gain_X_coolant_temp "Calibration: X-axis (coolant temp) for the ECU engine speed target dec gain table (°C = val*5/8−40; 4-element array)." 0x40008E58 coolant_temp RL_AXIS_UBYTE 0 CM_u8_temp_5_8_40c 4 -40 119.375 /end AXIS_PTS
/begin CHARACTERISTIC CAL_ecu_engine_speed_target_dec_gain "Calibration: ECU engine speed target dec gain (val/255; 4-element array)." CURVE 0x40008E5C RL_VALUE_UBYTE 0 CM_u8_factor_1_255 0 100
 /begin AXIS_DESCR COM_AXIS coolant_temp CM_u8_temp_5_8_40c 4 -40 119.375 AXIS_PTS_REF CAL_ecu_engine_speed_target_dec_gain_X_coolant_temp /end AXIS_DESCR
/end CHARACTERISTIC
/begin CHARACTERISTIC CAL_unused_40008e60 "Unused: no references in 0278." VAL_BLK 0x40008E60 RL_VALUE_UBYTE 0 NO_COMPU_METHOD 0 255 NUMBER 2 /end CHARACTERISTIC
/begin CHARACTERISTIC CAL_unused_40008e72 "Unused: no references in 0278 or 0091." VAL_BLK 0x40008E72 RL_VALUE_UBYTE 0 NO_COMPU_METHOD 0 255 NUMBER 8 /end CHARACTERISTIC
/begin CHARACTERISTIC CAL_unused_4000905a "Unused: no references in 0278 or 0091." VAL_BLK 0x4000905A RL_VALUE_UBYTE 0 NO_COMPU_METHOD 0 255 NUMBER 34 /end CHARACTERISTIC
/begin AXIS_PTS CAL_unused_inj_afterstart_enrichment_coolant_ips_X_coolant "Unused in 0278 (no refs); 0091 CAL_inj_afterstart_enrichment_coolant_ips_X_coolant." 0x4000907C NO_INPUT_QUANTITY RL_AXIS_UBYTE 0 CM_u8_temp_5_8_40c 12 -40 119.375 /end AXIS_PTS
/begin AXIS_PTS CAL_unused_inj_afterstart_enrichment_coolant_ips_Y_maf_accum "Unused in 0278 (no refs); 0091 ..._Y_maf_accum." 0x40009088 NO_INPUT_QUANTITY RL_AXIS_UBYTE 0 CM_u16_mass_g 14 0 255 /end AXIS_PTS
/begin CHARACTERISTIC CAL_unused_inj_afterstart_enrichment_coolant_ips "Unused in 0278 (no refs); 0091 CAL_inj_afterstart_enrichment_coolant_ips (12x14)." MAP 0x40009096 RL_VALUE_UBYTE 0 CM_u8_factor_1_32 0 796.875
 /begin AXIS_DESCR COM_AXIS NO_INPUT_QUANTITY CM_u8_temp_5_8_40c 12 -40 119.375 AXIS_PTS_REF CAL_unused_inj_afterstart_enrichment_coolant_ips_X_coolant /end AXIS_DESCR
 /begin AXIS_DESCR COM_AXIS NO_INPUT_QUANTITY CM_u16_mass_g 14 0 255 AXIS_PTS_REF CAL_unused_inj_afterstart_enrichment_coolant_ips_Y_maf_accum /end AXIS_DESCR
/end CHARACTERISTIC
/begin CHARACTERISTIC CAL_unused_4000915e "Unused: no references in 0278." VAL_BLK 0x4000915E RL_VALUE_UBYTE 0 NO_COMPU_METHOD 0 255 NUMBER 4 /end CHARACTERISTIC
/begin AXIS_PTS CAL_ac_evap_pid_p_gain_X_temp_error "Calibration: X axis of CAL_ac_evap_pid_p_gain. (0091 0x40009952)" 0x40009182 NO_INPUT_QUANTITY RL_AXIS_UBYTE 0 CM_u8_temp_5_8_40c 8 -40 119.375 /end AXIS_PTS
/begin CHARACTERISTIC CAL_ac_evap_pid_p_gain "Calibration: A/C evap PID P gain vs temp error. (0091 0x4000995a)" CURVE 0x4000918A RL_VALUE_UBYTE 0 NO_COMPU_METHOD 0 255
 /begin AXIS_DESCR COM_AXIS NO_INPUT_QUANTITY CM_u8_temp_5_8_40c 8 -40 119.375 AXIS_PTS_REF CAL_ac_evap_pid_p_gain_X_temp_error /end AXIS_DESCR
/end CHARACTERISTIC
/begin AXIS_PTS CAL_cruise_proportional_gain_manual_cr_X_gear "Calibration: X-axis (gear) for the cruise proportional gain manual cr table (4-element array)." 0x4000946A car_current_gear RL_AXIS_UBYTE 0 NO_COMPU_METHOD 4 0 255 /end AXIS_PTS
/begin CHARACTERISTIC CAL_cruise_proportional_gain_manual_cr "Calibration: cruise proportional gain manual cr (4-element array)." CURVE 0x4000946E RL_VALUE_UBYTE 0 NO_COMPU_METHOD 0 255
 /begin AXIS_DESCR COM_AXIS car_current_gear NO_COMPU_METHOD 4 0 255 AXIS_PTS_REF CAL_cruise_proportional_gain_manual_cr_X_gear /end AXIS_DESCR
/end CHARACTERISTIC
/begin AXIS_PTS CAL_cruise_integral_gain_manual_cr_X_gear "Calibration: X-axis (gear) for the cruise integral gain manual cr table (4-element array)." 0x40009472 car_current_gear RL_AXIS_UBYTE 0 NO_COMPU_METHOD 4 0 255 /end AXIS_PTS
/begin CHARACTERISTIC CAL_cruise_integral_gain_manual_cr "Calibration: cruise integral gain manual cr (val/100; 4-element array)." CURVE 0x40009476 RL_VALUE_UBYTE 0 CM_u8_factor_1_100 0 255
 /begin AXIS_DESCR COM_AXIS car_current_gear NO_COMPU_METHOD 4 0 255 AXIS_PTS_REF CAL_cruise_integral_gain_manual_cr_X_gear /end AXIS_DESCR
/end CHARACTERISTIC
/begin AXIS_PTS CAL_cruise_derivative_gain_manual_cr_X_gear "Calibration: X-axis (gear) for the cruise derivative gain manual cr table (4-element array)." 0x4000947A car_current_gear RL_AXIS_UBYTE 0 NO_COMPU_METHOD 4 0 255 /end AXIS_PTS
/begin CHARACTERISTIC CAL_cruise_derivative_gain_manual_cr "Calibration: cruise derivative gain manual cr (4-element array)." CURVE 0x4000947E RL_VALUE_UBYTE 0 NO_COMPU_METHOD 0 255
 /begin AXIS_DESCR COM_AXIS car_current_gear NO_COMPU_METHOD 4 0 255 AXIS_PTS_REF CAL_cruise_derivative_gain_manual_cr_X_gear /end AXIS_DESCR
/end CHARACTERISTIC
/begin CHARACTERISTIC CAL_unused_40009a32 "Unused: no references in 0278." VAL_BLK 0x40009A32 RL_VALUE_UBYTE 0 NO_COMPU_METHOD 0 255 NUMBER 8 /end CHARACTERISTIC
/begin AXIS_PTS CAL_cluster_shiftlight_rpm_offset_manual_X_gear "X-axis (gear) of CAL_cluster_shiftlight_rpm_offset_manual. Was duplicate name. (0091)" 0x40009B9A NO_INPUT_QUANTITY RL_AXIS_UBYTE 0 NO_COMPU_METHOD 8 0 255 /end AXIS_PTS
/begin CHARACTERISTIC CAL_cluster_shiftlight_rpm_offset_manual "Calibration: cluster shiftlight RPM offset manual (RPM = val*8; 8-element array)." CURVE 0x40009BA2 RL_VALUE_UBYTE 0 CM_u8_rspeed_8rpm 0 2040
 /begin AXIS_DESCR COM_AXIS NO_INPUT_QUANTITY NO_COMPU_METHOD 8 0 255 AXIS_PTS_REF CAL_cluster_shiftlight_rpm_offset_manual_X_gear /end AXIS_DESCR
/end CHARACTERISTIC
/begin AXIS_PTS CAL_ecu_engine_speed_target_sport_X_pps "Calibration: X-axis (pps) for the ECU engine speed target sport table (val/1023; 10-element array)." 0x40009CE6 accel_pedal_pos_16bit RL_AXIS_UWORD 0 CM_u16_factor_1_1023 10 0 6406.15835777126 /end AXIS_PTS
/begin CHARACTERISTIC CAL_ecu_engine_speed_target_sport "Calibration: ECU engine speed target sport (RPM = val/4; 10-element array)." CURVE 0x40009CFA RL_VALUE_UWORD 0 CM_u16_rspeed_1_4rpm 0 16383.75
 /begin AXIS_DESCR COM_AXIS accel_pedal_pos_16bit CM_u16_factor_1_1023 10 0 6406.15835777126 AXIS_PTS_REF CAL_ecu_engine_speed_target_sport_X_pps /end AXIS_DESCR
/end CHARACTERISTIC
/begin CHARACTERISTIC CAL_unused_40009d16 "Unused: no references in 0278." VAL_BLK 0x40009D16 RL_VALUE_UBYTE 0 NO_COMPU_METHOD 0 255 NUMBER 4 /end CHARACTERISTIC
/begin CHARACTERISTIC CAL_unused_40009e26 "Unused: no references in 0278." VAL_BLK 0x40009E26 RL_VALUE_UBYTE 0 NO_COMPU_METHOD 0 255 NUMBER 4 /end CHARACTERISTIC
/begin CHARACTERISTIC CAL_unused_4000a8be "Unused: no references in 0278." VAL_BLK 0x4000A8BE RL_VALUE_UBYTE 0 NO_COMPU_METHOD 0 255 NUMBER 4 /end CHARACTERISTIC
/begin CHARACTERISTIC CAL_unused_4000ada0 "Unused: no references in 0278." VAL_BLK 0x4000ADA0 RL_VALUE_UBYTE 0 NO_COMPU_METHOD 0 255 NUMBER 2 /end CHARACTERISTIC
/begin CHARACTERISTIC CAL_unused_4000b00a "Unused: no references in 0278." VAL_BLK 0x4000B00A RL_VALUE_UBYTE 0 NO_COMPU_METHOD 0 255 NUMBER 40 /end CHARACTERISTIC
/begin CHARACTERISTIC CAL_unused_4000b58e "Unused: no references in 0278 or 0091 (looks like u16 table data)." VAL_BLK 0x4000B58E RL_VALUE_UBYTE 0 NO_COMPU_METHOD 0 255 NUMBER 188 /end CHARACTERISTIC
/begin AXIS_PTS CAL_unused_ign_mbt_modeled_X_rpm "Unused in 0278 (no refs); 0091 CAL_ign_mbt_modeled_X_rpm." 0x4000BE9A NO_INPUT_QUANTITY RL_AXIS_UBYTE 0 CM_u8_rspeed_125_4_500rpm 16 500 8468.75 /end AXIS_PTS
/begin AXIS_PTS CAL_unused_ign_mbt_modeled_Y_load "Unused in 0278 (no refs); 0091 CAL_ign_mbt_modeled_Y_load." 0x4000BEAA NO_INPUT_QUANTITY RL_AXIS_UBYTE 0 CM_u8_load_4mg_stroke 16 0 1020 /end AXIS_PTS
/begin CHARACTERISTIC CAL_unused_ign_mbt_modeled "Unused in 0278 (no refs); 0091 CAL_ign_mbt_modeled (16x16)." MAP 0x4000BEBA RL_VALUE_UBYTE 0 CM_u8_angle_1_4_10deg -10 53.75
 /begin AXIS_DESCR COM_AXIS NO_INPUT_QUANTITY CM_u8_rspeed_125_4_500rpm 16 500 8468.75 AXIS_PTS_REF CAL_unused_ign_mbt_modeled_X_rpm /end AXIS_DESCR
 /begin AXIS_DESCR COM_AXIS NO_INPUT_QUANTITY CM_u8_load_4mg_stroke 16 0 1020 AXIS_PTS_REF CAL_unused_ign_mbt_modeled_Y_load /end AXIS_DESCR
/end CHARACTERISTIC
/begin CHARACTERISTIC CAL_unused_4000c0ca "Unused: no references in 0278." VALUE 0x4000C0CA RL_VALUE_UBYTE 0 NO_COMPU_METHOD 0 255 /end CHARACTERISTIC
/begin CHARACTERISTIC CAL_unused_4000c4ea "Unused: no references in 0278 or 0091." VAL_BLK 0x4000C4EA RL_VALUE_UBYTE 0 NO_COMPU_METHOD 0 255 NUMBER 48 /end CHARACTERISTIC
/begin AXIS_PTS CAL_cluster_shiftlight_rpm_offset_ips_X_gear "X-axis (gear) of CAL_cluster_shiftlight_rpm_offset_ips. Was duplicate name. (0091)" 0x4000C67A NO_INPUT_QUANTITY RL_AXIS_UBYTE 0 NO_COMPU_METHOD 8 0 255 /end AXIS_PTS
/begin CHARACTERISTIC CAL_cluster_shiftlight_rpm_offset_ips "Calibration: cluster shiftlight RPM offset IPS (RPM = val*8; 8-element array)." CURVE 0x4000C682 RL_VALUE_UBYTE 0 CM_u8_rspeed_8rpm 0 2040
 /begin AXIS_DESCR COM_AXIS NO_INPUT_QUANTITY NO_COMPU_METHOD 8 0 255 AXIS_PTS_REF CAL_cluster_shiftlight_rpm_offset_ips_X_gear /end AXIS_DESCR
/end CHARACTERISTIC
/begin CHARACTERISTIC CAL_unused_4000c79a "Unused: no references in 0278." VAL_BLK 0x4000C79A RL_VALUE_UBYTE 0 NO_COMPU_METHOD 0 255 NUMBER 8 /end CHARACTERISTIC
/begin AXIS_PTS CAL_ecu_engine_speed_target_tour_X_pps "Calibration: X-axis (pps) for the ECU engine speed target tour table (val/1023; 10-element array)." 0x4000C86A accel_pedal_pos_16bit RL_AXIS_UWORD 0 CM_u16_factor_1_1023 10 0 6406.15835777126 /end AXIS_PTS
/begin CHARACTERISTIC CAL_ecu_engine_speed_target_tour "Calibration: ECU engine speed target tour (RPM = val/4; 10-element array)." CURVE 0x4000C87E RL_VALUE_UWORD 0 CM_u16_rspeed_1_4rpm 0 16383.75
 /begin AXIS_DESCR COM_AXIS accel_pedal_pos_16bit CM_u16_factor_1_1023 10 0 6406.15835777126 AXIS_PTS_REF CAL_ecu_engine_speed_target_tour_X_pps /end AXIS_DESCR
/end CHARACTERISTIC
/begin AXIS_PTS CAL_dca_tps_limit_manual_X_time "Calibration: X-axis (time) for the drive-cycle-assist throttle position limit manual table (ms = val*50; 8-element array)." 0x4000C8D2 V_CAL_dca_tps_limit_manual_X_time RL_AXIS_UBYTE 0 CM_u8_time_50ms 8 0 12750 /end AXIS_PTS
/begin CHARACTERISTIC CAL_dca_tps_limit_manual "Calibration: drive-cycle-assist throttle position limit manual (val/255; 8-element array)." CURVE 0x4000C8DA RL_VALUE_UBYTE 0 CM_u8_factor_1_255 0 100
 /begin AXIS_DESCR COM_AXIS V_CAL_dca_tps_limit_manual_X_time CM_u8_time_50ms 8 0 12750 AXIS_PTS_REF CAL_dca_tps_limit_manual_X_time /end AXIS_DESCR
/end CHARACTERISTIC
/begin AXIS_PTS CAL_dca_unknown_ips_nolc_X_time "Calibration: X-axis (time) for the drive-cycle-assist IPS nolc table (ms = val*50; 8-element array)." 0x4000C8E2 V_CAL_dca_unknown_ips_nolc_X_time RL_AXIS_UBYTE 0 CM_u8_time_50ms 8 0 12750 /end AXIS_PTS
/begin CHARACTERISTIC CAL_dca_unknown_ips_nolc "Calibration: drive-cycle-assist IPS nolc (val/255; 8-element array)." CURVE 0x4000C8EA RL_VALUE_UBYTE 0 CM_u8_factor_1_255 0 100
 /begin AXIS_DESCR COM_AXIS V_CAL_dca_unknown_ips_nolc_X_time CM_u8_time_50ms 8 0 12750 AXIS_PTS_REF CAL_dca_unknown_ips_nolc_X_time /end AXIS_DESCR
/end CHARACTERISTIC
/begin CHARACTERISTIC CAL_dca_tps_limit_ips_x_time "Calibration: drive-cycle-assist throttle position limit IPS x time (ms = val*50; 8-element array)." VAL_BLK 0x4000C902 RL_VALUE_UBYTE 0 CM_u8_time_50ms 0 12750 NUMBER 8 /end CHARACTERISTIC
/begin CHARACTERISTIC CAL_dca_tps_limit_ips "Calibration: drive-cycle-assist throttle position limit IPS (val/255; 8-element array)." VAL_BLK 0x4000C90A RL_VALUE_UBYTE 0 CM_u8_factor_1_255 0 100 NUMBER 8 /end CHARACTERISTIC
/begin CHARACTERISTIC CAL_unused_4000c9bc "Unused: no references in 0278." VAL_BLK 0x4000C9BC RL_VALUE_UBYTE 0 NO_COMPU_METHOD 0 255 NUMBER 8 /end CHARACTERISTIC
/begin CHARACTERISTIC CAL_cluster_coolant_warning_test_enable "When set, flashes the coolant warning lamp (toggle every 5 ticks) instead of the real test. Was CAL_cluster_test_enable???." VALUE 0x4000C9D8 RL_VALUE_UBYTE 0 NO_COMPU_METHOD 0 255 /end CHARACTERISTIC
/begin CHARACTERISTIC CAL_ecu_system_voltage_threshold "Calibration: ECU system voltage threshold (2-element array)." VAL_BLK 0x4000CA0C RL_VALUE_UWORD 0 CM_u16_voltage_18_1023v 0 1153.10850439883 NUMBER 2 /end CHARACTERISTIC
/begin CHARACTERISTIC CAL_cluster_coolant_warning "Calibration: cluster coolant warning (°C = val*5/8−40; 2-element array)." VAL_BLK 0x4000CA32 RL_VALUE_UBYTE 0 CM_u8_temp_5_8_40c -40 119.375 NUMBER 2 /end CHARACTERISTIC
/begin CHARACTERISTIC CAL_can_sensor_timeout_reload "Calibration: CAN sensor timeout counter reload. 0278-only (0091 slot = TPMS)." VALUE 0x4000CA34 RL_VALUE_UBYTE 0 NO_COMPU_METHOD 0 255 /end CHARACTERISTIC
/begin CHARACTERISTIC CAL_lea_misfire_baseline_set "bool" VALUE 0x4000CA66 RL_VALUE_UBYTE 0 NO_COMPU_METHOD 0 255 /end CHARACTERISTIC
/begin CHARACTERISTIC CAL_ecu_obd_mode2F_timer "Calibration: ECU OBD mode2F timer (ms = val*5)." VALUE 0x4000CA90 RL_VALUE_UWORD 0 CM_u8_time_5ms 0 327675 /end CHARACTERISTIC
/begin CHARACTERISTIC CAL_unused_4000ca9e "Unused: no references in 0278." VAL_BLK 0x4000CA9E RL_VALUE_UBYTE 0 NO_COMPU_METHOD 0 255 NUMBER 2 /end CHARACTERISTIC
/begin CHARACTERISTIC CAL_cluster_fuel_level_warning_threshold "Calibration: cluster fuel level warning threshold (gal = val/10; 2-element array)." VAL_BLK 0x4000CAA0 RL_VALUE_UBYTE 0 CM_u8_volume_1_10gallon 0 25.5 NUMBER 2 /end CHARACTERISTIC
/begin CHARACTERISTIC CAL_unused_obd_ii_P0106_highload_rpm_window "Unused in 0278 (no refs); 0091 CAL_obd_ii_P0106_highload_rpm_window." VAL_BLK 0x4000CAD9 RL_VALUE_UBYTE 0 CM_u8_rspeed_125_4_500rpm 500 8468.75 NUMBER 2 /end CHARACTERISTIC
/begin CHARACTERISTIC CAL_unused_4000cb5c "Unused: no references in 0278." VALUE 0x4000CB5C RL_VALUE_UBYTE 0 NO_COMPU_METHOD 0 255 /end CHARACTERISTIC
/begin CHARACTERISTIC CAL_ac_evap_temp_voltage_low_threshold "Calibration: (0091 0x4000d336 CAL_ac_evap_temp_voltage_low_threshold)" VALUE 0x4000CB66 RL_VALUE_UWORD 0 CM_u16_voltage_5_1023v 0 320.307917888563 /end CHARACTERISTIC
/begin CHARACTERISTIC CAL_ac_evap_temp_voltage_high_threshold "Calibration: (0091 0x4000d338 CAL_ac_evap_temp_voltage_high_threshold)" VALUE 0x4000CB68 RL_VALUE_UWORD 0 CM_u16_voltage_5_1023v 0 320.307917888563 /end CHARACTERISTIC
/begin CHARACTERISTIC CAL_trans_gear_ratio_sport "Calibration: gear detection rpm/kph bands, sport/close ratio (x10)." VAL_BLK 0x4000CB6A RL_VALUE_UWORD 0 CM_u16_ratio_1_10rpm_kph 0 6553.5 NUMBER 12 /end CHARACTERISTIC
/begin CHARACTERISTIC CAL_unused_4000cb8a "Unused: no references in 0278." VAL_BLK 0x4000CB8A RL_VALUE_UBYTE 0 NO_COMPU_METHOD 0 255 NUMBER 4 /end CHARACTERISTIC
/begin CHARACTERISTIC CAL_unused_4000cbb6 "Unused: no references in 0278." VAL_BLK 0x4000CBB6 RL_VALUE_UBYTE 0 NO_COMPU_METHOD 0 255 NUMBER 2 /end CHARACTERISTIC
/begin CHARACTERISTIC CAL_can_yaw_timeout "Calibration: (0091 0x4000d3ce CAL_can_yaw_timeout)" VALUE 0x4000CBFE RL_VALUE_UBYTE 0 CM_u8_time_5ms 0 1275 /end CHARACTERISTIC
/begin CHARACTERISTIC CAL_can_lat_accel_standstill_timeout "Calibration: (0091 0x4000d3cf CAL_can_lat_accel_standstill_timeout)" VALUE 0x4000CBFF RL_VALUE_UBYTE 0 CM_u8_time_100ms 0 25500 /end CHARACTERISTIC
/begin CHARACTERISTIC CAL_can_yaw_data_timeout "Calibration: (0091 0x4000d3d0 CAL_can_yaw_data_timeout)" VALUE 0x4000CC00 RL_VALUE_UBYTE 0 CM_u8_time_5ms 0 1275 /end CHARACTERISTIC
/begin CHARACTERISTIC CAL_can_yaw_monitor_startup_delay "Calibration: (0091 0x4000d3d3 CAL_can_yaw_monitor_startup_delay)" VALUE 0x4000CC03 RL_VALUE_UBYTE 0 CM_u8_time_s 0 255 /end CHARACTERISTIC
/begin CHARACTERISTIC CAL_trans_pump_carspeed_enable "Calibration: transmission pump carspeed enable (km/h; 2-element array)." VAL_BLK 0x4000CC94 RL_VALUE_UBYTE 0 CM_u8_speed_kph 0 255 NUMBER 2 /end CHARACTERISTIC
/begin CHARACTERISTIC CAL_trans_pump_ect_on_min "Calibration: transmission pump ect on minimum (°C = val*5/8−40)." VALUE 0x4000CC96 RL_VALUE_UBYTE 0 CM_u8_temp_5_8_40c -40 119.375 /end CHARACTERISTIC
/begin CHARACTERISTIC CAL_trans_pump_ect_off_min "Calibration: transmission pump ect off minimum (°C = val*5/8−40)." VALUE 0x4000CC97 RL_VALUE_UBYTE 0 CM_u8_temp_5_8_40c -40 119.375 /end CHARACTERISTIC
/begin CHARACTERISTIC CAL_trans_pump_cold_cutoff "Calibration: transmission pump cold cutoff (°C = val*5/8−40)." VALUE 0x4000CC98 RL_VALUE_UBYTE 0 CM_u8_temp_5_8_40c -40 119.375 /end CHARACTERISTIC
/begin CHARACTERISTIC CAL_trans_pump_warmup_min "Calibration: transmission pump warmup minimum (°C = val*5/8−40)." VALUE 0x4000CC99 RL_VALUE_UBYTE 0 CM_u8_temp_5_8_40c -40 119.375 /end CHARACTERISTIC
/begin CHARACTERISTIC CAL_trans_pump_warmup_max "Calibration: transmission pump warmup maximum (°C = val*5/8−40)." VALUE 0x4000CC9A RL_VALUE_UBYTE 0 CM_u8_temp_5_8_40c -40 119.375 /end CHARACTERISTIC
/begin CHARACTERISTIC CAL_trans_pump_no_cool_min "Calibration: transmission pump no cool minimum (°C = val*5/8−40)." VALUE 0x4000CC9B RL_VALUE_UBYTE 0 CM_u8_temp_5_8_40c -40 119.375 /end CHARACTERISTIC
/begin CHARACTERISTIC CAL_trans_pump_ect_off_max "Calibration: transmission pump ect off maximum (°C = val*5/8−40)." VALUE 0x4000CC9C RL_VALUE_UBYTE 0 CM_u8_temp_5_8_40c -40 119.375 /end CHARACTERISTIC
/begin CHARACTERISTIC CAL_trans_pump_ect_on_max "Calibration: transmission pump ect on maximum (°C = val*5/8−40)." VALUE 0x4000CC9D RL_VALUE_UBYTE 0 CM_u8_temp_5_8_40c -40 119.375 /end CHARACTERISTIC
/begin CHARACTERISTIC CAL_trans_pump_cool_off "Calibration: transmission pump cool off (°C = val*5/8−40)." VALUE 0x4000CC9E RL_VALUE_UBYTE 0 CM_u8_temp_5_8_40c -40 119.375 /end CHARACTERISTIC
/begin CHARACTERISTIC CAL_trans_pump_no_cool_max "Calibration: transmission pump no cool maximum (°C = val*5/8−40)." VALUE 0x4000CC9F RL_VALUE_UBYTE 0 CM_u8_temp_5_8_40c -40 119.375 /end CHARACTERISTIC
/begin CHARACTERISTIC CAL_trans_temp_voltage_threshold "Calibration: trans fluid temp sensor voltage window [hi,lo]." VAL_BLK 0x4000CCA4 RL_VALUE_UWORD 0 CM_u16_voltage_5_1023v 0 320.307917888563 NUMBER 2 /end CHARACTERISTIC
/begin CHARACTERISTIC CAL_trans_fluid_P2797_threshold "Calibration: transmission fluid P2797 threshold (°C = val*5/8−40)." VALUE 0x4000CCA8 RL_VALUE_UBYTE 0 CM_u8_temp_5_8_40c -40 119.375 /end CHARACTERISTIC
/begin CHARACTERISTIC CAL_unused_4000ccc0 "Unused: no references in 0278." VALUE 0x4000CCC0 RL_VALUE_UBYTE 0 NO_COMPU_METHOD 0 255 /end CHARACTERISTIC
/begin CHARACTERISTIC CAL_unused_4000cd13 "Unused: no references in 0278." VALUE 0x4000CD13 RL_VALUE_UBYTE 0 NO_COMPU_METHOD 0 255 /end CHARACTERISTIC
/begin CHARACTERISTIC CAL_unused_4000d26e "Unused: no references in 0278 (inside DTC enable-level list)." VAL_BLK 0x4000D26E RL_VALUE_UBYTE 0 NO_COMPU_METHOD 0 255 NUMBER 10 /end CHARACTERISTIC
/begin CHARACTERISTIC CAL_unused_4000d296 "Unused: no references in 0278 or 0091 (after the DTC enable-level list; likely spare DTC slots)." VAL_BLK 0x4000D296 RL_VALUE_UBYTE 0 NO_COMPU_METHOD 0 255 NUMBER 272 /end CHARACTERISTIC
/begin CHARACTERISTIC CAL_unused_4000d3e8 "Unused: no references in 0278." VALUE 0x4000D3E8 RL_VALUE_UBYTE 0 NO_COMPU_METHOD 0 255 /end CHARACTERISTIC
/begin CHARACTERISTIC CAL_unused_4000d42d "Unused: no references in 0278." VALUE 0x4000D42D RL_VALUE_UBYTE 0 NO_COMPU_METHOD 0 255 /end CHARACTERISTIC
/begin CHARACTERISTIC CAL_unused_4000d478 "Unused: no references in 0278 or 0091 (all zero)." VAL_BLK 0x4000D478 RL_VALUE_UBYTE 0 NO_COMPU_METHOD 0 255 NUMBER 120 /end CHARACTERISTIC
/begin AXIS_PTS CAL_ips_revmatch_rpm_tolerance_X_rpm "Calibration: X axis (requested rpm) of CAL_ips_revmatch_rpm_tolerance. 0278-only." 0x4000D590 NO_INPUT_QUANTITY RL_AXIS_UWORD 0 CM_u8_rspeed_rpm 4 0 65535 /end AXIS_PTS
/begin CHARACTERISTIC CAL_ips_revmatch_rpm_tolerance "Calibration: IPS rev-match: proceed when requested - actual rpm <= this. 0278-only." CURVE 0x4000D598 RL_VALUE_UWORD 0 CM_u8_rspeed_rpm 0 65535
 /begin AXIS_DESCR COM_AXIS NO_INPUT_QUANTITY CM_u8_rspeed_rpm 4 0 65535 AXIS_PTS_REF CAL_ips_revmatch_rpm_tolerance_X_rpm /end AXIS_DESCR
/end CHARACTERISTIC
/begin AXIS_PTS CAL_ecu_engine_speed_target_ramp_gain_tour_X_rpm "Calibration: X-axis (rpm) for the ECU engine speed target ramp gain tour table (RPM = val*125/4+500; 4-element array)." 0x4000D614 engine_speed_8bit RL_AXIS_UBYTE 0 CM_u8_rspeed_125_4_500rpm 4 500 8468.75 /end AXIS_PTS
/begin AXIS_PTS CAL_ecu_engine_speed_target_ramp_gain_tour_Y_coolant_temp "Calibration: Y-axis (coolant temp) for the ECU engine speed target ramp gain tour table (°C = val*5/8−40; 4-element array)." 0x4000D618 coolant_temp RL_AXIS_UBYTE 0 CM_u8_temp_5_8_40c 4 -40 119.375 /end AXIS_PTS
/begin CHARACTERISTIC CAL_ecu_engine_speed_target_ramp_gain_tour "Calibration: ECU engine speed target ramp gain tour (val/2560; 16-element array)." MAP 0x4000D61C RL_VALUE_UBYTE 0 CM_u8_factor_1_2560 0 9.9609375
 /begin AXIS_DESCR COM_AXIS engine_speed_8bit CM_u8_rspeed_125_4_500rpm 4 500 8468.75 AXIS_PTS_REF CAL_ecu_engine_speed_target_ramp_gain_tour_X_rpm /end AXIS_DESCR
 /begin AXIS_DESCR COM_AXIS coolant_temp CM_u8_temp_5_8_40c 4 -40 119.375 AXIS_PTS_REF CAL_ecu_engine_speed_target_ramp_gain_tour_Y_coolant_temp /end AXIS_DESCR
/end CHARACTERISTIC
/begin AXIS_PTS CAL_ecu_engine_speed_target_ramp_gain_sport_X_rpm "Calibration: X-axis (rpm) for the ECU engine speed target ramp gain sport table (RPM = val*125/4+500; 4-element array)." 0x4000D62C engine_speed_8bit RL_AXIS_UBYTE 0 CM_u8_rspeed_125_4_500rpm 4 500 8468.75 /end AXIS_PTS
/begin AXIS_PTS CAL_ecu_engine_speed_target_ramp_gain_sport_Y_coolant_temp "Calibration: Y-axis (coolant temp) for the ECU engine speed target ramp gain sport table (°C = val*5/8−40; 4-element array)." 0x4000D630 coolant_temp RL_AXIS_UBYTE 0 CM_u8_temp_5_8_40c 4 -40 119.375 /end AXIS_PTS
/begin CHARACTERISTIC CAL_ecu_engine_speed_target_ramp_gain_sport "Calibration: ECU engine speed target ramp gain sport (val/2560; 16-element array)." MAP 0x4000D634 RL_VALUE_UBYTE 0 CM_u8_factor_1_2560 0 9.9609375
 /begin AXIS_DESCR COM_AXIS engine_speed_8bit CM_u8_rspeed_125_4_500rpm 4 500 8468.75 AXIS_PTS_REF CAL_ecu_engine_speed_target_ramp_gain_sport_X_rpm /end AXIS_DESCR
 /begin AXIS_DESCR COM_AXIS coolant_temp CM_u8_temp_5_8_40c 4 -40 119.375 AXIS_PTS_REF CAL_ecu_engine_speed_target_ramp_gain_sport_Y_coolant_temp /end AXIS_DESCR
/end CHARACTERISTIC
/begin CHARACTERISTIC CAL_unused_4000d6a4 "Unused in 0278 (no refs); 0091 has CAL_inj_cranking_enrichment_air_temp X/Y axes here, 0278 labels its own elsewhere." VAL_BLK 0x4000D6A4 RL_VALUE_UBYTE 0 NO_COMPU_METHOD 0 255 NUMBER 16 /end CHARACTERISTIC
/begin CHARACTERISTIC CAL_unused_4000d734 "Unused: no references in 0278 or 0091." VAL_BLK 0x4000D734 RL_VALUE_UBYTE 0 NO_COMPU_METHOD 0 255 NUMBER 8 /end CHARACTERISTIC
/begin CHARACTERISTIC CAL_unused_4000d8ec "Unused: no references in 0278 or 0091 (looks like table data)." VAL_BLK 0x4000D8EC RL_VALUE_UBYTE 0 NO_COMPU_METHOD 0 255 NUMBER 32 /end CHARACTERISTIC
/begin CHARACTERISTIC CAL_unused_4000d9ec "Unused: no references in 0278 or 0091." VAL_BLK 0x4000D9EC RL_VALUE_UBYTE 0 NO_COMPU_METHOD 0 255 NUMBER 4 /end CHARACTERISTIC
/begin CHARACTERISTIC CAL_misc_calid "Calibration: misc calid (16-element array)." ASCII 0x4000D9F0 RL_VALUE_UBYTE 0 NO_COMPU_METHOD 0 255 NUMBER 16 /end CHARACTERISTIC
/begin CHARACTERISTIC CAL_unused_4000da00 "Unused: no references in 0278 or 0091." VAL_BLK 0x4000DA00 RL_VALUE_UBYTE 0 NO_COMPU_METHOD 0 255 NUMBER 16 /end CHARACTERISTIC
/begin AXIS_PTS CAL_unused_evap_leak_test_P0456_decay_limit_2d_X_fuel_level "Unused in 0278 (no refs); 0091 CAL_evap_leak_test_P0456_decay_limit_X_fuel_level. 0278 uses the 4x10 table at 0xe106." 0x4000DF00 NO_INPUT_QUANTITY RL_AXIS_UBYTE 0 NO_COMPU_METHOD 16 0 255 /end AXIS_PTS
/begin CHARACTERISTIC CAL_unused_evap_leak_test_P0456_decay_limit_2d "Unused in 0278 (no refs); 0091 CAL_evap_leak_test_P0456_decay_limit." CURVE 0x4000DF10 RL_VALUE_UBYTE 0 NO_COMPU_METHOD 0 255
 /begin AXIS_DESCR COM_AXIS NO_INPUT_QUANTITY NO_COMPU_METHOD 16 0 255 AXIS_PTS_REF CAL_unused_evap_leak_test_P0456_decay_limit_2d_X_fuel_level /end AXIS_DESCR
/end CHARACTERISTIC
/begin CHARACTERISTIC CAL_ecu_thermostat_diag_maf_threshold_manual "uint8_t[18]" VAL_BLK 0x4000DFE8 RL_VALUE_UBYTE 0 NO_COMPU_METHOD 0 255 NUMBER 18 /end CHARACTERISTIC
/begin CHARACTERISTIC CAL_ecu_thermostat_diag_maf_threshold_ips "uint8_t[18]" VAL_BLK 0x4000E016 RL_VALUE_UBYTE 0 NO_COMPU_METHOD 0 255 NUMBER 18 /end CHARACTERISTIC
/begin CHARACTERISTIC CAL_prog_version "Calibration: prog version (32-element array)." ASCII 0x4000E028 RL_VALUE_UBYTE 0 NO_COMPU_METHOD 0 255 NUMBER 32 /end CHARACTERISTIC
/begin CHARACTERISTIC CAL_unused_4000e188 "Unused: no references in 0278 or 0091 (all zero)." VAL_BLK 0x4000E188 RL_VALUE_UBYTE 0 NO_COMPU_METHOD 0 255 NUMBER 8 /end CHARACTERISTIC
/begin AXIS_PTS CAL_cruise_maf_feedforward_X_carspeed "Calibration: X axis of CAL_cruise_maf_feedforward. (0091 0x4000eca8)" 0x4000E4D8 NO_INPUT_QUANTITY RL_AXIS_UBYTE 0 CM_u8_speed_kph 8 0 255 /end AXIS_PTS
/begin CHARACTERISTIC CAL_cruise_maf_feedforward "Calibration: cruise MAF feed-forward vs car speed. (0091 0x4000ecb0)" CURVE 0x4000E4E0 RL_VALUE_UBYTE 0 CM_u8_flow_g_s 0 255
 /begin AXIS_DESCR COM_AXIS NO_INPUT_QUANTITY CM_u8_speed_kph 8 0 255 AXIS_PTS_REF CAL_cruise_maf_feedforward_X_carspeed /end AXIS_DESCR
/end CHARACTERISTIC
/begin AXIS_PTS CAL_cluster_oil_pressure_warn_threshold_X_engine_speed "Calibration: X-axis (engine speed) for the cluster oil pressure warn threshold table (RPM = val*125/4+500; 8-element array)." 0x4000E6E4 engine_speed_8bit RL_AXIS_UBYTE 0 CM_u8_rspeed_125_4_500rpm 8 500 8468.75 /end AXIS_PTS
/begin CHARACTERISTIC CAL_cluster_oil_pressure_warn_threshold "Calibration: cluster oil pressure warn threshold (RPM = val*125/4+500; 8-element array)." CURVE 0x4000E6EC RL_VALUE_UBYTE 0 CM_u8_rspeed_125_4_500rpm 500 8468.75
 /begin AXIS_DESCR COM_AXIS engine_speed_8bit CM_u8_rspeed_125_4_500rpm 8 500 8468.75 AXIS_PTS_REF CAL_cluster_oil_pressure_warn_threshold_X_engine_speed /end AXIS_DESCR
/end CHARACTERISTIC
/begin CHARACTERISTIC CAL_unused_4000ed6a "Unused: no references in 0278 or 0091 (looks like u16 table data; end of cal block)." VAL_BLK 0x4000ED6A RL_VALUE_UBYTE 0 NO_COMPU_METHOD 0 255 NUMBER 656 /end CHARACTERISTIC
/begin CHARACTERISTIC CAL_ecu_unlock_magic "Calibration: ECU unlock magic (4-element array)." ASCII 0x4000EFFA RL_VALUE_UBYTE 0 NO_COMPU_METHOD 0 255 NUMBER 4 /end CHARACTERISTIC
/begin CHARACTERISTIC CAL_ecu_cvn "Calibration: ECU cvn." VALUE 0x4000EFFE RL_VALUE_UWORD 0 NO_COMPU_METHOD 0 65535 /end CHARACTERISTIC
/begin MEASUREMENT flash_ssd_config "SSD_CONFIG.c90flRegBase = FLASH_MCR register base; &flash_ssd_config is the pSSDConfig passed to every SSD call." ULONG NO_COMPU_METHOD 0 0 0 4294967295 ECU_ADDRESS 0x400005E8 /end MEASUREMENT
/begin MEASUREMENT flash_ssd_config_main_array_base "SSD_CONFIG.mainArrayBase: flash main array base address (blank-check ranges are offsets from it)." ULONG NO_COMPU_METHOD 0 0 0 4294967295 ECU_ADDRESS 0x400005EC /end MEASUREMENT
/begin MEASUREMENT obd_ii_readiness_init_table "Readiness group init values copied into the 0x4000601c table by obd_ii_readiness_monitor_init." UWORD NO_COMPU_METHOD 0 0 0 65535 ECU_ADDRESS 0x40000E28 /end MEASUREMENT
/begin MEASUREMENT crank_cycle_position_src "Pointer read by copyCAL2RAM to seed crank_cycle_position." ULONG NO_COMPU_METHOD 0 0 0 4294967295 ECU_ADDRESS 0x40001430 /end MEASUREMENT
/begin MEASUREMENT ecu_shutdown_timer "ECU shutdown timer (ms = val*5)." ULONG CM_u8_time_5ms 0 0 0 21474836475 ECU_ADDRESS 0x40001438 /end MEASUREMENT
/begin MEASUREMENT hc08_rx_timeout_5ms "HC08 link: reloaded to 100 (500 ms) on each valid frame; 0 = HC08 silent (HC08_com)." UBYTE CM_u8_time_5ms 0 0 0 1275 ECU_ADDRESS 0x4000143C /end MEASUREMENT
/begin MEASUREMENT event_timer_10hz "Divider inside 200 Hz, reload 20 -> 10 Hz (100 ms) slot; tested < 1 so signed." SWORD NO_COMPU_METHOD 0 0 -32768 32767 ECU_ADDRESS 0x4000143E /end MEASUREMENT
/begin MEASUREMENT event_timer_100hz "Divider inside 200 Hz, reload 2 -> 100 Hz slot." UBYTE NO_COMPU_METHOD 0 0 0 255 ECU_ADDRESS 0x40001440 /end MEASUREMENT
/begin MEASUREMENT event_timer_50hz "Divider inside 200 Hz, reload 4 -> 50 Hz slot (CAN-logger timeslots 2-3 only)." UBYTE NO_COMPU_METHOD 0 0 0 255 ECU_ADDRESS 0x40001441 /end MEASUREMENT
/begin MEASUREMENT event_timer_20hz "Divider inside 200 Hz, reload 10 -> 20 Hz slot (CAN-logger timeslots 4-5 only)." UBYTE NO_COMPU_METHOD 0 0 0 255 ECU_ADDRESS 0x40001442 /end MEASUREMENT
/begin MEASUREMENT event_timer_5hz "Divider inside 10 Hz, reload 2 -> 5 Hz slot (O2 sensor fault detection)." UBYTE NO_COMPU_METHOD 0 0 0 255 ECU_ADDRESS 0x40001443 /end MEASUREMENT
/begin MEASUREMENT event_timer_333ms "Divider inside 10 Hz, reload 3 -> 333 ms slot (eMIOS watchdog, A/C speed timeout, service coding). Was tick_counter_333ms." UBYTE NO_COMPU_METHOD 0 0 0 255 ECU_ADDRESS 0x40001444 /end MEASUREMENT
/begin MEASUREMENT event_timer_2hz "Divider inside 10 Hz, reload 5 -> 2 Hz slot (CAN-logger timeslot 8 only)." UBYTE NO_COMPU_METHOD 0 0 0 255 ECU_ADDRESS 0x40001445 /end MEASUREMENT
/begin MEASUREMENT event_timer_1s "Divider inside 10 Hz, reload 10 -> 1 Hz slot (CAN-logger timeslot 9 only)." UBYTE NO_COMPU_METHOD 0 0 0 255 ECU_ADDRESS 0x40001446 /end MEASUREMENT
/begin MEASUREMENT event_timer_1000hz "Divider in the 2 kHz ISR, reload 2 -> 1 kHz slot (idle air decay, tps_control_1000hz, IPS shift, mixture tests, CAC diag)." UBYTE NO_COMPU_METHOD 0 0 0 255 ECU_ADDRESS 0x40001447 /end MEASUREMENT
/begin MEASUREMENT event_timer_200hz "Divider, reload 10 -> 200 Hz slot (bulk of periodic work)." UBYTE NO_COMPU_METHOD 0 0 0 255 ECU_ADDRESS 0x40001448 /end MEASUREMENT
/begin MEASUREMENT isr_period_stats_warmup_count "ISR ticks to skip before min/max period capture. Was etpu_stats_warmup_counter." UBYTE NO_COMPU_METHOD 0 0 0 255 ECU_ADDRESS 0x40001449 /end MEASUREMENT
/begin MEASUREMENT tmap_expected_raw "TMAP lookup (°C = val*5/8−40)." UBYTE CM_u8_temp_5_8_40c 0 0 -40 119.375 ECU_ADDRESS 0x40001456 /end MEASUREMENT
/begin MEASUREMENT tmap_expected_K "TMAP expected K." UWORD NO_COMPU_METHOD 0 0 0 65535 ECU_ADDRESS 0x40001458 /end MEASUREMENT
/begin MEASUREMENT manifold_temp_correction_factor_1_20000 "Manifold temperature correction factor 1/20000." UWORD NO_COMPU_METHOD 0 0 0 65535 ECU_ADDRESS 0x4000145A /end MEASUREMENT
/begin MEASUREMENT ambient_temp_correction_factor_1_20000 "Ambient temperature correction factor 1/20000." UWORD NO_COMPU_METHOD 0 0 0 65535 ECU_ADDRESS 0x4000145C /end MEASUREMENT
/begin MEASUREMENT air_density_manifold_ratio_1_20000 "Air density manifold ratio 1/20000." UWORD NO_COMPU_METHOD 0 0 0 65535 ECU_ADDRESS 0x4000145E /end MEASUREMENT
/begin MEASUREMENT air_density_ambient_ratio_1_20000 "Air density ambient ratio 1/20000." UWORD NO_COMPU_METHOD 0 0 0 65535 ECU_ADDRESS 0x40001460 /end MEASUREMENT
/begin MEASUREMENT engine_running_confirm_timer "Countdown from CAL_misc_engine_running_confirm_delay before engine_is_running is confirmed." UWORD NO_COMPU_METHOD 0 0 0 65535 ECU_ADDRESS 0x40001462 /end MEASUREMENT
/begin MEASUREMENT ign_isr_cyl1_toggle "Alternating-event toggle in ign_isr_cylinder1 (flipped each event while 0-gated)." UBYTE NO_COMPU_METHOD 0 0 0 255 ECU_ADDRESS 0x40001464 /end MEASUREMENT
/begin MEASUREMENT ign_isr_cyl2_toggle "Alternating-event toggle in ign_isr_cylinder2." UBYTE NO_COMPU_METHOD 0 0 0 255 ECU_ADDRESS 0x40001465 /end MEASUREMENT
/begin MEASUREMENT ign_isr_cyl3_toggle "Alternating-event toggle in ign_isr_cylinder3." UBYTE NO_COMPU_METHOD 0 0 0 255 ECU_ADDRESS 0x40001466 /end MEASUREMENT
/begin MEASUREMENT ign_isr_cyl4_toggle "Alternating-event toggle in ign_isr_cylinder4." UBYTE NO_COMPU_METHOD 0 0 0 255 ECU_ADDRESS 0x40001467 /end MEASUREMENT
/begin MEASUREMENT ign_isr_cyl5_toggle "Alternating-event toggle in ign_isr_cylinder5." UBYTE NO_COMPU_METHOD 0 0 0 255 ECU_ADDRESS 0x40001468 /end MEASUREMENT
/begin MEASUREMENT ign_isr_cyl6_toggle "Alternating-event toggle in ign_isr_cylinder6." UBYTE NO_COMPU_METHOD 0 0 0 255 ECU_ADDRESS 0x40001469 /end MEASUREMENT
/begin MEASUREMENT etb_driver_spi_cmd "DSPI-C command word for the ETB H-bridge diagnostic read (0x80 after first read)." ULONG NO_COMPU_METHOD 0 0 0 4294967295 ECU_ADDRESS 0x40001470 /end MEASUREMENT
/begin MEASUREMENT knock_sensor1_voltage "Knock sensor1 voltage (V = val*5/1023)." UWORD CM_u16_voltage_5_1023v 0 0 0 320.307917888563 ECU_ADDRESS 0x40001478 /end MEASUREMENT
/begin MEASUREMENT knock_sensor2_voltage "Knock sensor2 voltage (V = val*5/1023)." UWORD CM_u16_voltage_5_1023v 0 0 0 320.307917888563 ECU_ADDRESS 0x4000147A /end MEASUREMENT
/begin MEASUREMENT brake_or_clutch_inactive_timer "Down-counter at 200 Hz." UBYTE CM_u8_time_5ms 0 0 0 1275 ECU_ADDRESS 0x4000147C /end MEASUREMENT
/begin MEASUREMENT fuel_level_stable_counter "u8_count" UBYTE NO_COMPU_METHOD 0 0 0 255 ECU_ADDRESS 0x4000147D /end MEASUREMENT
/begin MEASUREMENT start_input_debounce_timer "Start-input debounce (reload 40 = 400 ms with ignition off). Was brake_clutch_debounce_timer___." UBYTE CM_u8_time_10ms 0 0 0 2550 ECU_ADDRESS 0x4000147E /end MEASUREMENT
/begin MEASUREMENT ign_comp_overtemp "Over-temp spark comp = ign_comp_overtemp_rpm_base x ign_comp_overtemp_coolant_factor/128 (deg = val/4). Added in normal mode and to the knock ceiling. Was ign_comp_coolant." SWORD CM_u8_angle_1_4deg 0 0 -8192 8191.75 ECU_ADDRESS 0x40001480 /end MEASUREMENT
/begin MEASUREMENT ign_comp_air_temp_idle "Air-temp spark comp from CAL_ign_comp_engine_air[temp_engine_air], used only in idle/cruise modes (deg = val/4). Was ign_temp_engine_air_comp." SWORD CM_u8_angle_1_4deg 0 0 -8192 8191.75 ECU_ADDRESS 0x40001482 /end MEASUREMENT
/begin MEASUREMENT ign_comp_overtemp_rpm_base "CAL_ign_comp_overtemp[rpm] (^0x80 signed), before the coolant factor (deg = val/4). Was ign_comp_rpm." SWORD CM_u8_angle_1_4deg 0 0 -8192 8191.75 ECU_ADDRESS 0x40001484 /end MEASUREMENT
/begin MEASUREMENT ign_comp_overtemp_coolant_factor "CAL_ign_comp_overtemp_coeff[coolant_temp] multiplier on the over-temp comp (val/128). Was ign_adv_adj_coolant_factor." UBYTE CM_u8_factor_1_128 0 0 0 199.21875 ECU_ADDRESS 0x40001486 /end MEASUREMENT
/begin MEASUREMENT ign_comp_manifold_temp_base "CAL_ign_comp_manifold_temp[rpm, charge temp] (^0x80 signed), before the load factor (deg = val/4). Was ign_comp_manifold_temp_raw." SWORD CM_u8_angle_1_4deg 0 0 -8192 8191.75 ECU_ADDRESS 0x40001488 /end MEASUREMENT
/begin MEASUREMENT ign_comp_manifold_temp_load_factor "CAL_ign_comp_manifold_temp_load_multiplier[rpm, load] (val/128). Was ..._load_multiplier." UBYTE CM_u8_factor_1_128 0 0 0 199.21875 ECU_ADDRESS 0x4000148A /end MEASUREMENT
/begin MEASUREMENT ign_adv_max_low_gear "Low-gear spark cap from CAL_ign_limit_first_gear_manual (deg = val/4); 0xff = no cap. ign_base is clipped to it. Was ign_adv_limit." SWORD CM_u8_angle_1_4deg 0 0 -8192 8191.75 ECU_ADDRESS 0x4000148C /end MEASUREMENT
/begin MEASUREMENT ign_retard_recovery_step "Per-cylinder torque-retard recovery step per 200 Hz tick (deg = val/4, no offset: compared raw against ign_torque_retard_per_cyl)." UBYTE CM_u8_angle_1_4deg 0 0 0 63.75 ECU_ADDRESS 0x4000148E /end MEASUREMENT
/begin MEASUREMENT inj_warmup_factor "Warm-up enrichment factor CAL_inj_warmup_factor_*[load, coolant], min 64 (val/64)." UBYTE CM_u8_factor_1_64 0 0 0 398.4375 ECU_ADDRESS 0x40001490 /end MEASUREMENT
/begin MEASUREMENT cranking_enrichment_coolant "Cranking enrichment coolant (val/32)." UBYTE CM_u8_factor_1_32 0 0 0 796.875 ECU_ADDRESS 0x40001491 /end MEASUREMENT
/begin MEASUREMENT inj_cranking_comp_air_temp "Cranking air-temp enrichment CAL_inj_cranking_comp_air_temp[charge temp, air since start], clamped 32..64 (val/32 = 1.0..2.0)." UBYTE CM_u8_factor_1_32 0 0 0 796.875 ECU_ADDRESS 0x40001492 /end MEASUREMENT
/begin MEASUREMENT inj_pulse_time_b1 "Injector pulse time bank 1 (µs)." UWORD CM_u8_time_us 0 0 0 65535 ECU_ADDRESS 0x40001494 /end MEASUREMENT
/begin MEASUREMENT inj_pulse_time_b2 "Injector pulse time bank 2 (µs)." UWORD CM_u8_time_us 0 0 0 65535 ECU_ADDRESS 0x40001496 /end MEASUREMENT
/begin MEASUREMENT inj_enrichment_charge_air_temp "Charge-air-temp enrichment CAL_inj_enrichment_charge_air_temp[load, charge temp], min 128 (val/128)." UBYTE CM_u8_factor_1_128 0 0 0 199.21875 ECU_ADDRESS 0x40001498 /end MEASUREMENT
/begin MEASUREMENT engine_off_time_100ms "Engine off time 100ms (ms = val*100)." UWORD CM_u8_time_100ms 0 0 0 6553500 ECU_ADDRESS 0x4000149A /end MEASUREMENT
/begin MEASUREMENT engine_soak_time_effective "Effective soak time: CAL_inj_soak_time_max while stopped, decays by maf/(CAL_inj_post_start_enrichment_decay_divisor+1) per 100 ms while running; engine_off_time_100ms is clamped to it." UWORD CM_u8_time_100ms 0 0 0 6553500 ECU_ADDRESS 0x4000149C /end MEASUREMENT
/begin MEASUREMENT load_limit_from_inj "Load limit from injector (mg/stroke)." ULONG CM_u8_load_mg_stroke 0 0 0 4294967295 ECU_ADDRESS 0x400014A0 /end MEASUREMENT
/begin MEASUREMENT soak_timer_100ms_divider "200 Hz divider, reload 20 -> 100 ms soak/off-time update. Was soak_timer_tick_10hz___." UBYTE NO_COMPU_METHOD 0 0 0 255 ECU_ADDRESS 0x400014A4 /end MEASUREMENT
/begin MEASUREMENT fuel_usage_reset_request_timer "Countdown from CAL_cluster_fuel_usage_reset_request_timer." UBYTE CM_u8_time_100ms 0 0 0 25500 ECU_ADDRESS 0x400014A8 /end MEASUREMENT
/begin MEASUREMENT cluster_500ms_divider "Transmission cooler timer (ms = val*100)." UBYTE CM_u8_time_100ms 0 0 0 25500 ECU_ADDRESS 0x400014A9 /end MEASUREMENT
/begin MEASUREMENT cluster_lamp_test_duration "Bulb-check duration; read only, never written in code (stays 0 unless set externally)." UBYTE CM_u8_time_100ms 0 0 0 25500 ECU_ADDRESS 0x400014AA /end MEASUREMENT
/begin MEASUREMENT cluster_lamp_test_timer "Bulb-check elapsed time (100 ms ticks)." UBYTE CM_u8_time_100ms 0 0 0 25500 ECU_ADDRESS 0x400014AB /end MEASUREMENT
/begin MEASUREMENT cac_pump_dutcycle_debug_override "Charge-air-cooler pump dutcycle debug override (val/255)." UWORD CM_u8_factor_1_255 0 0 0 25700 ECU_ADDRESS 0x400014AE /end MEASUREMENT
/begin MEASUREMENT cluster_test_timer "100 ms divider, reload 5 -> 500 ms cluster test step." UBYTE NO_COMPU_METHOD 0 0 0 255 ECU_ADDRESS 0x400014B0 /end MEASUREMENT
/begin MEASUREMENT exhaust_flap_dc "Exhaust flap duty cycle (val/10000)." UWORD CM_u16_factor_1_10000 0 0 0 655.35 ECU_ADDRESS 0x400014B2 /end MEASUREMENT
/begin MEASUREMENT flexcan_a_tx_102_timer "Flexcan a tx 102 timer." SBYTE NO_COMPU_METHOD 0 0 -128 127 ECU_ADDRESS 0x400014B4 /end MEASUREMENT
/begin MEASUREMENT inj_tip_apply_adj "Injector tip apply adj (boolean flag)." UBYTE NO_COMPU_METHOD 0 0 0 255 ECU_ADDRESS 0x400014B8 /end MEASUREMENT
/begin MEASUREMENT perf_stats_rpm_hold_timer "Perf-stats max-rpm capture hold (reload 50)." UBYTE NO_COMPU_METHOD 0 0 0 255 ECU_ADDRESS 0x400014C0 /end MEASUREMENT
/begin MEASUREMENT perf_stats_event_hold_timer "Perf-stats event hold countdown (reload 10)." UBYTE NO_COMPU_METHOD 0 0 0 255 ECU_ADDRESS 0x400014C1 /end MEASUREMENT
/begin MEASUREMENT obd_ii_monitor_task_scheduler_token "OBD monitor run tokens: all bits set every 100 ms; each monitor consumes its bit (bit0 update_states, bit7 fuel-trim monitors, ...)." UWORD NO_COMPU_METHOD 0 0 0 65535 ECU_ADDRESS 0x400014C8 /end MEASUREMENT
/begin MEASUREMENT obd_ii_stft_bank1 "OBD-II: short-term fuel trim bank1 (% = val*100/128−100)." UBYTE CM_u8_percent_100_128_100 0 0 -100 99.21875 ECU_ADDRESS 0x400014CA /end MEASUREMENT
/begin MEASUREMENT obd_ii_stft_bank2 "OBD-II: short-term fuel trim bank2 (% = val*100/128−100)." UBYTE CM_u8_percent_100_128_100 0 0 -100 99.21875 ECU_ADDRESS 0x400014CB /end MEASUREMENT
/begin MEASUREMENT obd_ii_ltft_bank1 "OBD-II: long-term fuel trim bank1 (% = val*100/128−100)." UBYTE CM_u8_percent_100_128_100 0 0 -100 99.21875 ECU_ADDRESS 0x400014CC /end MEASUREMENT
/begin MEASUREMENT obd_ii_ltft_bank2 "OBD-II: long-term fuel trim bank2 (% = val*100/128−100)." UBYTE CM_u8_percent_100_128_100 0 0 -100 99.21875 ECU_ADDRESS 0x400014CD /end MEASUREMENT
/begin MEASUREMENT obd_ii_DTC_current "5-char text of the current-list DTC being shown (e.g. \\P0171\\)." ULONG NO_COMPU_METHOD 0 0 0 4294967295 ECU_ADDRESS 0x400014D0 /end MEASUREMENT
/begin MEASUREMENT obd_ii_perm_dtc "5-char text of the permanent-list DTC being shown." ULONG NO_COMPU_METHOD 0 0 0 4294967295 ECU_ADDRESS 0x400014D8 /end MEASUREMENT
/begin MEASUREMENT obd_ii_DTC_confirmed_text "string" ULONG NO_COMPU_METHOD 0 0 0 4294967295 ECU_ADDRESS 0x400014E0 /end MEASUREMENT
/begin MEASUREMENT obd_ii_DTC_pending "5-char text of the pending-list DTC being shown." ULONG NO_COMPU_METHOD 0 0 0 4294967295 ECU_ADDRESS 0x400014E8 /end MEASUREMENT
/begin MEASUREMENT tps_obd_ii_model_pos "u16_factor_1/20000" UWORD CM_u16_factor_1_20000 0 0 0 327.675 ECU_ADDRESS 0x400014F0 /end MEASUREMENT
/begin MEASUREMENT stft_ramp_interval_selected "STFT ramp interval chosen from CAL_closedloop_stft_ramp_interval_manual/ips; copied into the per-bank ramp timers. Was closedloop_o2_timer_unknown." UBYTE NO_COMPU_METHOD 0 0 0 255 ECU_ADDRESS 0x400014F8 /end MEASUREMENT
/begin MEASUREMENT idle_stable_timer_ms "1 kHz countdown from 30000 (30 s) while obd_ii_idle_status == 3; 0 -> status 4." UWORD NO_COMPU_METHOD 0 0 0 65535 ECU_ADDRESS 0x40001500 /end MEASUREMENT
/begin MEASUREMENT idle_control_100ms_divider "1 kHz divider, reload 100 -> 100 ms idle sub-tasks. Was idle_control_timer_10hz." UBYTE NO_COMPU_METHOD 0 0 0 255 ECU_ADDRESS 0x40001502 /end MEASUREMENT
/begin MEASUREMENT idle_control_500ms_divider "Divider inside the 100 ms task, reload 5 -> 500 ms." UBYTE NO_COMPU_METHOD 0 0 0 255 ECU_ADDRESS 0x40001503 /end MEASUREMENT
/begin MEASUREMENT knock_buffer_size "Knock buffer size." UBYTE NO_COMPU_METHOD 0 0 0 255 ECU_ADDRESS 0x40001508 /end MEASUREMENT
/begin MEASUREMENT knock_sensitivity "Knock sensitivity (val/255)." UBYTE CM_u8_factor_1_255 0 0 0 100 ECU_ADDRESS 0x40001509 /end MEASUREMENT
/begin MEASUREMENT knock_peak_threshold "Knock peak threshold." UBYTE NO_COMPU_METHOD 0 0 0 255 ECU_ADDRESS 0x4000150A /end MEASUREMENT
/begin MEASUREMENT knock_ign_retard_delay_timer "Knock retard decay: delay counter to 10 (200 Hz)." UBYTE NO_COMPU_METHOD 0 0 0 255 ECU_ADDRESS 0x4000150B /end MEASUREMENT
/begin MEASUREMENT knock_ign_retard_decay_counter "Knock retard decay: counter to 100 (200 Hz). Was knock_ign_retard_timer_unknown2." UBYTE NO_COMPU_METHOD 0 0 0 255 ECU_ADDRESS 0x4000150C /end MEASUREMENT
/begin MEASUREMENT evap_leak_pressure_margin "Pressure margin added to the leak-test start pressure; also the divisor of the decay rate." SWORD NO_COMPU_METHOD 0 0 -32768 32767 ECU_ADDRESS 0x40001510 /end MEASUREMENT
/begin MEASUREMENT o2_switch_rich_duration_prev_b1 "Bank-1 previous rich duration (0xffff = none)." UWORD CM_u8_time_5ms 0 0 0 327675 ECU_ADDRESS 0x40001518 /end MEASUREMENT
/begin MEASUREMENT o2_switch_lean_duration_prev_b1 "Bank-1 previous lean duration (0xffff = none)." UWORD CM_u8_time_5ms 0 0 0 327675 ECU_ADDRESS 0x4000151A /end MEASUREMENT
/begin MEASUREMENT o2_switch_rich_duration_prev_b2 "Bank-2 previous rich duration." UWORD CM_u8_time_5ms 0 0 0 327675 ECU_ADDRESS 0x4000151C /end MEASUREMENT
/begin MEASUREMENT o2_switch_lean_duration_prev_b2 "Bank-2 previous lean duration." UWORD CM_u8_time_5ms 0 0 0 327675 ECU_ADDRESS 0x4000151E /end MEASUREMENT
/begin MEASUREMENT accel_pedal_mode "Accelerator pedal mode (enumerated state)." UBYTE NO_COMPU_METHOD 0 0 0 255 ECU_ADDRESS 0x40001520 /end MEASUREMENT
/begin MEASUREMENT accel_pedal_d_zero_voltage "u16_factor_1/1023" UWORD CM_u16_factor_1_1023 0 0 0 6406.15835777126 ECU_ADDRESS 0x40001522 /end MEASUREMENT
/begin MEASUREMENT accel_pedal_e_zero_voltage "Learned APP sensor E zero (minimum) voltage." UWORD CM_u16_voltage_5_1023v 0 0 0 320.307917888563 ECU_ADDRESS 0x40001524 /end MEASUREMENT
/begin MEASUREMENT cruise_accel_override_holdoff_timer "Cruise accel-pedal override hold-off (reload 100 = 500 ms)." UBYTE CM_u8_time_5ms 0 0 0 1275 ECU_ADDRESS 0x40001526 /end MEASUREMENT
/begin MEASUREMENT cruise_accel_pedal_timer "Cruise accel-pedal timer (reload 500 = 2.5 s). Was cruise_timer_unknown." UWORD CM_u8_time_5ms 0 0 0 327675 ECU_ADDRESS 0x40001528 /end MEASUREMENT
/begin MEASUREMENT accel_pedal_zero_trim_timer "Accelerator pedal zero trim timer (ms = val*5)." UWORD CM_u8_time_5ms 0 0 0 327675 ECU_ADDRESS 0x4000152A /end MEASUREMENT
/begin MEASUREMENT evap_purge_ramp_up_step "Evap purge duty ramp-up step per tick (mode-dependent CAL)." UWORD NO_COMPU_METHOD 0 0 0 65535 ECU_ADDRESS 0x40001530 /end MEASUREMENT
/begin MEASUREMENT evap_purge_ramp_down_step "Evap purge duty ramp-down step per tick (mode-dependent CAL)." UWORD NO_COMPU_METHOD 0 0 0 65535 ECU_ADDRESS 0x40001532 /end MEASUREMENT
/begin MEASUREMENT evap_purge_conditioning_timer "Purge conditioning countdown (CAL_evap_purge_conditioning_timer_100ms)." UBYTE CM_u8_time_100ms 0 0 0 25500 ECU_ADDRESS 0x40001534 /end MEASUREMENT
/begin MEASUREMENT evap_purge_suspend_timer "Purge suspend countdown after power enrichment / DFCO (CAL_evap_purge_*_suspend_timeout)." UBYTE NO_COMPU_METHOD 0 0 0 255 ECU_ADDRESS 0x40001535 /end MEASUREMENT
/begin MEASUREMENT obd_ii_readiness_group_size_table "Readiness group size table (first entry; running sums built in obd_ii_readiness_monitor_init)." UBYTE NO_COMPU_METHOD 0 0 0 255 ECU_ADDRESS 0x40001538 /end MEASUREMENT
/begin MEASUREMENT obd_ii_p0101_load_ratio_pct "load_measured_maf*100/load_alphaN_expected (%; 100 = agree). Tested against 100 +- CAL tolerance for P0101." UWORD NO_COMPU_METHOD 0 0 0 65535 ECU_ADDRESS 0x40001540 /end MEASUREMENT
/begin MEASUREMENT obd_ii_p0111_iat_voltage_min "Min IAT sensor voltage seen this test (reset 0x3ff)." UWORD CM_u16_voltage_5_1023v 0 0 0 320.307917888563 ECU_ADDRESS 0x40001542 /end MEASUREMENT
/begin MEASUREMENT obd_ii_p0096_iat2_voltage_min "Min intake-air (IAT2) sensor voltage this test (reset 0x3ff)." UWORD CM_u16_voltage_5_1023v 0 0 0 320.307917888563 ECU_ADDRESS 0x40001544 /end MEASUREMENT
/begin MEASUREMENT obd_ii_p0116_stuck_check_request "1 = (re)start the coolant stuck check (set at init)." UBYTE NO_COMPU_METHOD 0 0 0 255 ECU_ADDRESS 0x40001546 /end MEASUREMENT
/begin MEASUREMENT obd_ii_p1109_map_voltage_min "Min MAP sensor voltage this test (reset 0x3ff)." UWORD CM_u16_voltage_5_1023v 0 0 0 320.307917888563 ECU_ADDRESS 0x40001548 /end MEASUREMENT
/begin MEASUREMENT obd_ii_p0806_clutch_voltage_min "Min clutch position voltage this drive (reset 0x3ff)." UWORD CM_u16_voltage_5_1023v 0 0 0 320.307917888563 ECU_ADDRESS 0x4000154A /end MEASUREMENT
/begin MEASUREMENT obd_ii_p0116_stuck_check_state "Coolant stuck-check result: 0 pass, 1 fail, 3 running." UBYTE NO_COMPU_METHOD 0 0 0 255 ECU_ADDRESS 0x4000154C /end MEASUREMENT
/begin MEASUREMENT obd_ii_p0116_stuck_check_waiting "1 = waiting for an rpm excursion before the next idle observation window." UBYTE NO_COMPU_METHOD 0 0 0 255 ECU_ADDRESS 0x4000154D /end MEASUREMENT
/begin MEASUREMENT clutch_sensor_confidence_min "Minimum clutch_sensor_confidence seen (reset to CAL_clutch_sensor_confidence_max)." UWORD NO_COMPU_METHOD 0 0 0 65535 ECU_ADDRESS 0x4000154E /end MEASUREMENT
/begin MEASUREMENT cam_park_position_max_inlet_b1 "Max inlet cam position seen during the start-up park check, bank 1." SWORD CM_u8_angle_1_4deg 0 0 -8192 8191.75 ECU_ADDRESS 0x40001550 /end MEASUREMENT
/begin MEASUREMENT cam_park_position_max_inlet_b2 "Max inlet cam position seen during the start-up park check, bank 2." SWORD CM_u8_angle_1_4deg 0 0 -8192 8191.75 ECU_ADDRESS 0x40001552 /end MEASUREMENT
/begin MEASUREMENT cam_park_position_max_exhaust_b1 "Max exhaust cam position seen during the start-up park check, bank 1." SWORD CM_u8_angle_1_4deg 0 0 -8192 8191.75 ECU_ADDRESS 0x40001554 /end MEASUREMENT
/begin MEASUREMENT cam_park_position_max_exhaust_b2 "Max exhaust cam position seen during the start-up park check, bank 2." SWORD CM_u8_angle_1_4deg 0 0 -8192 8191.75 ECU_ADDRESS 0x40001556 /end MEASUREMENT
/begin MEASUREMENT cam_park_position_min_inlet_b1 "Min inlet cam position seen during the start-up park check, bank 1." SWORD CM_u8_angle_1_4deg 0 0 -8192 8191.75 ECU_ADDRESS 0x40001558 /end MEASUREMENT
/begin MEASUREMENT cam_park_position_min_inlet_b2 "Min inlet cam position seen during the start-up park check, bank 2." SWORD CM_u8_angle_1_4deg 0 0 -8192 8191.75 ECU_ADDRESS 0x4000155A /end MEASUREMENT
/begin MEASUREMENT cam_park_position_min_exhaust_b1 "Min exhaust cam position seen during the start-up park check, bank 1." SWORD CM_u8_angle_1_4deg 0 0 -8192 8191.75 ECU_ADDRESS 0x4000155C /end MEASUREMENT
/begin MEASUREMENT cam_park_position_min_exhaust_b2 "Min exhaust cam position seen during the start-up park check, bank 2." SWORD CM_u8_angle_1_4deg 0 0 -8192 8191.75 ECU_ADDRESS 0x4000155E /end MEASUREMENT
/begin MEASUREMENT vvt_duty_inlet_b1 "Inlet VVT solenoid duty = pi_output/2 + 400 (val/1000; 1 = off). Sent x10 to vvt_inlet_update_b1." UWORD CM_u16_factor_1_1000 0 0 0 6553.5 ECU_ADDRESS 0x40001560 /end MEASUREMENT
/begin MEASUREMENT vvt_duty_inlet_b2 "Inlet VVT solenoid duty bank 2 (val/1000; ~1/1024 via CAL_vvt_pwm_period*val>>10)." UWORD CM_u16_factor_1_1000 0 0 0 6553.5 ECU_ADDRESS 0x40001562 /end MEASUREMENT
/begin MEASUREMENT vvt_duty_exh_b1 "Exhaust VVT solenoid duty bank 1 (val/1000)." UWORD CM_u16_factor_1_1000 0 0 0 6553.5 ECU_ADDRESS 0x40001564 /end MEASUREMENT
/begin MEASUREMENT vvt_duty_exh_b2 "Exhaust VVT solenoid duty bank 2 (val/1000; ~1/1024)." UWORD CM_u16_factor_1_1000 0 0 0 6553.5 ECU_ADDRESS 0x40001566 /end MEASUREMENT
/begin MEASUREMENT tps_warmup_limit_timer "Throttle warm-up limit step countdown (reload 100)." UBYTE NO_COMPU_METHOD 0 0 0 255 ECU_ADDRESS 0x40001568 /end MEASUREMENT
/begin MEASUREMENT throttle_actuator_activity "Throttle actuator activity (boolean flag)." UBYTE NO_COMPU_METHOD 0 0 0 255 ECU_ADDRESS 0x40001569 /end MEASUREMENT
/begin MEASUREMENT lfb_tps_max "TPS cap during left-foot braking (0xfff = none)." UWORD NO_COMPU_METHOD 0 0 0 65535 ECU_ADDRESS 0x4000156A /end MEASUREMENT
/begin MEASUREMENT tps_target_from_torque_limit "Throttle position target from torque limit (val/1023)." UWORD CM_u16_factor_1_1023 0 0 0 6406.15835777126 ECU_ADDRESS 0x4000156C /end MEASUREMENT
/begin MEASUREMENT etb_high_duty_timer "ETB high-duty timer (reload 100 = 100 ms at 1 kHz)." UWORD CM_u8_time_ms 0 0 0 65535 ECU_ADDRESS 0x4000156E /end MEASUREMENT
/begin MEASUREMENT throttle_fault_confirm_timer "1 kHz countdown from 3000 (3 s) before a throttle error (throttle_error_flags&8) is confirmed." UWORD CM_u8_time_ms 0 0 0 65535 ECU_ADDRESS 0x40001570 /end MEASUREMENT
/begin MEASUREMENT etb_low_voltage_debounce_counter "ETB low-voltage debounce (reload 5)." UBYTE NO_COMPU_METHOD 0 0 0 255 ECU_ADDRESS 0x40001572 /end MEASUREMENT
/begin MEASUREMENT lfb_requires_init "bool" UBYTE NO_COMPU_METHOD 0 0 0 255 ECU_ADDRESS 0x40001573 /end MEASUREMENT
/begin MEASUREMENT knock_sampling_active "Knock sampling active (boolean flag)." UBYTE NO_COMPU_METHOD 0 0 0 255 ECU_ADDRESS 0x40001578 /end MEASUREMENT
/begin MEASUREMENT knock_agc_stage_override_value "Knock AGC stage override value (1 or 2)." UBYTE NO_COMPU_METHOD 0 0 0 255 ECU_ADDRESS 0x40001579 /end MEASUREMENT
/begin MEASUREMENT knock_agc_gain_normalization_divisor "Knock AGC gain normalisation divisor (0x80 or 0xff)." UBYTE NO_COMPU_METHOD 0 0 0 255 ECU_ADDRESS 0x4000157A /end MEASUREMENT
/begin MEASUREMENT knock_window_irq_phase "Knock window ISR phase toggle." UBYTE NO_COMPU_METHOD 0 0 0 255 ECU_ADDRESS 0x4000157B /end MEASUREMENT
/begin MEASUREMENT flexcan_ccp_tx_timeout "Set to 4 (2 ms) when CAN 0x351 (CCP) is sent; if still pending (queue flag 0x08) when it expires the flag is cleared and flexcan_ccp_tx_timeout_count++." UBYTE CM_u8_time_500us 0 0 0 127500 ECU_ADDRESS 0x40001580 /end MEASUREMENT
/begin MEASUREMENT chlog_command_buffer "NUL-terminated channel-logger command string scanned by chlog_command_dispatch." UBYTE NO_COMPU_METHOD 0 0 0 255 ECU_ADDRESS 0x40001588 /end MEASUREMENT
/begin MEASUREMENT air_temp_ambient "Air temperature intake (°C = val*5/8−40)." UBYTE CM_u8_temp_5_8_40c 0 0 -40 119.375 ECU_ADDRESS 0x40001590 /end MEASUREMENT
/begin MEASUREMENT air_temp_ambient_unscaled "Raw ambient air temp byte from CAN 0x407 (degC = raw*10000/12805 in u8_temp_5/8-40c)." UBYTE NO_COMPU_METHOD 0 0 0 255 ECU_ADDRESS 0x40001591 /end MEASUREMENT
/begin MEASUREMENT torque_request_tc_fast_raw "CAN 0xB7 12-bit TC fast torque request (Nm = raw/4 + 400 offset form). Was torque_request1." UWORD NO_COMPU_METHOD 0 0 0 65535 ECU_ADDRESS 0x40001592 /end MEASUREMENT
/begin MEASUREMENT torque_request_esp_fast_raw "CAN 0xB7 12-bit ESP fast torque request. Was torque_request2." UWORD NO_COMPU_METHOD 0 0 0 65535 ECU_ADDRESS 0x40001594 /end MEASUREMENT
/begin MEASUREMENT torque_request_tc_slow_raw "CAN 0xB7 12-bit TC slow torque request. Was torque_request3." UWORD NO_COMPU_METHOD 0 0 0 65535 ECU_ADDRESS 0x40001596 /end MEASUREMENT
/begin MEASUREMENT hc08_rx_timeout_min "Lowest remaining hc08_rx_timeout_5ms seen at a valid frame (HC08 link margin)." UBYTE CM_u8_time_5ms 0 0 0 1275 ECU_ADDRESS 0x40001598 /end MEASUREMENT
/begin MEASUREMENT cruise_button_timer_a "cruise2_200hz countdown (reload 3)." UBYTE CM_u8_time_5ms 0 0 0 1275 ECU_ADDRESS 0x400015A0 /end MEASUREMENT
/begin MEASUREMENT cruise_button_timer_a_hold "cruise2_200hz hold byte (set 3)." UBYTE NO_COMPU_METHOD 0 0 0 255 ECU_ADDRESS 0x400015A1 /end MEASUREMENT
/begin MEASUREMENT cruise_button_timer_b_reload "Reload value copied into cruise_button_timer_b." UBYTE NO_COMPU_METHOD 0 0 0 255 ECU_ADDRESS 0x400015A2 /end MEASUREMENT
/begin MEASUREMENT cruise_button_timer_b "cruise2_200hz countdown." UBYTE CM_u8_time_5ms 0 0 0 1275 ECU_ADDRESS 0x400015A3 /end MEASUREMENT
/begin MEASUREMENT cruise_timer_c "cruise2_200hz countdown." UBYTE CM_u8_time_5ms 0 0 0 1275 ECU_ADDRESS 0x400015A4 /end MEASUREMENT
/begin MEASUREMENT cruise_timer_d "cruise2_200hz countdown." UBYTE CM_u8_time_5ms 0 0 0 1275 ECU_ADDRESS 0x400015A5 /end MEASUREMENT
/begin MEASUREMENT cruise_timer_e "cruise2_200hz countdown." UBYTE CM_u8_time_5ms 0 0 0 1275 ECU_ADDRESS 0x400015A6 /end MEASUREMENT
/begin MEASUREMENT cruise_maf_flow_target "Cruise airflow target (0xffff = unset; seeded from obd_ii_maf_flow)." UWORD CM_u16_flow_10mg_s 0 0 0 655350 ECU_ADDRESS 0x400015A8 /end MEASUREMENT
/begin MEASUREMENT cruise_min_engage_gear "enum_t6e_gear" UBYTE NO_COMPU_METHOD 0 0 0 255 ECU_ADDRESS 0x400015AA /end MEASUREMENT
/begin MEASUREMENT cruise_speed_band_hi_factor "Upper speed-band factor in cruise2_200hz." UBYTE NO_COMPU_METHOD 0 0 0 255 ECU_ADDRESS 0x400015AB /end MEASUREMENT
/begin MEASUREMENT cruise_speed_band_lo_factor "Lower speed-band factor in cruise2_200hz." UBYTE NO_COMPU_METHOD 0 0 0 255 ECU_ADDRESS 0x400015AC /end MEASUREMENT
/begin MEASUREMENT cruise_speed_error_limit "Speed-error limit (lookup<<2)." UWORD NO_COMPU_METHOD 0 0 0 65535 ECU_ADDRESS 0x400015AE /end MEASUREMENT
/begin MEASUREMENT cruise_maf_flow_target_prev "Previous cruise airflow target (low half used)." UWORD CM_u16_flow_10mg_s 0 0 0 655350 ECU_ADDRESS 0x400015B0 /end MEASUREMENT
/begin MEASUREMENT torque_limit_tps_current "Torque limit throttle position current (val/4095)." UWORD CM_u16_factor_1_4095 0 0 0 1600.3663003663 ECU_ADDRESS 0x400015B8 /end MEASUREMENT
/begin MEASUREMENT torque_limit_external_request "Torque limit external request (Nm)." UWORD CM_u8_torque_nm 0 0 0 65535 ECU_ADDRESS 0x400015BA /end MEASUREMENT
/begin MEASUREMENT torque_external_request_tps_based "Torque external request throttle position based (Nm)." UWORD CM_u8_torque_nm 0 0 0 65535 ECU_ADDRESS 0x400015BC /end MEASUREMENT
/begin MEASUREMENT torque_limit_external_tc_fast "Torque limit external traction control fast (Nm)." UWORD CM_u8_torque_nm 0 0 0 65535 ECU_ADDRESS 0x400015BE /end MEASUREMENT
/begin MEASUREMENT torque_limit_external_esp_fast "Torque limit external ESP fast (Nm)." UWORD CM_u8_torque_nm 0 0 0 65535 ECU_ADDRESS 0x400015C0 /end MEASUREMENT
/begin MEASUREMENT torque_limit_external_tc_slow "Torque limit external traction control slow (Nm)." UWORD CM_u8_torque_nm 0 0 0 65535 ECU_ADDRESS 0x400015C2 /end MEASUREMENT
/begin MEASUREMENT torque_limit_tcu_0xc7_raw "u16_torque_nm" UWORD CM_u8_torque_nm 0 0 0 65535 ECU_ADDRESS 0x400015C4 /end MEASUREMENT
/begin MEASUREMENT torque_limit_tcu_0xc7_raw_copy "Copy of torque_limit_tcu_0xc7_raw from CAN 0x199." UWORD NO_COMPU_METHOD 0 0 0 65535 ECU_ADDRESS 0x400015C6 /end MEASUREMENT
/begin MEASUREMENT torque_requested_during_shift_raw "u16_torque_nm" UWORD CM_u8_torque_nm 0 0 0 65535 ECU_ADDRESS 0x400015C8 /end MEASUREMENT
/begin MEASUREMENT torque_requested_during_shift_scaled "u16_torque_nm" UWORD CM_u8_torque_nm 0 0 0 65535 ECU_ADDRESS 0x400015CA /end MEASUREMENT
/begin MEASUREMENT torque_target_tps_compensated "Torque target throttle position compensated (Nm)." UWORD CM_u8_torque_nm 0 0 0 65535 ECU_ADDRESS 0x400015CC /end MEASUREMENT
/begin MEASUREMENT ips_tcu_torque_scale "CAN 0x250 byte 6 (0x80 on timeout); cruise torque request = CAL_cruise_torque_request_factor*256/this." UBYTE NO_COMPU_METHOD 0 0 0 255 ECU_ADDRESS 0x400015CE /end MEASUREMENT
/begin MEASUREMENT tps_feedforward_from_load_limit "Throttle position feedforward from load limit (val/4095)." UWORD CM_u16_factor_1_4095 0 0 0 1600.3663003663 ECU_ADDRESS 0x400015D0 /end MEASUREMENT
/begin MEASUREMENT torque_cut_demand_threshold "Torque cut demand threshold (val/255)." UWORD CM_u8_factor_1_255 0 0 0 25700 ECU_ADDRESS 0x400015D2 /end MEASUREMENT
/begin MEASUREMENT torque_reduction_factor_ign "Torque reduction factor ignition (val/255)." UBYTE CM_u8_factor_1_255 0 0 0 100 ECU_ADDRESS 0x400015D4 /end MEASUREMENT
/begin MEASUREMENT torque_spark_efficiency_slope "short" SWORD NO_COMPU_METHOD 0 0 -32768 32767 ECU_ADDRESS 0x400015D6 /end MEASUREMENT
/begin MEASUREMENT torque_spark_efficiency_current "Torque spark efficiency current (val/255)." UBYTE CM_u8_factor_1_255 0 0 0 100 ECU_ADDRESS 0x400015D8 /end MEASUREMENT
/begin MEASUREMENT torque_factor_from_ign_retard "Torque factor from ignition retard (val/255)." UBYTE CM_u8_factor_1_255 0 0 0 100 ECU_ADDRESS 0x400015D9 /end MEASUREMENT
/begin MEASUREMENT torque_factor_ign_retard_net "u8_factor_1/255" UBYTE CM_u8_factor_1_255 0 0 0 100 ECU_ADDRESS 0x400015DA /end MEASUREMENT
/begin MEASUREMENT torque_to_tps_cal "Torque to throttle position cal (val/4095)." UWORD CM_u16_factor_1_4095 0 0 0 1600.3663003663 ECU_ADDRESS 0x400015DC /end MEASUREMENT
/begin MEASUREMENT _torque_to_tps_lea "Torque to throttle position lea (val/100)." UBYTE CM_u8_factor_1_100 0 0 0 255 ECU_ADDRESS 0x400015DE /end MEASUREMENT
/begin MEASUREMENT torque_cruise_request "Torque cruise request (Nm)." UWORD CM_u8_torque_nm 0 0 0 65535 ECU_ADDRESS 0x400015E0 /end MEASUREMENT
/begin MEASUREMENT torque_limit_arbitrated_fast "u16_torque_nm" UWORD CM_u8_torque_nm 0 0 0 65535 ECU_ADDRESS 0x400015E2 /end MEASUREMENT
/begin MEASUREMENT torque_limit_arbitrated_slow "u16_torque_nm" UWORD CM_u8_torque_nm 0 0 0 65535 ECU_ADDRESS 0x400015E4 /end MEASUREMENT
/begin MEASUREMENT torque_limit_0xb7_fast_validated "u16_torque_nm" UWORD CM_u8_torque_nm 0 0 0 65535 ECU_ADDRESS 0x400015E6 /end MEASUREMENT
/begin MEASUREMENT torque_limit_0xb7_slow_validated "u16_torque_nm" UWORD CM_u8_torque_nm 0 0 0 65535 ECU_ADDRESS 0x400015E8 /end MEASUREMENT
/begin MEASUREMENT torque_limit_arbitrary_end_of_pass_unused "u16_torque_nm" UWORD CM_u8_torque_nm 0 0 0 65535 ECU_ADDRESS 0x400015EA /end MEASUREMENT
/begin MEASUREMENT torque_limit_tcu_0xc7_validated "u16_torque_nm" UWORD CM_u8_torque_nm 0 0 0 65535 ECU_ADDRESS 0x400015EC /end MEASUREMENT
/begin MEASUREMENT torque_limit_ips_shift_fast "u16_torque_nm" UWORD CM_u8_torque_nm 0 0 0 65535 ECU_ADDRESS 0x400015EE /end MEASUREMENT
/begin MEASUREMENT torque_limit_ips_shift_slow "u16_torque_nm" UWORD CM_u8_torque_nm 0 0 0 65535 ECU_ADDRESS 0x400015F0 /end MEASUREMENT
/begin MEASUREMENT torque_limit_dpm_spark "u16_torque_nm" UWORD CM_u8_torque_nm 0 0 0 65535 ECU_ADDRESS 0x400015F2 /end MEASUREMENT
/begin MEASUREMENT torque_limit_dpm_throttle "u16_torque_nm" UWORD CM_u8_torque_nm 0 0 0 65535 ECU_ADDRESS 0x400015F4 /end MEASUREMENT
/begin MEASUREMENT torque_model_10ms_divider "200 Hz divider, reload 2. Was torque_timer_primary_unknown." UBYTE NO_COMPU_METHOD 0 0 0 255 ECU_ADDRESS 0x400015F6 /end MEASUREMENT
/begin MEASUREMENT torque_cruise_10ms_divider "200 Hz divider, reload 2, for the cruise torque request update." UBYTE NO_COMPU_METHOD 0 0 0 255 ECU_ADDRESS 0x400015F7 /end MEASUREMENT
/begin MEASUREMENT ac_10hz_timer "A/C 10hz timer (ms = val*5)." UBYTE CM_u8_time_5ms 0 0 0 1275 ECU_ADDRESS 0x400015F8 /end MEASUREMENT
/begin MEASUREMENT ac_load_ramp_step_timer "A/C load ramp step countdown (CAL_ac_load_ramp_steps)." UBYTE NO_COMPU_METHOD 0 0 0 255 ECU_ADDRESS 0x400015F9 /end MEASUREMENT
/begin MEASUREMENT ac_10ms_divider "200 Hz divider, reload 2." UBYTE NO_COMPU_METHOD 0 0 0 255 ECU_ADDRESS 0x400015FA /end MEASUREMENT
/begin MEASUREMENT ac_compressor_soft_engage_timer "A/C compressor soft-engage countdown (CAL_ac_compressor_soft_engage_time)." UBYTE NO_COMPU_METHOD 0 0 0 255 ECU_ADDRESS 0x400015FB /end MEASUREMENT
/begin MEASUREMENT coding_validated "Coding validated (boolean flag)." UBYTE NO_COMPU_METHOD 0 0 0 255 ECU_ADDRESS 0x40001600 /end MEASUREMENT
/begin MEASUREMENT ips_tcu_status_byte1 "CAN 0x250 byte 1 (0xff on timeout)." UBYTE NO_COMPU_METHOD 0 0 0 255 ECU_ADDRESS 0x40001608 /end MEASUREMENT
/begin MEASUREMENT revlimit_integral_tps_max "TPS ceiling above which the rev-limit integrator stops winding up." UWORD CM_u16_factor_1_1023 0 0 0 6406.15835777126 ECU_ADDRESS 0x4000160A /end MEASUREMENT
/begin MEASUREMENT speed_limit_target_ramped "Speed limit target ramped (km/h = val/100)." UWORD CM_u8_speed_1_100kph 0 0 0 655.35 ECU_ADDRESS 0x4000160C /end MEASUREMENT
/begin MEASUREMENT revlimit_car_speed_limit "CAL_vehicle_speed_limit*200 (2 km/h units), 51000 = no limit (km/h = val/100)." UWORD CM_u8_speed_1_100kph 0 0 0 655.35 ECU_ADDRESS 0x4000160E /end MEASUREMENT
/begin MEASUREMENT yaw_sensor_status_flags "CAN 0x303 yaw/lat-accel sensor status bits (bit0 received, bit2, bit5 invalid)." UBYTE NO_COMPU_METHOD 0 0 0 255 ECU_ADDRESS 0x40001610 /end MEASUREMENT
/begin MEASUREMENT ambient_temp_can_status "CAN 0x407 ambient temp status: bit0 timeout latch, bit1 valid, bit5 received (set in flexcan_a_rx_407)." UBYTE NO_COMPU_METHOD 0 0 0 255 ECU_ADDRESS 0x40001611 /end MEASUREMENT
/begin MEASUREMENT can_timeout_20ms_divider "200 Hz divider, reload 4." UBYTE NO_COMPU_METHOD 0 0 0 255 ECU_ADDRESS 0x40001612 /end MEASUREMENT
/begin MEASUREMENT can_timeout_gear_info "CAN timeout countdown (reload 40 = 200 ms) for the gear-info message." UBYTE CM_u8_time_5ms 0 0 0 1275 ECU_ADDRESS 0x40001613 /end MEASUREMENT
/begin MEASUREMENT can_timeout_ips_gear_control "CAN timeout countdown (200 ms) for the IPS gear-control message." UBYTE CM_u8_time_5ms 0 0 0 1275 ECU_ADDRESS 0x40001614 /end MEASUREMENT
/begin MEASUREMENT can_timeout_ips_data "CAN timeout countdown (200 ms) for the IPS data message (0x250)." UBYTE CM_u8_time_5ms 0 0 0 1275 ECU_ADDRESS 0x40001615 /end MEASUREMENT
/begin MEASUREMENT can_timeout_front_wheelspeeds "CAN 0xA2 timeout countdown (reload 10 = 50 ms)." UBYTE CM_u8_time_5ms 0 0 0 1275 ECU_ADDRESS 0x40001616 /end MEASUREMENT
/begin MEASUREMENT can_timeout_rear_wheelspeeds "CAN 0xA4 timeout countdown (50 ms)." UBYTE CM_u8_time_5ms 0 0 0 1275 ECU_ADDRESS 0x40001617 /end MEASUREMENT
/begin MEASUREMENT can_timeout_abs_a8 "CAN 0xA8 timeout countdown (reload 20 = 100 ms)." UBYTE CM_u8_time_5ms 0 0 0 1275 ECU_ADDRESS 0x40001618 /end MEASUREMENT
/begin MEASUREMENT can_timeout_abs_flags "ABS flags message timeout countdown (50 ms)." UBYTE CM_u8_time_5ms 0 0 0 1275 ECU_ADDRESS 0x40001619 /end MEASUREMENT
/begin MEASUREMENT can_timeout_sas "CAN 0x85 steering-angle timeout countdown (50 ms). Was sas_timer_unknown." UBYTE CM_u8_time_5ms 0 0 0 1275 ECU_ADDRESS 0x4000161A /end MEASUREMENT
/begin MEASUREMENT obd_ii_misc1_holdoff_timer "Hold-off countdown in obd_ii_monitors_misc1 (reload 10)." UBYTE NO_COMPU_METHOD 0 0 0 255 ECU_ADDRESS 0x4000161B /end MEASUREMENT
/begin MEASUREMENT p0316_eval_tc_request_state "P0316 eval traction control request state (enumerated state)." UBYTE NO_COMPU_METHOD 0 0 0 255 ECU_ADDRESS 0x4000161C /end MEASUREMENT
/begin MEASUREMENT ips_speedmatch_param_a "Parameter byte referenced by the IPS speed-matching controller config (param_1[0x15])." UBYTE NO_COMPU_METHOD 0 0 0 255 ECU_ADDRESS 0x40001620 /end MEASUREMENT
/begin MEASUREMENT ips_speedmatch_param_b "IPS speed-matching config byte (param_1[0x17])." UBYTE NO_COMPU_METHOD 0 0 0 255 ECU_ADDRESS 0x40001621 /end MEASUREMENT
/begin MEASUREMENT ips_speedmatch_param_c "IPS speed-matching config byte (param_1[0x18])." UBYTE NO_COMPU_METHOD 0 0 0 255 ECU_ADDRESS 0x40001622 /end MEASUREMENT
/begin MEASUREMENT ips_shift_error_threshold "Error threshold in ips_shift_state_mgmt_1000hz." UWORD NO_COMPU_METHOD 0 0 0 65535 ECU_ADDRESS 0x40001624 /end MEASUREMENT
/begin MEASUREMENT ips_shift_timer_ms "1 kHz countdown (reload 999) in the IPS shift state machine." UWORD CM_u8_time_ms 0 0 0 65535 ECU_ADDRESS 0x40001626 /end MEASUREMENT
/begin MEASUREMENT ips_shift_hold_timer_ms "1 kHz countdown while no shift is active." UBYTE CM_u8_time_ms 0 0 0 255 ECU_ADDRESS 0x40001628 /end MEASUREMENT
/begin MEASUREMENT ips_shift_blend_factor "Blend factor in the IPS speed-match target (0xa00 - val weighting)." UBYTE NO_COMPU_METHOD 0 0 0 255 ECU_ADDRESS 0x40001629 /end MEASUREMENT
/begin MEASUREMENT ips_shift_enable "Enable byte for the IPS shift speed check." UBYTE NO_COMPU_METHOD 0 0 0 255 ECU_ADDRESS 0x4000162A /end MEASUREMENT
/begin MEASUREMENT fuel_pump_cl_10ms_divider "200 Hz divider, reload 2, for fuel_pump_closed_loop_update." UBYTE NO_COMPU_METHOD 0 0 0 255 ECU_ADDRESS 0x40001630 /end MEASUREMENT
/begin MEASUREMENT fuel_pump_cl_50ms_divider "Divider inside the fuel-pump 10 ms slot, reload 10." UBYTE NO_COMPU_METHOD 0 0 0 255 ECU_ADDRESS 0x40001631 /end MEASUREMENT
/begin MEASUREMENT fuel_pump_sm_first_pass "1 on the first fuel-pump state-machine pass after a reset." UBYTE NO_COMPU_METHOD 0 0 0 255 ECU_ADDRESS 0x40001632 /end MEASUREMENT
/begin MEASUREMENT dpm_control_flags "DPM / drive-mode control bits (bit4/6 set together, bit5 cluster indication)." UWORD NO_COMPU_METHOD 0 0 0 65535 ECU_ADDRESS 0x40001638 /end MEASUREMENT
/begin MEASUREMENT dpm_mode_index "Driver performance mode mode index." UBYTE NO_COMPU_METHOD 0 0 0 255 ECU_ADDRESS 0x4000163A /end MEASUREMENT
/begin MEASUREMENT torque_limit_dpm_spark_4000163C "Driver performance mode target torque reduced (Nm)." UWORD CM_u8_torque_nm 0 0 0 65535 ECU_ADDRESS 0x4000163C /end MEASUREMENT
/begin MEASUREMENT torque_limit_dpm_throttle_4000163E "Driver performance mode target torque upper limit (Nm)." UWORD CM_u8_torque_nm 0 0 0 65535 ECU_ADDRESS 0x4000163E /end MEASUREMENT
/begin MEASUREMENT dpm_torque_when_tc_activated "Driver performance mode torque when traction control activated (Nm)." UWORD CM_u8_torque_nm 0 0 0 65535 ECU_ADDRESS 0x40001640 /end MEASUREMENT
/begin MEASUREMENT flash_driver_init_status "pointer" ULONG NO_COMPU_METHOD 0 0 0 4294967295 ECU_ADDRESS 0x40001648 /end MEASUREMENT
/begin MEASUREMENT intc_sw_irq4_count "Count of INTC software IRQ 4 events (intc_sw_irq4_isr)." ULONG NO_COMPU_METHOD 0 0 0 4294967295 ECU_ADDRESS 0x40001650 /end MEASUREMENT
/begin MEASUREMENT eqadc3_cal_word_a "eQADC calibration result word (gain<<16 | offset) from init_eqADC3." ULONG NO_COMPU_METHOD 0 0 0 4294967295 ECU_ADDRESS 0x40001658 /end MEASUREMENT
/begin MEASUREMENT eqadc3_cal_word_b "eQADC calibration result word (gain<<16 | offset) from init_eqADC3." ULONG NO_COMPU_METHOD 0 0 0 4294967295 ECU_ADDRESS 0x4000165C /end MEASUREMENT
/begin MEASUREMENT eqadc2_cal_offset_copy "Copy of eqadc2_cal_offset." SWORD NO_COMPU_METHOD 0 0 -32768 32767 ECU_ADDRESS 0x40001660 /end MEASUREMENT
/begin MEASUREMENT eqadc2_cal_gain_copy "Copy of eqadc2_cal_gain." SWORD NO_COMPU_METHOD 0 0 -32768 32767 ECU_ADDRESS 0x40001662 /end MEASUREMENT
/begin MEASUREMENT eqadc2_cal_offset "eQADC offset-calibration constant (14-bit) written to the ADC calibration register." ULONG NO_COMPU_METHOD 0 0 0 4294967295 ECU_ADDRESS 0x40001664 /end MEASUREMENT
/begin MEASUREMENT eqadc2_cal_gain "eQADC gain-calibration constant (15-bit) written to the ADC calibration register." ULONG NO_COMPU_METHOD 0 0 0 4294967295 ECU_ADDRESS 0x40001668 /end MEASUREMENT
/begin MEASUREMENT flash_erase_pending_flags "bit0 flash erase pending (checked in init_flash_ctrl), bit1 CAL copy in progress." UBYTE NO_COMPU_METHOD 0 0 0 255 ECU_ADDRESS 0x40001670 /end MEASUREMENT
/begin MEASUREMENT crank_cycle_position "uint16_t" UWORD NO_COMPU_METHOD 0 0 0 65535 ECU_ADDRESS 0x40001674 /end MEASUREMENT
/begin MEASUREMENT ecu_unlocked "ECU unlocked (boolean flag)." UBYTE NO_COMPU_METHOD 0 0 0 255 ECU_ADDRESS 0x40001678 /end MEASUREMENT
/begin MEASUREMENT free_ram_overrun_flag "Free ram overrun flag (boolean flag)." UBYTE NO_COMPU_METHOD 0 0 0 255 ECU_ADDRESS 0x40001680 /end MEASUREMENT
/begin MEASUREMENT free_ram_count "Free (0x55-filled) RAM found by freeram_counter, in 16-byte blocks." ULONG NO_COMPU_METHOD 0 0 0 4294967295 ECU_ADDRESS 0x40001684 /end MEASUREMENT
/begin MEASUREMENT free_ram_scan_ptr "Scan pointer for the free-RAM 0x55 pattern check." ULONG NO_COMPU_METHOD 0 0 0 4294967295 ECU_ADDRESS 0x40001688 /end MEASUREMENT
/begin MEASUREMENT cal_copy_status "Cleared at start of copyCAL2RAM." UBYTE NO_COMPU_METHOD 0 0 0 255 ECU_ADDRESS 0x4000168C /end MEASUREMENT
/begin MEASUREMENT inj_bank_balance_test_trim "RAM-only dev trim (init 0x80), added as (x-128)/2 to the bank balance ratio. Was inj_bank_balance_trim_unused." UBYTE NO_COMPU_METHOD 0 0 0 255 ECU_ADDRESS 0x4000168D /end MEASUREMENT
/begin MEASUREMENT vvt_exhaust_target_test_override "RAM-only dev override (init 0): values >= 4 replace the exhaust base target. Was vvt_exhaust_fallback_angle_zero." UBYTE NO_COMPU_METHOD 0 0 0 255 ECU_ADDRESS 0x4000168E /end MEASUREMENT
/begin MEASUREMENT afr_target_test_trim "RAM-only dev trim (init 0): adds 0.02 AFR per count to afr_target_base." UBYTE NO_COMPU_METHOD 0 0 0 255 ECU_ADDRESS 0x4000168F /end MEASUREMENT
/begin MEASUREMENT vvt_intake_target_test_override "RAM-only dev override (init 0): values >= 4 replace the intake base target. Was vvt_intake_fallback_angle_zero." UBYTE CM_u8_angle_1_4deg 0 0 0 63.75 ECU_ADDRESS 0x40001690 /end MEASUREMENT
/begin MEASUREMENT fuel_pump_duty_trim "RAM-only dev trim (init 0x80): fuel pump duty offset (x-128)*5000." UBYTE CM_u8_raw_128 0 0 -128 127 ECU_ADDRESS 0x40001691 /end MEASUREMENT
/begin MEASUREMENT inj_angle_test_override "RAM-only dev override (init 0): values >= 3 replace CAL_inj_angle. Was inj_angle_test_trim." UBYTE CM_u8_angle_720_256deg 0 0 0 717.1875 ECU_ADDRESS 0x40001692 /end MEASUREMENT
/begin MEASUREMENT ign_advance_test_trim "RAM-only dev spark trim (init 0x80 = 0), added in every ignition mode." UBYTE CM_u8_angle_1_4_32deg 0 0 -32 31.75 ECU_ADDRESS 0x40001693 /end MEASUREMENT
/begin MEASUREMENT inj_efficiency_test_trim "RAM-only dev trim (init 0x80), adds (x-128)/2 to inj_efficiency (1/400 per count)." UBYTE CM_u8_raw_128 0 0 -128 127 ECU_ADDRESS 0x40001694 /end MEASUREMENT
/begin MEASUREMENT timer_main "main() super-loop pass counter." ULONG NO_COMPU_METHOD 0 0 0 4294967295 ECU_ADDRESS 0x40001698 /end MEASUREMENT
/begin MEASUREMENT tps_transient_magnitude_decay "Throttle position transient magnitude decay (val/1023)." UWORD CM_u16_factor_1_1023 0 0 0 6406.15835777126 ECU_ADDRESS 0x400016A0 /end MEASUREMENT
/begin MEASUREMENT ecu_run_timer "ECU run timer (ms = val*100)." UWORD CM_u8_time_100ms 0 0 0 6553500 ECU_ADDRESS 0x400016A2 /end MEASUREMENT
/begin MEASUREMENT dfco_pedal_ramp_current "Ramps +1 per CAL_dfco_pedal_ramp_step_interval toward dfco_pedal_ramp_target (pedal-based DFCO exit ramp); -1 per tick when inj_flags&2. Was dfco_pedal_ramp_target2." UWORD NO_COMPU_METHOD 0 0 0 65535 ECU_ADDRESS 0x400016A4 /end MEASUREMENT
/begin MEASUREMENT dfco_active_time_5ms "Time in decel fuel cut, saturates at 5100 (25.5 s); max captured by the catalyst monitor." UWORD CM_u8_time_5ms 0 0 0 327675 ECU_ADDRESS 0x400016A6 /end MEASUREMENT
/begin MEASUREMENT fuel_on_time_5ms "Continuous fueling time (no DFCO, injection cut or torque cut >= 6), saturates. Was fuel_on_continuous_ticks." UWORD CM_u8_time_5ms 0 0 0 327675 ECU_ADDRESS 0x400016A8 /end MEASUREMENT
/begin MEASUREMENT fuel_cut_inhibit_timer "Fuel-cut inhibit countdown (ms = val*5)." UWORD CM_u8_time_5ms 0 0 0 327675 ECU_ADDRESS 0x400016AA /end MEASUREMENT
/begin MEASUREMENT fan_engine_bay_enable_delay "Engine-bay fan enable delay, counts up while coded (vs CAL_cooling_engine_bay_fan_enable_delay)." UWORD CM_u8_time_5ms 0 0 0 327675 ECU_ADDRESS 0x400016AC /end MEASUREMENT
/begin MEASUREMENT tps_delta_rate "i16_factor_1/1023" SWORD CM_u16_factor_1_1023 0 0 -3203.12805474096 3203.0303030303 ECU_ADDRESS 0x400016AE /end MEASUREMENT
/begin MEASUREMENT tps_rate_steadystate "Throttle position rate current (val/255)." SWORD CM_u16_factor_1_1023 0 0 -3203.12805474096 3203.0303030303 ECU_ADDRESS 0x400016B0 /end MEASUREMENT
/begin MEASUREMENT fan_engine_bay_run_timer "Engine-bay fan run time, +1 per 10 ms while coded, saturates 255." UBYTE CM_u8_time_10ms 0 0 0 2550 ECU_ADDRESS 0x400016B2 /end MEASUREMENT
/begin MEASUREMENT maf_accumulated_since_start_raw "accumulated air since start (g) = obd_ii_accumulated_mass_air/1000. Was typed u16_mass_mg." UWORD CM_u16_mass_g 0 0 0 65535 ECU_ADDRESS 0x400016B4 /end MEASUREMENT
/begin MEASUREMENT maf_accum_load_weighted_g "Air mass since start weighted by cranking_load_weight (g). Axis of CAL_inj_cranking_enrichment_mass_accum. Was maf_accum_since_start_scaled." UWORD CM_u16_mass_g 0 0 0 65535 ECU_ADDRESS 0x400016B6 /end MEASUREMENT
/begin MEASUREMENT fuel_level "Fuel level (gal = val/10)." UBYTE CM_u8_volume_1_10gallon 0 0 0 25.5 ECU_ADDRESS 0x400016B8 /end MEASUREMENT
/begin MEASUREMENT load_learning_stabilization_timer "Alpha-N learning stabilization countdown (CAL_load_learning_stabilization_delay)." UWORD CM_u8_time_5ms 0 0 0 327675 ECU_ADDRESS 0x400016BA /end MEASUREMENT
/begin MEASUREMENT o2_heater_warmup_state "O2 heaters: 0 engine not running (off), 1 warm-up PWM (runtime < CAL_sensor_o2_heater_warmup_duration), 2 normal." UBYTE NO_COMPU_METHOD 0 0 0 255 ECU_ADDRESS 0x400016BC /end MEASUREMENT
/begin MEASUREMENT obd_ii_accumulated_mass_air "Air mass since start: += maf(10 mg/s)/20 at 200 Hz, so 1 count = 1 mg (/1000 = g). Was typed ug." ULONG CM_u16_mass_mg 0 0 0 4294967295 ECU_ADDRESS 0x400016C0 /end MEASUREMENT
/begin MEASUREMENT maf_accum_load_weighted "sum of maf*cranking_load_weight/500 per tick = mg x weight/25; /1000 -> maf_accum_load_weighted_g. Was maf_accum_integral." ULONG CM_u16_mass_mg 0 0 0 4294967295 ECU_ADDRESS 0x400016C4 /end MEASUREMENT
/begin MEASUREMENT o2_sensor1_heater_retry_timer "Set to 100 (500 ms) on sensor-1 heater over-current; heater re-enabled when it expires." UWORD CM_u8_time_5ms 0 0 0 327675 ECU_ADDRESS 0x400016C8 /end MEASUREMENT
/begin MEASUREMENT o2_sensor2_heater_retry_timer "Sensor-2 heater over-current retry (500 ms)." UWORD CM_u8_time_5ms 0 0 0 327675 ECU_ADDRESS 0x400016CA /end MEASUREMENT
/begin MEASUREMENT o2_sensor5_heater_retry_timer "Sensor-5 heater over-current retry (500 ms)." UWORD CM_u8_time_5ms 0 0 0 327675 ECU_ADDRESS 0x400016CC /end MEASUREMENT
/begin MEASUREMENT o2_sensor6_heater_retry_timer "Sensor-6 heater over-current retry (500 ms)." UWORD CM_u8_time_5ms 0 0 0 327675 ECU_ADDRESS 0x400016CE /end MEASUREMENT
/begin MEASUREMENT cooling_timer_recirc_pump "Cooling timer recirc pump (ms = val*5)." ULONG CM_u8_time_5ms 0 0 0 21474836475 ECU_ADDRESS 0x400016D0 /end MEASUREMENT
/begin MEASUREMENT injtip_overrun_hysteresis_timer "Injtip overrun hysteresis countdown." UWORD CM_u8_time_5ms 0 0 0 327675 ECU_ADDRESS 0x400016D4 /end MEASUREMENT
/begin MEASUREMENT fan_engine_bay_engine_off_timer "Engine-bay fan: time since engine stop (after it has run), 100 ms, saturates." UWORD CM_u8_time_100ms 0 0 0 6553500 ECU_ADDRESS 0x400016D6 /end MEASUREMENT
/begin MEASUREMENT fan_engine_bay_stationary_timer "Engine-bay fan: time stationary (car speed 0), 100 ms, saturates." UWORD CM_u8_time_100ms 0 0 0 6553500 ECU_ADDRESS 0x400016D8 /end MEASUREMENT
/begin MEASUREMENT current_gear_time "Current gear time (ms = val*100)." UWORD CM_u8_time_100ms 0 0 0 6553500 ECU_ADDRESS 0x400016DA /end MEASUREMENT
/begin MEASUREMENT engine_speed_delta100ms "Engine speed delta100ms (RPM)." UWORD CM_u8_rspeed_rpm 0 0 0 65535 ECU_ADDRESS 0x400016DC /end MEASUREMENT
/begin MEASUREMENT ign_on_time_100ms "Time since ignition on (100 ms), saturates." UWORD CM_u8_time_100ms 0 0 0 6553500 ECU_ADDRESS 0x400016DE /end MEASUREMENT
/begin MEASUREMENT timer_unused_400016e0 "Decremented at 200 Hz but never loaded or read elsewhere." UWORD CM_u8_time_5ms 0 0 0 327675 ECU_ADDRESS 0x400016E0 /end MEASUREMENT
/begin MEASUREMENT ign_on_engine_stopped_time "Time with ignition on and engine stopped (no readers)." ULONG CM_u8_time_5ms 0 0 0 21474836475 ECU_ADDRESS 0x400016E4 /end MEASUREMENT
/begin MEASUREMENT injtip_decay_cycle_counter "Tick counter for the tip-in/out decay divider (CAL_injtip_tipin/tipout_decay_rate_divider)." UWORD NO_COMPU_METHOD 0 0 0 65535 ECU_ADDRESS 0x400016E8 /end MEASUREMENT
/begin MEASUREMENT injtip_transient_throttle_response_time "Hold time before the transient magnitude decays (CAL_injtip_transient_throttle_response_time[coolant, rpm]) (ms = val*5)." UWORD CM_u8_time_5ms 0 0 0 327675 ECU_ADDRESS 0x400016EA /end MEASUREMENT
/begin MEASUREMENT load_learning_holdoff_timer "Alpha-N learning hold-off countdown after a disturbance (CAL_load_learning_holdoff_delay)." UWORD CM_u8_time_5ms 0 0 0 327675 ECU_ADDRESS 0x400016EC /end MEASUREMENT
/begin MEASUREMENT o2_heater_warmup_pwm_counter "Warm-up PWM phase counter (period CAL_sensor_o2_heater_warmup_pwm_period, on for the first 80%)." UBYTE CM_u8_time_5ms 0 0 0 1275 ECU_ADDRESS 0x400016EE /end MEASUREMENT
/begin MEASUREMENT ips_cruise_status_flags "IPS-coded cruise bits sent in CAN 0xD2: bit0 = cruise_status_flags.0, bit1 = .1, bit2 = .10 or .22, bit3 = .16 (updated at 100 Hz)." UBYTE NO_COMPU_METHOD 0 0 0 255 ECU_ADDRESS 0x400016EF /end MEASUREMENT
/begin MEASUREMENT load_alphaN_maf_corr_inc_count "Count of +1 steps applied to LEA_load_alphaN_maf_error_correction_X_rpm." UBYTE NO_COMPU_METHOD 0 0 0 255 ECU_ADDRESS 0x400016F0 /end MEASUREMENT
/begin MEASUREMENT load_alphaN_maf_corr_dec_count "Count of -1 steps applied to LEA_load_alphaN_maf_error_correction_X_rpm." UBYTE NO_COMPU_METHOD 0 0 0 255 ECU_ADDRESS 0x400016F1 /end MEASUREMENT
/begin MEASUREMENT dfco_pedal_ramp_step_interval "Countdown between dfco_pedal_ramp_current steps (CAL_dfco_pedal_ramp_step_interval)." UBYTE CM_u8_time_5ms 0 0 0 1275 ECU_ADDRESS 0x400016F2 /end MEASUREMENT
/begin MEASUREMENT task_timing_stats_reset_request "Non-zero clears the task/ISR timing min/max at the end of the ISR." UBYTE NO_COMPU_METHOD 0 0 0 255 ECU_ADDRESS 0x400016F3 /end MEASUREMENT
/begin MEASUREMENT inj_fuel_film_xtau_coeff "Fuel-film filter coefficient = X factor x alpha /255 (or the disabled default) (val/255). Was inj_fuel_fillm_xtau_coeff_combined." UBYTE CM_u8_factor_1_255 0 0 0 100 ECU_ADDRESS 0x400016F4 /end MEASUREMENT
/begin MEASUREMENT fuel_film_X_factor "X-axis (factor) for the fuel film table (val/255)." UBYTE CM_u8_factor_1_255 0 0 0 100 ECU_ADDRESS 0x400016F5 /end MEASUREMENT
/begin MEASUREMENT load_filter_alpha_xtau "Fuel-film alpha from CAL_injtip_fuel_film_alpha_inc/dec[airflow_rate_from_load] (val/255)." UBYTE CM_u8_factor_1_255 0 0 0 100 ECU_ADDRESS 0x400016F6 /end MEASUREMENT
/begin MEASUREMENT load_filtered_slow "u16_load_mg/stroke" UWORD CM_u8_load_mg_stroke 0 0 0 65535 ECU_ADDRESS 0x40001702 /end MEASUREMENT
/begin MEASUREMENT load_maf_diag_filter_q8 "X-tau filtered load_measured_maf accumulator (<<8); >>8 gives load_maf_diag. Was load_filtered_from_maf (typed mg, but is x256)." SLONG NO_COMPU_METHOD 0 0 -2147483648 2147483647 ECU_ADDRESS 0x40001704 /end MEASUREMENT
/begin MEASUREMENT load_measured_maf_filter_q8 "IIR accumulator (<<8) of load_measured_maf (CAL_load_filter_low_pass_coeff, 1 kHz); >>8 gives load_measured_maf_filtered. Was load_measured_maf_filter_accum_q8." SLONG NO_COMPU_METHOD 0 0 -2147483648 2147483647 ECU_ADDRESS 0x40001708 /end MEASUREMENT
/begin MEASUREMENT ecu_on_time_100ms "+1 per 100 ms, capped at 39,321,000 (45.5 days); no readers." ULONG CM_u8_time_100ms 0 0 0 429496729500 ECU_ADDRESS 0x4000170C /end MEASUREMENT
/begin MEASUREMENT isr_period_min_ticks "Min ISR period seen (reset 0x7fffffff). Was etpu_elapsed_min_ticks." ULONG CM_u32_time_100ns 0 0 0 429496729500 ECU_ADDRESS 0x40001710 /end MEASUREMENT
/begin MEASUREMENT isr_period_max_ticks "Max ISR period seen after warm-up. Was etpu_elapsed_max_captured_ticks." ULONG CM_u32_time_100ns 0 0 0 429496729500 ECU_ADDRESS 0x40001714 /end MEASUREMENT
/begin MEASUREMENT dspi_c_interval_timer "DSPI c interval timer (ms = val*5)." UBYTE CM_u8_time_5ms 0 0 0 1275 ECU_ADDRESS 0x40001718 /end MEASUREMENT
/begin MEASUREMENT esci_rx_frame_timeout_5ms "HC08 link: inter-byte timeout, reloaded to 6 (30 ms) per byte in esci_message_receive_validate; expiry resets the frame parser." UBYTE CM_u8_time_5ms 0 0 0 1275 ECU_ADDRESS 0x40001719 /end MEASUREMENT
/begin MEASUREMENT runtime_since_start "Engine running time, +1 per 200 Hz tick (ms = val*5); 0 when not running." ULONG CM_u8_time_5ms 0 0 0 21474836475 ECU_ADDRESS 0x4000171C /end MEASUREMENT
/begin MEASUREMENT crank_sync_partial_rev_count "Revolutions spent with crank_sync_level == 3 (partial sync), saturating; reset at full sync." UBYTE NO_COMPU_METHOD 0 0 0 255 ECU_ADDRESS 0x40001720 /end MEASUREMENT
/begin MEASUREMENT obd_ii_vvt_inlet_position_bank2 "Inlet cam position bank 2 (deg = val/4). Was obd_ii_vvt_inlet_angle_bank2." UWORD CM_u8_angle_1_4deg 0 0 0 16383.75 ECU_ADDRESS 0x40001722 /end MEASUREMENT
/begin MEASUREMENT obd_ii_vvt_exhaust_position_bank2 "OBD-II: VVT exhaust position bank2 (° = val/4)." UWORD CM_u8_angle_1_4deg 0 0 0 16383.75 ECU_ADDRESS 0x40001724 /end MEASUREMENT
/begin MEASUREMENT obd_ii_vvt_inlet_position_bank1 "OBD-II: VVT inlet position bank1 (° = val/4)." UWORD CM_u8_angle_1_4deg 0 0 0 16383.75 ECU_ADDRESS 0x40001726 /end MEASUREMENT
/begin MEASUREMENT obd_ii_vvt_exhaust_position_bank1 "OBD-II: VVT exhaust position bank1 (° = val/4)." UWORD CM_u8_angle_1_4deg 0 0 0 16383.75 ECU_ADDRESS 0x40001728 /end MEASUREMENT
/begin MEASUREMENT cam_inlet_b1_edges_per_cycle "Cam edges since crank tooth 15 (reset once per cycle in etpu_ch0_crank_isr), saturates; checked against CAL_obd_ii_crank_cam_error_count_max by the crank/cam monitor." UBYTE NO_COMPU_METHOD 0 0 0 255 ECU_ADDRESS 0x4000172A /end MEASUREMENT
/begin MEASUREMENT cam_inlet_b2_edges_per_cycle "Cam edges since crank tooth 15 (reset once per cycle in etpu_ch0_crank_isr), saturates; checked against CAL_obd_ii_crank_cam_error_count_max by the crank/cam monitor." UBYTE NO_COMPU_METHOD 0 0 0 255 ECU_ADDRESS 0x4000172B /end MEASUREMENT
/begin MEASUREMENT cam_exhaust_b1_edges_per_cycle "Cam edges since crank tooth 15 (reset once per cycle in etpu_ch0_crank_isr), saturates; checked against CAL_obd_ii_crank_cam_error_count_max by the crank/cam monitor." UBYTE NO_COMPU_METHOD 0 0 0 255 ECU_ADDRESS 0x4000172C /end MEASUREMENT
/begin MEASUREMENT cam_exhaust_b2_edges_per_cycle "Cam edges since crank tooth 15 (reset once per cycle in etpu_ch0_crank_isr), saturates; checked against CAL_obd_ii_crank_cam_error_count_max by the crank/cam monitor." UBYTE NO_COMPU_METHOD 0 0 0 255 ECU_ADDRESS 0x4000172D /end MEASUREMENT
/begin MEASUREMENT crank_sync_lost_rev_count "Revolutions with crank_sync_level < 3 after having synced." UBYTE NO_COMPU_METHOD 0 0 0 255 ECU_ADDRESS 0x4000172E /end MEASUREMENT
/begin MEASUREMENT ign_sync_spark_countdown "Spark events to skip after crank sync (reset to 12 in engine_sync_reset_etpu_init, -1 per ign ISR); spark/injection scheduling waits for 0. Was ign_startup_delay_counter." UWORD NO_COMPU_METHOD 0 0 0 65535 ECU_ADDRESS 0x40001730 /end MEASUREMENT
/begin MEASUREMENT maf_voltage_buffer_index "Write index into maf_voltage_buffer[32]." UWORD NO_COMPU_METHOD 0 0 0 65535 ECU_ADDRESS 0x40001732 /end MEASUREMENT
/begin MEASUREMENT map_voltage_buffer_index "Write index into map_voltage_buffer[32]." UWORD NO_COMPU_METHOD 0 0 0 65535 ECU_ADDRESS 0x40001734 /end MEASUREMENT
/begin MEASUREMENT cal_verification_lockout "Set by etpu_ch0_crank_isr when the program/CAL verification fails; blocks crank/cam monitors." UBYTE NO_COMPU_METHOD 0 0 0 255 ECU_ADDRESS 0x40001736 /end MEASUREMENT
/begin MEASUREMENT slow_period_update_divider "Divider (0..3) for the 16-deep roughness period history shift." UBYTE NO_COMPU_METHOD 0 0 0 255 ECU_ADDRESS 0x40001737 /end MEASUREMENT
/begin MEASUREMENT crank_isr_startup_delay "Set to 200 at the start-of-crank eTPU setup." UBYTE NO_COMPU_METHOD 0 0 0 255 ECU_ADDRESS 0x40001738 /end MEASUREMENT
/begin MEASUREMENT engine_sync_reset_count "Count of engine_sync_reset_etpu_init calls (sync losses)." UBYTE NO_COMPU_METHOD 0 0 0 255 ECU_ADDRESS 0x4000173A /end MEASUREMENT
/begin MEASUREMENT crank_tooth_time_prev "eTPU TCR1 timestamp of the previous crank tooth (24-bit); engine_speed_period_1 = now - this." ULONG NO_COMPU_METHOD 0 0 0 4294967295 ECU_ADDRESS 0x4000173C /end MEASUREMENT
/begin MEASUREMENT crank_tooth_period_prev "Previous tooth period kept by crank_trigger_process___." ULONG NO_COMPU_METHOD 0 0 0 4294967295 ECU_ADDRESS 0x40001740 /end MEASUREMENT
/begin MEASUREMENT maf_map_sample_toggle "Alternates between the MAF and MAP sample halves in sensor_interrupt_maf_map." UBYTE NO_COMPU_METHOD 0 0 0 255 ECU_ADDRESS 0x40001744 /end MEASUREMENT
/begin MEASUREMENT maf_map_sample_table_index "Index (step 2, wraps at 32) into the ROM sample-angle table at 0xcc3a8." UBYTE NO_COMPU_METHOD 0 0 0 255 ECU_ADDRESS 0x40001745 /end MEASUREMENT
/begin MEASUREMENT torque_cut_level_prev "Torque cut level prev." UBYTE NO_COMPU_METHOD 0 0 0 255 ECU_ADDRESS 0x40001746 /end MEASUREMENT
/begin MEASUREMENT torque_cut_remaining_cyl_count "Cylinders still to cut for the current torque cut level." UBYTE NO_COMPU_METHOD 0 0 0 255 ECU_ADDRESS 0x40001747 /end MEASUREMENT
/begin MEASUREMENT torque_cut_coilpack_failure_mask "coilpack_failure_flags & 0x3f snapshot used when choosing cut cylinders." UBYTE NO_COMPU_METHOD 0 0 0 255 ECU_ADDRESS 0x40001748 /end MEASUREMENT
/begin MEASUREMENT failed_ignition_cyl_count_prev "failed_ignition_cyl_count at the previous update." UBYTE NO_COMPU_METHOD 0 0 0 255 ECU_ADDRESS 0x40001749 /end MEASUREMENT
/begin MEASUREMENT torque_cut_cyl_anchor "Cylinder index the torque-cut pattern is anchored to (next_firing_cyl_index at cut start)." UBYTE NO_COMPU_METHOD 0 0 0 255 ECU_ADDRESS 0x4000174A /end MEASUREMENT
/begin MEASUREMENT ign_cyl_fire_inhibited_flags "Per-cylinder bits set in ign_isr_cylinderN when the spark is inhibited (ignition off, cut, misfire or coil failure)." UBYTE NO_COMPU_METHOD 0 0 0 255 ECU_ADDRESS 0x4000174B /end MEASUREMENT
/begin MEASUREMENT crank_sync_prev_cylinder_idx "Previous cylinder index used by update_cylinder_seq_sync_flags." UBYTE NO_COMPU_METHOD 0 0 0 255 ECU_ADDRESS 0x4000174C /end MEASUREMENT
/begin MEASUREMENT inj_prime_pulse_us "Prime pulse width actually fired at crank sync (inj_prime_pulse_time, min 160 us)." ULONG CM_u8_time_us 0 0 0 4294967295 ECU_ADDRESS 0x40001750 /end MEASUREMENT
/begin MEASUREMENT inj_prime_pulse_pending "1 after a sync reset until the prime pulse has been fired." UBYTE NO_COMPU_METHOD 0 0 0 255 ECU_ADDRESS 0x40001754 /end MEASUREMENT
/begin MEASUREMENT ign_cyl_active_count_bank2 "u8_count" UBYTE NO_COMPU_METHOD 0 0 0 255 ECU_ADDRESS 0x40001755 /end MEASUREMENT
/begin MEASUREMENT ign_cyl_active_count_bank1 "u8_count" UBYTE NO_COMPU_METHOD 0 0 0 255 ECU_ADDRESS 0x40001756 /end MEASUREMENT
/begin MEASUREMENT ign_cyl_cut_flags "Per-cylinder bits: cylinder spark cut (fuel cut, coil or misfire protection) in this cycle." UBYTE NO_COMPU_METHOD 0 0 0 255 ECU_ADDRESS 0x40001757 /end MEASUREMENT
/begin MEASUREMENT next_firing_cyl_index "Index (0..5) of the next cylinder to fire." UBYTE NO_COMPU_METHOD 0 0 0 255 ECU_ADDRESS 0x40001758 /end MEASUREMENT
/begin MEASUREMENT engine_period_trend_us "(older 4-sample mean - newest 4-sample mean of engine_period_90deg_us)/15; >0 = engine accelerating. Axis for CAL_ign_comp_idle_rpm_rate. Was rpm_or_roughness_measure_unknown." SLONG NO_COMPU_METHOD 0 0 -2147483648 2147483647 ECU_ADDRESS 0x4000175C /end MEASUREMENT
/begin MEASUREMENT engine_is_running "Engine is running (boolean flag)." UBYTE NO_COMPU_METHOD 0 0 0 255 ECU_ADDRESS 0x40001760 /end MEASUREMENT
/begin MEASUREMENT engine_speed_16bit "Engine speed 2 (RPM)." UWORD CM_u8_rspeed_rpm 0 0 0 65535 ECU_ADDRESS 0x40001762 /end MEASUREMENT
/begin MEASUREMENT obd_ii_engine_speed "OBD-II: engine speed (RPM = val/4)." UWORD CM_u16_rspeed_1_4rpm 0 0 0 16383.75 ECU_ADDRESS 0x40001764 /end MEASUREMENT
/begin MEASUREMENT intake_air_temp_engine_stopped "Intake-air sensor temp latched while stopped (CAL_sensor_intake_air_scaling); cranking air-temp axis when CAL_tmap_use_for_inj. Was temp_engine_air_derived1." UBYTE CM_u8_temp_5_8_40c 0 0 -40 119.375 ECU_ADDRESS 0x40001766 /end MEASUREMENT
/begin MEASUREMENT iat_engine_stopped "u8_temp_5/8-40c" UBYTE CM_u8_temp_5_8_40c 0 0 -40 119.375 ECU_ADDRESS 0x40001767 /end MEASUREMENT
/begin MEASUREMENT coolant_temp_engine_stopped "Coolant temperature engine stopped (°C = val*5/8−40)." UBYTE CM_u8_temp_5_8_40c 0 0 -40 119.375 ECU_ADDRESS 0x40001768 /end MEASUREMENT
/begin MEASUREMENT engine_speed_8bit "Engine speed 3 (RPM = val*125/4+500)." UBYTE CM_u8_rspeed_125_4_500rpm 0 0 500 8468.75 ECU_ADDRESS 0x40001769 /end MEASUREMENT
/begin MEASUREMENT engine_speed_period_1 "Crank tooth period (eTPU TCR1 ticks, 24-bit); 0xffffffff when stopped." ULONG NO_COMPU_METHOD 0 0 0 4294967295 ECU_ADDRESS 0x4000176C /end MEASUREMENT
/begin MEASUREMENT engine_period_90deg_us "Crank period per 90 deg (us): rpm = 15e6/val; 720 deg window = val*8. Was engine_speed_period_2." ULONG CM_u8_time_us 0 0 0 4294967295 ECU_ADDRESS 0x40001770 /end MEASUREMENT
/begin MEASUREMENT engine_speed_period_avg "Average of the last CAL_engine_speed_avg_samples engine_period_90deg_us values. Was engine_speeed_period_avg." UWORD CM_u8_time_us 0 0 0 65535 ECU_ADDRESS 0x40001774 /end MEASUREMENT
/begin MEASUREMENT engine_rpm_rate "Engine speed change over CAL_engine_accel_lookback_teeth (signed; raw units, used vs CAL_load_alphaN_learning_rpm_rate_max / CAL_idle_dashpot_decel_threshold)." SLONG NO_COMPU_METHOD 0 0 -2147483648 2147483647 ECU_ADDRESS 0x40001778 /end MEASUREMENT
/begin MEASUREMENT injection_flags "bit0/3 rev-limit fuel cut, bit4 ignition off, bit5 cut counted." UWORD NO_COMPU_METHOD 0 0 0 65535 ECU_ADDRESS 0x4000177C /end MEASUREMENT
/begin MEASUREMENT dfco_cut_duration "DFCO cut duration (saturates at 1023); axis for CAL_injtip_dfco_recovery_enrich_by_duration." UWORD CM_u8_time_5ms 0 0 0 327675 ECU_ADDRESS 0x4000177E /end MEASUREMENT
/begin MEASUREMENT cam_exhaust_b2_sync_edge_count "Cam edges seen while cam phase is undecided (crank_sync_level < 4 and cam_phase_detected == 0); phase decided from the 2nd edge." UWORD NO_COMPU_METHOD 0 0 0 65535 ECU_ADDRESS 0x40001780 /end MEASUREMENT
/begin MEASUREMENT cam_exhaust_b1_sync_edge_count "Cam edges seen while cam phase is undecided (crank_sync_level < 4 and cam_phase_detected == 0); phase decided from the 2nd edge." UWORD NO_COMPU_METHOD 0 0 0 65535 ECU_ADDRESS 0x40001782 /end MEASUREMENT
/begin MEASUREMENT cam_inlet_b1_sync_edge_count "Cam edges seen while cam phase is undecided (crank_sync_level < 4 and cam_phase_detected == 0); phase decided from the 2nd edge." UWORD NO_COMPU_METHOD 0 0 0 65535 ECU_ADDRESS 0x40001784 /end MEASUREMENT
/begin MEASUREMENT cam_inlet_b2_sync_edge_count "Cam edges seen while cam phase is undecided (crank_sync_level < 4 and cam_phase_detected == 0); phase decided from the 2nd edge." UWORD NO_COMPU_METHOD 0 0 0 65535 ECU_ADDRESS 0x40001786 /end MEASUREMENT
/begin MEASUREMENT crank_isr_event_count "Incremented once per etpu_ch0_crank_isr call (reset in engine_sync_reset_etpu_init); low byte snapshotted by the cam ISRs." UWORD NO_COMPU_METHOD 0 0 0 65535 ECU_ADDRESS 0x40001788 /end MEASUREMENT
/begin MEASUREMENT cam_exhaust_b1_last_crank_event "crank_isr_event_count (low byte) at the previous cam edge." UBYTE NO_COMPU_METHOD 0 0 0 255 ECU_ADDRESS 0x4000178A /end MEASUREMENT
/begin MEASUREMENT cam_exhaust_b2_last_crank_event "crank_isr_event_count (low byte) at the previous cam edge." UBYTE NO_COMPU_METHOD 0 0 0 255 ECU_ADDRESS 0x4000178B /end MEASUREMENT
/begin MEASUREMENT cam_inlet_b1_last_crank_event "crank_isr_event_count (low byte) at the previous cam edge." UBYTE NO_COMPU_METHOD 0 0 0 255 ECU_ADDRESS 0x4000178C /end MEASUREMENT
/begin MEASUREMENT cam_inlet_b2_last_crank_event "crank_isr_event_count (low byte) at the previous cam edge." UBYTE NO_COMPU_METHOD 0 0 0 255 ECU_ADDRESS 0x4000178D /end MEASUREMENT
/begin MEASUREMENT cam_exhaust_b1_crank_events_since_edge "Crank ISR events since the previous cam edge; classifies the cam tooth gap (4-7 / 8-13 / 14-19) during phase detection." UBYTE NO_COMPU_METHOD 0 0 0 255 ECU_ADDRESS 0x4000178E /end MEASUREMENT
/begin MEASUREMENT cam_exhaust_b2_crank_events_since_edge "Crank ISR events since the previous cam edge; classifies the cam tooth gap (4-7 / 8-13 / 14-19) during phase detection." UBYTE NO_COMPU_METHOD 0 0 0 255 ECU_ADDRESS 0x4000178F /end MEASUREMENT
/begin MEASUREMENT cam_inlet_b1_crank_events_since_edge "Crank ISR events since the previous cam edge; classifies the cam tooth gap (4-7 / 8-13 / 14-19) during phase detection." UBYTE NO_COMPU_METHOD 0 0 0 255 ECU_ADDRESS 0x40001790 /end MEASUREMENT
/begin MEASUREMENT cam_inlet_b2_crank_events_since_edge "Crank ISR events since the previous cam edge; classifies the cam tooth gap (4-7 / 8-13 / 14-19) during phase detection." UBYTE NO_COMPU_METHOD 0 0 0 255 ECU_ADDRESS 0x40001791 /end MEASUREMENT
/begin MEASUREMENT cam_exhaust_b1_edge_status "eTPU cam channel param 4 (edge status) read at each cam edge." UBYTE NO_COMPU_METHOD 0 0 0 255 ECU_ADDRESS 0x40001792 /end MEASUREMENT
/begin MEASUREMENT cam_exhaust_b2_edge_status "eTPU cam channel param 4 (edge status) read at each cam edge." UBYTE NO_COMPU_METHOD 0 0 0 255 ECU_ADDRESS 0x40001793 /end MEASUREMENT
/begin MEASUREMENT cam_inlet_b1_edge_status "eTPU cam channel param 4 (edge status) read at each cam edge." UBYTE NO_COMPU_METHOD 0 0 0 255 ECU_ADDRESS 0x40001794 /end MEASUREMENT
/begin MEASUREMENT cam_inlet_b2_edge_status "eTPU cam channel param 4 (edge status) read at each cam edge." UBYTE NO_COMPU_METHOD 0 0 0 255 ECU_ADDRESS 0x40001795 /end MEASUREMENT
/begin MEASUREMENT cam_exhaust_b1_pattern_state "Cam tooth-gap pattern state 1..6 used to decide the engine phase (cam_phase_detected = 1 or 2 when the sequence matches)." UBYTE NO_COMPU_METHOD 0 0 0 255 ECU_ADDRESS 0x40001796 /end MEASUREMENT
/begin MEASUREMENT cam_exhaust_b2_pattern_state "Cam tooth-gap pattern state 1..6 used to decide the engine phase (cam_phase_detected = 1 or 2 when the sequence matches)." UBYTE NO_COMPU_METHOD 0 0 0 255 ECU_ADDRESS 0x40001797 /end MEASUREMENT
/begin MEASUREMENT cam_inlet_b1_pattern_state "Cam tooth-gap pattern state 1..6 used to decide the engine phase (cam_phase_detected = 1 or 2 when the sequence matches)." UBYTE NO_COMPU_METHOD 0 0 0 255 ECU_ADDRESS 0x40001798 /end MEASUREMENT
/begin MEASUREMENT cam_inlet_b2_pattern_state "Cam tooth-gap pattern state 1..6 used to decide the engine phase (cam_phase_detected = 1 or 2 when the sequence matches)." UBYTE NO_COMPU_METHOD 0 0 0 255 ECU_ADDRESS 0x40001799 /end MEASUREMENT
/begin MEASUREMENT cam_exhaust_b1_edge_polarity "eTPU cam channel param 9: edge polarity (1 = the reference edge used for position)." UBYTE NO_COMPU_METHOD 0 0 0 255 ECU_ADDRESS 0x4000179A /end MEASUREMENT
/begin MEASUREMENT cam_exhaust_b2_edge_polarity "eTPU cam channel param 9: edge polarity (1 = the reference edge used for position)." UBYTE NO_COMPU_METHOD 0 0 0 255 ECU_ADDRESS 0x4000179B /end MEASUREMENT
/begin MEASUREMENT cam_inlet_b1_edge_polarity "eTPU cam channel param 9: edge polarity (1 = the reference edge used for position)." UBYTE NO_COMPU_METHOD 0 0 0 255 ECU_ADDRESS 0x4000179C /end MEASUREMENT
/begin MEASUREMENT cam_inlet_b2_edge_polarity "eTPU cam channel param 9: edge polarity (1 = the reference edge used for position)." UBYTE NO_COMPU_METHOD 0 0 0 255 ECU_ADDRESS 0x4000179D /end MEASUREMENT
/begin MEASUREMENT cam_exhaust_b1_delta_angle "Crank angle since the previous cam edge (deg = val/10, wrapped to 0..720)." UWORD CM_u16_angle_1_10deg 0 0 0 6553.5 ECU_ADDRESS 0x4000179E /end MEASUREMENT
/begin MEASUREMENT cam_exhaust_b2_delta_angle "Crank angle since the previous cam edge (deg = val/10, wrapped to 0..720)." UWORD CM_u16_angle_1_10deg 0 0 0 6553.5 ECU_ADDRESS 0x400017A0 /end MEASUREMENT
/begin MEASUREMENT cam_inlet_b1_delta_angle "Crank angle since the previous cam edge (deg = val/10, wrapped to 0..720)." UWORD CM_u16_angle_1_10deg 0 0 0 6553.5 ECU_ADDRESS 0x400017A2 /end MEASUREMENT
/begin MEASUREMENT cam_inlet_b2_delta_angle "Crank angle since the previous cam edge (deg = val/10, wrapped to 0..720)." UWORD CM_u16_angle_1_10deg 0 0 0 6553.5 ECU_ADDRESS 0x400017A4 /end MEASUREMENT
/begin MEASUREMENT cam_exhaust_b1_ref_edge_angle "Raw eTPU angle at the last reference edge used for the cam position (deg = val/10)." UWORD CM_u16_angle_1_10deg 0 0 0 6553.5 ECU_ADDRESS 0x400017A6 /end MEASUREMENT
/begin MEASUREMENT cam_exhaust_b2_ref_edge_angle "Raw eTPU angle at the last reference edge used for the cam position (deg = val/10)." UWORD CM_u16_angle_1_10deg 0 0 0 6553.5 ECU_ADDRESS 0x400017A8 /end MEASUREMENT
/begin MEASUREMENT cam_inlet_b1_ref_edge_angle "Raw eTPU angle at the last reference edge used for the cam position (deg = val/10)." UWORD CM_u16_angle_1_10deg 0 0 0 6553.5 ECU_ADDRESS 0x400017AA /end MEASUREMENT
/begin MEASUREMENT cam_inlet_b2_ref_edge_angle "Raw eTPU angle at the last reference edge used for the cam position (deg = val/10)." UWORD CM_u16_angle_1_10deg 0 0 0 6553.5 ECU_ADDRESS 0x400017AC /end MEASUREMENT
/begin MEASUREMENT cam_exhaust_b1_last_angle "eTPU crank angle (TCR2, 7200/cycle) at the previous cam edge (deg = val/10)." UWORD CM_u16_angle_1_10deg 0 0 0 6553.5 ECU_ADDRESS 0x400017AE /end MEASUREMENT
/begin MEASUREMENT cam_exhaust_b2_last_angle "eTPU crank angle (TCR2, 7200/cycle) at the previous cam edge (deg = val/10)." UWORD CM_u16_angle_1_10deg 0 0 0 6553.5 ECU_ADDRESS 0x400017B0 /end MEASUREMENT
/begin MEASUREMENT cam_inlet_b1_last_angle "eTPU crank angle (TCR2, 7200/cycle) at the previous cam edge (deg = val/10)." UWORD CM_u16_angle_1_10deg 0 0 0 6553.5 ECU_ADDRESS 0x400017B2 /end MEASUREMENT
/begin MEASUREMENT cam_inlet_b2_last_angle "eTPU crank angle (TCR2, 7200/cycle) at the previous cam edge (deg = val/10)." UWORD CM_u16_angle_1_10deg 0 0 0 6553.5 ECU_ADDRESS 0x400017B4 /end MEASUREMENT
/begin MEASUREMENT cam_exhaust_b1_last_time "eTPU timestamp of the previous cam edge (24-bit)." ULONG CM_u32_time_100ns 0 0 0 429496729500 ECU_ADDRESS 0x400017B8 /end MEASUREMENT
/begin MEASUREMENT cam_exhaust_b2_last_time "eTPU timestamp of the previous cam edge (24-bit)." ULONG CM_u32_time_100ns 0 0 0 429496729500 ECU_ADDRESS 0x400017BC /end MEASUREMENT
/begin MEASUREMENT cam_inlet_b1_last_time "eTPU timestamp of the previous cam edge (24-bit)." ULONG CM_u32_time_100ns 0 0 0 429496729500 ECU_ADDRESS 0x400017C0 /end MEASUREMENT
/begin MEASUREMENT cam_inlet_b2_last_time "eTPU timestamp of the previous cam edge (24-bit)." ULONG CM_u32_time_100ns 0 0 0 429496729500 ECU_ADDRESS 0x400017C4 /end MEASUREMENT
/begin MEASUREMENT cam_exhaust_b1_delta_time "Time between the last two cam edges (eTPU 24-bit timestamp delta)." ULONG CM_u32_time_100ns 0 0 0 429496729500 ECU_ADDRESS 0x400017C8 /end MEASUREMENT
/begin MEASUREMENT cam_exhaust_b2_delta_time "Time between the last two cam edges (eTPU 24-bit timestamp delta)." ULONG CM_u32_time_100ns 0 0 0 429496729500 ECU_ADDRESS 0x400017CC /end MEASUREMENT
/begin MEASUREMENT cam_inlet_b1_delta_time "Time between the last two cam edges (eTPU 24-bit timestamp delta)." ULONG CM_u32_time_100ns 0 0 0 429496729500 ECU_ADDRESS 0x400017D0 /end MEASUREMENT
/begin MEASUREMENT cam_inlet_b2_delta_time "Time between the last two cam edges (eTPU 24-bit timestamp delta)." ULONG CM_u32_time_100ns 0 0 0 429496729500 ECU_ADDRESS 0x400017D4 /end MEASUREMENT
/begin MEASUREMENT crank_sync_state "0 = not synced, 1 = crank/cam synced (set in etpu_ch0_crank_isr). Gates spark/injection scheduling. Was engine_running_state." UBYTE NO_COMPU_METHOD 0 0 0 255 ECU_ADDRESS 0x400017D8 /end MEASUREMENT
/begin MEASUREMENT cam_phase_detected "Engine phase decided from the cam tooth pattern: 0 undecided, 1 or 2 = phase written to the eTPU crank channel." UBYTE NO_COMPU_METHOD 0 0 0 255 ECU_ADDRESS 0x400017D9 /end MEASUREMENT
/begin MEASUREMENT crank_sync_level "eTPU crank channel sync state (etpu_sdm_read_u8(1)): < 2 lost, 3 partial, 4 = full sync (sets crank_sync_state)." UBYTE NO_COMPU_METHOD 0 0 0 255 ECU_ADDRESS 0x400017DA /end MEASUREMENT
/begin MEASUREMENT crank_etpu_status "eTPU crank channel status byte (etpu_sdm_read_u8(0)); < 2 forces a sync reset." UBYTE NO_COMPU_METHOD 0 0 0 255 ECU_ADDRESS 0x400017DB /end MEASUREMENT
/begin MEASUREMENT crank_tooth_counter "eTPU crank tooth counter (param 0x2d), ~0..71 per 720 deg engine cycle." UWORD NO_COMPU_METHOD 0 0 0 65535 ECU_ADDRESS 0x400017DC /end MEASUREMENT
/begin MEASUREMENT crank_etpu_param_3d "eTPU crank channel parameter 0x3d." ULONG NO_COMPU_METHOD 0 0 0 4294967295 ECU_ADDRESS 0x400017E0 /end MEASUREMENT
/begin MEASUREMENT crank_etpu_param_35 "eTPU crank channel parameter 0x35." ULONG NO_COMPU_METHOD 0 0 0 4294967295 ECU_ADDRESS 0x400017E4 /end MEASUREMENT
/begin MEASUREMENT crank_time_per_0p1deg_ns "eTPU crank param 0x31: time per 0.1 crank deg in ns (init 1666667 = 10 rpm). dwell_angle = dwell_us*1000/this. Was eTPU_crank_angle_speed_scaling." ULONG CM_u32_time_ns 0 0 0 4294967295 ECU_ADDRESS 0x400017E8 /end MEASUREMENT
/begin MEASUREMENT knock_window_irq_count "u8_count" UBYTE NO_COMPU_METHOD 0 0 0 255 ECU_ADDRESS 0x400017EC /end MEASUREMENT
/begin MEASUREMENT maf_map_isr_count "sensor_interrupt_maf_map call counter." UBYTE NO_COMPU_METHOD 0 0 0 255 ECU_ADDRESS 0x400017ED /end MEASUREMENT
/begin MEASUREMENT ign_isr_cyl6_count "ign_isr_cylinder6 call counter. Was cyl_fire_counter_unknown." UBYTE NO_COMPU_METHOD 0 0 0 255 ECU_ADDRESS 0x400017EE /end MEASUREMENT
/begin MEASUREMENT ign_isr_cyl5_count "ign_isr_cylinder5 call counter." UBYTE NO_COMPU_METHOD 0 0 0 255 ECU_ADDRESS 0x400017EF /end MEASUREMENT
/begin MEASUREMENT ign_isr_cyl4_count "ign_isr_cylinder4 call counter." UBYTE NO_COMPU_METHOD 0 0 0 255 ECU_ADDRESS 0x400017F0 /end MEASUREMENT
/begin MEASUREMENT ign_isr_cyl3_count "ign_isr_cylinder3 call counter." UBYTE NO_COMPU_METHOD 0 0 0 255 ECU_ADDRESS 0x400017F1 /end MEASUREMENT
/begin MEASUREMENT ign_isr_cyl2_count "ign_isr_cylinder2 call counter." UBYTE NO_COMPU_METHOD 0 0 0 255 ECU_ADDRESS 0x400017F2 /end MEASUREMENT
/begin MEASUREMENT ign_isr_cyl1_count "ign_isr_cylinder1 call counter." UBYTE NO_COMPU_METHOD 0 0 0 255 ECU_ADDRESS 0x400017F3 /end MEASUREMENT
/begin MEASUREMENT cam_sync_pulse_count "u8_count" UBYTE NO_COMPU_METHOD 0 0 0 255 ECU_ADDRESS 0x400017F4 /end MEASUREMENT
/begin MEASUREMENT etb_driver_diag_byte "Last ETB H-bridge diagnostic byte read over DSPI-C." UBYTE NO_COMPU_METHOD 0 0 0 255 ECU_ADDRESS 0x40001808 /end MEASUREMENT
/begin MEASUREMENT etb_driver_diag_state "ETB driver diag read state machine (0 send cmd, 1 read)." UBYTE NO_COMPU_METHOD 0 0 0 255 ECU_ADDRESS 0x40001809 /end MEASUREMENT
/begin MEASUREMENT diag_base_ptr "Base pointer set by diag_set_base_ptr, used by the channel logger." ULONG NO_COMPU_METHOD 0 0 0 4294967295 ECU_ADDRESS 0x40001810 /end MEASUREMENT
/begin MEASUREMENT emios_etb_pwm_isr_count "ETB PWM eMIOS ISR counter." UBYTE NO_COMPU_METHOD 0 0 0 255 ECU_ADDRESS 0x40001818 /end MEASUREMENT
/begin MEASUREMENT ac_compressor_speed_pulse_seen "uint8_t" UBYTE NO_COMPU_METHOD 0 0 0 255 ECU_ADDRESS 0x40001819 /end MEASUREMENT
/begin MEASUREMENT nonabs_wheel_speed_pulse_seen "Set by the wheel-speed eMIOS ISR, cleared by the 333 ms watchdog (no pulse -> period = 0xffffffff)." UBYTE NO_COMPU_METHOD 0 0 0 255 ECU_ADDRESS 0x4000181A /end MEASUREMENT
/begin MEASUREMENT ac_compressor_speed_period_us "u32_time_us" ULONG CM_u8_time_us 0 0 0 4294967295 ECU_ADDRESS 0x4000181C /end MEASUREMENT
/begin MEASUREMENT nonabs_wheel_speed_period_ticks "uint32_t" ULONG NO_COMPU_METHOD 0 0 0 4294967295 ECU_ADDRESS 0x40001820 /end MEASUREMENT
/begin MEASUREMENT obd_ii_relay_status "Relay driver output bits written via relay_driver_write (bit4 starter, bit7 ...)." UBYTE NO_COMPU_METHOD 0 0 0 255 ECU_ADDRESS 0x40001824 /end MEASUREMENT
/begin MEASUREMENT evap_pressure_filter_q8 "IIR accumulator (<<8) for the evap pressure low-pass (CAL_evap_pressure_filter_coeff)." SLONG NO_COMPU_METHOD 0 0 -2147483648 2147483647 ECU_ADDRESS 0x40001828 /end MEASUREMENT
/begin MEASUREMENT fuel_level_filtered_x40000 "Filtered fuel level x40000 (fuel_level_lookup_filtered)." ULONG NO_COMPU_METHOD 0 0 0 4294967295 ECU_ADDRESS 0x4000182C /end MEASUREMENT
/begin MEASUREMENT coolant_temp_sensor_voltage "Coolant temperature sensor voltage (V = val*5/1023)." UWORD CM_u16_voltage_5_1023v 0 0 0 320.307917888563 ECU_ADDRESS 0x40001830 /end MEASUREMENT
/begin MEASUREMENT ac_evap_temp_voltage "A/C evaporative temperature voltage (V = val*5/1023)." UWORD CM_u16_voltage_5_1023v 0 0 0 320.307917888563 ECU_ADDRESS 0x40001832 /end MEASUREMENT
/begin MEASUREMENT sensor_adc_engine_air_voltage "Sensor ADC engine air voltage (V = val*5/1023)." UWORD CM_u16_voltage_5_1023v 0 0 0 320.307917888563 ECU_ADDRESS 0x40001834 /end MEASUREMENT
/begin MEASUREMENT coolant_temp "Coolant temperature (°C = val*5/8−40)." UBYTE CM_u8_temp_5_8_40c 0 0 -40 119.375 ECU_ADDRESS 0x40001836 /end MEASUREMENT
/begin MEASUREMENT obd_ii_ac_evap_temp "OBD-II: A/C evaporative temperature (°C = val/10)." UWORD CM_u8_temp_1_10C 0 0 0 6553.5 ECU_ADDRESS 0x40001838 /end MEASUREMENT
/begin MEASUREMENT temp_engine_air "Temperature engine air (°C = val*5/8−40)." UBYTE CM_u8_temp_5_8_40c 0 0 -40 119.375 ECU_ADDRESS 0x4000183A /end MEASUREMENT
/begin MEASUREMENT iat "Intake air temp (°C = val*5/8−40)." UWORD CM_u8_temp_5_8_40c 0 0 -40 40919.375 ECU_ADDRESS 0x4000183C /end MEASUREMENT
/begin MEASUREMENT coolant_temp_raw "Coolant temperature (°C = val*5/8−40)." UWORD CM_u8_temp_5_8_40c 0 0 -40 40919.375 ECU_ADDRESS 0x4000183E /end MEASUREMENT
/begin MEASUREMENT ac_evap_temp "A/C evaporator temperature (raw - 400)." SWORD NO_COMPU_METHOD 0 0 -32768 32767 ECU_ADDRESS 0x40001840 /end MEASUREMENT
/begin MEASUREMENT atmo_baro_sensor_voltage "Barometric pressure sensor voltage (ADC, 5 V = 1023)." UWORD CM_u16_voltage_5_1023v 0 0 0 320.307917888563 ECU_ADDRESS 0x40001842 /end MEASUREMENT
/begin MEASUREMENT obd_ii_atmospheric_baro "OBD-II: atmospheric baro (mbar)." UWORD CM_i16_pressure_mbar 0 0 0 65535 ECU_ADDRESS 0x40001844 /end MEASUREMENT
/begin MEASUREMENT tps_8bit "Tps2 (val/255)." UBYTE CM_u8_factor_1_255 0 0 0 100 ECU_ADDRESS 0x40001846 /end MEASUREMENT
/begin MEASUREMENT fuel_level_raw "Fuel level." UBYTE NO_COMPU_METHOD 0 0 0 255 ECU_ADDRESS 0x40001847 /end MEASUREMENT
/begin MEASUREMENT obd_ii_evap_purge_pressure "Evap purge/tank pressure (signed)." SWORD NO_COMPU_METHOD 0 0 -32768 32767 ECU_ADDRESS 0x40001848 /end MEASUREMENT
/begin MEASUREMENT obd_ii_o2_sensor1_voltage "OBD-II: O2 sensor1 voltage (V = val*5/1023)." UWORD CM_u16_voltage_5_1023v 0 0 0 320.307917888563 ECU_ADDRESS 0x4000184A /end MEASUREMENT
/begin MEASUREMENT obd_ii_o2_sensor5_voltage "OBD-II: O2 sensor5 voltage (V = val*5/1023)." UWORD CM_u16_voltage_5_1023v 0 0 0 320.307917888563 ECU_ADDRESS 0x4000184C /end MEASUREMENT
/begin MEASUREMENT obd_ii_o2_sensor2_voltage "OBD-II: O2 sensor2 voltage (V = val*5/1023)." UWORD CM_u16_voltage_5_1023v 0 0 0 320.307917888563 ECU_ADDRESS 0x4000184E /end MEASUREMENT
/begin MEASUREMENT obd_ii_o2_sensor6_voltage "OBD-II: O2 sensor6 voltage (V = val*5/1023)." UWORD CM_u16_voltage_5_1023v 0 0 0 320.307917888563 ECU_ADDRESS 0x40001850 /end MEASUREMENT
/begin MEASUREMENT ignition_on_flags "uint16_t" UWORD NO_COMPU_METHOD 0 0 0 65535 ECU_ADDRESS 0x40001852 /end MEASUREMENT
/begin MEASUREMENT sensor_adc_ecu_voltage "Sensor ADC ECU voltage (V = val*18/1023)." UWORD CM_u16_voltage_18_1023v 0 0 0 1153.10850439883 ECU_ADDRESS 0x40001854 /end MEASUREMENT
/begin MEASUREMENT evap_purge_pressure_voltage "EVAP purge/tank pressure sensor voltage (ADC, 5 V = 1023)." UWORD CM_u16_voltage_5_1023v 0 0 0 320.307917888563 ECU_ADDRESS 0x40001856 /end MEASUREMENT
/begin MEASUREMENT clutch_pos_voltage "Clutch position voltage (V = val*5/1023)." UWORD CM_u16_voltage_5_1023v 0 0 0 320.307917888563 ECU_ADDRESS 0x40001858 /end MEASUREMENT
/begin MEASUREMENT clutch_pos_voltage_filtered "u16_voltage_5/1023v" UWORD CM_u16_voltage_5_1023v 0 0 0 320.307917888563 ECU_ADDRESS 0x4000185A /end MEASUREMENT
/begin MEASUREMENT fuel_level_voltage "Fuel level voltage (V = val*5/1023)." UWORD CM_u16_voltage_5_1023v 0 0 0 320.307917888563 ECU_ADDRESS 0x4000185C /end MEASUREMENT
/begin MEASUREMENT o2_sensor1_heater_current_scaled "O2 sensor1 heater current scaled (mA)." UWORD CM_u16_current_mA 0 0 0 65535 ECU_ADDRESS 0x4000185E /end MEASUREMENT
/begin MEASUREMENT o2_sensor2_heater_current_scaled "O2 sensor2 heater current scaled (mA)." UWORD CM_u16_current_mA 0 0 0 65535 ECU_ADDRESS 0x40001860 /end MEASUREMENT
/begin MEASUREMENT o2_sensor5_heater_current_scaled "O2 sensor5 heater current scaled (mA)." UWORD CM_u16_current_mA 0 0 0 65535 ECU_ADDRESS 0x40001862 /end MEASUREMENT
/begin MEASUREMENT o2_sensor6_heater_current_scaled "O2 sensor6 heater current scaled (mA)." UWORD CM_u16_current_mA 0 0 0 65535 ECU_ADDRESS 0x40001864 /end MEASUREMENT
/begin MEASUREMENT intake_air_sensor_voltage "Intake air sensor voltage (V = val*5/1023)." UWORD CM_u16_voltage_5_1023v 0 0 0 320.307917888563 ECU_ADDRESS 0x40001866 /end MEASUREMENT
/begin MEASUREMENT obd_ii_manifold_temp "OBD-II: manifold temperature (°C = val*5/8−40)." UBYTE CM_u8_temp_5_8_40c 0 0 -40 119.375 ECU_ADDRESS 0x40001868 /end MEASUREMENT
/begin MEASUREMENT chargecooler_temp_div_160 "Chargecooler temperature div 160." UWORD NO_COMPU_METHOD 0 0 0 65535 ECU_ADDRESS 0x4000186A /end MEASUREMENT
/begin MEASUREMENT sensor_temp_unk1_diag "Lookup result of CAL_sensor_aux_temp." UBYTE NO_COMPU_METHOD 0 0 0 255 ECU_ADDRESS 0x4000186C /end MEASUREMENT
/begin MEASUREMENT sensor_temp_unk2_diag "Lookup result of CAL_sensor_aux_temp." UBYTE NO_COMPU_METHOD 0 0 0 255 ECU_ADDRESS 0x4000186D /end MEASUREMENT
/begin MEASUREMENT adc_ch35_voltage "ADC DMA channel 0x35 sample (>>4)." UWORD CM_u16_voltage_5_1023v 0 0 0 320.307917888563 ECU_ADDRESS 0x4000186E /end MEASUREMENT
/begin MEASUREMENT load_mass_per_stroke_filter_q8 "X-tau (fuel-film) filtered load accumulator (<<8); >>8 gives load_mass_per_stroke_raw. Was load_filtered1." SLONG NO_COMPU_METHOD 0 0 -2147483648 2147483647 ECU_ADDRESS 0x40001870 /end MEASUREMENT
/begin MEASUREMENT load_filtered_slow_q8 "Slow IIR (255/256) of load_selected_raw, accumulator (<<8); >>8 gives load_filtered_slow. Was load_filtered_slow_accum." SLONG NO_COMPU_METHOD 0 0 -2147483648 2147483647 ECU_ADDRESS 0x40001874 /end MEASUREMENT
/begin MEASUREMENT load_maf_diag "u16_load_mg/stroke" UWORD CM_u8_load_mg_stroke 0 0 0 65535 ECU_ADDRESS 0x40001878 /end MEASUREMENT
/begin MEASUREMENT load_measured_maf_filtered "Load smoothed MAF (mg/stroke)." UWORD CM_u8_load_mg_stroke 0 0 0 65535 ECU_ADDRESS 0x4000187A /end MEASUREMENT
/begin MEASUREMENT map_voltage "MAP voltage (V = val*5/1023)." UWORD CM_u16_voltage_5_1023v 0 0 0 320.307917888563 ECU_ADDRESS 0x4000187C /end MEASUREMENT
/begin MEASUREMENT map "MAP (mbar)." UWORD CM_i16_pressure_mbar 0 0 0 65535 ECU_ADDRESS 0x4000187E /end MEASUREMENT
/begin MEASUREMENT obd_ii_manifold_pressure "OBD-II: manifold pressure (mbar)." UWORD CM_i16_pressure_mbar 0 0 0 65535 ECU_ADDRESS 0x40001880 /end MEASUREMENT
/begin MEASUREMENT map_filtered "IIR-filtered obd_ii_manifold_pressure (CAL_sensor_map_filter_alpha) (mbar). Used by P0106/P1109 engine-off and agreement checks." UWORD CM_i16_pressure_mbar 0 0 0 65535 ECU_ADDRESS 0x40001882 /end MEASUREMENT
/begin MEASUREMENT evap_purge_pressure_zero_offset "Learned evap pressure zero offset subtracted in adc_convert." SWORD NO_COMPU_METHOD 0 0 -32768 32767 ECU_ADDRESS 0x40001884 /end MEASUREMENT
/begin MEASUREMENT o2_sensor1_heater_overcurrent "1 = sensor-1 heater (gpdo 0x60) cut for over-current; cleared when the retry timer expires." UBYTE NO_COMPU_METHOD 0 0 0 255 ECU_ADDRESS 0x40001886 /end MEASUREMENT
/begin MEASUREMENT o2_sensor2_heater_overcurrent "1 = sensor-2 heater (gpdo 0x62) cut for over-current." UBYTE NO_COMPU_METHOD 0 0 0 255 ECU_ADDRESS 0x40001887 /end MEASUREMENT
/begin MEASUREMENT o2_sensor5_heater_overcurrent "1 = sensor-5 heater (gpdo 99) cut for over-current." UBYTE NO_COMPU_METHOD 0 0 0 255 ECU_ADDRESS 0x40001888 /end MEASUREMENT
/begin MEASUREMENT o2_sensor6_heater_overcurrent "1 = sensor-6 heater (gpdo 100) cut for over-current." UBYTE NO_COMPU_METHOD 0 0 0 255 ECU_ADDRESS 0x40001889 /end MEASUREMENT
/begin MEASUREMENT sport_button_pressed "Sport button pressed (boolean flag)." UBYTE NO_COMPU_METHOD 0 0 0 255 ECU_ADDRESS 0x4000188A /end MEASUREMENT
/begin MEASUREMENT race_button_state "Race button state (boolean flag)." UBYTE NO_COMPU_METHOD 0 0 0 255 ECU_ADDRESS 0x4000188B /end MEASUREMENT
/begin MEASUREMENT starter_request_active "bool" UBYTE NO_COMPU_METHOD 0 0 0 255 ECU_ADDRESS 0x4000188C /end MEASUREMENT
/begin MEASUREMENT lat_accel "Lateral acceleration, filtered imu_accel_lat (g = val/100)." SWORD CM_u8_accel_1_100g 0 0 -327.68 327.67 ECU_ADDRESS 0x4000188E /end MEASUREMENT
/begin MEASUREMENT vehicle_mode "Vehicle mode (enumerated state)." UBYTE NO_COMPU_METHOD 0 0 0 255 ECU_ADDRESS 0x40001890 /end MEASUREMENT
/begin MEASUREMENT vehicle_mode_flags "Vehicle mode flags." UWORD NO_COMPU_METHOD 0 0 0 65535 ECU_ADDRESS 0x40001892 /end MEASUREMENT
/begin MEASUREMENT oil_pressure_switch_raw "Oil pressure switch/sensor raw (0x7fff when invalid)." SWORD NO_COMPU_METHOD 0 0 -32768 32767 ECU_ADDRESS 0x40001894 /end MEASUREMENT
/begin MEASUREMENT lookup_last_index "Last bracket index used by lookup_2D_uint8_fixed." UBYTE NO_COMPU_METHOD 0 0 0 255 ECU_ADDRESS 0x40001896 /end MEASUREMENT
/begin MEASUREMENT iat_filter_q2560 "Engine air temp filter accumulator (x0xa00); temp_engine_air = this/0xa00. Was iat2." ULONG NO_COMPU_METHOD 0 0 0 4294967295 ECU_ADDRESS 0x40001898 /end MEASUREMENT
/begin MEASUREMENT trans_fluid_temp_filter_q8 "Trans fluid temp IIR accumulator (<<8). Was trans_fluid_temp_u32." ULONG NO_COMPU_METHOD 0 0 0 4294967295 ECU_ADDRESS 0x4000189C /end MEASUREMENT
/begin MEASUREMENT coolant_temp_filter1_q2560 "Coolant temp filter stage 1 accumulator (x0xa00). Was coolant_temp_derived1." ULONG NO_COMPU_METHOD 0 0 0 4294967295 ECU_ADDRESS 0x400018A0 /end MEASUREMENT
/begin MEASUREMENT coolant_temp_filter2_q2560 "Coolant temp filter stage 2 accumulator (x0xa00); /0xa00 -> coolant_temp_derived3. Was coolant_temp_derived2." ULONG NO_COMPU_METHOD 0 0 0 4294967295 ECU_ADDRESS 0x400018A4 /end MEASUREMENT
/begin MEASUREMENT ac_evap_temp_filter_q8 "A/C evaporator temp IIR accumulator (<<8). Was ac_evap_temp_raw." SLONG NO_COMPU_METHOD 0 0 -2147483648 2147483647 ECU_ADDRESS 0x400018A8 /end MEASUREMENT
/begin MEASUREMENT chargecooler_temp_filter_q2560 "Charge-cooler / manifold temp filter accumulator (x0xa00); /0xa00 -> obd_ii_manifold_temp. Was chargecooler_temp2." ULONG NO_COMPU_METHOD 0 0 0 4294967295 ECU_ADDRESS 0x400018AC /end MEASUREMENT
/begin MEASUREMENT fuel_pressure_abs_filter_q8 "Fuel pressure IIR accumulator (<<8). Was fuel_pressure_abs_scaled." ULONG NO_COMPU_METHOD 0 0 0 4294967295 ECU_ADDRESS 0x400018B0 /end MEASUREMENT
/begin MEASUREMENT map_filter_q8 "MAP IIR accumulator (<<8); >>8 gives map_filtered. Was intake_manifold_pressure2." ULONG NO_COMPU_METHOD 0 0 0 4294967295 ECU_ADDRESS 0x400018B4 /end MEASUREMENT
/begin MEASUREMENT clutch_pos_voltage_filter_q8 "uint32_t" ULONG NO_COMPU_METHOD 0 0 0 4294967295 ECU_ADDRESS 0x400018B8 /end MEASUREMENT
/begin MEASUREMENT o2_sensor1_heater_current "O2 sensor1 heater current (V = val*5/1023)." UWORD CM_u16_voltage_5_1023v 0 0 0 320.307917888563 ECU_ADDRESS 0x400018BC /end MEASUREMENT
/begin MEASUREMENT o2_sensor2_heater_current "O2 sensor2 heater current (V = val*5/1023)." UWORD CM_u16_voltage_5_1023v 0 0 0 320.307917888563 ECU_ADDRESS 0x400018BE /end MEASUREMENT
/begin MEASUREMENT o2_sensor5_heater_current "O2 sensor5 heater current (V = val*5/1023)." UWORD CM_u16_voltage_5_1023v 0 0 0 320.307917888563 ECU_ADDRESS 0x400018C0 /end MEASUREMENT
/begin MEASUREMENT o2_sensor6_heater_current "O2 sensor6 heater current (V = val*5/1023)." UWORD CM_u16_voltage_5_1023v 0 0 0 320.307917888563 ECU_ADDRESS 0x400018C2 /end MEASUREMENT
/begin MEASUREMENT fuel_level_update_holdoff_counter "uint16_t" UWORD NO_COMPU_METHOD 0 0 0 65535 ECU_ADDRESS 0x400018C4 /end MEASUREMENT
/begin MEASUREMENT lat_accel_last "Lateral accel low-pass filter state (= lat_accel << 8; g = val/25600)." SLONG CM_i32_accel_1_25600g 0 0 -83886.08 83886.0799609375 ECU_ADDRESS 0x400018C8 /end MEASUREMENT
/begin MEASUREMENT driver_input_hold_timer "Driver-input hold countdown (reload 25 = 250 ms)." UBYTE CM_u8_time_10ms 0 0 0 2550 ECU_ADDRESS 0x400018CC /end MEASUREMENT
/begin MEASUREMENT abs_a8_flag2_previous_state "uint8_t" UBYTE NO_COMPU_METHOD 0 0 0 255 ECU_ADDRESS 0x400018CD /end MEASUREMENT
/begin MEASUREMENT driver_input_debounce_timer "Driver input debounce timer (ms = val*10)." UWORD CM_u8_time_10ms 0 0 0 655350 ECU_ADDRESS 0x400018CE /end MEASUREMENT
/begin MEASUREMENT driver_input_mode_timer "Driver-input mode countdown." UBYTE CM_u8_time_10ms 0 0 0 2550 ECU_ADDRESS 0x400018D0 /end MEASUREMENT
/begin MEASUREMENT sport_button_press_count "Sport button press duration counter (100 Hz, saturating); > 20 = long press. Was sport_button_press_timer_unknown1." UBYTE NO_COMPU_METHOD 0 0 0 255 ECU_ADDRESS 0x400018D1 /end MEASUREMENT
/begin MEASUREMENT sport_button_release_time "Time since sport button release (100 Hz, saturating)." UWORD CM_u8_time_10ms 0 0 0 655350 ECU_ADDRESS 0x400018D2 /end MEASUREMENT
/begin MEASUREMENT race_button_press_count "Race button press duration counter (100 Hz, saturating); > 20 = long press. Was race_button_press_timer_unknown1." UBYTE NO_COMPU_METHOD 0 0 0 255 ECU_ADDRESS 0x400018D4 /end MEASUREMENT
/begin MEASUREMENT race_button_release_time "Time since race button release (100 Hz, saturating)." UWORD CM_u8_time_10ms 0 0 0 655350 ECU_ADDRESS 0x400018D6 /end MEASUREMENT
/begin MEASUREMENT vehicle_mode_button_register "bit0 sport button, bit1 race button pending press." UBYTE NO_COMPU_METHOD 0 0 0 255 ECU_ADDRESS 0x400018D8 /end MEASUREMENT
/begin MEASUREMENT vehicle_mode_change_holdoff "Countdown after a drive-mode change." UBYTE CM_u8_time_10ms 0 0 0 2550 ECU_ADDRESS 0x400018D9 /end MEASUREMENT
/begin MEASUREMENT vehicle_mode_timer_unknown3 "Vehicle mode timer unknown3 (ms = val*10)." UBYTE CM_u8_time_10ms 0 0 0 2550 ECU_ADDRESS 0x400018DA /end MEASUREMENT
/begin MEASUREMENT start_input_hold_timer "u8_time_10ms" UBYTE CM_u8_time_10ms 0 0 0 2550 ECU_ADDRESS 0x400018DB /end MEASUREMENT
/begin MEASUREMENT start_input_debounced "bool" UBYTE NO_COMPU_METHOD 0 0 0 255 ECU_ADDRESS 0x400018DC /end MEASUREMENT
/begin MEASUREMENT sqrt_iteration_count "Iteration counter in sqrt_integer. Was _tmp_val1." UWORD NO_COMPU_METHOD 0 0 0 65535 ECU_ADDRESS 0x400018DE /end MEASUREMENT
/begin MEASUREMENT sqrt_input "Input copy in sqrt_integer. Was _tmp_val2." ULONG NO_COMPU_METHOD 0 0 0 4294967295 ECU_ADDRESS 0x400018E0 /end MEASUREMENT
/begin MEASUREMENT fuel_pressure_atmo_relative "Fuel pressure atmo relative (mbar)." UWORD CM_i16_pressure_mbar 0 0 0 65535 ECU_ADDRESS 0x400018E6 /end MEASUREMENT
/begin MEASUREMENT fuel_pressure_abs2 "Fuel pressure abs2 (mbar)." UWORD CM_i16_pressure_mbar 0 0 0 65535 ECU_ADDRESS 0x400018E8 /end MEASUREMENT
/begin MEASUREMENT fuel_pressure_voltage "Fuel pressure voltage (V = val*5/1023)." UWORD CM_u16_voltage_5_1023v 0 0 0 320.307917888563 ECU_ADDRESS 0x400018EA /end MEASUREMENT
/begin MEASUREMENT fuel_pressure_abs "Fuel pressure ABS (mbar)." UWORD CM_i16_pressure_mbar 0 0 0 65535 ECU_ADDRESS 0x400018EC /end MEASUREMENT
/begin MEASUREMENT oil_pressure_sensor_voltage_raw "Oil pressure sensor voltage (V = val*5/1023)." UWORD CM_u16_voltage_5_1023v 0 0 0 320.307917888563 ECU_ADDRESS 0x400018EE /end MEASUREMENT
/begin MEASUREMENT adc_sample_status "Cleared in adc_sample." ULONG NO_COMPU_METHOD 0 0 0 4294967295 ECU_ADDRESS 0x400018F0 /end MEASUREMENT
/begin MEASUREMENT sensor_adc_ign_voltage "Cleared in adc_sample." ULONG NO_COMPU_METHOD 0 0 0 4294967295 ECU_ADDRESS 0x400018F2 /end MEASUREMENT
/begin MEASUREMENT sensor_aux_temp2_raw "Aux temperature sensor 2 ADC (>>2 into CAL_sensor_aux_temp). Was sensor_temp_unk2_raw." UWORD NO_COMPU_METHOD 0 0 0 65535 ECU_ADDRESS 0x400018F4 /end MEASUREMENT
/begin MEASUREMENT sensor_aux_temp1_raw "Aux temperature sensor 1 ADC (>>2 into CAL_sensor_aux_temp). Was sensor_temp_unk1_raw." UWORD NO_COMPU_METHOD 0 0 0 65535 ECU_ADDRESS 0x400018F6 /end MEASUREMENT
/begin MEASUREMENT trans_fluid_temp_u8 "Transmission fluid temperature (°C = val*5/8−40)." UBYTE CM_u8_temp_5_8_40c 0 0 -40 119.375 ECU_ADDRESS 0x400018F8 /end MEASUREMENT
/begin MEASUREMENT trans_fluid_temp_raw "Transmission fluid temperature (°C = val*5/8−40)." UBYTE CM_u8_temp_5_8_40c 0 0 -40 119.375 ECU_ADDRESS 0x400018F9 /end MEASUREMENT
/begin MEASUREMENT trans_temp_voltage "Transmission temperature voltage (V = val*5/1023)." UWORD CM_u16_voltage_5_1023v 0 0 0 320.307917888563 ECU_ADDRESS 0x400018FA /end MEASUREMENT
/begin MEASUREMENT ign_base_limited "ign_base clipped to ign_adv_max_low_gear; base for normal/startup modes (deg = val/4). Was ign_adv_target1." SWORD CM_u8_angle_1_4deg 0 0 -8192 8191.75 ECU_ADDRESS 0x40001900 /end MEASUREMENT
/begin MEASUREMENT ign_base "Ignition base (° = val/4)." SWORD CM_u8_angle_1_4deg 0 0 -8192 8191.75 ECU_ADDRESS 0x40001902 /end MEASUREMENT
/begin MEASUREMENT ign_knock_safe "Ignition knock safe (° = val/4)." SWORD CM_u8_angle_1_4deg 0 0 -8192 8191.75 ECU_ADDRESS 0x40001904 /end MEASUREMENT
/begin MEASUREMENT ign_adv_target_rate_limited "ign_adv_target slewed by ignition_retard_and_recovery_200hz (step_advance/step_retard every 10 ticks = 50 ms); bypassed while torque_limit_source_flags&0x3f (deg = val/4). Was ign_target_rate_limited." SWORD CM_u8_angle_1_4deg 0 0 -8192 8191.75 ECU_ADDRESS 0x40001906 /end MEASUREMENT
/begin MEASUREMENT ign_adv_target "Ignition adv target (° = val/4)." SWORD CM_u8_angle_1_4deg 0 0 -8192 8191.75 ECU_ADDRESS 0x40001908 /end MEASUREMENT
/begin MEASUREMENT ign_dwell_time "Ignition dwell time (µs)." UWORD CM_u8_time_us 0 0 0 65535 ECU_ADDRESS 0x4000190A /end MEASUREMENT
/begin MEASUREMENT ign_comp_normal_total "Sum of normal-mode comps: driveaway + manifold temp + over-temp + test trim - tps-rate retard (+ startup base scaling) (deg = val/4). Also used by torque_model. Was ign_comp_rpm_accel." SWORD CM_u8_angle_1_4deg 0 0 -8192 8191.75 ECU_ADDRESS 0x4000190C /end MEASUREMENT
/begin MEASUREMENT ign_mbt_modeled "Ignition MBT modeled (° = val/4)." SWORD CM_u8_angle_1_4deg 0 0 -8192 8191.75 ECU_ADDRESS 0x4000190E /end MEASUREMENT
/begin MEASUREMENT ign_adv_min "Ignition adv minimum (° = val/4)." SWORD CM_u8_angle_1_4deg 0 0 -8192 8191.75 ECU_ADDRESS 0x40001910 /end MEASUREMENT
/begin MEASUREMENT ign_comp_roughness "Roughness spark comp actually applied (= ign_comp_roughness_request in NORMAL/NORMAL_STARTUP modes with roughness_flags&0x100, else 0) (deg = val/4). Was __ign_comp_roughness_detection." SWORD CM_u8_angle_1_4deg 0 0 -8192 8191.75 ECU_ADDRESS 0x40001912 /end MEASUREMENT
/begin MEASUREMENT ign_comp_idle_error "Idle speed-error spark comp from CAL_ign_comp_idle_error (or _moving above CAL_vehicle_moving_speed_min), plus dashpot lift term (deg = val/4)." SWORD CM_u8_angle_1_4deg 0 0 -8192 8191.75 ECU_ADDRESS 0x40001914 /end MEASUREMENT
/begin MEASUREMENT ign_comp_idle_error_driveaway "Driveaway idle-error spark comp from CAL_ign_comp_idle_error_driveaway[idle_speed_error_pedal_comp] (deg = val/4); 0 above driveaway speed/rpm." SWORD CM_u8_angle_1_4deg 0 0 -8192 8191.75 ECU_ADDRESS 0x40001916 /end MEASUREMENT
/begin MEASUREMENT ign_adv_coolant_comp "Ignition adv coolant compensation (° = val/4)." SWORD CM_u8_angle_1_4deg 0 0 -8192 8191.75 ECU_ADDRESS 0x40001918 /end MEASUREMENT
/begin MEASUREMENT ign_base_scale_startup "Startup scaling of ign_base_limited from CAL_ign_comp_startup_tps[maf accum, tps] (val/255); 0xff = inactive. Was ign_comp_startup_tps (not an angle)." UWORD CM_u8_factor_1_255 0 0 0 25700 ECU_ADDRESS 0x4000191A /end MEASUREMENT
/begin MEASUREMENT ign_retard_startup "Startup spark retard from CAL_ign_comp_startup_* (stopped coolant x air since start), subtracted in idle/cruise modes (deg = val/4). Was ign_comp_startup." UBYTE CM_u8_angle_1_4deg 0 0 0 63.75 ECU_ADDRESS 0x4000191C /end MEASUREMENT
/begin MEASUREMENT ign_operating_state_flags "bit0 stopped-coolant in startup window, bit1 startup comp applied, bit2 cruise target reached." UWORD NO_COMPU_METHOD 0 0 0 65535 ECU_ADDRESS 0x4000191E /end MEASUREMENT
/begin MEASUREMENT ign_retard_tps_rate "Throttle-rate spark retard from CAL_ign_comp_tps_rate (subtracted, zero-extended) (deg = val/4). Was ign_comp_tps_rate." UBYTE CM_u8_angle_1_4deg 0 0 0 63.75 ECU_ADDRESS 0x40001920 /end MEASUREMENT
/begin MEASUREMENT ign_comp_manifold_temp "Charge/manifold-temp spark comp = base x load factor/128 (deg = val/4). Also used by injection power-enrich-from-retard. Was ign_comp_iat." SWORD CM_u8_angle_1_4deg 0 0 -8192 8191.75 ECU_ADDRESS 0x40001922 /end MEASUREMENT
/begin MEASUREMENT ign_idle_mode_holdover_timer_5ms "u16_time_5ms" UWORD CM_u8_time_5ms 0 0 0 327675 ECU_ADDRESS 0x40001930 /end MEASUREMENT
/begin MEASUREMENT ign_adv_start "Fixed spark during crank + hold window, CAL_ign_comp_coldstart[stopped coolant] used raw, no -10 deg offset (deg = val/4). Was ign_coldstart_comp." UBYTE CM_u8_angle_1_4deg 0 0 0 63.75 ECU_ADDRESS 0x40001932 /end MEASUREMENT
/begin MEASUREMENT ign_target_step_advance "u8_angle_1/4deg" UBYTE CM_u8_angle_1_4deg 0 0 0 63.75 ECU_ADDRESS 0x40001933 /end MEASUREMENT
/begin MEASUREMENT ign_target_step_retard "u8_angle_1/4deg" UBYTE CM_u8_angle_1_4deg 0 0 0 63.75 ECU_ADDRESS 0x40001934 /end MEASUREMENT
/begin MEASUREMENT ign_comp_idle_rpm_rate "Idle dashpot spark comp from CAL_ign_comp_idle_rpm_rate[engine_period_trend_us]; 0 when no dashpot lift (deg = val/4). Was ign_comp_transient_total." SWORD CM_u8_angle_1_4deg 0 0 -8192 8191.75 ECU_ADDRESS 0x40001936 /end MEASUREMENT
/begin MEASUREMENT ign_comp_idle_error_moving "Idle speed-error spark comp while moving (CAL_ign_comp_idle_error_moving)." SWORD CM_u8_angle_1_4deg 0 0 -8192 8191.75 ECU_ADDRESS 0x40001938 /end MEASUREMENT
/begin MEASUREMENT ign_target_step_prescaler "u8_time_5ms" UBYTE CM_u8_time_5ms 0 0 0 1275 ECU_ADDRESS 0x4000193A /end MEASUREMENT
/begin MEASUREMENT ign_start_timing_hold_timer_5ms "Held at CAL_ign_target_update_inhibit_timer*2 while engine not running, counts down after start; non-zero = IGN_COLD_START mode (ign_adv_start). Was ign_target_update_inhibit_timer_5ms." UWORD CM_u8_time_5ms 0 0 0 327675 ECU_ADDRESS 0x4000193C /end MEASUREMENT
/begin MEASUREMENT ign_idle_dashpot_recovery_timer_5ms "Reloaded with CAL_ign_comp_recovery_timer while dashpot lift active; scales the negative idle-error comp back in. Was ign_idle_comp_recovery_timer_5ms." UBYTE CM_u8_time_5ms 0 0 0 1275 ECU_ADDRESS 0x4000193E /end MEASUREMENT
/begin MEASUREMENT ign_mode "Ignition mode (enumerated state)." UBYTE NO_COMPU_METHOD 0 0 0 255 ECU_ADDRESS 0x4000193F /end MEASUREMENT
/begin MEASUREMENT tps_rate_filtered_for_ign_comp "i16_factor_1/1023" SWORD CM_u16_factor_1_1023 0 0 -3203.12805474096 3203.0303030303 ECU_ADDRESS 0x40001940 /end MEASUREMENT
/begin MEASUREMENT tps_rate_ign_decay_tick_counter "u16_time_5ms" UWORD CM_u8_time_5ms 0 0 0 327675 ECU_ADDRESS 0x4000194A /end MEASUREMENT
/begin MEASUREMENT inj_deadtime_us "Injector dead time = CAL_inj_deadtime_base[volts, dP]*20 us x CAL_inj_deadtime_comp_iat/100, max 5100 (us)." UWORD CM_u8_time_us 0 0 0 65535 ECU_ADDRESS 0x40001950 /end MEASUREMENT
/begin MEASUREMENT inj_pw_from_mass_b1 "Bank-1 pulse for the required fuel mass: mass(10 ug)*10000/flow(mg/s) (us), before enrichments. Was mass_to_time_scaler_b1." ULONG CM_u8_time_us 0 0 0 4294967295 ECU_ADDRESS 0x40001954 /end MEASUREMENT
/begin MEASUREMENT inj_pw_from_mass_b2 "Bank-2 pulse for the required fuel mass (us). Was mass_to_time_scaler_b2." ULONG CM_u8_time_us 0 0 0 4294967295 ECU_ADDRESS 0x40001958 /end MEASUREMENT
/begin MEASUREMENT cranking_enrichment_blend "mass_accum x soak x air_temp factors /65025; pulse x (1 + val/255). Was enrichment_cranking_blend." UBYTE CM_u8_factor_1_255 0 0 0 100 ECU_ADDRESS 0x4000195C /end MEASUREMENT
/begin MEASUREMENT obd_ii_injector_pulse_time_bank1_us "OBD-II: injector pulse time bank1 us (µs)." ULONG CM_u8_time_us 0 0 0 4294967295 ECU_ADDRESS 0x40001960 /end MEASUREMENT
/begin MEASUREMENT obd_ii_injector_pulse_time_bank2_us "OBD-II: injector pulse time bank2 us (µs)." ULONG CM_u8_time_us 0 0 0 4294967295 ECU_ADDRESS 0x40001964 /end MEASUREMENT
/begin MEASUREMENT inj_prime_pulse_time "Prime pulse fired at crank sync = startup offset + dead time, max 65535 (us). Was inj_startup_pulse_time." ULONG CM_u8_time_us 0 0 0 4294967295 ECU_ADDRESS 0x40001968 /end MEASUREMENT
/begin MEASUREMENT inj_start_angle_target "CAL_inj_angle (or test override) x 7200/256 (deg = val/10)." ULONG CM_u16_angle_1_10deg 0 0 0 429496729.5 ECU_ADDRESS 0x4000196C /end MEASUREMENT
/begin MEASUREMENT inj_start_angle_offset_deg "Injection start angle actually used; slews +-2 deg per 200 Hz tick toward inj_start_angle_target." ULONG CM_u16_angle_1_10deg 0 0 0 429496729.5 ECU_ADDRESS 0x40001970 /end MEASUREMENT
/begin MEASUREMENT afr_target "Base AFR target, forced to CAL_closedloop_afr during the closed-loop entry hold (AFR = val/100). afr_commanded = this - afr_enrichment_from_ign_retard. Was afr_target2." UWORD CM_u16_afr_1_100 0 0 0 655.35 ECU_ADDRESS 0x40001974 /end MEASUREMENT
/begin MEASUREMENT afr_commanded "AFR commanded (val/100)." UWORD CM_u16_afr_1_100 0 0 0 655.35 ECU_ADDRESS 0x40001976 /end MEASUREMENT
/begin MEASUREMENT inj_flow_rate_scaled "Injector flow rate scaled (mg/s)." UWORD CM_u16_flow_mg_s 0 0 0 65535 ECU_ADDRESS 0x40001978 /end MEASUREMENT
/begin MEASUREMENT inj_fuel_mass_required "Fuel mass per injection = load_mass_per_stroke_raw*100/AFR (mg = val/100)." UWORD CM_u16_mass_10ug 0 0 0 655350 ECU_ADDRESS 0x4000197A /end MEASUREMENT
/begin MEASUREMENT fuel_control_mode_flags "uint8_t" UBYTE NO_COMPU_METHOD 0 0 0 255 ECU_ADDRESS 0x4000197C /end MEASUREMENT
/begin MEASUREMENT inj_pw_b1_with_trims "Injector pw bank 1 with trims (µs)." ULONG CM_u8_time_us 0 0 0 4294967295 ECU_ADDRESS 0x40001980 /end MEASUREMENT
/begin MEASUREMENT inj_pw_b2_with_trims "u32_time_us" ULONG CM_u8_time_us 0 0 0 4294967295 ECU_ADDRESS 0x40001984 /end MEASUREMENT
/begin MEASUREMENT inj_startup_enrichment_offset "Injector startup enrichment offset (µs)." ULONG CM_u8_time_us 0 0 0 4294967295 ECU_ADDRESS 0x40001988 /end MEASUREMENT
/begin MEASUREMENT inj_pw_b1_limited "Bank-1 pulse after the cold-start cap and the overflow clamp, before fuel trims (us). Was inj_pw_b1_pretrim." ULONG CM_u8_time_us 0 0 0 4294967295 ECU_ADDRESS 0x4000198C /end MEASUREMENT
/begin MEASUREMENT inj_pw_b2_limited "Bank-2 pulse after the cold-start cap and the overflow clamp, before fuel trims (us). Was inj_pw_b2_pretrim." ULONG CM_u8_time_us 0 0 0 4294967295 ECU_ADDRESS 0x40001990 /end MEASUREMENT
/begin MEASUREMENT inj_fuel_mass_bank1 "Bank-1 fuel mass after evap purge credit (mg = val/100)." UWORD CM_u16_mass_10ug 0 0 0 655350 ECU_ADDRESS 0x40001994 /end MEASUREMENT
/begin MEASUREMENT inj_fuel_mass_bank2 "Bank-2 fuel mass after evap purge credit (mg = val/100)." UWORD CM_u16_mass_10ug 0 0 0 655350 ECU_ADDRESS 0x40001996 /end MEASUREMENT
/begin MEASUREMENT inj_angle_raw "Injector angle." UBYTE CM_u8_angle_720_256deg 0 0 0 717.1875 ECU_ADDRESS 0x40001998 /end MEASUREMENT
/begin MEASUREMENT afr_enrichment_from_ign_retard "u8_afr_1/100" UBYTE CM_u16_afr_1_100 0 0 0 2.55 ECU_ADDRESS 0x40001999 /end MEASUREMENT
/begin MEASUREMENT inj_efficiency "Injector efficiency CAL_inj_efficiency + test trim, clamped 100..255 (val/200; 200 = 1.0). Was typed /100." UBYTE CM_u8_factor_1_200 0 0 0 127.5 ECU_ADDRESS 0x4000199A /end MEASUREMENT
/begin MEASUREMENT inj_duty_cycle_bank1 "Injector duty cycle bank1 (val/100)." UBYTE CM_u8_factor_1_100 0 0 0 255 ECU_ADDRESS 0x4000199B /end MEASUREMENT
/begin MEASUREMENT inj_duty_cycle_bank2 "Injector duty cycle bank2 (val/100)." UBYTE CM_u8_factor_1_100 0 0 0 255 ECU_ADDRESS 0x4000199C /end MEASUREMENT
/begin MEASUREMENT fuel_usage_instantaneous "Instantaneous fuel volume flow = rpm*flow*avg_pw/CAL density/15000 (mL/s = val/100). Was typed 1/10 mL/km." UWORD CM_u16_flow_1_100ml_s 0 0 0 655.35 ECU_ADDRESS 0x4000199E /end MEASUREMENT
/begin MEASUREMENT fuel_mileage_instantaneous "fuel_usage_instantaneous*360/car_speed_u8 (mL/km = val/10)." UWORD CM_u16_economy_1_10ml_per_km 0 0 0 6553.5 ECU_ADDRESS 0x400019A0 /end MEASUREMENT
/begin GROUP G_Driveline_ips "ips"
 /begin REF_CHARACTERISTIC CAL_ips_revmatch_p_gain CAL_ips_revmatch_p_gain_X_rpm CAL_ips_revmatch_rpm_tolerance CAL_ips_revmatch_rpm_tolerance_X_rpm CAL_ips_speed_match_d_gain CAL_ips_speed_match_d_sample_ticks CAL_ips_speed_match_d_term_max CAL_ips_speed_match_d_term_min CAL_ips_speed_match_i_error_window CAL_ips_speed_match_i_gain CAL_ips_speed_match_i_reset CAL_ips_speed_match_i_term_max CAL_ips_speed_match_i_term_min CAL_ips_speed_match_p_gain CAL_ips_speed_match_p_term_max CAL_ips_speed_match_p_term_min CAL_ips_speed_match_torque_max CAL_ips_torque_reduction_slow_floor_nm CAL_ips_torque_reduction_slow_scale_pct /end REF_CHARACTERISTIC
/end GROUP
/begin GROUP G_Driveline_trans "trans"
 /begin REF_CHARACTERISTIC CAL_trans_fluid_P2797_threshold CAL_trans_gear_ratio_sport CAL_trans_gear_ratio_tour CAL_trans_gear_ratio_tour_6th CAL_trans_pump_carspeed_enable CAL_trans_pump_cold_cutoff CAL_trans_pump_cool_off CAL_trans_pump_ect_off_max CAL_trans_pump_ect_off_min CAL_trans_pump_ect_on_max CAL_trans_pump_ect_on_min CAL_trans_pump_no_cool_max CAL_trans_pump_no_cool_min CAL_trans_pump_warmup_max CAL_trans_pump_warmup_min CAL_trans_temp_voltage_threshold /end REF_CHARACTERISTIC
/end GROUP
/begin GROUP G_Climate "Air conditioning" ROOT
 /begin REF_CHARACTERISTIC CAL_ac_compressor_deactivate_car_speed CAL_ac_compressor_engine_speed2 CAL_ac_compressor_engine_speed3 CAL_ac_compressor_engine_speed_max CAL_ac_compressor_engine_speed_min CAL_ac_compressor_max_coolant_temp_max CAL_ac_compressor_max_coolant_temp_min CAL_ac_compressor_power_offset CAL_ac_compressor_runtime_min CAL_ac_compressor_soft_engage_time CAL_ac_compressor_speed_filter_coeff CAL_ac_evap_freeze_inhibit_delay CAL_ac_evap_pid_d_period CAL_ac_evap_pid_derivative_filter_alpha CAL_ac_evap_pid_integrator_limit CAL_ac_evap_pid_kd CAL_ac_evap_pid_ki_cold CAL_ac_evap_pid_ki_cold_boost_delay CAL_ac_evap_pid_ki_cold_boost_factor CAL_ac_evap_pid_ki_warm CAL_ac_evap_pid_p_gain CAL_ac_evap_pid_p_gain_X_temp_error CAL_ac_evap_pid_update_period_cold CAL_ac_evap_target_temp CAL_ac_evap_temp_trend_period2 CAL_ac_evap_temp_voltage_high_threshold CAL_ac_evap_temp_voltage_low_threshold CAL_ac_evap_timer_ticks_5ms CAL_ac_fan_startup_hold_time CAL_ac_ign_comp_delay CAL_ac_inhibit_evap_temp CAL_ac_inhibit_rpm_cutoff_min_hold CAL_ac_inhibit_rpm_cutoff_on_delay CAL_ac_inhibit_rpm_min_hold CAL_ac_inhibit_tps CAL_ac_load_limit CAL_ac_load_limit_X_rpm CAL_ac_load_ramp_down_step CAL_ac_load_ramp_steps CAL_ac_load_slew_down_period CAL_ac_load_slew_down_step CAL_ac_load_slew_up_period CAL_ac_load_slew_up_step CAL_ac_output_pwm_freq CAL_ac_shutdown_delay CAL_ac_tps_inhibit_timer CAL_ac_unknown3 /end REF_CHARACTERISTIC
/end GROUP
/begin GROUP G_Cruise "Cruise control" ROOT
 /begin REF_CHARACTERISTIC CAL_cruise_accel_pedal_override_threshold_enter CAL_cruise_accel_pedal_override_threshold_exit CAL_cruise_airflow_fast_slew_time CAL_cruise_airflow_slew_step CAL_cruise_brake_cancel_time CAL_cruise_derivative_clamp CAL_cruise_derivative_gain_ips CAL_cruise_derivative_gain_ips_X_gear CAL_cruise_derivative_gain_manual_cr CAL_cruise_derivative_gain_manual_cr_X_gear CAL_cruise_derivative_gain_manual_longbox CAL_cruise_derivative_gain_manual_longbox_X_gear CAL_cruise_derivative_term_limit CAL_cruise_feedforward_blend_threshold CAL_cruise_integral_freeze_accel CAL_cruise_integral_gain_ips CAL_cruise_integral_gain_ips_X_gear CAL_cruise_integral_gain_manual_cr CAL_cruise_integral_gain_manual_cr_X_gear CAL_cruise_integral_gain_manual_longbox CAL_cruise_integral_gain_manual_longbox_X_gear CAL_cruise_integral_gearchange_retain CAL_cruise_integral_term_limit CAL_cruise_integrator_clamp CAL_cruise_maf_feedforward CAL_cruise_maf_feedforward_X_carspeed CAL_cruise_override_coast_cancel_time CAL_cruise_override_timeout CAL_cruise_proportional_gain_ips CAL_cruise_proportional_gain_ips_X_gear CAL_cruise_proportional_gain_manual_cr CAL_cruise_proportional_gain_manual_cr_X_gear CAL_cruise_proportional_gain_manual_longbox CAL_cruise_proportional_gain_manual_longbox_X_gear CAL_cruise_resume_pedal_handoff_threshold CAL_cruise_resume_timer CAL_cruise_rpm_max_ips CAL_cruise_rpm_max_manual CAL_cruise_rpm_min_ips CAL_cruise_rpm_min_manual CAL_cruise_speed_deadband CAL_cruise_speed_decrement CAL_cruise_speed_error_limit CAL_cruise_speed_filter_coeff CAL_cruise_speed_increment CAL_cruise_speed_increment2 CAL_cruise_speed_limit CAL_cruise_torque_request_braking CAL_cruise_torque_request_factor CAL_cruise_tps_accelerating_threshold /end REF_CHARACTERISTIC
/end GROUP
/begin GROUP G_Vehicle "Vehicle and body" ROOT
 /begin SUB_GROUP G_Vehicle_can G_Vehicle_cluster G_Vehicle_dca G_Vehicle_vehicle /end SUB_GROUP
/end GROUP
/begin GROUP G_Vehicle_can "can"
 /begin REF_CHARACTERISTIC CAL_can_lat_accel_standstill_timeout CAL_can_sensor_timeout_reload CAL_can_yaw_data_timeout CAL_can_yaw_monitor_startup_delay CAL_can_yaw_timeout /end REF_CHARACTERISTIC
/end GROUP
/begin GROUP G_Vehicle_cluster "cluster"
 /begin REF_CHARACTERISTIC CAL_cluster_brake_switch_max_speed_ips_unknown CAL_cluster_coolant_warning CAL_cluster_coolant_warning_test_enable CAL_cluster_dte_min_distance_threshold CAL_cluster_fuel_economy_factor_limit CAL_cluster_fuel_economy_factory_stepsize CAL_cluster_fuel_level_warning_threshold CAL_cluster_fuel_level_zero_clip_threshold CAL_cluster_fuel_mileage_update_timer CAL_cluster_fuel_range_remaining_smoothing_factor CAL_cluster_fuel_range_smoothing_interval CAL_cluster_fuel_usage_reset_request_timer CAL_cluster_oil_pressure_warn_threshold CAL_cluster_oil_pressure_warn_threshold_X_engine_speed CAL_cluster_shift_light_deadband_rpm CAL_cluster_shiftlight_rpm_offset_ips CAL_cluster_shiftlight_rpm_offset_ips_X_gear CAL_cluster_shiftlight_rpm_offset_manual CAL_cluster_shiftlight_rpm_offset_manual_X_gear /end REF_CHARACTERISTIC
/end GROUP
/begin GROUP G_Vehicle_dca "dca"
 /begin REF_CHARACTERISTIC CAL_dca_activate_timer CAL_dca_activate_tps_threshold CAL_dca_enable_carspeed CAL_dca_enable_steering_max CAL_dca_enable_tps_margin CAL_dca_enable_untested CAL_dca_freerev_wait_time CAL_dca_ramp_timer_unknown CAL_dca_stationary_wait_time CAL_dca_tps_initial_offset CAL_dca_tps_limit_ips CAL_dca_tps_limit_ips_x_time CAL_dca_tps_limit_manual CAL_dca_tps_limit_manual_X_time CAL_dca_unknown_ips_nolc CAL_dca_unknown_ips_nolc_X_time /end REF_CHARACTERISTIC
/end GROUP
/begin GROUP G_Vehicle_vehicle "vehicle"
 /begin REF_CHARACTERISTIC CAL_vehicle_moving_speed_min CAL_vehicle_speed_limit CAL_vehicle_speed_limit_enforce CAL_vehicle_speed_limit_enforce_margin CAL_vehicle_standing_start_throttle_threshold /end REF_CHARACTERISTIC
/end GROUP
/begin GROUP G_Other "Other" ROOT
 /begin SUB_GROUP G_Other_base G_Other_driver G_Other_ecu G_Other_hc08 G_Other_lea G_Other_logger G_Other_misc G_Other_prog G_Other_unused /end SUB_GROUP
/end GROUP
/begin GROUP G_Other_base "base" /begin REF_CHARACTERISTIC CAL_base /end REF_CHARACTERISTIC /end GROUP
/begin GROUP G_Other_driver "driver"
 /begin REF_CHARACTERISTIC CAL_driver_input_mode_coolant_max CAL_driver_input_mode_coolant_min /end REF_CHARACTERISTIC
/end GROUP
/begin GROUP G_Other_ecu "ecu"
 /begin REF_CHARACTERISTIC CAL_ecu_2gr_cylinder_air_mass_mg CAL_ecu_2gr_cylinder_air_mass_mg_obd_ii CAL_ecu_abs_ring_teeth_count CAL_ecu_brake_or_clutch_inactive_timer CAL_ecu_cvn CAL_ecu_data_base CAL_ecu_engine_breakin_distance CAL_ecu_engine_running_threshold_unknown CAL_ecu_engine_speed_decel_hysteresis_rpm CAL_ecu_engine_speed_reference_enable CAL_ecu_engine_speed_target_dec_gain CAL_ecu_engine_speed_target_dec_gain_X_coolant_temp CAL_ecu_engine_speed_target_ramp_gain_sport CAL_ecu_engine_speed_target_ramp_gain_sport_X_rpm CAL_ecu_engine_speed_target_ramp_gain_sport_Y_coolant_temp CAL_ecu_engine_speed_target_ramp_gain_tour CAL_ecu_engine_speed_target_ramp_gain_tour_X_rpm CAL_ecu_engine_speed_target_ramp_gain_tour_Y_coolant_temp CAL_ecu_engine_speed_target_sport CAL_ecu_engine_speed_target_sport_X_pps CAL_ecu_engine_speed_target_tour CAL_ecu_engine_speed_target_tour_X_pps CAL_ecu_ign_threshold CAL_ecu_ips_calibration_version CAL_ecu_learning_x_axis_stability_threshold CAL_ecu_learning_y_axis_stability_threshold CAL_ecu_obd_mode2F_timer CAL_ecu_rpm_5250 CAL_ecu_rpm_600 CAL_ecu_standing_start_threshold CAL_ecu_starter_max_engage_after_run CAL_ecu_system_voltage_threshold CAL_ecu_thermostat_diag_maf_threshold_ips CAL_ecu_thermostat_diag_maf_threshold_manual CAL_ecu_unlock_magic CAL_ecu_vehicle_mode_button_time CAL_ecu_wheelspeed_update_timer /end REF_CHARACTERISTIC
/end GROUP
/begin GROUP G_Other_hc08 "hc08" /begin REF_CHARACTERISTIC CAL_hc08_status_mode_flag_bit7 /end REF_CHARACTERISTIC /end GROUP
/begin GROUP G_Other_lea "lea" /begin REF_CHARACTERISTIC CAL_lea_misfire_baseline_set /end REF_CHARACTERISTIC /end GROUP
/begin GROUP G_Other_logger "logger" /begin REF_CHARACTERISTIC CAL_logger_high_speed_logger_enable /end REF_CHARACTERISTIC /end GROUP
/begin GROUP G_Other_misc "misc"
 /begin REF_CHARACTERISTIC CAL_misc_calid CAL_misc_engine_detection_off CAL_misc_engine_running_confirm_delay /end REF_CHARACTERISTIC
/end GROUP
/begin GROUP G_Other_prog "prog" /begin REF_CHARACTERISTIC CAL_prog_version /end REF_CHARACTERISTIC /end GROUP
/begin GROUP G_Other_unused "unused"
 /begin REF_CHARACTERISTIC CAL_unused_40008694 CAL_unused_400086f3 CAL_unused_4000877c CAL_unused_40008819 CAL_unused_400088ff CAL_unused_40008d46 CAL_unused_40008d50 CAL_unused_40008e47 CAL_unused_40008e60 CAL_unused_40008e72 CAL_unused_4000905a CAL_unused_4000915e CAL_unused_40009a32 CAL_unused_40009d16 CAL_unused_40009e26 CAL_unused_4000a8be CAL_unused_4000ada0 CAL_unused_4000b00a CAL_unused_4000b58e CAL_unused_4000c0ca CAL_unused_4000c4ea CAL_unused_4000c79a CAL_unused_4000c9bc CAL_unused_4000ca9e CAL_unused_4000cb5c CAL_unused_4000cb8a CAL_unused_4000cbb6 CAL_unused_4000ccc0 CAL_unused_4000cd13 CAL_unused_4000d26e CAL_unused_4000d296 CAL_unused_4000d3e8 CAL_unused_4000d42d CAL_unused_4000d478 CAL_unused_4000d6a4 CAL_unused_4000d734 CAL_unused_4000d8ec CAL_unused_4000d9ec CAL_unused_4000da00 CAL_unused_4000e188 CAL_unused_4000ed6a CAL_unused_evap_leak_test_P0456_decay_limit_2d CAL_unused_evap_leak_test_P0456_decay_limit_2d_X_fuel_level CAL_unused_ign_mbt_modeled CAL_unused_ign_mbt_modeled_X_rpm CAL_unused_ign_mbt_modeled_Y_load CAL_unused_inj_afterstart_enrichment_coolant_ips CAL_unused_inj_afterstart_enrichment_coolant_ips_X_coolant CAL_unused_inj_afterstart_enrichment_coolant_ips_Y_maf_accum CAL_unused_obd_ii_P0106_highload_rpm_window /end REF_CHARACTERISTIC
/end GROUP
/end MODULE
/end PROJECT
