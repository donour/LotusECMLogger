ASAP2_VERSION 1 61
/begin PROJECT C132E0278 "Lotus T6 C132E0278"
/begin HEADER "" VERSION "generated v1" /end HEADER
/begin MODULE C132E0278 ""
/begin MOD_COMMON "" BYTE_ORDER MSB_FIRST ALIGNMENT_BYTE 1 ALIGNMENT_WORD 2 ALIGNMENT_LONG 4 /end MOD_COMMON
/begin RECORD_LAYOUT RL_VALUE_UBYTE FNC_VALUES 1 UBYTE ROW_DIR DIRECT /end RECORD_LAYOUT
/begin RECORD_LAYOUT RL_AXIS_UBYTE AXIS_PTS_X 1 UBYTE INDEX_INCR DIRECT /end RECORD_LAYOUT
/begin RECORD_LAYOUT RL_VALUE_UWORD FNC_VALUES 1 UWORD ROW_DIR DIRECT /end RECORD_LAYOUT
/begin RECORD_LAYOUT RL_AXIS_UWORD AXIS_PTS_X 1 UWORD INDEX_INCR DIRECT /end RECORD_LAYOUT
/begin RECORD_LAYOUT RL_VALUE_SWORD FNC_VALUES 1 SWORD ROW_DIR DIRECT /end RECORD_LAYOUT
/begin RECORD_LAYOUT RL_VALUE_ULONG FNC_VALUES 1 ULONG ROW_DIR DIRECT /end RECORD_LAYOUT
/begin COMPU_METHOD CM_u16_angle_1_10deg "u16_angle_1/10deg" RAT_FUNC "%9.1" "deg" COEFFS 0 1 0 0 0 0.1 /end COMPU_METHOD
/begin COMPU_METHOD CM_u16_distance_mm_div2 "u16_distance_mm_div2" RAT_FUNC "%9.1" "mm" COEFFS 0 1 0 0 0 0.5 /end COMPU_METHOD
/begin COMPU_METHOD CM_u16_factor_1_1023 "u16_factor_1/1023" RAT_FUNC "%12.4" "%" COEFFS 0 1 0 0 0 0.0977517106549365 /end COMPU_METHOD
/begin COMPU_METHOD CM_u16_factor_1_4095 "u16_factor_1/4095" RAT_FUNC "%12.4" "%" COEFFS 0 1 0 0 0 0.0244200244200244 /end COMPU_METHOD
/begin COMPU_METHOD CM_u16_flow_100mg_s "u16_flow_100mg/s" RAT_FUNC "%8.0" "mg/s" COEFFS 0 1 0 0 0 100 /end COMPU_METHOD
/begin COMPU_METHOD CM_u16_load_mg_stroke "u16_load_mg/stroke" RAT_FUNC "%8.0" "mg/stroke" COEFFS 0 1 0 0 0 1 /end COMPU_METHOD
/begin COMPU_METHOD CM_u16_mass_mg "u16_mass_mg" RAT_FUNC "%8.0" "mg" COEFFS 0 1 0 0 0 1 /end COMPU_METHOD
/begin COMPU_METHOD CM_u16_power_1_100kw "u16_power_1/100kw" RAT_FUNC "%10.2" "kW" COEFFS 0 1 0 0 0 0.01 /end COMPU_METHOD
/begin COMPU_METHOD CM_u16_pressure_mbar "u16_pressure_mbar" RAT_FUNC "%8.0" "mbar" COEFFS 0 1 0 0 0 1 /end COMPU_METHOD
/begin COMPU_METHOD CM_u16_rspeed_rpm "u16_rspeed_rpm" RAT_FUNC "%8.0" "rpm" COEFFS 0 1 0 0 0 1 /end COMPU_METHOD
/begin COMPU_METHOD CM_u16_slip_1_8pct "u16_slip_1/8pct" RAT_FUNC "%11.3" "%" COEFFS 0 1 0 0 0 0.125 /end COMPU_METHOD
/begin COMPU_METHOD CM_u16_voltage_18_1023v "u16_voltage_18/1023v" RAT_FUNC "%12.4" "V" COEFFS 0 1 0 0 0 0.0175953079178886 /end COMPU_METHOD
/begin COMPU_METHOD CM_u16_voltage_5_1023v "u16_voltage_5/1023v" RAT_FUNC "%12.4" "V" COEFFS 0 1 0 0 0 0.00488758553274682 /end COMPU_METHOD
/begin COMPU_METHOD CM_u8__127 "u8_-127" RAT_FUNC "%8.0" "" COEFFS 0 1 127 0 0 1 /end COMPU_METHOD
/begin COMPU_METHOD CM_u8_angle_1_4_64deg "u8_angle_1/4-64deg" RAT_FUNC "%10.2" "deg" COEFFS 0 1 64 0 0 0.25 /end COMPU_METHOD
/begin COMPU_METHOD CM_u8_angle_1_4deg "u8_angle_1/4deg" RAT_FUNC "%10.2" "deg" COEFFS 0 1 0 0 0 0.25 /end COMPU_METHOD
/begin COMPU_METHOD CM_u8_factor_1_100 "u8_factor_1/100" RAT_FUNC "%8.0" "%" COEFFS 0 1 0 0 0 1 /end COMPU_METHOD
/begin COMPU_METHOD CM_u8_factor_1_255 "u8_factor_1/255" RAT_FUNC "%12.4" "%" COEFFS 0 1 0 0 0 0.392156862745098 /end COMPU_METHOD
/begin COMPU_METHOD CM_u8_factor_1_2560 "u8_factor_1/2560" RAT_FUNC "%12.4" "%" COEFFS 0 1 0 0 0 0.0390625 /end COMPU_METHOD
/begin COMPU_METHOD CM_u8_flow_2g_s "u8_flow_2g/s" RAT_FUNC "%8.0" "g/s" COEFFS 0 1 0 0 0 2 /end COMPU_METHOD
/begin COMPU_METHOD CM_u8_flow_g_s "u8_flow_g/s" RAT_FUNC "%8.0" "g/s" COEFFS 0 1 0 0 0 1 /end COMPU_METHOD
/begin COMPU_METHOD CM_u8_load_1173mg_255stroke "u8_load_1173mg/255stroke" RAT_FUNC "%9.1" "mg/stroke" COEFFS 0 1 0 0 0 4.6 /end COMPU_METHOD
/begin COMPU_METHOD CM_u8_load_4mg_stroke "u8_load_4mg/stroke" RAT_FUNC "%8.0" "mg/stroke" COEFFS 0 1 0 0 0 4 /end COMPU_METHOD
/begin COMPU_METHOD CM_u8_mass_g "u8_mass_g" RAT_FUNC "%8.0" "g" COEFFS 0 1 0 0 0 1 /end COMPU_METHOD
/begin COMPU_METHOD CM_u8_pressure_4mbar "u8_pressure_4mbar" RAT_FUNC "%8.0" "mbar" COEFFS 0 1 0 0 0 4 /end COMPU_METHOD
/begin COMPU_METHOD CM_u8_rspeed_10rpm "u8_rspeed_10rpm" RAT_FUNC "%8.0" "rpm" COEFFS 0 1 0 0 0 10 /end COMPU_METHOD
/begin COMPU_METHOD CM_u8_rspeed_125_4_500rpm "u8_rspeed_125/4+500rpm" RAT_FUNC "%10.2" "rpm" COEFFS 0 1 -500 0 0 31.25 /end COMPU_METHOD
/begin COMPU_METHOD CM_u8_rspeed_25rpm "u8_rspeed_25rpm" RAT_FUNC "%8.0" "rpm" COEFFS 0 1 0 0 0 25 /end COMPU_METHOD
/begin COMPU_METHOD CM_u8_rspeed_2rpm "u8_rspeed_2rpm" RAT_FUNC "%8.0" "rpm" COEFFS 0 1 0 0 0 2 /end COMPU_METHOD
/begin COMPU_METHOD CM_u8_rspeed_4_500rpm "u8_rspeed_4+500rpm" RAT_FUNC "%8.0" "rpm" COEFFS 0 1 -500 0 0 4 /end COMPU_METHOD
/begin COMPU_METHOD CM_u8_rspeed_4rpm "u8_rspeed_4rpm" RAT_FUNC "%8.0" "rpm" COEFFS 0 1 0 0 0 4 /end COMPU_METHOD
/begin COMPU_METHOD CM_u8_rspeed_50rpm "u8_rspeed_50rpm" RAT_FUNC "%8.0" "rpm" COEFFS 0 1 0 0 0 50 /end COMPU_METHOD
/begin COMPU_METHOD CM_u8_rspeed_8rpm "u8_rspeed_8rpm" RAT_FUNC "%8.0" "rpm" COEFFS 0 1 0 0 0 8 /end COMPU_METHOD
/begin COMPU_METHOD CM_u8_slip_2pct "u8_slip_2pct" RAT_FUNC "%8.0" "%" COEFFS 0 1 0 0 0 2 /end COMPU_METHOD
/begin COMPU_METHOD CM_u8_speed_1_100kph "u8_speed_1/100kph" RAT_FUNC "%10.2" "km/h" COEFFS 0 1 0 0 0 0.01 /end COMPU_METHOD
/begin COMPU_METHOD CM_u8_speed_1_10kph "u8_speed_1/10kph" RAT_FUNC "%9.1" "km/h" COEFFS 0 1 0 0 0 0.1 /end COMPU_METHOD
/begin COMPU_METHOD CM_u8_speed_kph "u8_speed_kph" RAT_FUNC "%8.0" "km/h" COEFFS 0 1 0 0 0 1 /end COMPU_METHOD
/begin COMPU_METHOD CM_u8_temp_5_8_40c "u8_temp_5/8-40c" RAT_FUNC "%11.3" "°C" COEFFS 0 1 40 0 0 0.625 /end COMPU_METHOD
/begin COMPU_METHOD CM_u8_time_100ms "u8_time_100ms" RAT_FUNC "%8.0" "ms" COEFFS 0 1 0 0 0 100 /end COMPU_METHOD
/begin COMPU_METHOD CM_u8_time_10ms "u8_time_10ms" RAT_FUNC "%8.0" "ms" COEFFS 0 1 0 0 0 10 /end COMPU_METHOD
/begin COMPU_METHOD CM_u8_time_250ms "u8_time_250ms" RAT_FUNC "%8.0" "ms" COEFFS 0 1 0 0 0 250 /end COMPU_METHOD
/begin COMPU_METHOD CM_u8_time_50ms "u8_time_50ms" RAT_FUNC "%8.0" "ms" COEFFS 0 1 0 0 0 50 /end COMPU_METHOD
/begin COMPU_METHOD CM_u8_time_5ms "u8_time_5ms" RAT_FUNC "%8.0" "ms" COEFFS 0 1 0 0 0 5 /end COMPU_METHOD
/begin COMPU_METHOD CM_u8_time_5s "u8_time_5s" RAT_FUNC "%8.0" "s" COEFFS 0 1 0 0 0 5 /end COMPU_METHOD
/begin COMPU_METHOD CM_u8_time_ms "u8_time_ms" RAT_FUNC "%8.0" "ms" COEFFS 0 1 0 0 0 1 /end COMPU_METHOD
/begin COMPU_METHOD CM_u8_time_s "u8_time_s" RAT_FUNC "%8.0" "s" COEFFS 0 1 0 0 0 1 /end COMPU_METHOD
/begin COMPU_METHOD CM_u8_torque_2nm "u8_torque_2nm" RAT_FUNC "%8.0" "Nm" COEFFS 0 1 0 0 0 2 /end COMPU_METHOD
/begin COMPU_METHOD CM_u8_torque_4nm "u8_torque_4nm" RAT_FUNC "%8.0" "Nm" COEFFS 0 1 0 0 0 4 /end COMPU_METHOD
/begin COMPU_METHOD CM_u8_torque_nm "u8_torque_nm" RAT_FUNC "%8.0" "Nm" COEFFS 0 1 0 0 0 1 /end COMPU_METHOD
/begin CHARACTERISTIC CAL_idle_clutch_antistall_speed_threshold "Calibration: idle clutch antistall speed threshold (km/h = val/10)." VALUE 0x4000867A RL_VALUE_UBYTE 0 CM_u8_speed_1_10kph 0 25.5 /end CHARACTERISTIC
/begin CHARACTERISTIC CAL_evap_purge_pressure_offset "Calibration: evaporative purge pressure offset." VALUE 0x40008682 RL_VALUE_UWORD 0 NO_COMPU_METHOD 0 65535 /end CHARACTERISTIC
/begin CHARACTERISTIC CAL_cooling_fan_engine_bay_airtemp_enable "Calibration: cooling fan engine bay airtemp enable (°C = val*5/8−40)." VALUE 0x4000868B RL_VALUE_UBYTE 0 CM_u8_temp_5_8_40c -40 119.375 /end CHARACTERISTIC
/begin CHARACTERISTIC CAL_cooling_fan_startup_time "Calibration: cooling fan startup time (ms = val*5)." VALUE 0x4000868C RL_VALUE_UWORD 0 CM_u8_time_5ms 0 327675 /end CHARACTERISTIC
/begin CHARACTERISTIC CAL_cooling_fan_hotstart_temp "Calibration: cooling fan hotstart temperature (°C = val*5/8−40)." VALUE 0x4000868E RL_VALUE_UBYTE 0 CM_u8_temp_5_8_40c -40 119.375 /end CHARACTERISTIC
/begin CHARACTERISTIC CAL_cooling_fan_hotstart_dutycycle "Calibration: cooling fan hotstart dutycycle (val/255)." VALUE 0x4000868F RL_VALUE_UBYTE 0 CM_u8_factor_1_255 0 100 /end CHARACTERISTIC
/begin CHARACTERISTIC CAL_cooling_fan_engine_bay_radfan_threshold_enable "Calibration: cooling fan engine bay radfan threshold enable (val/255)." VALUE 0x40008691 RL_VALUE_UBYTE 0 CM_u8_factor_1_255 0 100 /end CHARACTERISTIC
/begin CHARACTERISTIC CAL_cooling_fan_engine_bay_radfan_threshold_disable "Calibration: cooling fan engine bay radfan threshold disable (val/255)." VALUE 0x40008692 RL_VALUE_UBYTE 0 CM_u8_factor_1_255 0 100 /end CHARACTERISTIC
/begin CHARACTERISTIC CAL_torque_ext_torque_limit_hold_count "u8_time_10ms" VALUE 0x400086A4 RL_VALUE_UBYTE 0 CM_u8_time_10ms 0 2550 /end CHARACTERISTIC
/begin CHARACTERISTIC CAL_cooling_fan_speed_disable_speed "Calibration: cooling fan speed disable speed (km/h)." VALUE 0x400086BF RL_VALUE_UBYTE 0 CM_u8_speed_kph 0 255 /end CHARACTERISTIC
/begin CHARACTERISTIC CAL_idle_learn_integral_max "undefined1" VALUE 0x400086C2 RL_VALUE_UBYTE 0 NO_COMPU_METHOD 0 255 /end CHARACTERISTIC
/begin CHARACTERISTIC CAL_idle_learn_integral_min "undefined1" VALUE 0x400086C3 RL_VALUE_UBYTE 0 NO_COMPU_METHOD 0 255 /end CHARACTERISTIC
/begin CHARACTERISTIC CAL_cooling_recirc_reset_coolant_temp "Calibration: cooling recirc reset coolant temperature (°C = val*5/8−40)." VALUE 0x400086CD RL_VALUE_UBYTE 0 CM_u8_temp_5_8_40c -40 119.375 /end CHARACTERISTIC
/begin CHARACTERISTIC CAL_torque_torque_to_tps_scaling_rpm_range "Calibration: torque torque to throttle position scaling RPM range (RPM = val*125/4+500; 2-element array)." VAL_BLK 0x400086CF RL_VALUE_UBYTE 0 CM_u8_rspeed_125_4_500rpm 500 8468.75 NUMBER 2 /end CHARACTERISTIC
/begin CHARACTERISTIC CAL_wheel_speed_smoothing "Calibration: wheel speed smoothing." VALUE 0x400086D3 RL_VALUE_UBYTE 0 NO_COMPU_METHOD 0 255 /end CHARACTERISTIC
/begin CHARACTERISTIC CAL_evap_purge_idle_duty_max "undefined1" VALUE 0x400086DE RL_VALUE_UBYTE 0 NO_COMPU_METHOD 0 255 /end CHARACTERISTIC
/begin CHARACTERISTIC CAL_evap_purge_conditioning_timer_100ms "undefined1" VALUE 0x400086F8 RL_VALUE_UBYTE 0 NO_COMPU_METHOD 0 255 /end CHARACTERISTIC
/begin CHARACTERISTIC CAL_evap_purge_min_inj_pulse_enter "undefined1" VALUE 0x400086F9 RL_VALUE_UBYTE 0 NO_COMPU_METHOD 0 255 /end CHARACTERISTIC
/begin CHARACTERISTIC CAL_evap_purge_min_inj_pulse_exit "undefined1" VALUE 0x400086FA RL_VALUE_UBYTE 0 NO_COMPU_METHOD 0 255 /end CHARACTERISTIC
/begin CHARACTERISTIC CAL_evap_purge_duty_ramp_up_min "undefined1" VALUE 0x400086FB RL_VALUE_UBYTE 0 NO_COMPU_METHOD 0 255 /end CHARACTERISTIC
/begin CHARACTERISTIC CAL_evap_purge_filter_alpha "undefined1" VALUE 0x400086FE RL_VALUE_UBYTE 0 NO_COMPU_METHOD 0 255 /end CHARACTERISTIC
/begin CHARACTERISTIC CAL_engine_speed_avg_samples "undefined1" VALUE 0x40008706 RL_VALUE_UBYTE 0 NO_COMPU_METHOD 0 255 /end CHARACTERISTIC
/begin CHARACTERISTIC CAL_idle_exit_rpm_offset "undefined1" VALUE 0x4000872C RL_VALUE_UBYTE 0 NO_COMPU_METHOD 0 255 /end CHARACTERISTIC
/begin CHARACTERISTIC CAL_obd_o2_tps_transient_threshold "undefined1" VALUE 0x4000872E RL_VALUE_UBYTE 0 NO_COMPU_METHOD 0 255 /end CHARACTERISTIC
/begin CHARACTERISTIC CAL_idle_car_moving_threshold "Calibration: idle car moving threshold (km/h)." VALUE 0x40008732 RL_VALUE_UBYTE 0 CM_u8_speed_kph 0 255 /end CHARACTERISTIC
/begin CHARACTERISTIC CAL_cooling_recirc_enable_airtemp "Calibration: cooling recirc enable airtemp (°C = val*5/8−40)." VALUE 0x40008737 RL_VALUE_UBYTE 0 CM_u8_temp_5_8_40c -40 119.375 /end CHARACTERISTIC
/begin CHARACTERISTIC CAL_torque_limit_low_speed_min_torque "u8_torque_nm" VALUE 0x40008746 RL_VALUE_UBYTE 0 CM_u8_torque_nm 0 255 /end CHARACTERISTIC
/begin CHARACTERISTIC CAL_torque_limit_low_speed_rpm_threshold "u16_rspeed_rpm" VALUE 0x4000874C RL_VALUE_UWORD 0 CM_u16_rspeed_rpm 0 65535 /end CHARACTERISTIC
/begin CHARACTERISTIC CAL_cooling_fan_inhibit_window_end_5s "undefined1" VALUE 0x4000875F RL_VALUE_UBYTE 0 NO_COMPU_METHOD 0 255 /end CHARACTERISTIC
/begin CHARACTERISTIC CAL_cooling_recirc_timer "Calibration: cooling recirc timer (s)." VALUE 0x40008760 RL_VALUE_UBYTE 0 CM_u8_time_s 0 255 /end CHARACTERISTIC
/begin CHARACTERISTIC CAL_cooling_fan_inhibit_temp_drop_threshold "Calibration: cooling fan inhibit temperature drop threshold (°C = val*5/8−40)." VALUE 0x40008762 RL_VALUE_UBYTE 0 CM_u8_temp_5_8_40c -40 119.375 /end CHARACTERISTIC
/begin CHARACTERISTIC CAL_cooling_fan_inhibit_resample_period_100ms "undefined1" VALUE 0x40008763 RL_VALUE_UBYTE 0 NO_COMPU_METHOD 0 255 /end CHARACTERISTIC
/begin CHARACTERISTIC CAL_idle_unknown4 "u8_rspeed_8rpm" VALUE 0x40008764 RL_VALUE_UBYTE 0 CM_u8_rspeed_8rpm 0 2040 /end CHARACTERISTIC
/begin CHARACTERISTIC CAL_idle_unknown3 "u8_rspeed_8rpm" VALUE 0x40008765 RL_VALUE_UBYTE 0 CM_u8_rspeed_8rpm 0 2040 /end CHARACTERISTIC
/begin CHARACTERISTIC CAL_cooling_fan_inhibit_window_start_5s "undefined1" VALUE 0x40008766 RL_VALUE_UBYTE 0 NO_COMPU_METHOD 0 255 /end CHARACTERISTIC
/begin CHARACTERISTIC CAL_trans_gear_ratio_tour "Calibration: transmission gear ratio tour (10-element array)." VAL_BLK 0x40008788 RL_VALUE_UWORD 0 NO_COMPU_METHOD 0 65535 NUMBER 10 /end CHARACTERISTIC
/begin CHARACTERISTIC CAL_cooling_engine_bay_fan_enable_delay "Calibration: cooling engine bay fan enable delay." VALUE 0x400087AC RL_VALUE_UWORD 0 NO_COMPU_METHOD 0 65535 /end CHARACTERISTIC
/begin CHARACTERISTIC CAL_idle_air_control_unknown "undefined1" VALUE 0x400087C3 RL_VALUE_UBYTE 0 NO_COMPU_METHOD 0 255 /end CHARACTERISTIC
/begin CHARACTERISTIC CAL_idle_unknown2 "u8_rspeed_8rpm" VALUE 0x400087C7 RL_VALUE_UBYTE 0 CM_u8_rspeed_8rpm 0 2040 /end CHARACTERISTIC
/begin CHARACTERISTIC CAL_idle_unknown1 "u8_rspeed_8rpm" VALUE 0x400087C8 RL_VALUE_UBYTE 0 CM_u8_rspeed_8rpm 0 2040 /end CHARACTERISTIC
/begin CHARACTERISTIC CAL_obd_ii_o2_response_load_stability_max "undefined1" VALUE 0x400087CA RL_VALUE_UBYTE 0 NO_COMPU_METHOD 0 255 /end CHARACTERISTIC
/begin CHARACTERISTIC CAL_idle_tps_max_opening "Calibration: idle throttle position maximum opening (val/1023)." VALUE 0x400087E4 RL_VALUE_UWORD 0 CM_u16_factor_1_1023 0 6406.15835777126 /end CHARACTERISTIC
/begin CHARACTERISTIC CAL_evap_commanded_purge_unknown "Calibration: evaporative commanded purge (val/255)." VALUE 0x400087FA RL_VALUE_UWORD 0 CM_u8_factor_1_255 0 25700 /end CHARACTERISTIC
/begin CHARACTERISTIC CAL_obd_ii_commanded_evap_purge_max "undefined1" VALUE 0x40008802 RL_VALUE_UBYTE 0 NO_COMPU_METHOD 0 255 /end CHARACTERISTIC
/begin CHARACTERISTIC CAL_obd_ii_commanded_evap_purge_min "undefined1" VALUE 0x40008803 RL_VALUE_UBYTE 0 NO_COMPU_METHOD 0 255 /end CHARACTERISTIC
/begin CHARACTERISTIC CAL_vvt_pwm_driver_divisor "Calibration: VVT PWM driver divisor." VALUE 0x40008804 RL_VALUE_UWORD 0 NO_COMPU_METHOD 0 65535 /end CHARACTERISTIC
/begin CHARACTERISTIC CAL_exhaust_flap_sport_mode_enable "Calibration: exhaust flap sport mode enable (boolean flag)." VALUE 0x40008806 RL_VALUE_UBYTE 0 NO_COMPU_METHOD 0 255 /end CHARACTERISTIC
/begin CHARACTERISTIC CAL_exhaust_flap_tour_mode_enable "Calibration: exhaust flap tour mode enable (boolean flag)." VALUE 0x40008807 RL_VALUE_UBYTE 0 NO_COMPU_METHOD 0 255 /end CHARACTERISTIC
/begin CHARACTERISTIC CAL_vvt_error_gain_startup "Calibration: VVT error gain startup (val/255)." VALUE 0x40008812 RL_VALUE_UWORD 0 CM_u8_factor_1_255 0 25700 /end CHARACTERISTIC
/begin CHARACTERISTIC CAL_vvt_integral_gain "Calibration: VVT integral gain." VALUE 0x40008814 RL_VALUE_UWORD 0 NO_COMPU_METHOD 0 65535 /end CHARACTERISTIC
/begin CHARACTERISTIC CAL_idle_flow_adj1_maf_accum_max "undefined2" VALUE 0x40008816 RL_VALUE_UWORD 0 NO_COMPU_METHOD 0 65535 /end CHARACTERISTIC
/begin CHARACTERISTIC CAL_cooling_recirc_enginespeed_disable_engine_on "Calibration: cooling recirc enginespeed disable engine on (RPM)." VALUE 0x4000881A RL_VALUE_UWORD 0 CM_u16_rspeed_rpm 0 65535 /end CHARACTERISTIC
/begin CHARACTERISTIC CAL_revlimit_fuelcut_hysteresis "Calibration: rev-limit fuelcut hysteresis (RPM)." VALUE 0x40008820 RL_VALUE_UWORD 0 CM_u16_rspeed_rpm 0 65535 /end CHARACTERISTIC
/begin CHARACTERISTIC CAL_trans_gear_lookup_unknown2 "Calibration: transmission gear lookup unknown2 (2-element array)." VAL_BLK 0x40008824 RL_VALUE_UWORD 0 NO_COMPU_METHOD 0 65535 NUMBER 2 /end CHARACTERISTIC
/begin CHARACTERISTIC CAL_evap_purge_power_enrich_suspend_timeout "undefined1" VALUE 0x40008829 RL_VALUE_UBYTE 0 NO_COMPU_METHOD 0 255 /end CHARACTERISTIC
/begin CHARACTERISTIC CAL_revlimit_startup_offset_decrement "Calibration: rev-limit startup offset decrement." VALUE 0x40008854 RL_VALUE_UBYTE 0 NO_COMPU_METHOD 0 255 /end CHARACTERISTIC
/begin CHARACTERISTIC CAL_idle_rpm_ramp_step "uint8_t" VALUE 0x40008858 RL_VALUE_UBYTE 0 NO_COMPU_METHOD 0 255 /end CHARACTERISTIC
/begin CHARACTERISTIC CAL_torque_tps_gain "u8_factor_1/255" VALUE 0x4000885F RL_VALUE_UBYTE 0 CM_u8_factor_1_255 0 100 /end CHARACTERISTIC
/begin CHARACTERISTIC CAL_torque_limit_tps_filter_coeff "u8_factor_1/1023" VALUE 0x40008876 RL_VALUE_UBYTE 0 CM_u16_factor_1_1023 0 24.9266862170088 /end CHARACTERISTIC
/begin CHARACTERISTIC CAL_cooling_recirc_airtemp_disable_engine_on "Calibration: cooling recirc airtemp disable engine on (°C = val*5/8−40)." VALUE 0x4000887A RL_VALUE_UBYTE 0 CM_u8_temp_5_8_40c -40 119.375 /end CHARACTERISTIC
/begin CHARACTERISTIC CAL_cooling_recirc_rpm_enable_engine_on "Calibration: cooling recirc RPM enable engine on (RPM)." VALUE 0x4000887C RL_VALUE_UWORD 0 CM_u16_rspeed_rpm 0 65535 /end CHARACTERISTIC
/begin CHARACTERISTIC CAL_idle_air_fast_decay_period "undefined1" VALUE 0x40008889 RL_VALUE_UBYTE 0 NO_COMPU_METHOD 0 255 /end CHARACTERISTIC
/begin CHARACTERISTIC CAL_exhaust_flap_RPM_threshold_open "Calibration: exhaust flap RPM threshold open (RPM)." VALUE 0x4000888A RL_VALUE_UWORD 0 CM_u16_rspeed_rpm 0 65535 /end CHARACTERISTIC
/begin CHARACTERISTIC CAL_exhaust_flap_RPM_threshold_close "Calibration: exhaust flap RPM threshold close (RPM)." VALUE 0x4000888C RL_VALUE_UWORD 0 CM_u16_rspeed_rpm 0 65535 /end CHARACTERISTIC
/begin CHARACTERISTIC CAL_exhaust_flap_startup_threshold "Calibration: exhaust flap startup threshold (ms = val*100)." VALUE 0x40008893 RL_VALUE_UBYTE 0 CM_u8_time_100ms 0 25500 /end CHARACTERISTIC
/begin CHARACTERISTIC CAL_revlimit_flow_proportional_limit "Calibration: rev-limit flow proportional term (g)." VALUE 0x40008894 RL_VALUE_UBYTE 0 CM_u8_mass_g 0 255 /end CHARACTERISTIC
/begin CHARACTERISTIC CAL_revlimit_flow_integral_limit "Calibration: rev-limit flow unknown2 (g)." VALUE 0x40008895 RL_VALUE_UBYTE 0 CM_u8_mass_g 0 255 /end CHARACTERISTIC
/begin CHARACTERISTIC CAL_revlimit_maf_error_max_10g "Calibration: rev-limit MAF error maximum 10g." VALUE 0x40008896 RL_VALUE_UBYTE 0 NO_COMPU_METHOD 0 255 /end CHARACTERISTIC
/begin CHARACTERISTIC CAL_revlimit_integrator_limit "Calibration: rev-limit integrator limit (val/100)." VALUE 0x40008897 RL_VALUE_UBYTE 0 CM_u8_factor_1_100 0 255 /end CHARACTERISTIC
/begin CHARACTERISTIC CAL_revlimit_rpm_rate_limit "Calibration: rev-limit RPM rate limit (RPM = val*25)." VALUE 0x40008898 RL_VALUE_UBYTE 0 CM_u8_rspeed_25rpm 0 6375 /end CHARACTERISTIC
/begin CHARACTERISTIC CAL_revlimit_flow_rpm_rate_limit "u8_factor_1/100" VALUE 0x40008899 RL_VALUE_UBYTE 0 CM_u8_factor_1_100 0 255 /end CHARACTERISTIC
/begin CHARACTERISTIC CAL_wheel_speed_front_dvdt_scaling "Calibration: wheel speed front dvdt scaling (val/255)." VALUE 0x400088AD RL_VALUE_UBYTE 0 CM_u8_factor_1_255 0 100 /end CHARACTERISTIC
/begin CHARACTERISTIC CAL_revlimit_throttle_clamp "Calibration: rev-limit throttle clamp (boolean flag)." VALUE 0x400088B1 RL_VALUE_UBYTE 0 NO_COMPU_METHOD 0 255 /end CHARACTERISTIC
/begin CHARACTERISTIC CAL_revlimit_release_rpm_delta "Calibration: rev-limit scaler (RPM = val*10)." VALUE 0x400088B2 RL_VALUE_UBYTE 0 CM_u8_rspeed_10rpm 0 2550 /end CHARACTERISTIC
/begin CHARACTERISTIC CAL_revlimit_overspeed_time "Calibration: rev-limit overspeed time (ms = val*100)." VALUE 0x400088B3 RL_VALUE_UBYTE 0 CM_u8_time_100ms 0 25500 /end CHARACTERISTIC
/begin CHARACTERISTIC CAL_revlimit_max_with_speedlimit "Calibration: rev-limit maximum with speedlimit (RPM)." VALUE 0x400088B4 RL_VALUE_UWORD 0 CM_u16_rspeed_rpm 0 65535 /end CHARACTERISTIC
/begin CHARACTERISTIC CAL_revlimit_overrun_count_threshold "Calibration: rev-limit overrun count threshold." VALUE 0x400088B7 RL_VALUE_UBYTE 0 NO_COMPU_METHOD 0 255 /end CHARACTERISTIC
/begin CHARACTERISTIC CAL_idle_rpm_ramp_step_ips "uint8_t" VALUE 0x400088BE RL_VALUE_UBYTE 0 NO_COMPU_METHOD 0 255 /end CHARACTERISTIC
/begin CHARACTERISTIC CAL_vvt_low_load_disable "Calibration: VVT low load disable (boolean flag)." VALUE 0x400088E5 RL_VALUE_UBYTE 0 NO_COMPU_METHOD 0 255 /end CHARACTERISTIC
/begin CHARACTERISTIC CAL_obd_ii_diag_unknown "Calibration: OBD-II diag." VALUE 0x400088E6 RL_VALUE_UBYTE 0 NO_COMPU_METHOD 0 255 /end CHARACTERISTIC
/begin CHARACTERISTIC CAL_vvt_low_load_map_enable_temp "Calibration: VVT low load MAP enable temperature (°C = val*5/8−40)." VALUE 0x400088E7 RL_VALUE_UBYTE 0 CM_u8_temp_5_8_40c -40 119.375 /end CHARACTERISTIC
/begin CHARACTERISTIC CAL_oil_pressure_warning_light_mode "Calibration: oil pressure warning light mode (enumerated state)." VALUE 0x400088EA RL_VALUE_UBYTE 0 NO_COMPU_METHOD 0 255 /end CHARACTERISTIC
/begin CHARACTERISTIC CAL_revlimit_startup_delay "Calibration: rev-limit startup delay (ms = val*250)." VALUE 0x400088F0 RL_VALUE_UBYTE 0 CM_u8_time_250ms 0 63750 /end CHARACTERISTIC
/begin CHARACTERISTIC CAL_revlimit_coolant_coldstart_threshold "Calibration: rev-limit coolant coldstart threshold (°C = val*5/8−40)." VALUE 0x400088F1 RL_VALUE_UBYTE 0 CM_u8_temp_5_8_40c -40 119.375 /end CHARACTERISTIC
/begin CHARACTERISTIC CAL_ips_speed_match_p_gain "undefined" VALUE 0x400088F2 RL_VALUE_ULONG 0 NO_COMPU_METHOD 0 4294967295 /end CHARACTERISTIC
/begin CHARACTERISTIC CAL_torque_estimate_min_ips "undefined2" VALUE 0x4000890E RL_VALUE_UWORD 0 NO_COMPU_METHOD 0 65535 /end CHARACTERISTIC
/begin CHARACTERISTIC CAL_ips_torque_reduction_slow_scale_pct "u8_factor_1/255" VALUE 0x40008910 RL_VALUE_UBYTE 0 CM_u8_factor_1_255 0 100 /end CHARACTERISTIC
/begin CHARACTERISTIC CAL_ips_torque_reduction_slow_floor_nm_ "u8_torque_nm" VALUE 0x40008911 RL_VALUE_UBYTE 0 CM_u8_torque_nm 0 255 /end CHARACTERISTIC
/begin CHARACTERISTIC CAL_idle_unknown6 "u8_temp_5/8-40c" VALUE 0x40008912 RL_VALUE_UBYTE 0 CM_u8_temp_5_8_40c -40 119.375 /end CHARACTERISTIC
/begin CHARACTERISTIC CAL_idle_learn_temp_range "Calibration: idle learn temperature range (°C = val*5/8−40; 2-element array)." VAL_BLK 0x40008913 RL_VALUE_UBYTE 0 CM_u8_temp_5_8_40c -40 119.375 NUMBER 2 /end CHARACTERISTIC
/begin CHARACTERISTIC CAL_vvt_low_load_ips_enable "Calibration: VVT low load IPS enable (boolean flag)." VALUE 0x4000891E RL_VALUE_UBYTE 0 NO_COMPU_METHOD 0 255 /end CHARACTERISTIC
/begin CHARACTERISTIC CAL_revlimit_enforce_delay_after_start "Calibration: rev-limit enforce delay after start (ms = val*50)." VALUE 0x40008923 RL_VALUE_UBYTE 0 CM_u8_time_50ms 0 12750 /end CHARACTERISTIC
/begin CHARACTERISTIC CAL_exhaust_flap_load_threshold_open "Calibration: exhaust flap load threshold open (mg/stroke = val*4)." VALUE 0x4000892A RL_VALUE_UBYTE 0 CM_u8_load_4mg_stroke 0 1020 /end CHARACTERISTIC
/begin CHARACTERISTIC CAL_exhaust_flap_load_threshold_close "Calibration: exhaust flap load threshold close (mg/stroke = val*4)." VALUE 0x4000892B RL_VALUE_UBYTE 0 CM_u8_load_4mg_stroke 0 1020 /end CHARACTERISTIC
/begin CHARACTERISTIC CAL_torque_hysteresis_threshold1 "Calibration: torque hysteresis threshold1 (Nm)." VALUE 0x4000892C RL_VALUE_UBYTE 0 CM_u8_torque_nm 0 255 /end CHARACTERISTIC
/begin CHARACTERISTIC CAL_idle_low_car_speed_exit "Calibration: idle low car speed exit (km/h)." VALUE 0x40008944 RL_VALUE_UBYTE 0 CM_u8_speed_kph 0 255 /end CHARACTERISTIC
/begin CHARACTERISTIC CAL_idle_low_car_speed_enter "Calibration: idle low car speed enter (km/h)." VALUE 0x40008945 RL_VALUE_UBYTE 0 CM_u8_speed_kph 0 255 /end CHARACTERISTIC
/begin CHARACTERISTIC CAL_cooling_fan_low_rpm_hysteresis_threshold "Calibration: cooling fan low RPM hysteresis threshold (RPM = val*4; 2-element array)." VAL_BLK 0x40008952 RL_VALUE_UBYTE 0 CM_u8_rspeed_4rpm 0 1020 NUMBER 2 /end CHARACTERISTIC
/begin CHARACTERISTIC CAL_oil_pressure_switch_voltage_scaling "Calibration: oil pressure switch voltage scaling (mbar)." VALUE 0x40008954 RL_VALUE_UWORD 0 CM_u16_pressure_mbar 0 65535 /end CHARACTERISTIC
/begin CHARACTERISTIC CAL_oil_pressure_switch_offset "Calibration: oil pressure switch offset (mbar)." VALUE 0x40008956 RL_VALUE_UWORD 0 CM_u16_pressure_mbar 0 65535 /end CHARACTERISTIC
/begin CHARACTERISTIC CAL_torque_proportional_limit_positive "Calibration: torque proportional limit positive (val/1023)." VALUE 0x40008980 RL_VALUE_UWORD 0 CM_u16_factor_1_1023 0 6406.15835777126 /end CHARACTERISTIC
/begin CHARACTERISTIC CAL_torque_proportional_limit_negative "Calibration: torque proportional limit negative (val/1023)." VALUE 0x40008982 RL_VALUE_UWORD 0 CM_u16_factor_1_1023 0 6406.15835777126 /end CHARACTERISTIC
/begin CHARACTERISTIC CAL_torque_integral_limit_positive "Calibration: torque integral limit positive (val/4095)." VALUE 0x40008984 RL_VALUE_UWORD 0 CM_u16_factor_1_4095 0 1600.3663003663 /end CHARACTERISTIC
/begin CHARACTERISTIC CAL_torque_integral_limit_negative "Calibration: torque integral limit negative (val/4095)." VALUE 0x40008986 RL_VALUE_UWORD 0 CM_u16_factor_1_4095 0 1600.3663003663 /end CHARACTERISTIC
/begin CHARACTERISTIC CAL_revlimit_torque_limit_confirmation_threshold "Calibration: rev-limit torque limit confirmation threshold (Nm = val*2)." VALUE 0x40008988 RL_VALUE_UBYTE 0 CM_u8_torque_2nm 0 510 /end CHARACTERISTIC
/begin CHARACTERISTIC CAL_torque_limit_integral_update_period "u8_time_ms" VALUE 0x40008989 RL_VALUE_UBYTE 0 CM_u8_time_ms 0 255 /end CHARACTERISTIC
/begin CHARACTERISTIC CAL_torque_limit_integral_deadband "Calibration: torque limit integral deadband." VALUE 0x4000898A RL_VALUE_UBYTE 0 NO_COMPU_METHOD 0 255 /end CHARACTERISTIC
/begin AXIS_PTS CAL_idle_comp_accel_pedal_pos_X_pps "Calibration: X-axis (pps) for the idle compensation accelerator pedal position table (val/255; 8-element array)." 0x400089B6 V_CAL_idle_comp_accel_pedal_pos_X_pps RL_AXIS_UBYTE 0 CM_u8_factor_1_255 8 0 100 /end AXIS_PTS
/begin CHARACTERISTIC CAL_idle_comp_accel_pedal_pos "Calibration: idle compensation accelerator pedal position (8-element array)." CURVE 0x400089BE RL_VALUE_UBYTE 0 NO_COMPU_METHOD 0 255
 /begin AXIS_DESCR COM_AXIS V_CAL_idle_comp_accel_pedal_pos_X_pps CM_u8_factor_1_255 8 0 100 AXIS_PTS_REF CAL_idle_comp_accel_pedal_pos_X_pps /end AXIS_DESCR
/end CHARACTERISTIC
/begin AXIS_PTS CAL_evap_purge_warmup_time_X_coolant_temp "Calibration: X-axis (coolant temp) for the evaporative purge warmup time table (°C = val*5/8−40; 8-element array)." 0x40008D1E coolant_temp RL_AXIS_UBYTE 0 CM_u8_temp_5_8_40c 8 -40 119.375 /end AXIS_PTS
/begin CHARACTERISTIC CAL_evap_purge_warmup_time "Calibration: evaporative purge warmup time (8-element array)." CURVE 0x40008D26 RL_VALUE_UBYTE 0 NO_COMPU_METHOD 0 255
 /begin AXIS_DESCR COM_AXIS coolant_temp CM_u8_temp_5_8_40c 8 -40 119.375 AXIS_PTS_REF CAL_evap_purge_warmup_time_X_coolant_temp /end AXIS_DESCR
/end CHARACTERISTIC
/begin AXIS_PTS CAL_idle_comp_iat_X_iat "Calibration: X-axis (iat) for the idle compensation intake air temp table (°C = val*5/8−40; 8-element array)." 0x40008D56 temp_engine_air RL_AXIS_UBYTE 0 CM_u8_temp_5_8_40c 8 -40 119.375 /end AXIS_PTS
/begin CHARACTERISTIC CAL_idle_comp_iat "Calibration: idle compensation intake air temp (RPM; 8-element array)." CURVE 0x40008D5E RL_VALUE_UBYTE 0 CM_u16_rspeed_rpm 0 255
 /begin AXIS_DESCR COM_AXIS temp_engine_air CM_u8_temp_5_8_40c 8 -40 119.375 AXIS_PTS_REF CAL_idle_comp_iat_X_iat /end AXIS_DESCR
/end CHARACTERISTIC
/begin AXIS_PTS CAL_torque_limit_proportional_X_load_error "Calibration: X-axis (load error) for the torque limit proportional table (8-element array)." 0x40008E48 NO_INPUT_QUANTITY RL_AXIS_UBYTE 0 CM_u8__127 8 -127 128 /end AXIS_PTS
/begin CHARACTERISTIC CAL_torque_limit_proportional "Calibration: torque limit proportional (val/255; 8-element array)." CURVE 0x40008E50 RL_VALUE_UBYTE 0 CM_u8_factor_1_255 0 100
 /begin AXIS_DESCR COM_AXIS NO_INPUT_QUANTITY CM_u8__127 8 -127 128 AXIS_PTS_REF CAL_torque_limit_proportional_X_load_error /end AXIS_DESCR
/end CHARACTERISTIC
/begin AXIS_PTS CAL_vvt_intake_advance_base_X_engine_speed "Calibration: X-axis (engine speed) for the VVT intake advance base table (RPM = val*125/4+500; 16-element array)." 0x40008E7A engine_speed_8bit RL_AXIS_UBYTE 0 CM_u8_rspeed_125_4_500rpm 16 500 8468.75 /end AXIS_PTS
/begin AXIS_PTS CAL_vvt_intake_advance_base_Y_load "Calibration: Y-axis (load) for the VVT intake advance base table (mg/stroke = val*4; 16-element array)." 0x40008E8A load_mass_per_stroke RL_AXIS_UBYTE 0 CM_u8_load_4mg_stroke 16 0 1020 /end AXIS_PTS
/begin CHARACTERISTIC CAL_vvt_intake_advance_base "Calibration: VVT intake advance base (° = val/4; 256-element array)." MAP 0x40008E9A RL_VALUE_UBYTE 0 CM_u8_angle_1_4deg 0 63.75
 /begin AXIS_DESCR COM_AXIS engine_speed_8bit CM_u8_rspeed_125_4_500rpm 16 500 8468.75 AXIS_PTS_REF CAL_vvt_intake_advance_base_X_engine_speed /end AXIS_DESCR
 /begin AXIS_DESCR COM_AXIS load_mass_per_stroke CM_u8_load_4mg_stroke 16 0 1020 AXIS_PTS_REF CAL_vvt_intake_advance_base_Y_load /end AXIS_DESCR
/end CHARACTERISTIC
/begin AXIS_PTS CAL_vvt_intake_advance_coolant_offset_X_temp "Calibration: X-axis (temp) for the VVT intake advance coolant offset table (°C = val*5/8−40; 16-element array)." 0x40008F9A coolant_temp RL_AXIS_UBYTE 0 CM_u8_temp_5_8_40c 16 -40 119.375 /end AXIS_PTS
/begin CHARACTERISTIC CAL_vvt_intake_advance_coolant_offset "Calibration: VVT intake advance coolant offset (° = val/4; 16-element array)." CURVE 0x40008FAA RL_VALUE_UBYTE 0 CM_u8_angle_1_4deg 0 63.75
 /begin AXIS_DESCR COM_AXIS coolant_temp CM_u8_temp_5_8_40c 16 -40 119.375 AXIS_PTS_REF CAL_vvt_intake_advance_coolant_offset_X_temp /end AXIS_DESCR
/end CHARACTERISTIC
/begin AXIS_PTS CAL_torque_engine_ac_load_base_X_ac "Calibration: X-axis (ac) for the torque engine A/C load base table (16-element array)." 0x4000913E NO_INPUT_QUANTITY RL_AXIS_UBYTE 0 NO_COMPU_METHOD 16 0 255 /end AXIS_PTS
/begin CHARACTERISTIC CAL_torque_engine_ac_load_base "Calibration: torque engine A/C load base (Nm; 16-element array)." CURVE 0x4000914E RL_VALUE_UBYTE 0 CM_u8_torque_nm 0 255
 /begin AXIS_DESCR COM_AXIS NO_INPUT_QUANTITY NO_COMPU_METHOD 16 0 255 AXIS_PTS_REF CAL_torque_engine_ac_load_base_X_ac /end AXIS_DESCR
/end CHARACTERISTIC
/begin AXIS_PTS CAL_idle_target_manual_tour_X_coolant_temp "Calibration: X-axis (coolant temp) for the idle target manual tour table (°C = val*5/8−40; 16-element array)." 0x400091C2 NO_INPUT_QUANTITY RL_AXIS_UBYTE 0 CM_u8_temp_5_8_40c 16 -40 119.375 /end AXIS_PTS
/begin CHARACTERISTIC CAL_idle_target_manual_tour "Calibration: idle target manual tour (RPM = val*4+500; 16-element array)." CURVE 0x400091D2 RL_VALUE_UBYTE 0 CM_u8_rspeed_4_500rpm 500 1520
 /begin AXIS_DESCR COM_AXIS NO_INPUT_QUANTITY CM_u8_temp_5_8_40c 16 -40 119.375 AXIS_PTS_REF CAL_idle_target_manual_tour_X_coolant_temp /end AXIS_DESCR
/end CHARACTERISTIC
/begin CHARACTERISTIC CAL_idle_air_warmup_factor_manual_X_coolant_temp "undefined" VALUE 0x400091E2 RL_VALUE_ULONG 0 NO_COMPU_METHOD 0 4294967295 /end CHARACTERISTIC
/begin CHARACTERISTIC CAL_idle_air_warmup_factor_manual_Y_maf_accumulated "undefined" VALUE 0x400091F2 RL_VALUE_ULONG 0 NO_COMPU_METHOD 0 4294967295 /end CHARACTERISTIC
/begin CHARACTERISTIC CAL_idle_air_warmup_factor_manual "undefined" VALUE 0x400091FA RL_VALUE_ULONG 0 NO_COMPU_METHOD 0 4294967295 /end CHARACTERISTIC
/begin AXIS_PTS CAL_idle_comp_ac_X_ac_load "Calibration: X-axis (ac load) for the idle compensation A/C table (8-element array)." 0x4000929A NO_INPUT_QUANTITY RL_AXIS_UWORD 0 NO_COMPU_METHOD 8 0 65535 /end AXIS_PTS
/begin CHARACTERISTIC CAL_idle_comp_ac "Calibration: idle compensation A/C (8-element array)." CURVE 0x400092AA RL_VALUE_UWORD 0 NO_COMPU_METHOD 0 65535
 /begin AXIS_DESCR COM_AXIS NO_INPUT_QUANTITY NO_COMPU_METHOD 8 0 65535 AXIS_PTS_REF CAL_idle_comp_ac_X_ac_load /end AXIS_DESCR
/end CHARACTERISTIC
/begin AXIS_PTS CAL_idle_comp_baro2_X_ambient_baro "Calibration: X-axis (ambiant baro) for the idle compensation baro2 table (mbar; 8-element array)." 0x4000941A obd_ii_atmospheric_baro RL_AXIS_UWORD 0 CM_u16_pressure_mbar 8 0 65535 /end AXIS_PTS
/begin CHARACTERISTIC CAL_idle_comp_baro2 "Calibration: idle compensation baro2 (8-element array)." CURVE 0x4000942A RL_VALUE_SWORD 0 NO_COMPU_METHOD -32768 32767
 /begin AXIS_DESCR COM_AXIS obd_ii_atmospheric_baro CM_u16_pressure_mbar 8 0 65535 AXIS_PTS_REF CAL_idle_comp_baro2_X_ambient_baro /end AXIS_DESCR
/end CHARACTERISTIC
/begin AXIS_PTS CAL_dpm_torque_cut_p_term_X_carspeed "Calibration: X-axis (carspeed) for the driver performance mode torque cut factor table (km/h = val/100; 6-element array)." 0x4000996A NO_INPUT_QUANTITY RL_AXIS_UWORD 0 CM_u8_speed_1_100kph 6 0 655.35 /end AXIS_PTS
/begin AXIS_PTS CAL_dpm_torque_cut_p_term_Y_slip "Calibration: Y-axis (slip) for the driver performance mode torque cut factor table (% = val/8; 10-element array)." 0x40009976 NO_INPUT_QUANTITY RL_AXIS_UWORD 0 CM_u16_slip_1_8pct 10 0 8191.875 /end AXIS_PTS
/begin CHARACTERISTIC CAL_dpm_torque_cut_p_term "dpm_torque_cut_factor is the proportional part of the GT430's ECU traction control. Once the filtered slip error (how far wheel slip is above the target) passes CAL_dpm_intervention_threshold, the ECU looks it up in the 6×10 table CAL_dpm_torque_cut_" MAP 0x4000998A RL_VALUE_UWORD 0 CM_u8_factor_1_255 0 25700
 /begin AXIS_DESCR COM_AXIS NO_INPUT_QUANTITY CM_u8_speed_1_100kph 6 0 655.35 AXIS_PTS_REF CAL_dpm_torque_cut_p_term_X_carspeed /end AXIS_DESCR
 /begin AXIS_DESCR COM_AXIS NO_INPUT_QUANTITY CM_u16_slip_1_8pct 10 0 8191.875 AXIS_PTS_REF CAL_dpm_torque_cut_p_term_Y_slip /end AXIS_DESCR
/end CHARACTERISTIC
/begin AXIS_PTS CAL_dpm_slip_target_from_pedal_X_carspeed "Calibration: X-axis (carspeed) for the driver performance mode slip target compensation pedal table (km/h; 6-element array)." 0x40009A02 dpm_vehicle_speed_kph RL_AXIS_UBYTE 0 CM_u8_speed_kph 6 0 255 /end AXIS_PTS
/begin AXIS_PTS CAL_dpm_slip_target_from_pedal_Y_pps "Calibration: Y-axis (pps) for the driver performance mode slip target compensation pedal table (val/255; 6-element array)." 0x40009A08 V_CAL_dpm_slip_target_from_pedal_Y_pps RL_AXIS_UBYTE 0 CM_u8_factor_1_255 6 0 100 /end AXIS_PTS
/begin CHARACTERISTIC CAL_dpm_slip_target_from_pedal "Calibration: driver performance mode slip target compensation pedal (% = val*2; 36-element array)." MAP 0x40009A0E RL_VALUE_UBYTE 0 CM_u8_slip_2pct 0 510
 /begin AXIS_DESCR COM_AXIS dpm_vehicle_speed_kph CM_u8_speed_kph 6 0 255 AXIS_PTS_REF CAL_dpm_slip_target_from_pedal_X_carspeed /end AXIS_DESCR
 /begin AXIS_DESCR COM_AXIS V_CAL_dpm_slip_target_from_pedal_Y_pps CM_u8_factor_1_255 6 0 100 AXIS_PTS_REF CAL_dpm_slip_target_from_pedal_Y_pps /end AXIS_DESCR
/end CHARACTERISTIC
/begin AXIS_PTS CAL_idle_target_manual_sport_X_coolant_temp "Calibration: X-axis (coolant temp) for the idle target manual sport table (°C = val*5/8−40; 16-element array)." 0x40009A3A NO_INPUT_QUANTITY RL_AXIS_UBYTE 0 CM_u8_temp_5_8_40c 16 -40 119.375 /end AXIS_PTS
/begin CHARACTERISTIC CAL_idle_target_manual_sport "Calibration: idle target manual sport (RPM = val*4+500; 16-element array)." CURVE 0x40009A4A RL_VALUE_UBYTE 0 CM_u8_rspeed_4_500rpm 500 1520
 /begin AXIS_DESCR COM_AXIS NO_INPUT_QUANTITY CM_u8_temp_5_8_40c 16 -40 119.375 AXIS_PTS_REF CAL_idle_target_manual_sport_X_coolant_temp /end AXIS_DESCR
/end CHARACTERISTIC
/begin AXIS_PTS CAL_vvt_exhaust_advance_base_X_engine_speed "Calibration: X-axis (engine speed) for the VVT exhaust advance base table (RPM = val*125/4+500; 16-element array)." 0x40009A7A engine_speed_8bit RL_AXIS_UBYTE 0 CM_u8_rspeed_125_4_500rpm 16 500 8468.75 /end AXIS_PTS
/begin AXIS_PTS CAL_vvt_exhaust_advance_base_Y_load "Calibration: Y-axis (load) for the VVT exhaust advance base table (mg/stroke = val*4; 16-element array)." 0x40009A8A load_mass_per_stroke RL_AXIS_UBYTE 0 CM_u8_load_4mg_stroke 16 0 1020 /end AXIS_PTS
/begin CHARACTERISTIC CAL_vvt_exhaust_advance_base "Calibration: VVT exhaust advance base (° = val/4; 256-element array)." MAP 0x40009A9A RL_VALUE_UBYTE 0 CM_u8_angle_1_4deg 0 63.75
 /begin AXIS_DESCR COM_AXIS engine_speed_8bit CM_u8_rspeed_125_4_500rpm 16 500 8468.75 AXIS_PTS_REF CAL_vvt_exhaust_advance_base_X_engine_speed /end AXIS_DESCR
 /begin AXIS_DESCR COM_AXIS load_mass_per_stroke CM_u8_load_4mg_stroke 16 0 1020 AXIS_PTS_REF CAL_vvt_exhaust_advance_base_Y_load /end AXIS_DESCR
/end CHARACTERISTIC
/begin AXIS_PTS CAL_torque_engine_ac_load_scaler_X_engine_speed "Calibration: X-axis (engine speed) for the torque engine A/C load scaler table (RPM = val*125/4+500; 8-element array)." 0x40009CD6 engine_speed_8bit RL_AXIS_UBYTE 0 CM_u8_rspeed_125_4_500rpm 8 500 8468.75 /end AXIS_PTS
/begin CHARACTERISTIC CAL_torque_engine_ac_load_scaler "Calibration: torque engine A/C load scaler (val/255; 8-element array)." CURVE 0x40009CDE RL_VALUE_UBYTE 0 CM_u8_factor_1_255 0 100
 /begin AXIS_DESCR COM_AXIS engine_speed_8bit CM_u8_rspeed_125_4_500rpm 8 500 8468.75 AXIS_PTS_REF CAL_torque_engine_ac_load_scaler_X_engine_speed /end AXIS_DESCR
/end CHARACTERISTIC
/begin AXIS_PTS CAL_torque_limit_by_coolant_X_coolant "Calibration: X-axis (coolant) for the torque limit by coolant table (°C = val*5/8−40; 4-element array)." 0x40009D0E coolant_temp RL_AXIS_UBYTE 0 CM_u8_temp_5_8_40c 4 -40 119.375 /end AXIS_PTS
/begin CHARACTERISTIC CAL_torque_limit_by_coolant "*WARNING* This table has been patched to double the torque values. Each 8bit value represents 4nm of torque." CURVE 0x40009D12 RL_VALUE_UBYTE 0 CM_u8_torque_4nm 0 1020
 /begin AXIS_DESCR COM_AXIS coolant_temp CM_u8_temp_5_8_40c 4 -40 119.375 AXIS_PTS_REF CAL_torque_limit_by_coolant_X_coolant /end AXIS_DESCR
/end CHARACTERISTIC
/begin AXIS_PTS CAL_idle_comp_tps_while_cranking_X_baro "Calibration: X-axis (baro) for the idle compensation throttle position while cranking table (mbar = val*4; 4-element array)." 0x40009DD2 NO_INPUT_QUANTITY RL_AXIS_UBYTE 0 CM_u8_pressure_4mbar 4 0 1020 /end AXIS_PTS
/begin AXIS_PTS CAL_idle_comp_tps_while_cranking_Y_coolant_temp "Calibration: Y-axis (coolant temp) for the idle compensation throttle position while cranking table (°C = val*5/8−40; 16-element array)." 0x40009DD6 coolant_temp RL_AXIS_UBYTE 0 CM_u8_temp_5_8_40c 16 -40 119.375 /end AXIS_PTS
/begin CHARACTERISTIC CAL_idle_comp_tps_while_cranking "Calibration: idle compensation throttle position while cranking (val/255; 64-element array)." MAP 0x40009DE6 RL_VALUE_UBYTE 0 CM_u8_factor_1_255 0 100
 /begin AXIS_DESCR COM_AXIS NO_INPUT_QUANTITY CM_u8_pressure_4mbar 4 0 1020 AXIS_PTS_REF CAL_idle_comp_tps_while_cranking_X_baro /end AXIS_DESCR
 /begin AXIS_DESCR COM_AXIS coolant_temp CM_u8_temp_5_8_40c 16 -40 119.375 AXIS_PTS_REF CAL_idle_comp_tps_while_cranking_Y_coolant_temp /end AXIS_DESCR
/end CHARACTERISTIC
/begin AXIS_PTS CAL_idle_airflow_expected_X_rpm "Calibration: X-axis (rpm) for the idle airflow expected table (RPM; 16-element array)." 0x40009E4A obd_ii_idle_speed_target_total RL_AXIS_UWORD 0 CM_u16_rspeed_rpm 16 0 65535 /end AXIS_PTS
/begin CHARACTERISTIC CAL_idle_airflow_expected "Calibration: idle airflow expected (16-element array)." CURVE 0x40009E6A RL_VALUE_UWORD 0 NO_COMPU_METHOD 0 65535
 /begin AXIS_DESCR COM_AXIS obd_ii_idle_speed_target_total CM_u16_rspeed_rpm 16 0 65535 AXIS_PTS_REF CAL_idle_airflow_expected_X_rpm /end AXIS_DESCR
/end CHARACTERISTIC
/begin AXIS_PTS CAL_cooling_fan_afterrun_X_air_temp "Calibration: X-axis (air temp) for the cooling fan afterrun table (°C = val*5/8−40; 8-element array)." 0x40009E8A temp_engine_air RL_AXIS_UBYTE 0 CM_u8_temp_5_8_40c 8 -40 119.375 /end AXIS_PTS
/begin AXIS_PTS CAL_cooling_fan_afterrun_Y_coolant_temp "Calibration: Y-axis (coolant temp) for the cooling fan afterrun table (°C = val*5/8−40; 8-element array)." 0x40009E92 coolant_temp RL_AXIS_UBYTE 0 CM_u8_temp_5_8_40c 8 -40 119.375 /end AXIS_PTS
/begin CHARACTERISTIC CAL_cooling_fan_afterrun "Calibration: cooling fan afterrun (ms = val*250; 64-element array)." MAP 0x40009E9A RL_VALUE_UBYTE 0 CM_u8_time_5s 0 1275
 /begin AXIS_DESCR COM_AXIS temp_engine_air CM_u8_temp_5_8_40c 8 -40 119.375 AXIS_PTS_REF CAL_cooling_fan_afterrun_X_air_temp /end AXIS_DESCR
 /begin AXIS_DESCR COM_AXIS coolant_temp CM_u8_temp_5_8_40c 8 -40 119.375 AXIS_PTS_REF CAL_cooling_fan_afterrun_Y_coolant_temp /end AXIS_DESCR
/end CHARACTERISTIC
/begin AXIS_PTS CAL_idle_comp_fan_X_duty_cycle "Calibration: X-axis (duty cycle) for the idle compensation fan table (8-element array)." 0x40009EDA radiator_fan_duty_cycle_target RL_AXIS_UWORD 0 NO_COMPU_METHOD 8 0 65535 /end AXIS_PTS
/begin CHARACTERISTIC CAL_idle_comp_fan "Calibration: idle compensation fan (8-element array)." CURVE 0x40009EEA RL_VALUE_UWORD 0 NO_COMPU_METHOD 0 65535
 /begin AXIS_DESCR COM_AXIS radiator_fan_duty_cycle_target NO_COMPU_METHOD 8 0 65535 AXIS_PTS_REF CAL_idle_comp_fan_X_duty_cycle /end AXIS_DESCR
/end CHARACTERISTIC
/begin AXIS_PTS CAL_idle_comp_carspeed_manual_X_carspeed "Calibration: X-axis (carspeed) for the idle compensation carspeed manual table (km/h; 8-element array)." 0x40009F2A car_speed_u8 RL_AXIS_UBYTE 0 CM_u8_speed_kph 8 0 255 /end AXIS_PTS
/begin CHARACTERISTIC CAL_idle_comp_carspeed_manual "Calibration: idle compensation carspeed manual (RPM = val*4; 8-element array)." CURVE 0x40009F32 RL_VALUE_UBYTE 0 CM_u8_rspeed_4rpm 0 1020
 /begin AXIS_DESCR COM_AXIS car_speed_u8 CM_u8_speed_kph 8 0 255 AXIS_PTS_REF CAL_idle_comp_carspeed_manual_X_carspeed /end AXIS_DESCR
/end CHARACTERISTIC
/begin AXIS_PTS CAL_idle_comp_timer_carspeed_manual_X_airtemp "Calibration: X-axis (airtemp) for the idle compensation timer carspeed manual table (°C = val*5/8−40; 8-element array)." 0x40009F4A NO_INPUT_QUANTITY RL_AXIS_UBYTE 0 CM_u8_temp_5_8_40c 8 -40 119.375 /end AXIS_PTS
/begin AXIS_PTS CAL_idle_comp_timer_carspeed_manual_Y_time_above_speed "Calibration: Y-axis (time above speed) for the idle compensation timer carspeed manual table (8-element array)." 0x40009F52 timer_above_min_carspeed RL_AXIS_UBYTE 0 NO_COMPU_METHOD 8 0 255 /end AXIS_PTS
/begin CHARACTERISTIC CAL_idle_comp_timer_carspeed_manual "Calibration: idle compensation timer carspeed manual (RPM = val*8; 64-element array)." MAP 0x40009F5A RL_VALUE_UBYTE 0 CM_u8_rspeed_8rpm 0 2040
 /begin AXIS_DESCR COM_AXIS NO_INPUT_QUANTITY CM_u8_temp_5_8_40c 8 -40 119.375 AXIS_PTS_REF CAL_idle_comp_timer_carspeed_manual_X_airtemp /end AXIS_DESCR
 /begin AXIS_DESCR COM_AXIS timer_above_min_carspeed NO_COMPU_METHOD 8 0 255 AXIS_PTS_REF CAL_idle_comp_timer_carspeed_manual_Y_time_above_speed /end AXIS_DESCR
/end CHARACTERISTIC
/begin AXIS_PTS CAL_torque_engine_friction_speed_component_X_engine_speed "Calibration: X-axis (engine speed) for the torque engine friction speed component table (RPM = val*125/4+500; 20-element array)." 0x4000A56A engine_speed_8bit RL_AXIS_UBYTE 0 CM_u8_rspeed_125_4_500rpm 20 500 8468.75 /end AXIS_PTS
/begin AXIS_PTS CAL_torque_engine_friction_speed_component_Y_load "Calibration: Y-axis (load) for the torque engine friction speed component table (mg/stroke = val*1173; 20-element array)." 0x4000A57E NO_INPUT_QUANTITY RL_AXIS_UBYTE 0 CM_u8_load_1173mg_255stroke 20 0 1173 /end AXIS_PTS
/begin CHARACTERISTIC CAL_torque_engine_friction_speed_component "Calibration: torque engine friction speed component (Nm; 400-element array)." MAP 0x4000A592 RL_VALUE_UBYTE 0 CM_u8_torque_nm 0 255
 /begin AXIS_DESCR COM_AXIS engine_speed_8bit CM_u8_rspeed_125_4_500rpm 20 500 8468.75 AXIS_PTS_REF CAL_torque_engine_friction_speed_component_X_engine_speed /end AXIS_DESCR
 /begin AXIS_DESCR COM_AXIS NO_INPUT_QUANTITY CM_u8_load_1173mg_255stroke 20 0 1173 AXIS_PTS_REF CAL_torque_engine_friction_speed_component_Y_load /end AXIS_DESCR
/end CHARACTERISTIC
/begin AXIS_PTS CAL_idle_comp_vehicle_speed_manual_X_carspeed "Calibration: X-axis (carspeed) for the idle compensation vehicle speed manual table (km/h = val/100; 8-element array)." 0x4000A942 car_speed_x100 RL_AXIS_UWORD 0 CM_u8_speed_1_100kph 8 0 655.35 /end AXIS_PTS
/begin CHARACTERISTIC CAL_idle_comp_vehicle_speed_manual "Calibration: idle compensation vehicle speed manual (8-element array)." CURVE 0x4000A952 RL_VALUE_UWORD 0 NO_COMPU_METHOD 0 65535
 /begin AXIS_DESCR COM_AXIS car_speed_x100 CM_u8_speed_1_100kph 8 0 655.35 AXIS_PTS_REF CAL_idle_comp_vehicle_speed_manual_X_carspeed /end AXIS_DESCR
/end CHARACTERISTIC
/begin AXIS_PTS CAL_revlimit_speedbase_manual_tour_X_coolant_temp "Calibration: X-axis (coolant temp) for the rev-limit speedbase manual tour table (°C = val*5/8−40; 4-element array)." 0x4000A972 coolant_temp RL_AXIS_UWORD 0 CM_u8_temp_5_8_40c 4 -40 40919.375 /end AXIS_PTS
/begin AXIS_PTS CAL_revlimit_speedbase_manual_tour_Y_timer "Calibration: Y-axis (timer) for the rev-limit speedbase manual tour table (ms = val*5; 4-element array)." 0x4000A97A NO_INPUT_QUANTITY RL_AXIS_UWORD 0 CM_u8_time_5ms 4 0 327675 /end AXIS_PTS
/begin CHARACTERISTIC CAL_revlimit_speedbase_manual_tour "Calibration: rev-limit speedbase manual tour (RPM; 16-element array)." MAP 0x4000A982 RL_VALUE_UWORD 0 CM_u16_rspeed_rpm 0 65535
 /begin AXIS_DESCR COM_AXIS coolant_temp CM_u8_temp_5_8_40c 4 -40 40919.375 AXIS_PTS_REF CAL_revlimit_speedbase_manual_tour_X_coolant_temp /end AXIS_DESCR
 /begin AXIS_DESCR COM_AXIS NO_INPUT_QUANTITY CM_u8_time_5ms 4 0 327675 AXIS_PTS_REF CAL_revlimit_speedbase_manual_tour_Y_timer /end AXIS_DESCR
/end CHARACTERISTIC
/begin AXIS_PTS CAL_idle_comp_ecu_voltage_X_voltage "Calibration: X-axis (voltage) for the idle compensation ECU voltage table (V = val*18/1023; 8-element array)." 0x4000A9A2 sensor_adc_ecu_voltage RL_AXIS_UWORD 0 CM_u16_voltage_18_1023v 8 0 1153.10850439883 /end AXIS_PTS
/begin CHARACTERISTIC CAL_idle_comp_ecu_voltage "Calibration: idle compensation ECU voltage (8-element array)." CURVE 0x4000A9B2 RL_VALUE_SWORD 0 NO_COMPU_METHOD -32768 32767
 /begin AXIS_DESCR COM_AXIS sensor_adc_ecu_voltage CM_u16_voltage_18_1023v 8 0 1153.10850439883 AXIS_PTS_REF CAL_idle_comp_ecu_voltage_X_voltage /end AXIS_DESCR
/end CHARACTERISTIC
/begin AXIS_PTS CAL_vvt_start_timer_X_coolant_temp "Calibration: X-axis (coolant temp) for the VVT start timer table (°C = val*5/8−40; 8-element array)." 0x4000AA12 coolant_temp_engine_stopped RL_AXIS_UBYTE 0 CM_u8_temp_5_8_40c 8 -40 119.375 /end AXIS_PTS
/begin CHARACTERISTIC CAL_vvt_start_timer "Calibration: VVT start timer (ms = val*100; 8-element array)." CURVE 0x4000AA1A RL_VALUE_UBYTE 0 CM_u8_time_100ms 0 25500
 /begin AXIS_DESCR COM_AXIS coolant_temp_engine_stopped CM_u8_temp_5_8_40c 8 -40 119.375 AXIS_PTS_REF CAL_vvt_start_timer_X_coolant_temp /end AXIS_DESCR
/end CHARACTERISTIC
/begin AXIS_PTS CAL_cooling_fan_ac_on_X_air_temp "Calibration: X-axis (air temp) for the cooling fan A/C on table (°C = val*5/8−40; 6-element array)." 0x4000AC82 temp_engine_air_cooling_control RL_AXIS_UBYTE 0 CM_u8_temp_5_8_40c 6 -40 119.375 /end AXIS_PTS
/begin AXIS_PTS CAL_cooling_fan_ac_on_Y_carspeed "Calibration: Y-axis (carspeed) for the cooling fan A/C on table (6-element array)." 0x4000AC88 NO_INPUT_QUANTITY RL_AXIS_UBYTE 0 NO_COMPU_METHOD 6 0 255 /end AXIS_PTS
/begin CHARACTERISTIC CAL_cooling_fan_ac_on "Calibration: cooling fan A/C on (% = val*100/255; 36-element array)." MAP 0x4000AC8E RL_VALUE_UBYTE 0 CM_u8_factor_1_255 0 100
 /begin AXIS_DESCR COM_AXIS temp_engine_air_cooling_control CM_u8_temp_5_8_40c 6 -40 119.375 AXIS_PTS_REF CAL_cooling_fan_ac_on_X_air_temp /end AXIS_DESCR
 /begin AXIS_DESCR COM_AXIS NO_INPUT_QUANTITY NO_COMPU_METHOD 6 0 255 AXIS_PTS_REF CAL_cooling_fan_ac_on_Y_carspeed /end AXIS_DESCR
/end CHARACTERISTIC
/begin AXIS_PTS CAL_idle_comp_vehicle_speed_ips_X_vehicle_speed "Calibration: X-axis (vehicle speed) for the idle compensation vehicle speed IPS table (km/h = val/100; 8-element array)." 0x4000ACB2 car_speed_x100 RL_AXIS_UWORD 0 CM_u8_speed_1_100kph 8 0 655.35 /end AXIS_PTS
/begin CHARACTERISTIC CAL_idle_comp_vehicle_speed_ips "Calibration: idle compensation vehicle speed IPS (8-element array)." CURVE 0x4000ACC2 RL_VALUE_UWORD 0 NO_COMPU_METHOD 0 65535
 /begin AXIS_DESCR COM_AXIS car_speed_x100 CM_u8_speed_1_100kph 8 0 655.35 AXIS_PTS_REF CAL_idle_comp_vehicle_speed_ips_X_vehicle_speed /end AXIS_DESCR
/end CHARACTERISTIC
/begin AXIS_PTS CAL_revlimit_escalation_integrator_step_X_gear "Calibration: X-axis (gear) for the rev-limit escalation integrator step table (7-element array)." 0x4000AD92 car_current_gear RL_AXIS_UBYTE 0 NO_COMPU_METHOD 7 0 255 /end AXIS_PTS
/begin CHARACTERISTIC CAL_revlimit_escalation_integrator_step "Calibration: rev-limit escalation integrator step (7-element array)." CURVE 0x4000AD99 RL_VALUE_UBYTE 0 NO_COMPU_METHOD 0 255
 /begin AXIS_DESCR COM_AXIS car_current_gear NO_COMPU_METHOD 7 0 255 AXIS_PTS_REF CAL_revlimit_escalation_integrator_step_X_gear /end AXIS_DESCR
/end CHARACTERISTIC
/begin AXIS_PTS CAL_torque_limit_integral_X_load_error "Calibration: X-axis (load error) for the torque limit integral table (8-element array)." 0x4000ADC2 NO_INPUT_QUANTITY RL_AXIS_UBYTE 0 CM_u8__127 8 -127 128 /end AXIS_PTS
/begin CHARACTERISTIC CAL_torque_limit_integral "Calibration: torque limit integral (val/255; 8-element array)." CURVE 0x4000ADCA RL_VALUE_UBYTE 0 CM_u8_factor_1_255 0 100
 /begin AXIS_DESCR COM_AXIS NO_INPUT_QUANTITY CM_u8__127 8 -127 128 AXIS_PTS_REF CAL_torque_limit_integral_X_load_error /end AXIS_DESCR
/end CHARACTERISTIC
/begin AXIS_PTS CAL_idle_target_ips_coolant_fallback_X_coolant_temp "Calibration: X-axis (coolant temp) for the idle target IPS coolant fallback table (°C = val*5/8−40; 16-element array)." 0x4000ADD2 NO_INPUT_QUANTITY RL_AXIS_UBYTE 0 CM_u8_temp_5_8_40c 16 -40 119.375 /end AXIS_PTS
/begin CHARACTERISTIC CAL_idle_target_ips_coolant_fallback "Calibration: idle target IPS coolant fallback (RPM = val*4+500; 16-element array)." CURVE 0x4000ADE2 RL_VALUE_UBYTE 0 CM_u8_rspeed_4_500rpm 500 1520
 /begin AXIS_DESCR COM_AXIS NO_INPUT_QUANTITY CM_u8_temp_5_8_40c 16 -40 119.375 AXIS_PTS_REF CAL_idle_target_ips_coolant_fallback_X_coolant_temp /end AXIS_DESCR
/end CHARACTERISTIC
/begin AXIS_PTS CAL_torque_limit_by_rpm_X_gear "Calibration: X-axis (gear) for the torque limit by RPM table (8-element array)." 0x4000AFAA car_current_gear RL_AXIS_UBYTE 0 NO_COMPU_METHOD 8 0 255 /end AXIS_PTS
/begin AXIS_PTS CAL_torque_limit_by_rpm_Y_rpm "Calibration: Y-axis (rpm) for the torque limit by RPM table (RPM = val*125/4+500; 8-element array)." 0x4000AFB2 engine_speed_8bit RL_AXIS_UBYTE 0 CM_u8_rspeed_125_4_500rpm 8 500 8468.75 /end AXIS_PTS
/begin CHARACTERISTIC CAL_torque_limit_by_rpm "*WARNING* This table has been patched to double the torque values. Each 8bit value represents 4nm of torque." MAP 0x4000AFBA RL_VALUE_UBYTE 0 CM_u8_torque_4nm 0 1020
 /begin AXIS_DESCR COM_AXIS car_current_gear NO_COMPU_METHOD 8 0 255 AXIS_PTS_REF CAL_torque_limit_by_rpm_X_gear /end AXIS_DESCR
 /begin AXIS_DESCR COM_AXIS engine_speed_8bit CM_u8_rspeed_125_4_500rpm 8 500 8468.75 AXIS_PTS_REF CAL_torque_limit_by_rpm_Y_rpm /end AXIS_DESCR
/end CHARACTERISTIC
/begin AXIS_PTS CAL_evap_purge_flow_coefficient_X_dutycycle "Calibration: X-axis (dutycycle) for the evaporative purge flow coefficient table (val/255; 16-element array)." 0x4000B182 NO_INPUT_QUANTITY RL_AXIS_UBYTE 0 CM_u8_factor_1_255 16 0 100 /end AXIS_PTS
/begin AXIS_PTS CAL_evap_purge_flow_coefficient_Y_vacuum "Calibration: Y-axis (vacuum) for the evaporative purge flow coefficient table (mbar = val*4; 16-element array)." 0x4000B192 NO_INPUT_QUANTITY RL_AXIS_UBYTE 0 CM_u8_pressure_4mbar 16 0 1020 /end AXIS_PTS
/begin CHARACTERISTIC CAL_evap_purge_flow_coefficient "Calibration: evaporative purge flow coefficient (256-element array)." MAP 0x4000B1A2 RL_VALUE_UBYTE 0 NO_COMPU_METHOD 0 255
 /begin AXIS_DESCR COM_AXIS NO_INPUT_QUANTITY CM_u8_factor_1_255 16 0 100 AXIS_PTS_REF CAL_evap_purge_flow_coefficient_X_dutycycle /end AXIS_DESCR
 /begin AXIS_DESCR COM_AXIS NO_INPUT_QUANTITY CM_u8_pressure_4mbar 16 0 1020 AXIS_PTS_REF CAL_evap_purge_flow_coefficient_Y_vacuum /end AXIS_DESCR
/end CHARACTERISTIC
/begin AXIS_PTS CAL_torque_torque_to_load_X_engine_speed "Calibration: X-axis (engine speed) for the torque torque to load table (RPM; 16-element array)." 0x4000B64A engine_speed_16bit RL_AXIS_UWORD 0 CM_u16_rspeed_rpm 16 0 65535 /end AXIS_PTS
/begin AXIS_PTS CAL_torque_torque_to_load_Y_torque "Calibration: Y-axis (torque) for the torque torque to load table (Nm; 16-element array)." 0x4000B66A NO_INPUT_QUANTITY RL_AXIS_UWORD 0 CM_u8_torque_nm 16 0 65535 /end AXIS_PTS
/begin CHARACTERISTIC CAL_torque_torque_to_load "Calibration: torque torque to load (mg/stroke; 256-element array)." MAP 0x4000B68A RL_VALUE_UWORD 0 CM_u16_load_mg_stroke 0 65535
 /begin AXIS_DESCR COM_AXIS engine_speed_16bit CM_u16_rspeed_rpm 16 0 65535 AXIS_PTS_REF CAL_torque_torque_to_load_X_engine_speed /end AXIS_DESCR
 /begin AXIS_DESCR COM_AXIS NO_INPUT_QUANTITY CM_u8_torque_nm 16 0 65535 AXIS_PTS_REF CAL_torque_torque_to_load_Y_torque /end AXIS_DESCR
/end CHARACTERISTIC
/begin AXIS_PTS CAL_torque_ign_retard_base_X_engine_speed "Calibration: X-axis (engine speed) for the torque ignition retard base table (RPM = val*125/4+500; 16-element array)." 0x4000B88A engine_speed_8bit RL_AXIS_UBYTE 0 CM_u8_rspeed_125_4_500rpm 16 500 8468.75 /end AXIS_PTS
/begin AXIS_PTS CAL_torque_ign_retard_base_Y_torque_reduction_factor "Calibration: Y-axis (torque reduction factor) for the torque ignition retard base table (val/255; 16-element array)." 0x4000B89A torque_reduction_factor_ign RL_AXIS_UBYTE 0 CM_u8_factor_1_255 16 0 100 /end AXIS_PTS
/begin CHARACTERISTIC CAL_torque_ign_retard_base "Calibration: torque ignition retard base (° = val/4−64; 256-element array)." MAP 0x4000B8AA RL_VALUE_UBYTE 0 CM_u8_angle_1_4_64deg -64 -0.25
 /begin AXIS_DESCR COM_AXIS engine_speed_8bit CM_u8_rspeed_125_4_500rpm 16 500 8468.75 AXIS_PTS_REF CAL_torque_ign_retard_base_X_engine_speed /end AXIS_DESCR
 /begin AXIS_DESCR COM_AXIS torque_reduction_factor_ign CM_u8_factor_1_255 16 0 100 AXIS_PTS_REF CAL_torque_ign_retard_base_Y_torque_reduction_factor /end AXIS_DESCR
/end CHARACTERISTIC
/begin AXIS_PTS CAL_idle_target_ips_X_coolant_temp "Calibration: X-axis (coolant temp) for the idle target IPS table (°C = val*5/8−40; 16-element array)." 0x4000BACA coolant_temp RL_AXIS_UBYTE 0 CM_u8_temp_5_8_40c 16 -40 119.375 /end AXIS_PTS
/begin CHARACTERISTIC CAL_idle_target_ips "Calibration: idle target IPS (RPM = val*4+500; 16-element array)." CURVE 0x4000BADA RL_VALUE_UBYTE 0 CM_u8_rspeed_4_500rpm 500 1520
 /begin AXIS_DESCR COM_AXIS coolant_temp CM_u8_temp_5_8_40c 16 -40 119.375 AXIS_PTS_REF CAL_idle_target_ips_X_coolant_temp /end AXIS_DESCR
/end CHARACTERISTIC
/begin AXIS_PTS CAL_torque_limit_base_factor_X_rpm "Calibration: X-axis (rpm) for the torque limit base factor table (RPM = val*125/4+500; 16-element array)." 0x4000BAEA engine_speed_8bit RL_AXIS_UBYTE 0 CM_u8_rspeed_125_4_500rpm 16 500 8468.75 /end AXIS_PTS
/begin AXIS_PTS CAL_torque_limit_base_factor_Y_load "Calibration: Y-axis (load) for the torque limit base factor table (mg/stroke = val*4; 16-element array)." 0x4000BAFA load_mass_per_stroke RL_AXIS_UBYTE 0 CM_u8_load_4mg_stroke 16 0 1020 /end AXIS_PTS
/begin CHARACTERISTIC CAL_torque_limit_base_factor "// Used in cylinder cut calculation" MAP 0x4000BB0A RL_VALUE_UBYTE 0 CM_u8_factor_1_255 0 100
 /begin AXIS_DESCR COM_AXIS engine_speed_8bit CM_u8_rspeed_125_4_500rpm 16 500 8468.75 AXIS_PTS_REF CAL_torque_limit_base_factor_X_rpm /end AXIS_DESCR
 /begin AXIS_DESCR COM_AXIS load_mass_per_stroke CM_u8_load_4mg_stroke 16 0 1020 AXIS_PTS_REF CAL_torque_limit_base_factor_Y_load /end AXIS_DESCR
/end CHARACTERISTIC
/begin AXIS_PTS CAL_torque_engine_friction_temp_component_X_coolant "Calibration: X-axis (coolant) for the torque engine friction temperature component table (°C = val*5/8−40; 8-element array)." 0x4000BC0A coolant_temp RL_AXIS_UBYTE 0 CM_u8_temp_5_8_40c 8 -40 119.375 /end AXIS_PTS
/begin AXIS_PTS CAL_torque_engine_friction_temp_component_Y_load "Calibration: Y-axis (load) for the torque engine friction temperature component table (mg/stroke = val*4; 8-element array)." 0x4000BC12 load_mass_per_stroke RL_AXIS_UBYTE 0 CM_u8_load_4mg_stroke 8 0 1020 /end AXIS_PTS
/begin CHARACTERISTIC CAL_torque_engine_friction_temp_component "Calibration: torque engine friction temperature component (Nm; 64-element array)." MAP 0x4000BC1A RL_VALUE_UBYTE 0 CM_u8_torque_nm 0 255
 /begin AXIS_DESCR COM_AXIS coolant_temp CM_u8_temp_5_8_40c 8 -40 119.375 AXIS_PTS_REF CAL_torque_engine_friction_temp_component_X_coolant /end AXIS_DESCR
 /begin AXIS_DESCR COM_AXIS load_mass_per_stroke CM_u8_load_4mg_stroke 8 0 1020 AXIS_PTS_REF CAL_torque_engine_friction_temp_component_Y_load /end AXIS_DESCR
/end CHARACTERISTIC
/begin AXIS_PTS CAL_torque_spark_efficiency_X_rpm "Calibration: X-axis (rpm) for the torque spark efficiency table (16-element array)." 0x4000BC5A engine_speed_8bit RL_AXIS_UBYTE 0 NO_COMPU_METHOD 16 0 255 /end AXIS_PTS
/begin AXIS_PTS CAL_torque_spark_efficiency_Y_ign_retard_from_mbt "Calibration: Y-axis (ign retard from mbt) for the torque spark efficiency table (° = val/4; 16-element array)." 0x4000BC6A NO_INPUT_QUANTITY RL_AXIS_UBYTE 0 CM_u8_angle_1_4deg 16 0 63.75 /end AXIS_PTS
/begin CHARACTERISTIC CAL_torque_spark_efficiency "Calibration: torque spark efficiency (val/255; 256-element array)." MAP 0x4000BC7A RL_VALUE_UBYTE 0 CM_u8_factor_1_255 0 100
 /begin AXIS_DESCR COM_AXIS engine_speed_8bit NO_COMPU_METHOD 16 0 255 AXIS_PTS_REF CAL_torque_spark_efficiency_X_rpm /end AXIS_DESCR
 /begin AXIS_DESCR COM_AXIS NO_INPUT_QUANTITY CM_u8_angle_1_4deg 16 0 63.75 AXIS_PTS_REF CAL_torque_spark_efficiency_Y_ign_retard_from_mbt /end AXIS_DESCR
/end CHARACTERISTIC
/begin AXIS_PTS CAL_torque_spark_efficiency_slope_X_rpm "Calibration: X-axis (rpm) for the torque spark efficiency slope table (RPM = val*125/4+500; 16-element array)." 0x4000BD7A engine_speed_8bit RL_AXIS_UBYTE 0 CM_u8_rspeed_125_4_500rpm 16 500 8468.75 /end AXIS_PTS
/begin AXIS_PTS CAL_torque_spark_efficiency_slope_Y_load "Calibration: Y-axis (load) for the torque spark efficiency slope table (mg/stroke = val*4; 16-element array)." 0x4000BD8A load_mass_per_stroke RL_AXIS_UBYTE 0 CM_u8_load_4mg_stroke 16 0 1020 /end AXIS_PTS
/begin CHARACTERISTIC CAL_torque_spark_efficiency_slope "Calibration: torque spark efficiency slope (256-element array)." MAP 0x4000BD9A RL_VALUE_UBYTE 0 NO_COMPU_METHOD 0 255
 /begin AXIS_DESCR COM_AXIS engine_speed_8bit CM_u8_rspeed_125_4_500rpm 16 500 8468.75 AXIS_PTS_REF CAL_torque_spark_efficiency_slope_X_rpm /end AXIS_DESCR
 /begin AXIS_DESCR COM_AXIS load_mass_per_stroke CM_u8_load_4mg_stroke 16 0 1020 AXIS_PTS_REF CAL_torque_spark_efficiency_slope_Y_load /end AXIS_DESCR
/end CHARACTERISTIC
/begin AXIS_PTS CAL_revlimit_speedbase_manual_sport_X_coolant_temp "Calibration: X-axis (coolant temp) for the rev-limit speedbase manual sport table (°C = val*5/8−40; 4-element array)." 0x4000C01A coolant_temp RL_AXIS_UWORD 0 CM_u8_temp_5_8_40c 4 -40 40919.375 /end AXIS_PTS
/begin AXIS_PTS CAL_revlimit_speedbase_manual_sport_Y_timer "Calibration: Y-axis (timer) for the rev-limit speedbase manual sport table (ms = val*5; 4-element array)." 0x4000C022 NO_INPUT_QUANTITY RL_AXIS_UWORD 0 CM_u8_time_5ms 4 0 327675 /end AXIS_PTS
/begin CHARACTERISTIC CAL_revlimit_speedbase_manual_sport "Calibration: rev-limit speedbase manual sport (RPM; 16-element array)." MAP 0x4000C02A RL_VALUE_UWORD 0 CM_u16_rspeed_rpm 0 65535
 /begin AXIS_DESCR COM_AXIS coolant_temp CM_u8_temp_5_8_40c 4 -40 40919.375 AXIS_PTS_REF CAL_revlimit_speedbase_manual_sport_X_coolant_temp /end AXIS_DESCR
 /begin AXIS_DESCR COM_AXIS NO_INPUT_QUANTITY CM_u8_time_5ms 4 0 327675 AXIS_PTS_REF CAL_revlimit_speedbase_manual_sport_Y_timer /end AXIS_DESCR
/end CHARACTERISTIC
/begin AXIS_PTS CAL_revlimit_speedbase_ips_tour_X_coolant_temp "Calibration: X-axis (coolant temp) for the rev-limit speedbase IPS tour table (°C = val*5/8−40; 4-element array)." 0x4000C04A coolant_temp RL_AXIS_UWORD 0 CM_u8_temp_5_8_40c 4 -40 40919.375 /end AXIS_PTS
/begin AXIS_PTS CAL_revlimit_speedbase_ips_tour_Y_timer "Calibration: Y-axis (timer) for the rev-limit speedbase IPS tour table (ms = val*5; 4-element array)." 0x4000C052 NO_INPUT_QUANTITY RL_AXIS_UWORD 0 CM_u8_time_5ms 4 0 327675 /end AXIS_PTS
/begin CHARACTERISTIC CAL_revlimit_speedbase_ips_tour "Calibration: rev-limit speedbase IPS tour (RPM; 16-element array)." MAP 0x4000C05A RL_VALUE_UWORD 0 CM_u16_rspeed_rpm 0 65535
 /begin AXIS_DESCR COM_AXIS coolant_temp CM_u8_temp_5_8_40c 4 -40 40919.375 AXIS_PTS_REF CAL_revlimit_speedbase_ips_tour_X_coolant_temp /end AXIS_DESCR
 /begin AXIS_DESCR COM_AXIS NO_INPUT_QUANTITY CM_u8_time_5ms 4 0 327675 AXIS_PTS_REF CAL_revlimit_speedbase_ips_tour_Y_timer /end AXIS_DESCR
/end CHARACTERISTIC
/begin AXIS_PTS CAL_revlimit_speedbase_ips_sport_X_coolant_temp "Calibration: X-axis (coolant temp) for the rev-limit speedbase IPS sport table (°C = val*5/8−40; 4-element array)." 0x4000C07A coolant_temp RL_AXIS_UWORD 0 CM_u8_temp_5_8_40c 4 -40 40919.375 /end AXIS_PTS
/begin AXIS_PTS CAL_revlimit_speedbase_ips_sport_Y_timer "Calibration: Y-axis (timer) for the rev-limit speedbase IPS sport table (ms = val*5; 4-element array)." 0x4000C082 NO_INPUT_QUANTITY RL_AXIS_UWORD 0 CM_u8_time_5ms 4 0 327675 /end AXIS_PTS
/begin CHARACTERISTIC CAL_revlimit_speedbase_ips_sport "Calibration: rev-limit speedbase IPS sport (RPM; 16-element array)." MAP 0x4000C08A RL_VALUE_UWORD 0 CM_u16_rspeed_rpm 0 65535
 /begin AXIS_DESCR COM_AXIS coolant_temp CM_u8_temp_5_8_40c 4 -40 40919.375 AXIS_PTS_REF CAL_revlimit_speedbase_ips_sport_X_coolant_temp /end AXIS_DESCR
 /begin AXIS_DESCR COM_AXIS NO_INPUT_QUANTITY CM_u8_time_5ms 4 0 327675 AXIS_PTS_REF CAL_revlimit_speedbase_ips_sport_Y_timer /end AXIS_DESCR
/end CHARACTERISTIC
/begin AXIS_PTS CAL_revlimit_coldstart_rpm_envelope_X_index "Calibration: X-axis (index) for the rev-limit coldstart RPM envelope table (4-element array)." 0x4000C0AA NO_INPUT_QUANTITY RL_AXIS_UWORD 0 NO_COMPU_METHOD 4 0 65535 /end AXIS_PTS
/begin CHARACTERISTIC CAL_revlimit_coldstart_rpm_envelope "Calibration: rev-limit coldstart RPM envelope (RPM; 4-element array)." CURVE 0x4000C0B2 RL_VALUE_UWORD 0 CM_u16_rspeed_rpm 0 65535
 /begin AXIS_DESCR COM_AXIS NO_INPUT_QUANTITY NO_COMPU_METHOD 4 0 65535 AXIS_PTS_REF CAL_revlimit_coldstart_rpm_envelope_X_index /end AXIS_DESCR
/end CHARACTERISTIC
/begin AXIS_PTS CAL_idle_comp_carspeed_ips_X_carspeed "Calibration: X-axis (carspeed) for the idle compensation carspeed IPS table (km/h; 8-element array)." 0x4000C0BA car_speed_u8 RL_AXIS_UBYTE 0 CM_u8_speed_kph 8 0 255 /end AXIS_PTS
/begin CHARACTERISTIC CAL_idle_comp_carspeed_ips "Calibration: idle compensation carspeed IPS (RPM = val*4; 8-element array)." CURVE 0x4000C0C2 RL_VALUE_UBYTE 0 CM_u8_rspeed_4rpm 0 1020
 /begin AXIS_DESCR COM_AXIS car_speed_u8 CM_u8_speed_kph 8 0 255 AXIS_PTS_REF CAL_idle_comp_carspeed_ips_X_carspeed /end AXIS_DESCR
/end CHARACTERISTIC
/begin AXIS_PTS CAL_idle_comp_while_moving_X_rpm "Calibration: X-axis (rpm) for the idle compensation while moving table (RPM; 16-element array)." 0x4000C63A engine_speed_16bit RL_AXIS_UWORD 0 CM_u16_rspeed_rpm 16 0 65535 /end AXIS_PTS
/begin CHARACTERISTIC CAL_idle_comp_while_moving "Calibration: idle compensation while moving (mg/s = val*100; 16-element array)." CURVE 0x4000C65A RL_VALUE_UWORD 0 CM_u16_flow_100mg_s 0 6553500
 /begin AXIS_DESCR COM_AXIS engine_speed_16bit CM_u16_rspeed_rpm 16 0 65535 AXIS_PTS_REF CAL_idle_comp_while_moving_X_rpm /end AXIS_DESCR
/end CHARACTERISTIC
/begin AXIS_PTS CAL_vvt_exhaust_comp_temp_X_coolant_temp "Calibration: X-axis (coolant temp) for the VVT exhaust compensation temperature table (°C = val*5/8−40; 16-element array)." 0x4000C68A coolant_temp RL_AXIS_UBYTE 0 CM_u8_temp_5_8_40c 16 -40 119.375 /end AXIS_PTS
/begin CHARACTERISTIC CAL_vvt_exhaust_comp_temp "Calibration: VVT exhaust compensation temperature (° = val/4; 16-element array)." CURVE 0x4000C69A RL_VALUE_UBYTE 0 CM_u8_angle_1_4deg 0 63.75
 /begin AXIS_DESCR COM_AXIS coolant_temp CM_u8_temp_5_8_40c 16 -40 119.375 AXIS_PTS_REF CAL_vvt_exhaust_comp_temp_X_coolant_temp /end AXIS_DESCR
/end CHARACTERISTIC
/begin AXIS_PTS CAL_idle_comp_steering_X_steering_load "Calibration: X-axis (steering load) for the idle compensation steering table (4-element array)." 0x4000C6AA NO_INPUT_QUANTITY RL_AXIS_UBYTE 0 NO_COMPU_METHOD 4 0 255 /end AXIS_PTS
/begin CHARACTERISTIC CAL_idle_comp_steering "Calibration: idle compensation steering (4-element array)." CURVE 0x4000C6AE RL_VALUE_UBYTE 0 NO_COMPU_METHOD 0 255
 /begin AXIS_DESCR COM_AXIS NO_INPUT_QUANTITY NO_COMPU_METHOD 4 0 255 AXIS_PTS_REF CAL_idle_comp_steering_X_steering_load /end AXIS_DESCR
/end CHARACTERISTIC
/begin AXIS_PTS CAL_vvt_intake_advance_base_low_load_X_engine_speed "Calibration: X-axis (engine speed) for the VVT intake advance base low load table (RPM = val*125/4+500; 6-element array)." 0x4000C6F2 engine_speed_8bit RL_AXIS_UBYTE 0 CM_u8_rspeed_125_4_500rpm 6 500 8468.75 /end AXIS_PTS
/begin AXIS_PTS CAL_vvt_intake_advance_base_low_load_Y_load "Calibration: Y-axis (load) for the VVT intake advance base low load table (mg/stroke = val*4; 6-element array)." 0x4000C6F8 load_mass_per_stroke RL_AXIS_UBYTE 0 CM_u8_load_4mg_stroke 6 0 1020 /end AXIS_PTS
/begin CHARACTERISTIC CAL_vvt_intake_advance_base_low_load "Calibration: VVT intake advance base low load (° = val/4; 36-element array)." MAP 0x4000C6FE RL_VALUE_UBYTE 0 CM_u8_angle_1_4deg 0 63.75
 /begin AXIS_DESCR COM_AXIS engine_speed_8bit CM_u8_rspeed_125_4_500rpm 6 500 8468.75 AXIS_PTS_REF CAL_vvt_intake_advance_base_low_load_X_engine_speed /end AXIS_DESCR
 /begin AXIS_DESCR COM_AXIS load_mass_per_stroke CM_u8_load_4mg_stroke 6 0 1020 AXIS_PTS_REF CAL_vvt_intake_advance_base_low_load_Y_load /end AXIS_DESCR
/end CHARACTERISTIC
/begin AXIS_PTS CAL_vvt_exhaust_advance_base_low_load_X_engine_speed "Calibration: X-axis (engine speed) for the VVT exhaust advance base low load table (RPM = val*125/4+500; 6-element array)." 0x4000C76A engine_speed_8bit RL_AXIS_UBYTE 0 CM_u8_rspeed_125_4_500rpm 6 500 8468.75 /end AXIS_PTS
/begin AXIS_PTS CAL_vvt_exhaust_advance_base_low_load_Y_load "Calibration: Y-axis (load) for the VVT exhaust advance base low load table (mg/stroke = val*4; 6-element array)." 0x4000C770 load_mass_per_stroke RL_AXIS_UBYTE 0 CM_u8_load_4mg_stroke 6 0 1020 /end AXIS_PTS
/begin CHARACTERISTIC CAL_vvt_exhaust_advance_base_low_load "Calibration: VVT exhaust advance base low load (° = val/4; 36-element array)." MAP 0x4000C776 RL_VALUE_UBYTE 0 CM_u8_angle_1_4deg 0 63.75
 /begin AXIS_DESCR COM_AXIS engine_speed_8bit CM_u8_rspeed_125_4_500rpm 6 500 8468.75 AXIS_PTS_REF CAL_vvt_exhaust_advance_base_low_load_X_engine_speed /end AXIS_DESCR
 /begin AXIS_DESCR COM_AXIS load_mass_per_stroke CM_u8_load_4mg_stroke 6 0 1020 AXIS_PTS_REF CAL_vvt_exhaust_advance_base_low_load_Y_load /end AXIS_DESCR
/end CHARACTERISTIC
/begin AXIS_PTS CAL_idle_air_control_proportional_X_speed_error "Calibration: X-axis (speed error) for the idle air control proportional table (16-element array)." 0x4000C7A2 V_CAL_idle_air_control_proportional_X_speed_error RL_AXIS_UWORD 0 NO_COMPU_METHOD 16 0 65535 /end AXIS_PTS
/begin CHARACTERISTIC CAL_idle_air_control_proportional "Calibration: idle air control proportional (16-element array)." CURVE 0x4000C7C2 RL_VALUE_UWORD 0 NO_COMPU_METHOD 0 65535
 /begin AXIS_DESCR COM_AXIS V_CAL_idle_air_control_proportional_X_speed_error NO_COMPU_METHOD 16 0 65535 AXIS_PTS_REF CAL_idle_air_control_proportional_X_speed_error /end AXIS_DESCR
/end CHARACTERISTIC
/begin AXIS_PTS CAL_revlimit_trim_per_gear_X_gear "Calibration: X-axis (gear) for the rev-limit trim per gear table (7-element array)." 0x4000C84E car_current_gear RL_AXIS_UBYTE 0 NO_COMPU_METHOD 7 0 255 /end AXIS_PTS
/begin CHARACTERISTIC CAL_revlimit_trim_per_gear "Calibration: rev-limit trim per gear (RPM = val*2; 7-element array)." CURVE 0x4000C855 RL_VALUE_UBYTE 0 CM_u8_rspeed_2rpm 0 510
 /begin AXIS_DESCR COM_AXIS car_current_gear NO_COMPU_METHOD 7 0 255 AXIS_PTS_REF CAL_revlimit_trim_per_gear_X_gear /end AXIS_DESCR
/end CHARACTERISTIC
/begin AXIS_PTS CAL_revlimit_airflow_threshold_X_gear "Calibration: X-axis (gear) for the rev-limit airflow threshold table (7-element array)." 0x4000C85C car_current_gear RL_AXIS_UBYTE 0 NO_COMPU_METHOD 7 0 255 /end AXIS_PTS
/begin CHARACTERISTIC CAL_revlimit_airflow_threshold "Calibration: rev-limit airflow threshold (g/s = val*2; 7-element array)." CURVE 0x4000C863 RL_VALUE_UBYTE 0 CM_u8_flow_2g_s 0 510
 /begin AXIS_DESCR COM_AXIS car_current_gear NO_COMPU_METHOD 7 0 255 AXIS_PTS_REF CAL_revlimit_airflow_threshold_X_gear /end AXIS_DESCR
/end CHARACTERISTIC
/begin AXIS_PTS CAL_idle_error_correction_unknown_X_speed_error "Calibration: X-axis (speed error) for the idle error correction table (16-element array)." 0x4000C892 V_CAL_idle_error_correction_unknown_X_speed_error RL_AXIS_UWORD 0 NO_COMPU_METHOD 16 0 65535 /end AXIS_PTS
/begin CHARACTERISTIC CAL_idle_error_correction_unknown "Calibration: idle error correction (16-element array)." CURVE 0x4000C8B2 RL_VALUE_UWORD 0 NO_COMPU_METHOD 0 65535
 /begin AXIS_DESCR COM_AXIS V_CAL_idle_error_correction_unknown_X_speed_error NO_COMPU_METHOD 16 0 65535 AXIS_PTS_REF CAL_idle_error_correction_unknown_X_speed_error /end AXIS_DESCR
/end CHARACTERISTIC
/begin AXIS_PTS CAL_idle_comp_misfire_X_failed_cyl_count "Calibration: X-axis (failed cyl count) for the idle compensation misfire table (8-element array)." 0x4000C8F2 failed_ignition_cyl_count RL_AXIS_UBYTE 0 NO_COMPU_METHOD 8 0 255 /end AXIS_PTS
/begin CHARACTERISTIC CAL_idle_comp_misfire "Calibration: idle compensation misfire (g/s; 8-element array)." CURVE 0x4000C8FA RL_VALUE_UBYTE 0 CM_u8_flow_g_s 0 255
 /begin AXIS_DESCR COM_AXIS failed_ignition_cyl_count NO_COMPU_METHOD 8 0 255 AXIS_PTS_REF CAL_idle_comp_misfire_X_failed_cyl_count /end AXIS_DESCR
/end CHARACTERISTIC
/begin AXIS_PTS CAL_revlimit_airflow_gain_from_rpm_delta_X_gear "Calibration: X-axis (gear) for the rev-limit airflow gain from RPM delta table (7-element array)." 0x4000C992 car_current_gear RL_AXIS_UBYTE 0 NO_COMPU_METHOD 7 0 255 /end AXIS_PTS
/begin CHARACTERISTIC CAL_revlimit_airflow_gain_from_rpm_delta "Calibration: rev-limit airflow gain from RPM delta (val/255; 7-element array)." CURVE 0x4000C999 RL_VALUE_UBYTE 0 CM_u8_factor_1_255 0 100
 /begin AXIS_DESCR COM_AXIS car_current_gear NO_COMPU_METHOD 7 0 255 AXIS_PTS_REF CAL_revlimit_airflow_gain_from_rpm_delta_X_gear /end AXIS_DESCR
/end CHARACTERISTIC
/begin AXIS_PTS CAL_revlimit_airflow_gain_from_integrator_X_gear "Calibration: X-axis (gear) for the rev-limit airflow gain from integrator table (7-element array)." 0x4000C9A0 car_current_gear RL_AXIS_UBYTE 0 NO_COMPU_METHOD 7 0 255 /end AXIS_PTS
/begin CHARACTERISTIC CAL_revlimit_airflow_gain_from_integrator "Calibration: rev-limit airflow gain from integrator (val/255; 7-element array)." CURVE 0x4000C9A7 RL_VALUE_UBYTE 0 CM_u8_factor_1_255 0 100
 /begin AXIS_DESCR COM_AXIS car_current_gear NO_COMPU_METHOD 7 0 255 AXIS_PTS_REF CAL_revlimit_airflow_gain_from_integrator_X_gear /end AXIS_DESCR
/end CHARACTERISTIC
/begin AXIS_PTS CAL_revlimit_airflow_gain_from_rpm_X_gear "Calibration: X-axis (gear) for the rev-limit airflow gain from RPM table (7-element array)." 0x4000C9AE car_current_gear RL_AXIS_UBYTE 0 NO_COMPU_METHOD 7 0 255 /end AXIS_PTS
/begin CHARACTERISTIC CAL_revlimit_airflow_gain_from_rpm "Calibration: rev-limit airflow gain from RPM (val/255; 7-element array)." CURVE 0x4000C9B5 RL_VALUE_UBYTE 0 CM_u8_factor_1_255 0 100
 /begin AXIS_DESCR COM_AXIS car_current_gear NO_COMPU_METHOD 7 0 255 AXIS_PTS_REF CAL_revlimit_airflow_gain_from_rpm_X_gear /end AXIS_DESCR
/end CHARACTERISTIC
/begin CHARACTERISTIC CAL_obd_ii_coolant_warmup_thresholds "Calibration: OBD-II coolant warmup thresholds (2-element array)." VAL_BLK 0x4000C9C4 RL_VALUE_UBYTE 0 NO_COMPU_METHOD 0 255 NUMBER 2 /end CHARACTERISTIC
/begin CHARACTERISTIC CAL_obd_ii_similar_cond_load_window "undefined1" VALUE 0x4000C9C7 RL_VALUE_UBYTE 0 NO_COMPU_METHOD 0 255 /end CHARACTERISTIC
/begin CHARACTERISTIC CAL_obd_ii_cat_monitor_maf_min "undefined1" VALUE 0x4000C9C9 RL_VALUE_UBYTE 0 NO_COMPU_METHOD 0 255 /end CHARACTERISTIC
/begin CHARACTERISTIC CAL_obd_ii_o2_lean_period_excess_max "undefined2" VALUE 0x4000C9CE RL_VALUE_UWORD 0 NO_COMPU_METHOD 0 65535 /end CHARACTERISTIC
/begin CHARACTERISTIC CAL_obd_ii_o2_rich_period_excess_max "undefined2" VALUE 0x4000C9D0 RL_VALUE_UWORD 0 NO_COMPU_METHOD 0 65535 /end CHARACTERISTIC
/begin CHARACTERISTIC CAL_oil_pressure_low_timer_threshold "Calibration: oil pressure low timer threshold." VALUE 0x4000C9D6 RL_VALUE_UBYTE 0 NO_COMPU_METHOD 0 255 /end CHARACTERISTIC
/begin CHARACTERISTIC CAL_obd_ii_monitor_debounce_cycles "Calibration: OBD-II monitor debounce cycles." VALUE 0x4000C9D9 RL_VALUE_UBYTE 0 NO_COMPU_METHOD 0 255 /end CHARACTERISTIC
/begin CHARACTERISTIC CAL_evap_pressure_filter_coeff "undefined1" VALUE 0x4000C9E1 RL_VALUE_UBYTE 0 NO_COMPU_METHOD 0 255 /end CHARACTERISTIC
/begin CHARACTERISTIC CAL_obd_ii_o2_sensor1_voltage_threshold "undefined2" VALUE 0x4000C9E6 RL_VALUE_UWORD 0 NO_COMPU_METHOD 0 65535 /end CHARACTERISTIC
/begin CHARACTERISTIC CAL_obd_ii_o2_sensor1_voltage_limit "undefined2" VALUE 0x4000C9E8 RL_VALUE_UWORD 0 NO_COMPU_METHOD 0 65535 /end CHARACTERISTIC
/begin CHARACTERISTIC CAL_obd_ii_o2_sensor2_voltage_threshold "undefined2" VALUE 0x4000C9EA RL_VALUE_UWORD 0 NO_COMPU_METHOD 0 65535 /end CHARACTERISTIC
/begin CHARACTERISTIC CAL_obd_ii_o2_sensor2_voltage_limit "undefined2" VALUE 0x4000C9EC RL_VALUE_UWORD 0 NO_COMPU_METHOD 0 65535 /end CHARACTERISTIC
/begin CHARACTERISTIC CAL_obd_ii_cat_monitor_ect_min "undefined1" VALUE 0x4000C9F4 RL_VALUE_UBYTE 0 NO_COMPU_METHOD 0 255 /end CHARACTERISTIC
/begin CHARACTERISTIC CAL_obd_ii_P0420_maf_min "undefined2" VALUE 0x4000C9F6 RL_VALUE_UWORD 0 NO_COMPU_METHOD 0 65535 /end CHARACTERISTIC
/begin CHARACTERISTIC CAL_obd_ii_P0420_maf_max "undefined2" VALUE 0x4000C9F8 RL_VALUE_UWORD 0 NO_COMPU_METHOD 0 65535 /end CHARACTERISTIC
/begin CHARACTERISTIC CAL_obd_ii_postcat_o2_mean_filter_gain "Calibration: OBD-II postcat O2 voltage scaling." VALUE 0x4000C9FA RL_VALUE_UBYTE 0 CM_u8_factor_1_2560 0 9.9609375 /end CHARACTERISTIC
/begin CHARACTERISTIC CAL_obd_ii_o2_activity_rate_inband "undefined1" VALUE 0x4000C9FD RL_VALUE_UBYTE 0 NO_COMPU_METHOD 0 255 /end CHARACTERISTIC
/begin CHARACTERISTIC CAL_obd_ii_P0420_car_speed_max "undefined1" VALUE 0x4000C9FE RL_VALUE_UBYTE 0 NO_COMPU_METHOD 0 255 /end CHARACTERISTIC
/begin CHARACTERISTIC CAL_obd_ii_P0420_car_speed_min "undefined1" VALUE 0x4000C9FF RL_VALUE_UBYTE 0 NO_COMPU_METHOD 0 255 /end CHARACTERISTIC
/begin CHARACTERISTIC CAL_revlimit_limp_mode "Calibration: rev-limit limp mode (RPM)." VALUE 0x4000CA08 RL_VALUE_UWORD 0 CM_u16_rspeed_rpm 0 65535 /end CHARACTERISTIC
/begin CHARACTERISTIC CAL_obd_ii_o2_slow_response_arm_dwell "undefined2" VALUE 0x4000CA0A RL_VALUE_UWORD 0 NO_COMPU_METHOD 0 65535 /end CHARACTERISTIC
/begin CHARACTERISTIC CAL_obd_ii_cat_precat_o2_lean_thresh "undefined2" VALUE 0x4000CA16 RL_VALUE_UWORD 0 NO_COMPU_METHOD 0 65535 /end CHARACTERISTIC
/begin CHARACTERISTIC CAL_obd_ii_cat_precat_o2_rich_thresh "undefined2" VALUE 0x4000CA18 RL_VALUE_UWORD 0 NO_COMPU_METHOD 0 65535 /end CHARACTERISTIC
/begin CHARACTERISTIC CAL_obd_ii_postcat_o2_switch_band_lean "undefined2" VALUE 0x4000CA1A RL_VALUE_UWORD 0 NO_COMPU_METHOD 0 65535 /end CHARACTERISTIC
/begin CHARACTERISTIC CAL_obd_ii_postcat_o2_switch_band_rich "undefined2" VALUE 0x4000CA1C RL_VALUE_UWORD 0 NO_COMPU_METHOD 0 65535 /end CHARACTERISTIC
/begin CHARACTERISTIC CAL_obd_ii_cat_switch_ratio_fail_threshold "undefined2" VALUE 0x4000CA1E RL_VALUE_UWORD 0 NO_COMPU_METHOD 0 65535 /end CHARACTERISTIC
/begin CHARACTERISTIC CAL_obd_ii_vvt_exhaust_error_bank1_limit "undefined2" VALUE 0x4000CA20 RL_VALUE_UWORD 0 NO_COMPU_METHOD 0 65535 /end CHARACTERISTIC
/begin CHARACTERISTIC CAL_obd_P0171_ltft_limit "undefined2" VALUE 0x4000CA22 RL_VALUE_UWORD 0 NO_COMPU_METHOD 0 65535 /end CHARACTERISTIC
/begin CHARACTERISTIC CAL_obd_P0172_ltft_limit "undefined2" VALUE 0x4000CA24 RL_VALUE_UWORD 0 NO_COMPU_METHOD 0 65535 /end CHARACTERISTIC
/begin CHARACTERISTIC CAL_obd_ii_o2_response_car_speed_min "undefined1" VALUE 0x4000CA26 RL_VALUE_UBYTE 0 NO_COMPU_METHOD 0 255 /end CHARACTERISTIC
/begin CHARACTERISTIC CAL_obd_ii_o2_response_car_speed_max "undefined1" VALUE 0x4000CA27 RL_VALUE_UBYTE 0 NO_COMPU_METHOD 0 255 /end CHARACTERISTIC
/begin CHARACTERISTIC CAL_obd_ii_o2_transition_count "undefined1" VALUE 0x4000CA28 RL_VALUE_UBYTE 0 NO_COMPU_METHOD 0 255 /end CHARACTERISTIC
/begin CHARACTERISTIC CAL_obd_ii_mode06_o2_switch_time_min "uint16_t" VALUE 0x4000CA2A RL_VALUE_UWORD 0 NO_COMPU_METHOD 0 65535 /end CHARACTERISTIC
/begin CHARACTERISTIC CAL_obd_ii_mode06_o2_switch_time_max "undefined2" VALUE 0x4000CA2C RL_VALUE_UWORD 0 NO_COMPU_METHOD 0 65535 /end CHARACTERISTIC
/begin CHARACTERISTIC CAL_misfire_enable_coolant_min "Calibration: misfire enable coolant minimum (°C = val*5/8−40)." VALUE 0x4000CA30 RL_VALUE_UBYTE 0 CM_u8_temp_5_8_40c -40 119.375 /end CHARACTERISTIC
/begin CHARACTERISTIC CAL_misfire_enable_coolant_max "Calibration: misfire enable coolant maximum (°C = val*5/8−40)." VALUE 0x4000CA31 RL_VALUE_UBYTE 0 CM_u8_temp_5_8_40c -40 119.375 /end CHARACTERISTIC
/begin CHARACTERISTIC CAL_misfire_enable_rpm_min "Calibration: misfire enable RPM minimum (RPM = val*125/4+500)." VALUE 0x4000CA36 RL_VALUE_UBYTE 0 CM_u8_rspeed_125_4_500rpm 500 8468.75 /end CHARACTERISTIC
/begin CHARACTERISTIC CAL_misfire_enable_rpm_max "Calibration: misfire enable RPM maximum (RPM = val*125/4+500)." VALUE 0x4000CA37 RL_VALUE_UBYTE 0 CM_u8_rspeed_125_4_500rpm 500 8468.75 /end CHARACTERISTIC
/begin CHARACTERISTIC CAL_obd_ii_P0500_test_time "undefined2" VALUE 0x4000CA38 RL_VALUE_UWORD 0 NO_COMPU_METHOD 0 65535 /end CHARACTERISTIC
/begin CHARACTERISTIC CAL_misfire_failed_bank_scaling "Calibration: misfire failed bank scaling (val/255)." VALUE 0x4000CA3A RL_VALUE_UBYTE 0 CM_u8_factor_1_255 0 100 /end CHARACTERISTIC
/begin CHARACTERISTIC CAL_obd_ii_P0500_car_speed_min "u8_speed_kph" VALUE 0x4000CA3C RL_VALUE_UBYTE 0 CM_u8_speed_kph 0 255 /end CHARACTERISTIC
/begin CHARACTERISTIC CAL_obd_ii_crank_cam_error_count_max "undefined1" VALUE 0x4000CA3D RL_VALUE_UBYTE 0 NO_COMPU_METHOD 0 255 /end CHARACTERISTIC
/begin CHARACTERISTIC CAL_obd_ii_o2_activity_rate_outband "undefined1" VALUE 0x4000CA3E RL_VALUE_UBYTE 0 NO_COMPU_METHOD 0 255 /end CHARACTERISTIC
/begin CHARACTERISTIC CAL_idle_learn_ac_on_param "undefined1" VALUE 0x4000CA44 RL_VALUE_UBYTE 0 NO_COMPU_METHOD 0 255 /end CHARACTERISTIC
/begin CHARACTERISTIC CAL_obd_ii_idle_learn_limit "undefined1" VALUE 0x4000CA45 RL_VALUE_UBYTE 0 NO_COMPU_METHOD 0 255 /end CHARACTERISTIC
/begin CHARACTERISTIC CAL_obd_ii_idle_error_fail_count "undefined1" VALUE 0x4000CA46 RL_VALUE_UBYTE 0 NO_COMPU_METHOD 0 255 /end CHARACTERISTIC
/begin CHARACTERISTIC CAL_vvt_zero_target_timeout "Calibration: VVT zero target timeout (ms = val*100)." VALUE 0x4000CA47 RL_VALUE_UBYTE 0 CM_u8_time_100ms 0 25500 /end CHARACTERISTIC
/begin CHARACTERISTIC CAL_obd_ii_vvt_error_fail_count "undefined1" VALUE 0x4000CA49 RL_VALUE_UBYTE 0 NO_COMPU_METHOD 0 255 /end CHARACTERISTIC
/begin CHARACTERISTIC CAL_wheel_speed_rate_min "Calibration: wheel speed rate minimum." VALUE 0x4000CA54 RL_VALUE_UWORD 0 NO_COMPU_METHOD 0 65535 /end CHARACTERISTIC
/begin CHARACTERISTIC CAL_obd_P0171_learn_time_threshold "undefined1" VALUE 0x4000CA56 RL_VALUE_UBYTE 0 NO_COMPU_METHOD 0 255 /end CHARACTERISTIC
/begin CHARACTERISTIC CAL_obd_P0172_learn_time_threshold "undefined1" VALUE 0x4000CA57 RL_VALUE_UBYTE 0 NO_COMPU_METHOD 0 255 /end CHARACTERISTIC
/begin CHARACTERISTIC CAL_coolant_temp_threshold "undefined1" VALUE 0x4000CA5C RL_VALUE_UBYTE 0 NO_COMPU_METHOD 0 255 /end CHARACTERISTIC
/begin CHARACTERISTIC CAL_obd_ii_o2_sensors_present "Calibration: OBD-II O2 sensors present." VALUE 0x4000CA5D RL_VALUE_UBYTE 0 NO_COMPU_METHOD 0 255 /end CHARACTERISTIC
/begin CHARACTERISTIC CAL_obd_ii_standards_supported "Calibration: OBD-II standards supported." VALUE 0x4000CA5E RL_VALUE_UBYTE 0 NO_COMPU_METHOD 0 255 /end CHARACTERISTIC
/begin CHARACTERISTIC CAL_obd_ii_o2_slow_response_sample_count "undefined1" VALUE 0x4000CA5F RL_VALUE_UBYTE 0 NO_COMPU_METHOD 0 255 /end CHARACTERISTIC
/begin CHARACTERISTIC CAL_obd_ii_o2_r2l_time_max_asym "undefined1" VALUE 0x4000CA60 RL_VALUE_UBYTE 0 NO_COMPU_METHOD 0 255 /end CHARACTERISTIC
/begin CHARACTERISTIC CAL_obd_ii_o2_l2r_time_max_asym "undefined1" VALUE 0x4000CA61 RL_VALUE_UBYTE 0 NO_COMPU_METHOD 0 255 /end CHARACTERISTIC
/begin CHARACTERISTIC CAL_obd_ii_o2_slow_response_limit_lean_to_rich "undefined2" VALUE 0x4000CA62 RL_VALUE_UWORD 0 NO_COMPU_METHOD 0 65535 /end CHARACTERISTIC
/begin CHARACTERISTIC CAL_obd_ii_o2_slow_response_limit_rich_to_lean "undefined2" VALUE 0x4000CA64 RL_VALUE_UWORD 0 NO_COMPU_METHOD 0 65535 /end CHARACTERISTIC
/begin CHARACTERISTIC CAL_obd_ii_P0133_min_coolant_temp "undefined1" VALUE 0x4000CA69 RL_VALUE_UBYTE 0 NO_COMPU_METHOD 0 255 /end CHARACTERISTIC
/begin CHARACTERISTIC CAL_obd_ii_switch_voltage_debounce "undefined1" VALUE 0x4000CA6E RL_VALUE_UBYTE 0 NO_COMPU_METHOD 0 255 /end CHARACTERISTIC
/begin CHARACTERISTIC CAL_obd_ii_vvt_ok_pass_count "undefined1" VALUE 0x4000CA70 RL_VALUE_UBYTE 0 NO_COMPU_METHOD 0 255 /end CHARACTERISTIC
/begin CHARACTERISTIC CAL_engine_speed_3_threshold_2 "undefined1" VALUE 0x4000CA76 RL_VALUE_UBYTE 0 NO_COMPU_METHOD 0 255 /end CHARACTERISTIC
/begin CHARACTERISTIC CAL_engine_speed_3_threshold_3 "undefined1" VALUE 0x4000CA77 RL_VALUE_UBYTE 0 NO_COMPU_METHOD 0 255 /end CHARACTERISTIC
/begin CHARACTERISTIC CAL_obd_ii_o2_switch_time_threshold "undefined1" VALUE 0x4000CA78 RL_VALUE_UBYTE 0 NO_COMPU_METHOD 0 255 /end CHARACTERISTIC
/begin CHARACTERISTIC CAL_obd_ii_o2_switch_time_min "undefined1" VALUE 0x4000CA79 RL_VALUE_UBYTE 0 NO_COMPU_METHOD 0 255 /end CHARACTERISTIC
/begin CHARACTERISTIC CAL_obd_ii_o2_precat_diag_timer "Calibration: OBD-II O2 precat diag timer." VALUE 0x4000CA8A RL_VALUE_UWORD 0 NO_COMPU_METHOD 0 65535 /end CHARACTERISTIC
/begin CHARACTERISTIC CAL_obd_ii_mode2f_timeout "Calibration: OBD-II mode2f timeout (ms = val*100)." VALUE 0x4000CA8C RL_VALUE_UWORD 0 CM_u8_time_100ms 0 6553500 /end CHARACTERISTIC
/begin CHARACTERISTIC CAL_obd_ii_mode2f_injector_test_pulse_10us "undefined2" VALUE 0x4000CA94 RL_VALUE_UWORD 0 NO_COMPU_METHOD 0 65535 /end CHARACTERISTIC
/begin CHARACTERISTIC CAL_obd_ii_mode2f_injector_test_duration "undefined2" VALUE 0x4000CA96 RL_VALUE_UWORD 0 NO_COMPU_METHOD 0 65535 /end CHARACTERISTIC
/begin CHARACTERISTIC CAL_obd_ii_mode08_evap_test_duration "undefined2" VALUE 0x4000CA98 RL_VALUE_UWORD 0 NO_COMPU_METHOD 0 65535 /end CHARACTERISTIC
/begin CHARACTERISTIC CAL_obd_ii_P0106_partload_rpm_window "u8_rspeed_125/4+500rpm" VALUE 0x4000CAA6 RL_VALUE_UBYTE 0 CM_u8_rspeed_125_4_500rpm 500 8468.75 /end CHARACTERISTIC
/begin CHARACTERISTIC CAL_obd_ii_mode2f_coil_test_pulse_count "undefined2" VALUE 0x4000CAAE RL_VALUE_UWORD 0 NO_COMPU_METHOD 0 65535 /end CHARACTERISTIC
/begin CHARACTERISTIC CAL_oil_pressure_switch_startup_time "Calibration: oil pressure switch startup time (s)." VALUE 0x4000CAB0 RL_VALUE_UBYTE 0 CM_u8_time_s 0 255 /end CHARACTERISTIC
/begin CHARACTERISTIC CAL_obd_ii_oil_pressure_switch_low_voltage "Calibration: OBD-II oil pressure switch low voltage (V = val*5/1023)." VALUE 0x4000CAB4 RL_VALUE_UWORD 0 CM_u16_voltage_5_1023v 0 320.307917888563 /end CHARACTERISTIC
/begin CHARACTERISTIC CAL_obd_ii_o2_precat_activity_window "undefined2" VALUE 0x4000CAC4 RL_VALUE_UWORD 0 NO_COMPU_METHOD 0 65535 /end CHARACTERISTIC
/begin CHARACTERISTIC CAL_obd_ii_o2_postcat_activity_min "undefined2" VALUE 0x4000CAC6 RL_VALUE_UWORD 0 NO_COMPU_METHOD 0 65535 /end CHARACTERISTIC
/begin CHARACTERISTIC CAL_obd_ii_o2_slow_response_runtime_limit_unknown "undefined2" VALUE 0x4000CAC8 RL_VALUE_UWORD 0 NO_COMPU_METHOD 0 65535 /end CHARACTERISTIC
/begin CHARACTERISTIC CAL_obd_ii_cat_monitor_min_engine_runtime "Calibration: OBD-II cat monitor minimum engine runtime (ms = val*5)." VALUE 0x4000CAD0 RL_VALUE_UWORD 0 CM_u8_time_5ms 0 327675 /end CHARACTERISTIC
/begin CHARACTERISTIC CAL_misfire_emissions_limit "Calibration: misfire emissions limit." VALUE 0x4000CAD8 RL_VALUE_UBYTE 0 NO_COMPU_METHOD 0 255 /end CHARACTERISTIC
/begin CHARACTERISTIC CAL_obd_ii_fuel_type "Calibration: OBD-II fuel type." VALUE 0x4000CAE2 RL_VALUE_UBYTE 0 NO_COMPU_METHOD 0 255 /end CHARACTERISTIC
/begin CHARACTERISTIC CAL_cat_check_unknown4 "undefined2" VALUE 0x4000CAF4 RL_VALUE_UWORD 0 NO_COMPU_METHOD 0 65535 /end CHARACTERISTIC
/begin CHARACTERISTIC CAL_obd_ii_commanded_evap_purge_threshold "undefined2" VALUE 0x4000CAF6 RL_VALUE_UWORD 0 NO_COMPU_METHOD 0 65535 /end CHARACTERISTIC
/begin CHARACTERISTIC CAL_evap_tank_vacuum_flow_threshold "undefined2" VALUE 0x4000CAF8 RL_VALUE_UWORD 0 NO_COMPU_METHOD 0 65535 /end CHARACTERISTIC
/begin CHARACTERISTIC CAL_evap_system_state_flags_param "undefined2" VALUE 0x4000CAFA RL_VALUE_UWORD 0 NO_COMPU_METHOD 0 65535 /end CHARACTERISTIC
/begin CHARACTERISTIC CAL_evap_purge_flow_state_timer_init "undefined1" VALUE 0x4000CAFC RL_VALUE_UBYTE 0 NO_COMPU_METHOD 0 255 /end CHARACTERISTIC
/begin CHARACTERISTIC CAL_evap_canister_purge_solenoid_timer_init "undefined1" VALUE 0x4000CAFD RL_VALUE_UBYTE 0 NO_COMPU_METHOD 0 255 /end CHARACTERISTIC
/begin CHARACTERISTIC CAL_evap_purge_min_load "undefined1" VALUE 0x4000CAFE RL_VALUE_UBYTE 0 NO_COMPU_METHOD 0 255 /end CHARACTERISTIC
/begin CHARACTERISTIC CAL_evap_purge_vacuum_min "undefined2" VALUE 0x4000CB00 RL_VALUE_UWORD 0 NO_COMPU_METHOD 0 65535 /end CHARACTERISTIC
/begin CHARACTERISTIC CAL_evap_leak_test_fuel_level_max "undefined1" VALUE 0x4000CB07 RL_VALUE_UBYTE 0 NO_COMPU_METHOD 0 255 /end CHARACTERISTIC
/begin CHARACTERISTIC CAL_evap_purge_flow_vacuum_min "undefined2" VALUE 0x4000CB08 RL_VALUE_UWORD 0 NO_COMPU_METHOD 0 65535 /end CHARACTERISTIC
/begin CHARACTERISTIC CAL_evap_leak_test_purge_settle_delay "undefined1" VALUE 0x4000CB0B RL_VALUE_UBYTE 0 NO_COMPU_METHOD 0 255 /end CHARACTERISTIC
/begin CHARACTERISTIC CAL_evap_leak_test_settle_samples "undefined1" VALUE 0x4000CB0C RL_VALUE_UBYTE 0 NO_COMPU_METHOD 0 255 /end CHARACTERISTIC
/begin CHARACTERISTIC CAL_cooling_thermostat_open "Calibration: cooling thermostat open (°C = val*5/8−40)." VALUE 0x4000CB22 RL_VALUE_UBYTE 0 CM_u8_temp_5_8_40c -40 119.375 /end CHARACTERISTIC
/begin CHARACTERISTIC CAL_obd_ii_cat_unknown3 "undefined2" VALUE 0x4000CB2C RL_VALUE_UWORD 0 NO_COMPU_METHOD 0 65535 /end CHARACTERISTIC
/begin CHARACTERISTIC CAL_obd_ii_cat_monitor_stable_time "undefined2" VALUE 0x4000CB3A RL_VALUE_UWORD 0 NO_COMPU_METHOD 0 65535 /end CHARACTERISTIC
/begin CHARACTERISTIC CAL_obd_evap_entry_settle_delay "undefined1" VALUE 0x4000CB3D RL_VALUE_UBYTE 0 NO_COMPU_METHOD 0 255 /end CHARACTERISTIC
/begin CHARACTERISTIC CAL_wheel_speed_multiplier_front "Calibration: wheel speed multiplier front (mm_div2)." VALUE 0x4000CB46 RL_VALUE_UWORD 0 CM_u16_distance_mm_div2 0 32767.5 /end CHARACTERISTIC
/begin CHARACTERISTIC CAL_wheel_speed_multiplier_rear "Calibration: wheel speed multiplier rear (mm_div2)." VALUE 0x4000CB48 RL_VALUE_UWORD 0 CM_u16_distance_mm_div2 0 32767.5 /end CHARACTERISTIC
/begin CHARACTERISTIC CAL_obd_ac_load_diag_tolerance_pct "undefined1" VALUE 0x4000CB4C RL_VALUE_UBYTE 0 NO_COMPU_METHOD 0 255 /end CHARACTERISTIC
/begin CHARACTERISTIC CAL_vvt_cam_park_offset_max "undefined1" VALUE 0x4000CB58 RL_VALUE_UBYTE 0 NO_COMPU_METHOD 0 255 /end CHARACTERISTIC
/begin CHARACTERISTIC CAL_clutch_pos_voltage_threshold "undefined2" VALUE 0x4000CB62 RL_VALUE_UWORD 0 NO_COMPU_METHOD 0 65535 /end CHARACTERISTIC
/begin CHARACTERISTIC CAL_trans_gear_ratio_sport "Calibration: transmission gear ratio sport (12-element array)." VAL_BLK 0x4000CB6A RL_VALUE_UWORD 0 NO_COMPU_METHOD 0 65535 NUMBER 12 /end CHARACTERISTIC
/begin CHARACTERISTIC CAL_obd_ii_P0111_maf_low_band "undefined1" VALUE 0x4000CB9C RL_VALUE_UBYTE 0 NO_COMPU_METHOD 0 255 /end CHARACTERISTIC
/begin CHARACTERISTIC CAL_obd_ii_P0111_maf_debounce_time "undefined1" VALUE 0x4000CB9E RL_VALUE_UBYTE 0 NO_COMPU_METHOD 0 255 /end CHARACTERISTIC
/begin CHARACTERISTIC CAL_obd_ii_high_load_monitor_afr_max "undefined2" VALUE 0x4000CBA2 RL_VALUE_UWORD 0 NO_COMPU_METHOD 0 65535 /end CHARACTERISTIC
/begin CHARACTERISTIC CAL_obd_ii_P2191_lean_confirm_time "undefined1" VALUE 0x4000CBA4 RL_VALUE_UBYTE 0 NO_COMPU_METHOD 0 255 /end CHARACTERISTIC
/begin CHARACTERISTIC CAL_obd_ii_P2192_rich_confirm_time "undefined1" VALUE 0x4000CBA5 RL_VALUE_UBYTE 0 NO_COMPU_METHOD 0 255 /end CHARACTERISTIC
/begin CHARACTERISTIC CAL_obd_ii_high_load_monitor_load_min "undefined1" VALUE 0x4000CBA6 RL_VALUE_UBYTE 0 NO_COMPU_METHOD 0 255 /end CHARACTERISTIC
/begin CHARACTERISTIC CAL_obd_ii_drive_cycle_idle_time "undefined2" VALUE 0x4000CBA8 RL_VALUE_UWORD 0 NO_COMPU_METHOD 0 65535 /end CHARACTERISTIC
/begin CHARACTERISTIC CAL_obd_ii_monitor_rpm_delta_max "undefined2" VALUE 0x4000CBAE RL_VALUE_UWORD 0 NO_COMPU_METHOD 0 65535 /end CHARACTERISTIC
/begin CHARACTERISTIC CAL_idle_sensor_fault_coolant_temp "Calibration: idle sensor fault coolant temperature (°C = val*5/8−40)." VALUE 0x4000CBB0 RL_VALUE_UBYTE 0 CM_u8_temp_5_8_40c -40 119.375 /end CHARACTERISTIC
/begin CHARACTERISTIC CAL_obd_ii_evap_purge_settle_debounce "undefined1" VALUE 0x4000CBB3 RL_VALUE_UBYTE 0 NO_COMPU_METHOD 0 255 /end CHARACTERISTIC
/begin CHARACTERISTIC CAL_evap_pressure_deviation_max "undefined1" VALUE 0x4000CBB4 RL_VALUE_UBYTE 0 NO_COMPU_METHOD 0 255 /end CHARACTERISTIC
/begin CHARACTERISTIC CAL_obd_ii_P0451_debounce_count "undefined1" VALUE 0x4000CBB5 RL_VALUE_UBYTE 0 NO_COMPU_METHOD 0 255 /end CHARACTERISTIC
/begin CHARACTERISTIC CAL_obd_ii_o2_period_consistency_tol "undefined1" VALUE 0x4000CBB8 RL_VALUE_UBYTE 0 NO_COMPU_METHOD 0 255 /end CHARACTERISTIC
/begin CHARACTERISTIC CAL_obd_ii_o2_slow_response_maf_limit_unknown2 "undefined2" VALUE 0x4000CBBA RL_VALUE_UWORD 0 NO_COMPU_METHOD 0 65535 /end CHARACTERISTIC
/begin CHARACTERISTIC CAL_obd_o2_precat_diag_init_counter "undefined2" VALUE 0x4000CBBC RL_VALUE_UWORD 0 NO_COMPU_METHOD 0 65535 /end CHARACTERISTIC
/begin CHARACTERISTIC CAL_obd_ii_o2_period_excess_max "undefined1" VALUE 0x4000CBBE RL_VALUE_UBYTE 0 NO_COMPU_METHOD 0 255 /end CHARACTERISTIC
/begin CHARACTERISTIC CAL_obd_ii_o2_imbalance_accum_cap "undefined1" VALUE 0x4000CBBF RL_VALUE_UBYTE 0 NO_COMPU_METHOD 0 255 /end CHARACTERISTIC
/begin CHARACTERISTIC CAL_wheel_speed_min "Calibration: wheel speed minimum." VALUE 0x4000CBC4 RL_VALUE_UWORD 0 NO_COMPU_METHOD 0 65535 /end CHARACTERISTIC
/begin CHARACTERISTIC CAL_obd_ii_o2_slow_response_maf_limit_unknown "undefined2" VALUE 0x4000CBC8 RL_VALUE_UWORD 0 NO_COMPU_METHOD 0 65535 /end CHARACTERISTIC
/begin CHARACTERISTIC CAL_obd_o2_precat_diag_reset_counter "undefined2" VALUE 0x4000CBCA RL_VALUE_UWORD 0 NO_COMPU_METHOD 0 65535 /end CHARACTERISTIC
/begin CHARACTERISTIC CAL_obd_ii_P0579_stuck_timeout "undefined1" VALUE 0x4000CBD1 RL_VALUE_UBYTE 0 NO_COMPU_METHOD 0 255 /end CHARACTERISTIC
/begin CHARACTERISTIC CAL_clutch_sensor_confidence_max "Calibration: clutch sensor confidence maximum." VALUE 0x4000CBD2 RL_VALUE_UWORD 0 NO_COMPU_METHOD 0 65535 /end CHARACTERISTIC
/begin CHARACTERISTIC CAL_clutch_variance_threshold "Calibration: clutch variance threshold." VALUE 0x4000CBD4 RL_VALUE_UBYTE 0 NO_COMPU_METHOD 0 255 /end CHARACTERISTIC
/begin CHARACTERISTIC CAL_clutch_confidence_decrement "Calibration: clutch confidence decrement." VALUE 0x4000CBD5 RL_VALUE_UBYTE 0 NO_COMPU_METHOD 0 255 /end CHARACTERISTIC
/begin CHARACTERISTIC CAL_clutch_confidence_increment "Calibration: clutch confidence increment." VALUE 0x4000CBD6 RL_VALUE_UBYTE 0 NO_COMPU_METHOD 0 255 /end CHARACTERISTIC
/begin CHARACTERISTIC CAL_obd_high_load_monitor_load_max "undefined2" VALUE 0x4000CBDA RL_VALUE_UWORD 0 NO_COMPU_METHOD 0 65535 /end CHARACTERISTIC
/begin CHARACTERISTIC CAL_engine_speed_3_limit_0 "undefined1" VALUE 0x4000CBDC RL_VALUE_UBYTE 0 NO_COMPU_METHOD 0 255 /end CHARACTERISTIC
/begin CHARACTERISTIC CAL_engine_speed_3_threshold_4 "undefined1" VALUE 0x4000CBDD RL_VALUE_UBYTE 0 NO_COMPU_METHOD 0 255 /end CHARACTERISTIC
/begin CHARACTERISTIC CAL_coolant_temp_limit_2 "undefined1" VALUE 0x4000CBE4 RL_VALUE_UBYTE 0 NO_COMPU_METHOD 0 255 /end CHARACTERISTIC
/begin CHARACTERISTIC CAL_obd_ii_o2_imbalance_threshold "undefined2" VALUE 0x4000CBEA RL_VALUE_UWORD 0 NO_COMPU_METHOD 0 65535 /end CHARACTERISTIC
/begin CHARACTERISTIC CAL_obd_ii_P0101_plausibility_enable "undefined1" VALUE 0x4000CBF4 RL_VALUE_UBYTE 0 NO_COMPU_METHOD 0 255 /end CHARACTERISTIC
/begin CHARACTERISTIC CAL_obd_ii_knock_no_activity_count "undefined1" VALUE 0x4000CBF5 RL_VALUE_UBYTE 0 NO_COMPU_METHOD 0 255 /end CHARACTERISTIC
/begin CHARACTERISTIC CAL_slip_gear_speed_ratios_ips "Calibration: slip gear speed ratios IPS (6-element array)." VAL_BLK 0x4000CC04 RL_VALUE_UWORD 0 NO_COMPU_METHOD 0 65535 NUMBER 6 /end CHARACTERISTIC
/begin CHARACTERISTIC CAL_slip_gear_speed_ratios_cr "Calibration: slip gear speed ratios cr (6-element array)." VAL_BLK 0x4000CC10 RL_VALUE_UWORD 0 NO_COMPU_METHOD 0 65535 NUMBER 6 /end CHARACTERISTIC
/begin CHARACTERISTIC CAL_slip_gear_speed_ratios_long "Calibration: slip gear speed ratios long (6-element array)." VAL_BLK 0x4000CC1C RL_VALUE_UWORD 0 NO_COMPU_METHOD 0 65535 NUMBER 6 /end CHARACTERISTIC
/begin CHARACTERISTIC CAL_slip_threshold_1st_Gear "Calibration: slip threshold 1st Gear (RPM = val*4+500)." VALUE 0x4000CC28 RL_VALUE_UBYTE 0 CM_u8_rspeed_4_500rpm 500 1520 /end CHARACTERISTIC
/begin CHARACTERISTIC CAL_slip_threshold_per_gear_manual "Calibration: slip threshold per gear manual (RPM = val*4+500; 5-element array)." VAL_BLK 0x4000CC29 RL_VALUE_UBYTE 0 CM_u8_rspeed_4_500rpm 500 1520 NUMBER 5 /end CHARACTERISTIC
/begin CHARACTERISTIC CAL_slip_slip_threshold_per_gear_ips "Calibration: slip slip threshold per gear IPS (RPM = val*4+500; 5-element array)." VAL_BLK 0x4000CC2E RL_VALUE_UBYTE 0 CM_u8_rspeed_4_500rpm 500 1520 NUMBER 5 /end CHARACTERISTIC
/begin CHARACTERISTIC CAL_slip_detect_mode "Calibration: slip detect mode (enumerated state)." VALUE 0x4000CC33 RL_VALUE_UBYTE 0 NO_COMPU_METHOD 0 255 /end CHARACTERISTIC
/begin CHARACTERISTIC CAL_slip_inhibit_accel_pedal_min "Calibration: slip inhibit accelerator pedal minimum (val/1023)." VALUE 0x4000CC34 RL_VALUE_UWORD 0 CM_u16_factor_1_1023 0 6406.15835777126 /end CHARACTERISTIC
/begin CHARACTERISTIC CAL_slip_steering_angle_max_unknown "Calibration: slip steering angle maximum (° = val/10)." VALUE 0x4000CC36 RL_VALUE_UWORD 0 CM_u16_angle_1_10deg 0 6553.5 /end CHARACTERISTIC
/begin CHARACTERISTIC CAL_slip_car_speed_unknown1 "Calibration: slip car speed unknown1 (km/h = val/100)." VALUE 0x4000CC38 RL_VALUE_UWORD 0 CM_u8_speed_1_100kph 0 655.35 /end CHARACTERISTIC
/begin CHARACTERISTIC CAL_slip_threshold_car_speed "Calibration: slip threshold car speed (km/h)." VALUE 0x4000CC3A RL_VALUE_UBYTE 0 CM_u8_speed_kph 0 255 /end CHARACTERISTIC
/begin CHARACTERISTIC CAL_slip_coldstart_coolant_threshold "Calibration: slip coldstart coolant threshold (°C = val*5/8−40)." VALUE 0x4000CC3B RL_VALUE_UBYTE 0 CM_u8_temp_5_8_40c -40 119.375 /end CHARACTERISTIC
/begin CHARACTERISTIC CAL_slip_timer_per_gear_intervention "Calibration: slip timer per gear intervention (ms = val*100)." VALUE 0x4000CC3C RL_VALUE_UBYTE 0 CM_u8_time_100ms 0 25500 /end CHARACTERISTIC
/begin CHARACTERISTIC CAL_slip_inhibit_cornering_base "Calibration: slip inhibit cornering base (val/255)." VALUE 0x4000CC3D RL_VALUE_UBYTE 0 CM_u8_factor_1_255 0 100 /end CHARACTERISTIC
/begin CHARACTERISTIC CAL_slip_inhibit_cornering_offset "Calibration: slip inhibit cornering offset (val/255)." VALUE 0x4000CC3E RL_VALUE_UBYTE 0 CM_u8_factor_1_255 0 100 /end CHARACTERISTIC
/begin CHARACTERISTIC CAL_slip_steering_rate_factor "Calibration: slip steering rate factor (val/100)." VALUE 0x4000CC3F RL_VALUE_UBYTE 0 CM_u8_factor_1_100 0 255 /end CHARACTERISTIC
/begin CHARACTERISTIC CAL_slip_steering_increase_factor_min "Calibration: slip steering increase factor minimum (val/255)." VALUE 0x4000CC40 RL_VALUE_UBYTE 0 CM_u8_factor_1_255 0 100 /end CHARACTERISTIC
/begin CHARACTERISTIC CAL_slip_steering_angle_smooth_factor "Calibration: slip steering angle smooth factor (val/255)." VALUE 0x4000CC41 RL_VALUE_UBYTE 0 CM_u8_factor_1_255 0 100 /end CHARACTERISTIC
/begin CHARACTERISTIC CAL_slip_inhibit_accel_pedal_timer "Calibration: slip inhibit accelerator pedal timer (ms = val*100)." VALUE 0x4000CC42 RL_VALUE_UBYTE 0 CM_u8_time_100ms 0 25500 /end CHARACTERISTIC
/begin CHARACTERISTIC CAL_slip_threshold_hysteresis_offset "Calibration: slip threshold hysteresis offset (RPM = val*4+500)." VALUE 0x4000CC44 RL_VALUE_UBYTE 0 CM_u8_rspeed_4_500rpm 500 1520 /end CHARACTERISTIC
/begin CHARACTERISTIC CAL_slip_timer_intervention2 "Calibration: slip timer intervention2 (ms = val*100)." VALUE 0x4000CC45 RL_VALUE_UBYTE 0 CM_u8_time_100ms 0 25500 /end CHARACTERISTIC
/begin CHARACTERISTIC CAL_slip_gear_offset_unknown "Calibration: slip gear offset." VALUE 0x4000CC46 RL_VALUE_UBYTE 0 NO_COMPU_METHOD 0 255 /end CHARACTERISTIC
/begin CHARACTERISTIC CAL_slip_wheelspeed_front_accel_threshold "Calibration: slip wheelspeed front accelerator threshold." VALUE 0x4000CC48 RL_VALUE_UBYTE 0 NO_COMPU_METHOD 0 255 /end CHARACTERISTIC
/begin CHARACTERISTIC CAL_slip_enable_speed "Calibration: slip enable speed (km/h)." VALUE 0x4000CC49 RL_VALUE_UBYTE 0 CM_u8_speed_kph 0 255 /end CHARACTERISTIC
/begin CHARACTERISTIC CAL_trans_pump_carspeed_enable "Calibration: transmission pump carspeed enable (km/h; 2-element array)." VAL_BLK 0x4000CC94 RL_VALUE_UBYTE 0 CM_u8_speed_kph 0 255 NUMBER 2 /end CHARACTERISTIC
/begin CHARACTERISTIC CAL_trans_pump_ect_on_min "Calibration: transmission pump ect on minimum (°C = val*5/8−40)." VALUE 0x4000CC96 RL_VALUE_UBYTE 0 CM_u8_temp_5_8_40c -40 119.375 /end CHARACTERISTIC
/begin CHARACTERISTIC CAL_trans_pump_ect_off_min "Calibration: transmission pump ect off minimum (°C = val*5/8−40)." VALUE 0x4000CC97 RL_VALUE_UBYTE 0 CM_u8_temp_5_8_40c -40 119.375 /end CHARACTERISTIC
/begin CHARACTERISTIC CAL_trans_pump_cold_cutoff "Calibration: transmission pump cold cutoff (°C = val*5/8−40)." VALUE 0x4000CC98 RL_VALUE_UBYTE 0 CM_u8_temp_5_8_40c -40 119.375 /end CHARACTERISTIC
/begin CHARACTERISTIC CAL_trans_pump_warmup_min "Calibration: transmission pump warmup minimum (°C = val*5/8−40)." VALUE 0x4000CC99 RL_VALUE_UBYTE 0 CM_u8_temp_5_8_40c -40 119.375 /end CHARACTERISTIC
/begin CHARACTERISTIC CAL_trans_pump_warmup_max "Calibration: transmission pump warmup maximum (°C = val*5/8−40)." VALUE 0x4000CC9A RL_VALUE_UBYTE 0 CM_u8_temp_5_8_40c -40 119.375 /end CHARACTERISTIC
/begin CHARACTERISTIC CAL_trans_pump_no_cool_min "Calibration: transmission pump no cool minimum (°C = val*5/8−40)." VALUE 0x4000CC9B RL_VALUE_UBYTE 0 CM_u8_temp_5_8_40c -40 119.375 /end CHARACTERISTIC
/begin CHARACTERISTIC CAL_trans_pump_ect_off_max "Calibration: transmission pump ect off maximum (°C = val*5/8−40)." VALUE 0x4000CC9C RL_VALUE_UBYTE 0 CM_u8_temp_5_8_40c -40 119.375 /end CHARACTERISTIC
/begin CHARACTERISTIC CAL_trans_pump_ect_on_max "Calibration: transmission pump ect on maximum (°C = val*5/8−40)." VALUE 0x4000CC9D RL_VALUE_UBYTE 0 CM_u8_temp_5_8_40c -40 119.375 /end CHARACTERISTIC
/begin CHARACTERISTIC CAL_trans_pump_cool_off "Calibration: transmission pump cool off (°C = val*5/8−40)." VALUE 0x4000CC9E RL_VALUE_UBYTE 0 CM_u8_temp_5_8_40c -40 119.375 /end CHARACTERISTIC
/begin CHARACTERISTIC CAL_trans_pump_no_cool_max "Calibration: transmission pump no cool maximum (°C = val*5/8−40)." VALUE 0x4000CC9F RL_VALUE_UBYTE 0 CM_u8_temp_5_8_40c -40 119.375 /end CHARACTERISTIC
/begin CHARACTERISTIC CAL_trans_temp_voltage_threshold "Calibration: transmission temperature voltage threshold (2-element array)." VAL_BLK 0x4000CCA4 RL_VALUE_UWORD 0 NO_COMPU_METHOD 0 65535 NUMBER 2 /end CHARACTERISTIC
/begin CHARACTERISTIC CAL_trans_fluid_P2797_threshold "Calibration: transmission fluid P2797 threshold (°C = val*5/8−40)." VALUE 0x4000CCA8 RL_VALUE_UBYTE 0 CM_u8_temp_5_8_40c -40 119.375 /end CHARACTERISTIC
/begin CHARACTERISTIC CAL_exhaust_flap_stationary_override_enable "Calibration: exhaust flap stationary override enable (enumerated state)." VALUE 0x4000CCA9 RL_VALUE_UBYTE 0 NO_COMPU_METHOD 0 255 /end CHARACTERISTIC
/begin CHARACTERISTIC CAL_dpm_min_engine_rpm "Calibration: driver performance mode minimum engine RPM (RPM)." VALUE 0x4000CCAE RL_VALUE_UWORD 0 CM_u16_rspeed_rpm 0 65535 /end CHARACTERISTIC
/begin CHARACTERISTIC CAL_dpm_cornering_lr_speed_diff_threshold "Calibration: driver performance mode lr diff threshold (km/h = val/100)." VALUE 0x4000CCB0 RL_VALUE_UWORD 0 CM_u8_speed_1_100kph 0 655.35 /end CHARACTERISTIC
/begin CHARACTERISTIC CAL_dpm_cornering_release_delay "\\Direct mode\\ (flag bit 2) likely means more aggressive TC intervention when there's significant left-right wheel speed difference - i.e., one wheel spinning more than the other." VALUE 0x4000CCB2 RL_VALUE_UWORD 0 CM_u8_time_5ms 0 327675 /end CHARACTERISTIC
/begin CHARACTERISTIC CAL_dpm_cornering_detect_delay "\\Direct mode\\ (flag bit 2) likely means more aggressive TC intervention when there's significant left-right wheel speed difference - i.e., one wheel spinning more than the other." VALUE 0x4000CCB4 RL_VALUE_UWORD 0 CM_u8_time_5ms 0 327675 /end CHARACTERISTIC
/begin CHARACTERISTIC CAL_dpm_integral_update_period "Integral adapation is very slow. It seems to be used to account for tire condition changes and surface changes." VALUE 0x4000CCB6 RL_VALUE_UWORD 0 CM_u8_time_5ms 0 327675 /end CHARACTERISTIC
/begin CHARACTERISTIC CAL_dpm_torque_min_allowed "Calibration: driver performance mode torque minimum allowed (Nm)." VALUE 0x4000CCB8 RL_VALUE_UWORD 0 CM_u8_torque_nm 0 65535 /end CHARACTERISTIC
/begin CHARACTERISTIC CAL_dpm_slip_target_straight_line_offset "A fixed extra slip allowance, in 1/8 % steps (u8_slip_1/8pct), added to the pedal-derived target dpm_slip_target_from_pedal to give the final dpm_slip_target. It's only applied while flag bit 2 is clear. dpm_system_state_manager_200hz sets that bit w" VALUE 0x4000CCBA RL_VALUE_UBYTE 0 CM_u16_slip_1_8pct 0 31.875 /end CHARACTERISTIC
/begin CHARACTERISTIC CAL_dpm_max_vehicle_speed "Calibration: driver performance mode maximum vehicle speed (km/h)." VALUE 0x4000CCBB RL_VALUE_UBYTE 0 CM_u8_speed_kph 0 255 /end CHARACTERISTIC
/begin CHARACTERISTIC CAL_dpm_min_vehicle_speed "Calibration: driver performance mode minimum vehicle speed (km/h)." VALUE 0x4000CCBC RL_VALUE_UBYTE 0 CM_u8_speed_kph 0 255 /end CHARACTERISTIC
/begin CHARACTERISTIC CAL_dpm_intervention_threshold "Calibration: driver performance mode intervention threshold (% = val/8)." VALUE 0x4000CCBD RL_VALUE_UBYTE 0 CM_u16_slip_1_8pct 0 31.875 /end CHARACTERISTIC
/begin CHARACTERISTIC CAL_dpm_torque_cut_i_gain "Calibration: driver performance mode integral gain." VALUE 0x4000CCBE RL_VALUE_UBYTE 0 NO_COMPU_METHOD 0 255 /end CHARACTERISTIC
/begin CHARACTERISTIC CAL_dpm_torque_cut_i_limit "Calibration: driver performance mode integral limit." VALUE 0x4000CCBF RL_VALUE_UBYTE 0 NO_COMPU_METHOD 0 255 /end CHARACTERISTIC
/begin CHARACTERISTIC CAL_dpm_torque_margin_factor "Calibration: driver performance mode torque margin factor (val/255)." VALUE 0x4000CCC1 RL_VALUE_UBYTE 0 CM_u8_factor_1_255 0 100 /end CHARACTERISTIC
/begin CHARACTERISTIC CAL_torque_limit_tps_rate_limit "Calibration: torque limit throttle position rate limit (2-element array)." VAL_BLK 0x4000CCC4 RL_VALUE_UWORD 0 NO_COMPU_METHOD 0 65535 NUMBER 2 /end CHARACTERISTIC
/begin CHARACTERISTIC CAL_torque_limit_cooldown_timer "uint16_t" VALUE 0x4000CCC8 RL_VALUE_UWORD 0 NO_COMPU_METHOD 0 65535 /end CHARACTERISTIC
/begin CHARACTERISTIC CAL_torque_limit_cooldown_tps_rate_threshold "u8_factor_1/255" VALUE 0x4000CCCA RL_VALUE_UBYTE 0 CM_u8_factor_1_255 0 100 /end CHARACTERISTIC
/begin AXIS_PTS CAL_torque_load_to_torque_X_engine_speed "Calibration: X-axis (engine speed) for the torque load to torque table (RPM; 16-element array)." 0x4000CDB4 engine_speed_16bit RL_AXIS_UWORD 0 CM_u16_rspeed_rpm 16 0 65535 /end AXIS_PTS
/begin AXIS_PTS CAL_torque_load_to_torque_Y_load "Calibration: Y-axis (load) for the torque load to torque table (mg/stroke; 16-element array)." 0x4000CDD4 NO_INPUT_QUANTITY RL_AXIS_UWORD 0 CM_u16_load_mg_stroke 16 0 65535 /end AXIS_PTS
/begin CHARACTERISTIC CAL_torque_load_to_torque "Calibration: torque load to torque (Nm; 256-element array)." MAP 0x4000CDF4 RL_VALUE_UWORD 0 CM_u8_torque_nm 0 65535
 /begin AXIS_DESCR COM_AXIS engine_speed_16bit CM_u16_rspeed_rpm 16 0 65535 AXIS_PTS_REF CAL_torque_load_to_torque_X_engine_speed /end AXIS_DESCR
 /begin AXIS_DESCR COM_AXIS NO_INPUT_QUANTITY CM_u16_load_mg_stroke 16 0 65535 AXIS_PTS_REF CAL_torque_load_to_torque_Y_load /end AXIS_DESCR
/end CHARACTERISTIC
/begin CHARACTERISTIC CAL_obd_ii_P0712 "Calibration: OBD-II P0712 (OBD-II monitor enable level)." VALUE 0x4000D1AC RL_VALUE_UBYTE 0 NO_COMPU_METHOD 0 255 /end CHARACTERISTIC
/begin CHARACTERISTIC CAL_obd_ii_P0106 "Calibration: OBD-II P0106 (OBD-II monitor enable level)." VALUE 0x4000D1AD RL_VALUE_UBYTE 0 NO_COMPU_METHOD 0 255 /end CHARACTERISTIC
/begin CHARACTERISTIC CAL_obd_ii_P0107 "Calibration: OBD-II P0107 (OBD-II monitor enable level)." VALUE 0x4000D1AE RL_VALUE_UBYTE 0 NO_COMPU_METHOD 0 255 /end CHARACTERISTIC
/begin CHARACTERISTIC CAL_obd_ii_P0108 "Calibration: OBD-II P0108 (OBD-II monitor enable level)." VALUE 0x4000D1AF RL_VALUE_UBYTE 0 NO_COMPU_METHOD 0 255 /end CHARACTERISTIC
/begin CHARACTERISTIC CAL_obd_ii_P0713 "Calibration: OBD-II P0713 (OBD-II monitor enable level)." VALUE 0x4000D1B0 RL_VALUE_UBYTE 0 NO_COMPU_METHOD 0 255 /end CHARACTERISTIC
/begin CHARACTERISTIC CAL_obd_ii_P0111 "Calibration: OBD-II P0111 (OBD-II monitor enable level)." VALUE 0x4000D1B1 RL_VALUE_UBYTE 0 NO_COMPU_METHOD 0 255 /end CHARACTERISTIC
/begin CHARACTERISTIC CAL_obd_ii_P0112 "Calibration: OBD-II P0112 (OBD-II monitor enable level)." VALUE 0x4000D1B2 RL_VALUE_UBYTE 0 NO_COMPU_METHOD 0 255 /end CHARACTERISTIC
/begin CHARACTERISTIC CAL_obd_ii_P0113 "Calibration: OBD-II P0113 (OBD-II monitor enable level)." VALUE 0x4000D1B3 RL_VALUE_UBYTE 0 NO_COMPU_METHOD 0 255 /end CHARACTERISTIC
/begin CHARACTERISTIC CAL_obd_ii_P0071 "Calibration: OBD-II P0071 (OBD-II monitor enable level)." VALUE 0x4000D1B4 RL_VALUE_UBYTE 0 NO_COMPU_METHOD 0 255 /end CHARACTERISTIC
/begin CHARACTERISTIC CAL_obd_ii_P0116 "Calibration: OBD-II P0116 (OBD-II monitor enable level)." VALUE 0x4000D1B5 RL_VALUE_UBYTE 0 NO_COMPU_METHOD 0 255 /end CHARACTERISTIC
/begin CHARACTERISTIC CAL_obd_ii_P0117 "Calibration: OBD-II P0117 (OBD-II monitor enable level)." VALUE 0x4000D1B6 RL_VALUE_UBYTE 0 NO_COMPU_METHOD 0 255 /end CHARACTERISTIC
/begin CHARACTERISTIC CAL_obd_ii_P0118 "Calibration: OBD-II P0118 (OBD-II monitor enable level)." VALUE 0x4000D1B7 RL_VALUE_UBYTE 0 NO_COMPU_METHOD 0 255 /end CHARACTERISTIC
/begin CHARACTERISTIC CAL_obd_ii_P2170 "Calibration: OBD-II P2170 (OBD-II monitor enable level)." VALUE 0x4000D1B8 RL_VALUE_UBYTE 0 NO_COMPU_METHOD 0 255 /end CHARACTERISTIC
/begin CHARACTERISTIC CAL_obd_ii_P2171 "Calibration: OBD-II P2171 (OBD-II monitor enable level)." VALUE 0x4000D1B9 RL_VALUE_UBYTE 0 NO_COMPU_METHOD 0 255 /end CHARACTERISTIC
/begin CHARACTERISTIC CAL_obd_ii_P0122 "Calibration: OBD-II P0122 (OBD-II monitor enable level)." VALUE 0x4000D1BA RL_VALUE_UBYTE 0 NO_COMPU_METHOD 0 255 /end CHARACTERISTIC
/begin CHARACTERISTIC CAL_obd_ii_P0123 "Calibration: OBD-II P0123 (OBD-II monitor enable level)." VALUE 0x4000D1BB RL_VALUE_UBYTE 0 NO_COMPU_METHOD 0 255 /end CHARACTERISTIC
/begin CHARACTERISTIC CAL_obd_ii_P2191 "Calibration: OBD-II P2191 (OBD-II monitor enable level)." VALUE 0x4000D1BC RL_VALUE_UBYTE 0 NO_COMPU_METHOD 0 255 /end CHARACTERISTIC
/begin CHARACTERISTIC CAL_obd_ii_P0128 "Calibration: OBD-II P0128 (OBD-II monitor enable level)." VALUE 0x4000D1BD RL_VALUE_UBYTE 0 NO_COMPU_METHOD 0 255 /end CHARACTERISTIC
/begin CHARACTERISTIC CAL_obd_ii_P0131 "Calibration: OBD-II P0131 (OBD-II monitor enable level)." VALUE 0x4000D1BE RL_VALUE_UBYTE 0 NO_COMPU_METHOD 0 255 /end CHARACTERISTIC
/begin CHARACTERISTIC CAL_obd_ii_P0132 "Calibration: OBD-II P0132 (OBD-II monitor enable level)." VALUE 0x4000D1BF RL_VALUE_UBYTE 0 NO_COMPU_METHOD 0 255 /end CHARACTERISTIC
/begin CHARACTERISTIC CAL_obd_ii_P0133 "Calibration: OBD-II P0133 (OBD-II monitor enable level)." VALUE 0x4000D1C0 RL_VALUE_UBYTE 0 NO_COMPU_METHOD 0 255 /end CHARACTERISTIC
/begin CHARACTERISTIC CAL_obd_ii_P0134 "Calibration: OBD-II P0134 (OBD-II monitor enable level)." VALUE 0x4000D1C1 RL_VALUE_UBYTE 0 NO_COMPU_METHOD 0 255 /end CHARACTERISTIC
/begin CHARACTERISTIC CAL_obd_ii_P0135 "Calibration: OBD-II P0135 (OBD-II monitor enable level)." VALUE 0x4000D1C2 RL_VALUE_UBYTE 0 NO_COMPU_METHOD 0 255 /end CHARACTERISTIC
/begin CHARACTERISTIC CAL_obd_ii_P2193 "Calibration: OBD-II P2193 (OBD-II monitor enable level)." VALUE 0x4000D1C3 RL_VALUE_UBYTE 0 NO_COMPU_METHOD 0 255 /end CHARACTERISTIC
/begin CHARACTERISTIC CAL_obd_ii_P0137 "Calibration: OBD-II P0137 (OBD-II monitor enable level)." VALUE 0x4000D1C4 RL_VALUE_UBYTE 0 NO_COMPU_METHOD 0 255 /end CHARACTERISTIC
/begin CHARACTERISTIC CAL_obd_ii_P0138 "Calibration: OBD-II P0138 (OBD-II monitor enable level)." VALUE 0x4000D1C5 RL_VALUE_UBYTE 0 NO_COMPU_METHOD 0 255 /end CHARACTERISTIC
/begin CHARACTERISTIC CAL_obd_ii_P0139 "Calibration: OBD-II P0139 (OBD-II monitor enable level)." VALUE 0x4000D1C6 RL_VALUE_UBYTE 0 NO_COMPU_METHOD 0 255 /end CHARACTERISTIC
/begin CHARACTERISTIC CAL_obd_ii_P0140 "Calibration: OBD-II P0140 (OBD-II monitor enable level)." VALUE 0x4000D1C7 RL_VALUE_UBYTE 0 NO_COMPU_METHOD 0 255 /end CHARACTERISTIC
/begin CHARACTERISTIC CAL_obd_ii_P0141 "Calibration: OBD-II P0141 (OBD-II monitor enable level)." VALUE 0x4000D1C8 RL_VALUE_UBYTE 0 NO_COMPU_METHOD 0 255 /end CHARACTERISTIC
/begin CHARACTERISTIC CAL_obd_ii_P0102 "Calibration: OBD-II P0102 (OBD-II monitor enable level)." VALUE 0x4000D1C9 RL_VALUE_UBYTE 0 NO_COMPU_METHOD 0 255 /end CHARACTERISTIC
/begin CHARACTERISTIC CAL_obd_ii_P0103 "Calibration: OBD-II P0103 (OBD-II monitor enable level)." VALUE 0x4000D1CA RL_VALUE_UBYTE 0 NO_COMPU_METHOD 0 255 /end CHARACTERISTIC
/begin CHARACTERISTIC CAL_obd_ii_P0101_manual "Calibration: OBD-II P0101 manual (OBD-II monitor enable level)." VALUE 0x4000D1CB RL_VALUE_UBYTE 0 NO_COMPU_METHOD 0 255 /end CHARACTERISTIC
/begin CHARACTERISTIC CAL_obd_ii_P2122 "Calibration: OBD-II P2122 (OBD-II monitor enable level)." VALUE 0x4000D1CC RL_VALUE_UBYTE 0 NO_COMPU_METHOD 0 255 /end CHARACTERISTIC
/begin CHARACTERISTIC CAL_obd_ii_P2123 "Calibration: OBD-II P2123 (OBD-II monitor enable level)." VALUE 0x4000D1CD RL_VALUE_UBYTE 0 NO_COMPU_METHOD 0 255 /end CHARACTERISTIC
/begin CHARACTERISTIC CAL_obd_ii_P2127 "Calibration: OBD-II P2127 (OBD-II monitor enable level)." VALUE 0x4000D1CE RL_VALUE_UBYTE 0 NO_COMPU_METHOD 0 255 /end CHARACTERISTIC
/begin CHARACTERISTIC CAL_obd_ii_P2128 "Calibration: OBD-II P2128 (OBD-II monitor enable level)." VALUE 0x4000D1CF RL_VALUE_UBYTE 0 NO_COMPU_METHOD 0 255 /end CHARACTERISTIC
/begin CHARACTERISTIC CAL_obd_ii_P0222 "Calibration: OBD-II P0222 (OBD-II monitor enable level)." VALUE 0x4000D1D0 RL_VALUE_UBYTE 0 NO_COMPU_METHOD 0 255 /end CHARACTERISTIC
/begin CHARACTERISTIC CAL_obd_ii_P0223 "Calibration: OBD-II P0223 (OBD-II monitor enable level)." VALUE 0x4000D1D1 RL_VALUE_UBYTE 0 NO_COMPU_METHOD 0 255 /end CHARACTERISTIC
/begin CHARACTERISTIC CAL_obd_ii_P2135 "Calibration: OBD-II P2135 (OBD-II monitor enable level)." VALUE 0x4000D1D2 RL_VALUE_UBYTE 0 NO_COMPU_METHOD 0 255 /end CHARACTERISTIC
/begin CHARACTERISTIC CAL_obd_ii_P0638 "Calibration: OBD-II P0638 (OBD-II monitor enable level)." VALUE 0x4000D1D3 RL_VALUE_UBYTE 0 NO_COMPU_METHOD 0 255 /end CHARACTERISTIC
/begin CHARACTERISTIC CAL_obd_ii_P2119 "Calibration: OBD-II P2119 (OBD-II monitor enable level)." VALUE 0x4000D1D4 RL_VALUE_UBYTE 0 NO_COMPU_METHOD 0 255 /end CHARACTERISTIC
/begin CHARACTERISTIC CAL_obd_ii_P1106 "Calibration: OBD-II P1106 (OBD-II monitor enable level)." VALUE 0x4000D1D5 RL_VALUE_UBYTE 0 NO_COMPU_METHOD 0 255 /end CHARACTERISTIC
/begin CHARACTERISTIC CAL_obd_ii_P0171 "Calibration: OBD-II P0171 (OBD-II monitor enable level)." VALUE 0x4000D1D6 RL_VALUE_UBYTE 0 NO_COMPU_METHOD 0 255 /end CHARACTERISTIC
/begin CHARACTERISTIC CAL_obd_ii_P0172 "Calibration: OBD-II P0172 (OBD-II monitor enable level)." VALUE 0x4000D1D7 RL_VALUE_UBYTE 0 NO_COMPU_METHOD 0 255 /end CHARACTERISTIC
/begin CHARACTERISTIC CAL_obd_ii_P0627 "Calibration: OBD-II P0627 (OBD-II monitor enable level)." VALUE 0x4000D1D8 RL_VALUE_UBYTE 0 NO_COMPU_METHOD 0 255 /end CHARACTERISTIC
/begin CHARACTERISTIC CAL_obd_ii_P0076 "Calibration: OBD-II P0076 (OBD-II monitor enable level)." VALUE 0x4000D1D9 RL_VALUE_UBYTE 0 NO_COMPU_METHOD 0 255 /end CHARACTERISTIC
/begin CHARACTERISTIC CAL_obd_ii_P0077 "Calibration: OBD-II P0077 (OBD-II monitor enable level)." VALUE 0x4000D1DA RL_VALUE_UBYTE 0 NO_COMPU_METHOD 0 255 /end CHARACTERISTIC
/begin CHARACTERISTIC CAL_obd_ii_P0261 "Calibration: OBD-II P0261 (OBD-II monitor enable level)." VALUE 0x4000D1DB RL_VALUE_UBYTE 0 NO_COMPU_METHOD 0 255 /end CHARACTERISTIC
/begin CHARACTERISTIC CAL_obd_ii_P0262 "Calibration: OBD-II P0262 (OBD-II monitor enable level)." VALUE 0x4000D1DC RL_VALUE_UBYTE 0 NO_COMPU_METHOD 0 255 /end CHARACTERISTIC
/begin CHARACTERISTIC CAL_obd_ii_P0264 "Calibration: OBD-II P0264 (OBD-II monitor enable level)." VALUE 0x4000D1DD RL_VALUE_UBYTE 0 NO_COMPU_METHOD 0 255 /end CHARACTERISTIC
/begin CHARACTERISTIC CAL_obd_ii_P0265 "Calibration: OBD-II P0265 (OBD-II monitor enable level)." VALUE 0x4000D1DE RL_VALUE_UBYTE 0 NO_COMPU_METHOD 0 255 /end CHARACTERISTIC
/begin CHARACTERISTIC CAL_obd_ii_P0267 "Calibration: OBD-II P0267 (OBD-II monitor enable level)." VALUE 0x4000D1DF RL_VALUE_UBYTE 0 NO_COMPU_METHOD 0 255 /end CHARACTERISTIC
/begin CHARACTERISTIC CAL_obd_ii_P0268 "Calibration: OBD-II P0268 (OBD-II monitor enable level)." VALUE 0x4000D1E0 RL_VALUE_UBYTE 0 NO_COMPU_METHOD 0 255 /end CHARACTERISTIC
/begin CHARACTERISTIC CAL_obd_ii_P0270 "Calibration: OBD-II P0270 (OBD-II monitor enable level)." VALUE 0x4000D1E1 RL_VALUE_UBYTE 0 NO_COMPU_METHOD 0 255 /end CHARACTERISTIC
/begin CHARACTERISTIC CAL_obd_ii_P0271 "Calibration: OBD-II P0271 (OBD-II monitor enable level)." VALUE 0x4000D1E2 RL_VALUE_UBYTE 0 NO_COMPU_METHOD 0 255 /end CHARACTERISTIC
/begin CHARACTERISTIC CAL_obd_ii_P0273 "Calibration: OBD-II P0273 (OBD-II monitor enable level)." VALUE 0x4000D1E3 RL_VALUE_UBYTE 0 NO_COMPU_METHOD 0 255 /end CHARACTERISTIC
/begin CHARACTERISTIC CAL_obd_ii_P0274 "Calibration: OBD-II P0274 (OBD-II monitor enable level)." VALUE 0x4000D1E4 RL_VALUE_UBYTE 0 NO_COMPU_METHOD 0 255 /end CHARACTERISTIC
/begin CHARACTERISTIC CAL_obd_ii_P0276 "Calibration: OBD-II P0276 (OBD-II monitor enable level)." VALUE 0x4000D1E5 RL_VALUE_UBYTE 0 NO_COMPU_METHOD 0 255 /end CHARACTERISTIC
/begin CHARACTERISTIC CAL_obd_ii_P0277 "Calibration: OBD-II P0277 (OBD-II monitor enable level)." VALUE 0x4000D1E6 RL_VALUE_UBYTE 0 NO_COMPU_METHOD 0 255 /end CHARACTERISTIC
/begin CHARACTERISTIC CAL_obd_ii_P025C "Calibration: OBD-II P025C (OBD-II monitor enable level)." VALUE 0x4000D1E7 RL_VALUE_UBYTE 0 NO_COMPU_METHOD 0 255 /end CHARACTERISTIC
/begin CHARACTERISTIC CAL_obd_ii_P0351 "Calibration: OBD-II P0351 (OBD-II monitor enable level)." VALUE 0x4000D1E8 RL_VALUE_UBYTE 0 NO_COMPU_METHOD 0 255 /end CHARACTERISTIC
/begin CHARACTERISTIC CAL_obd_ii_P0352 "Calibration: OBD-II P0352 (OBD-II monitor enable level)." VALUE 0x4000D1E9 RL_VALUE_UBYTE 0 NO_COMPU_METHOD 0 255 /end CHARACTERISTIC
/begin CHARACTERISTIC CAL_obd_ii_P0353 "Calibration: OBD-II P0353 (OBD-II monitor enable level)." VALUE 0x4000D1EA RL_VALUE_UBYTE 0 NO_COMPU_METHOD 0 255 /end CHARACTERISTIC
/begin CHARACTERISTIC CAL_obd_ii_P0354 "Calibration: OBD-II P0354 (OBD-II monitor enable level)." VALUE 0x4000D1EB RL_VALUE_UBYTE 0 NO_COMPU_METHOD 0 255 /end CHARACTERISTIC
/begin CHARACTERISTIC CAL_obd_ii_P025D "Calibration: OBD-II P025D (OBD-II monitor enable level)." VALUE 0x4000D1EC RL_VALUE_UBYTE 0 NO_COMPU_METHOD 0 255 /end CHARACTERISTIC
/begin CHARACTERISTIC CAL_obd_ii_P0300 "Calibration: OBD-II P0300 (OBD-II monitor enable level)." VALUE 0x4000D1ED RL_VALUE_UBYTE 0 NO_COMPU_METHOD 0 255 /end CHARACTERISTIC
/begin CHARACTERISTIC CAL_obd_ii_P0301 "Calibration: OBD-II P0301 (OBD-II monitor enable level)." VALUE 0x4000D1EE RL_VALUE_UBYTE 0 NO_COMPU_METHOD 0 255 /end CHARACTERISTIC
/begin CHARACTERISTIC CAL_obd_ii_P0302 "Calibration: OBD-II P0302 (OBD-II monitor enable level)." VALUE 0x4000D1EF RL_VALUE_UBYTE 0 NO_COMPU_METHOD 0 255 /end CHARACTERISTIC
/begin CHARACTERISTIC CAL_obd_ii_P0303 "Calibration: OBD-II P0303 (OBD-II monitor enable level)." VALUE 0x4000D1F0 RL_VALUE_UBYTE 0 NO_COMPU_METHOD 0 255 /end CHARACTERISTIC
/begin CHARACTERISTIC CAL_obd_ii_P0304 "Calibration: OBD-II P0304 (OBD-II monitor enable level)." VALUE 0x4000D1F1 RL_VALUE_UBYTE 0 NO_COMPU_METHOD 0 255 /end CHARACTERISTIC
/begin CHARACTERISTIC CAL_obd_ii_P0305 "Calibration: OBD-II P0305 (OBD-II monitor enable level)." VALUE 0x4000D1F2 RL_VALUE_UBYTE 0 NO_COMPU_METHOD 0 255 /end CHARACTERISTIC
/begin CHARACTERISTIC CAL_obd_ii_P0306 "Calibration: OBD-II P0306 (OBD-II monitor enable level)." VALUE 0x4000D1F3 RL_VALUE_UBYTE 0 NO_COMPU_METHOD 0 255 /end CHARACTERISTIC
/begin CHARACTERISTIC CAL_obd_ii_P0700 "Calibration: OBD-II P0700 (OBD-II monitor enable level)." VALUE 0x4000D1F4 RL_VALUE_UBYTE 0 NO_COMPU_METHOD 0 255 /end CHARACTERISTIC
/begin CHARACTERISTIC CAL_obd_ii_P0571 "Calibration: OBD-II P0571 (OBD-II monitor enable level)." VALUE 0x4000D1F5 RL_VALUE_UBYTE 0 NO_COMPU_METHOD 0 255 /end CHARACTERISTIC
/begin CHARACTERISTIC CAL_obd_ii_P0327 "Calibration: OBD-II P0327 (OBD-II monitor enable level)." VALUE 0x4000D1F6 RL_VALUE_UBYTE 0 NO_COMPU_METHOD 0 255 /end CHARACTERISTIC
/begin CHARACTERISTIC CAL_obd_ii_P0328 "Calibration: OBD-II P0328 (OBD-II monitor enable level)." VALUE 0x4000D1F7 RL_VALUE_UBYTE 0 NO_COMPU_METHOD 0 255 /end CHARACTERISTIC
/begin CHARACTERISTIC CAL_obd_ii_P0335 "Calibration: OBD-II P0335 (OBD-II monitor enable level)." VALUE 0x4000D1F8 RL_VALUE_UBYTE 0 NO_COMPU_METHOD 0 255 /end CHARACTERISTIC
/begin CHARACTERISTIC CAL_obd_ii_P0826 "Calibration: OBD-II P0826 (OBD-II monitor enable level)." VALUE 0x4000D1F9 RL_VALUE_UBYTE 0 NO_COMPU_METHOD 0 255 /end CHARACTERISTIC
/begin CHARACTERISTIC CAL_obd_ii_P1301 "Calibration: OBD-II P1301 (OBD-II monitor enable level)." VALUE 0x4000D1FA RL_VALUE_UBYTE 0 NO_COMPU_METHOD 0 255 /end CHARACTERISTIC
/begin CHARACTERISTIC CAL_obd_ii_P1302 "Calibration: OBD-II P1302 (OBD-II monitor enable level)." VALUE 0x4000D1FB RL_VALUE_UBYTE 0 NO_COMPU_METHOD 0 255 /end CHARACTERISTIC
/begin CHARACTERISTIC CAL_obd_ii_P0014 "Calibration: OBD-II P0014 (OBD-II monitor enable level)." VALUE 0x4000D1FC RL_VALUE_UBYTE 0 NO_COMPU_METHOD 0 255 /end CHARACTERISTIC
/begin CHARACTERISTIC CAL_obd_ii_P0015 "Calibration: OBD-II P0015 (OBD-II monitor enable level)." VALUE 0x4000D1FD RL_VALUE_UBYTE 0 NO_COMPU_METHOD 0 255 /end CHARACTERISTIC
/begin CHARACTERISTIC CAL_obd_ii_P0024 "Calibration: OBD-II P0024 (OBD-II monitor enable level)." VALUE 0x4000D1FE RL_VALUE_UBYTE 0 NO_COMPU_METHOD 0 255 /end CHARACTERISTIC
/begin CHARACTERISTIC CAL_obd_ii_P0025 "Calibration: OBD-II P0025 (OBD-II monitor enable level)." VALUE 0x4000D1FF RL_VALUE_UBYTE 0 NO_COMPU_METHOD 0 255 /end CHARACTERISTIC
/begin CHARACTERISTIC CAL_obd_ii_P0079 "Calibration: OBD-II P0079 (OBD-II monitor enable level)." VALUE 0x4000D200 RL_VALUE_UBYTE 0 NO_COMPU_METHOD 0 255 /end CHARACTERISTIC
/begin CHARACTERISTIC CAL_obd_ii_P0080 "Calibration: OBD-II P0080 (OBD-II monitor enable level)." VALUE 0x4000D201 RL_VALUE_UBYTE 0 NO_COMPU_METHOD 0 255 /end CHARACTERISTIC
/begin CHARACTERISTIC CAL_obd_ii_P0082 "Calibration: OBD-II P0082 (OBD-II monitor enable level)." VALUE 0x4000D202 RL_VALUE_UBYTE 0 NO_COMPU_METHOD 0 255 /end CHARACTERISTIC
/begin CHARACTERISTIC CAL_obd_ii_P0083 "Calibration: OBD-II P0083 (OBD-II monitor enable level)." VALUE 0x4000D203 RL_VALUE_UBYTE 0 NO_COMPU_METHOD 0 255 /end CHARACTERISTIC
/begin CHARACTERISTIC CAL_obd_ii_P0420 "Calibration: OBD-II P0420 (OBD-II monitor enable level)." VALUE 0x4000D204 RL_VALUE_UBYTE 0 NO_COMPU_METHOD 0 255 /end CHARACTERISTIC
/begin CHARACTERISTIC CAL_obd_ii_P0085 "Calibration: OBD-II P0085 (OBD-II monitor enable level)." VALUE 0x4000D205 RL_VALUE_UBYTE 0 NO_COMPU_METHOD 0 255 /end CHARACTERISTIC
/begin CHARACTERISTIC CAL_obd_ii_P0086 "Calibration: OBD-II P0086 (OBD-II monitor enable level)." VALUE 0x4000D206 RL_VALUE_UBYTE 0 NO_COMPU_METHOD 0 255 /end CHARACTERISTIC
/begin CHARACTERISTIC CAL_obd_ii_P0827 "Calibration: OBD-II P0827 (OBD-II monitor enable level)." VALUE 0x4000D207 RL_VALUE_UBYTE 0 NO_COMPU_METHOD 0 255 /end CHARACTERISTIC
/begin CHARACTERISTIC CAL_obd_ii_P1809 "Calibration: OBD-II P1809 (OBD-II monitor enable level)." VALUE 0x4000D208 RL_VALUE_UBYTE 0 NO_COMPU_METHOD 0 255 /end CHARACTERISTIC
/begin CHARACTERISTIC CAL_obd_ii_P0430 "Calibration: OBD-II P0430 (OBD-II monitor enable level)." VALUE 0x4000D209 RL_VALUE_UBYTE 0 NO_COMPU_METHOD 0 255 /end CHARACTERISTIC
/begin CHARACTERISTIC CAL_obd_ii_P0355 "Calibration: OBD-II P0355 (OBD-II monitor enable level)." VALUE 0x4000D20A RL_VALUE_UBYTE 0 NO_COMPU_METHOD 0 255 /end CHARACTERISTIC
/begin CHARACTERISTIC CAL_obd_ii_P0356 "Calibration: OBD-II P0356 (OBD-II monitor enable level)." VALUE 0x4000D20B RL_VALUE_UBYTE 0 NO_COMPU_METHOD 0 255 /end CHARACTERISTIC
/begin CHARACTERISTIC CAL_obd_ii_P0579 "Calibration: OBD-II P0579 (OBD-II monitor enable level)." VALUE 0x4000D20C RL_VALUE_UBYTE 0 NO_COMPU_METHOD 0 255 /end CHARACTERISTIC
/begin CHARACTERISTIC CAL_obd_ii_P1104 "Calibration: OBD-II P1104 (OBD-II monitor enable level)." VALUE 0x4000D20D RL_VALUE_UBYTE 0 NO_COMPU_METHOD 0 255 /end CHARACTERISTIC
/begin CHARACTERISTIC CAL_obd_ii_P0828 "Calibration: OBD-II P0828 (OBD-II monitor enable level)." VALUE 0x4000D20E RL_VALUE_UBYTE 0 NO_COMPU_METHOD 0 255 /end CHARACTERISTIC
/begin CHARACTERISTIC CAL_obd_ii_P0441 "Calibration: OBD-II P0441 (OBD-II monitor enable level)." VALUE 0x4000D20F RL_VALUE_UBYTE 0 NO_COMPU_METHOD 0 255 /end CHARACTERISTIC
/begin CHARACTERISTIC CAL_obd_ii_P0442 "Calibration: OBD-II P0442 (OBD-II monitor enable level)." VALUE 0x4000D210 RL_VALUE_UBYTE 0 NO_COMPU_METHOD 0 255 /end CHARACTERISTIC
/begin CHARACTERISTIC CAL_obd_ii_P050B "Calibration: OBD-II P050B (OBD-II monitor enable level)." VALUE 0x4000D211 RL_VALUE_UBYTE 0 NO_COMPU_METHOD 0 255 /end CHARACTERISTIC
/begin CHARACTERISTIC CAL_obd_ii_P0444 "Calibration: OBD-II P0444 (OBD-II monitor enable level)." VALUE 0x4000D212 RL_VALUE_UBYTE 0 NO_COMPU_METHOD 0 255 /end CHARACTERISTIC
/begin CHARACTERISTIC CAL_obd_ii_P0445 "Calibration: OBD-II P0445 (OBD-II monitor enable level)." VALUE 0x4000D213 RL_VALUE_UBYTE 0 NO_COMPU_METHOD 0 255 /end CHARACTERISTIC
/begin CHARACTERISTIC CAL_obd_ii_P0446 "Calibration: OBD-II P0446 (OBD-II monitor enable level)." VALUE 0x4000D214 RL_VALUE_UBYTE 0 NO_COMPU_METHOD 0 255 /end CHARACTERISTIC
/begin CHARACTERISTIC CAL_obd_ii_P0447 "Calibration: OBD-II P0447 (OBD-II monitor enable level)." VALUE 0x4000D215 RL_VALUE_UBYTE 0 NO_COMPU_METHOD 0 255 /end CHARACTERISTIC
/begin CHARACTERISTIC CAL_obd_ii_P0448 "Calibration: OBD-II P0448 (OBD-II monitor enable level)." VALUE 0x4000D216 RL_VALUE_UBYTE 0 NO_COMPU_METHOD 0 255 /end CHARACTERISTIC
/begin CHARACTERISTIC CAL_obd_ii_P050A "Calibration: OBD-II P050A (OBD-II monitor enable level)." VALUE 0x4000D217 RL_VALUE_UBYTE 0 NO_COMPU_METHOD 0 255 /end CHARACTERISTIC
/begin CHARACTERISTIC CAL_obd_ii_P0451 "Calibration: OBD-II P0451 (OBD-II monitor enable level)." VALUE 0x4000D218 RL_VALUE_UBYTE 0 NO_COMPU_METHOD 0 255 /end CHARACTERISTIC
/begin CHARACTERISTIC CAL_obd_ii_P0452 "Calibration: OBD-II P0452 (OBD-II monitor enable level)." VALUE 0x4000D219 RL_VALUE_UBYTE 0 NO_COMPU_METHOD 0 255 /end CHARACTERISTIC
/begin CHARACTERISTIC CAL_obd_ii_P0453 "Calibration: OBD-II P0453 (OBD-II monitor enable level)." VALUE 0x4000D21A RL_VALUE_UBYTE 0 NO_COMPU_METHOD 0 255 /end CHARACTERISTIC
/begin CHARACTERISTIC CAL_obd_ii_P0480 "Calibration: OBD-II P0480 (OBD-II monitor enable level)." VALUE 0x4000D21B RL_VALUE_UBYTE 0 NO_COMPU_METHOD 0 255 /end CHARACTERISTIC
/begin CHARACTERISTIC CAL_obd_ii_P1109 "Calibration: OBD-II P1109 (OBD-II monitor enable level)." VALUE 0x4000D21C RL_VALUE_UBYTE 0 NO_COMPU_METHOD 0 255 /end CHARACTERISTIC
/begin CHARACTERISTIC CAL_obd_ii_P0341 "Calibration: OBD-II P0341 (OBD-II monitor enable level)." VALUE 0x4000D21D RL_VALUE_UBYTE 0 NO_COMPU_METHOD 0 255 /end CHARACTERISTIC
/begin CHARACTERISTIC CAL_obd_ii_P0346 "Calibration: OBD-II P0346 (OBD-II monitor enable level)." VALUE 0x4000D21E RL_VALUE_UBYTE 0 NO_COMPU_METHOD 0 255 /end CHARACTERISTIC
/begin CHARACTERISTIC CAL_obd_ii_P0366 "Calibration: OBD-II P0366 (OBD-II monitor enable level)." VALUE 0x4000D21F RL_VALUE_UBYTE 0 NO_COMPU_METHOD 0 255 /end CHARACTERISTIC
/begin CHARACTERISTIC CAL_obd_ii_P0391 "Calibration: OBD-II P0391 (OBD-II monitor enable level)." VALUE 0x4000D220 RL_VALUE_UBYTE 0 NO_COMPU_METHOD 0 255 /end CHARACTERISTIC
/begin CHARACTERISTIC CAL_obd_ii_P0482 "Calibration: OBD-II P0482 (OBD-II monitor enable level)." VALUE 0x4000D221 RL_VALUE_UBYTE 0 NO_COMPU_METHOD 0 255 /end CHARACTERISTIC
/begin CHARACTERISTIC CAL_obd_ii_P0461 "Calibration: OBD-II P0461 (OBD-II monitor enable level)." VALUE 0x4000D222 RL_VALUE_UBYTE 0 NO_COMPU_METHOD 0 255 /end CHARACTERISTIC
/begin CHARACTERISTIC CAL_obd_ii_P0462 "Calibration: OBD-II P0462 (OBD-II monitor enable level)." VALUE 0x4000D223 RL_VALUE_UBYTE 0 NO_COMPU_METHOD 0 255 /end CHARACTERISTIC
/begin CHARACTERISTIC CAL_obd_ii_P0463 "Calibration: OBD-II P0463 (OBD-II monitor enable level)." VALUE 0x4000D224 RL_VALUE_UBYTE 0 NO_COMPU_METHOD 0 255 /end CHARACTERISTIC
/begin CHARACTERISTIC CAL_obd_ii_P0523 "Calibration: OBD-II P0523 (OBD-II monitor enable level)." VALUE 0x4000D225 RL_VALUE_UBYTE 0 NO_COMPU_METHOD 0 255 /end CHARACTERISTIC
/begin CHARACTERISTIC CAL_obd_ii_P0563 "Calibration: OBD-II P0563 (OBD-II monitor enable level)." VALUE 0x4000D226 RL_VALUE_UBYTE 0 NO_COMPU_METHOD 0 255 /end CHARACTERISTIC
/begin CHARACTERISTIC CAL_obd_ii_P0562 "Calibration: OBD-II P0562 (OBD-II monitor enable level)." VALUE 0x4000D227 RL_VALUE_UBYTE 0 NO_COMPU_METHOD 0 255 /end CHARACTERISTIC
/begin CHARACTERISTIC CAL_obd_ii_P0685 "Calibration: OBD-II P0685 (OBD-II monitor enable level)." VALUE 0x4000D228 RL_VALUE_UBYTE 0 NO_COMPU_METHOD 0 255 /end CHARACTERISTIC
/begin CHARACTERISTIC CAL_obd_ii_P0610 "Calibration: OBD-II P0610 (OBD-II monitor enable level)." VALUE 0x4000D229 RL_VALUE_UBYTE 0 NO_COMPU_METHOD 0 255 /end CHARACTERISTIC
/begin CHARACTERISTIC CAL_obd_ii_P0646 "Calibration: OBD-II P0646 (OBD-II monitor enable level)." VALUE 0x4000D22A RL_VALUE_UBYTE 0 NO_COMPU_METHOD 0 255 /end CHARACTERISTIC
/begin CHARACTERISTIC CAL_obd_ii_P0647 "Calibration: OBD-II P0647 (OBD-II monitor enable level)." VALUE 0x4000D22B RL_VALUE_UBYTE 0 NO_COMPU_METHOD 0 255 /end CHARACTERISTIC
/begin CHARACTERISTIC CAL_obd_ii_P0500 "Calibration: OBD-II P0500 (OBD-II monitor enable level)." VALUE 0x4000D22C RL_VALUE_UBYTE 0 NO_COMPU_METHOD 0 255 /end CHARACTERISTIC
/begin CHARACTERISTIC CAL_obd_ii_P0506 "Calibration: OBD-II P0506 (OBD-II monitor enable level)." VALUE 0x4000D22D RL_VALUE_UBYTE 0 NO_COMPU_METHOD 0 255 /end CHARACTERISTIC
/begin CHARACTERISTIC CAL_obd_ii_P0507 "Calibration: OBD-II P0507 (OBD-II monitor enable level)." VALUE 0x4000D22E RL_VALUE_UBYTE 0 NO_COMPU_METHOD 0 255 /end CHARACTERISTIC
/begin CHARACTERISTIC CAL_obd_ii_P0096 "Calibration: OBD-II P0096 (OBD-II monitor enable level)." VALUE 0x4000D22F RL_VALUE_UBYTE 0 NO_COMPU_METHOD 0 255 /end CHARACTERISTIC
/begin CHARACTERISTIC CAL_obd_ii_P0072 "Calibration: OBD-II P0072 (OBD-II monitor enable level)." VALUE 0x4000D230 RL_VALUE_UBYTE 0 NO_COMPU_METHOD 0 255 /end CHARACTERISTIC
/begin CHARACTERISTIC CAL_obd_ii_P0073 "Calibration: OBD-II P0073 (OBD-II monitor enable level)." VALUE 0x4000D231 RL_VALUE_UBYTE 0 NO_COMPU_METHOD 0 255 /end CHARACTERISTIC
/begin CHARACTERISTIC CAL_obd_ii_P0616 "Calibration: OBD-II P0616 (OBD-II monitor enable level)." VALUE 0x4000D232 RL_VALUE_UBYTE 0 NO_COMPU_METHOD 0 255 /end CHARACTERISTIC
/begin CHARACTERISTIC CAL_obd_ii_P0617 "Calibration: OBD-II P0617 (OBD-II monitor enable level)." VALUE 0x4000D233 RL_VALUE_UBYTE 0 NO_COMPU_METHOD 0 255 /end CHARACTERISTIC
/begin CHARACTERISTIC CAL_obd_ii_P0630 "Calibration: OBD-II P0630 (OBD-II monitor enable level)." VALUE 0x4000D234 RL_VALUE_UBYTE 0 NO_COMPU_METHOD 0 255 /end CHARACTERISTIC
/begin CHARACTERISTIC CAL_obd_ii_P2138 "Calibration: OBD-II P2138 (OBD-II monitor enable level)." VALUE 0x4000D235 RL_VALUE_UBYTE 0 NO_COMPU_METHOD 0 255 /end CHARACTERISTIC
/begin CHARACTERISTIC CAL_obd_ii_P2602 "Calibration: OBD-II P2602 (OBD-II monitor enable level)." VALUE 0x4000D236 RL_VALUE_UBYTE 0 NO_COMPU_METHOD 0 255 /end CHARACTERISTIC
/begin CHARACTERISTIC CAL_obd_ii_P2603 "Calibration: OBD-II P2603 (OBD-II monitor enable level)." VALUE 0x4000D237 RL_VALUE_UBYTE 0 NO_COMPU_METHOD 0 255 /end CHARACTERISTIC
/begin CHARACTERISTIC CAL_obd_ii_P0011 "Calibration: OBD-II P0011 (OBD-II monitor enable level)." VALUE 0x4000D238 RL_VALUE_UBYTE 0 NO_COMPU_METHOD 0 255 /end CHARACTERISTIC
/begin CHARACTERISTIC CAL_obd_ii_P0012 "Calibration: OBD-II P0012 (OBD-II monitor enable level)." VALUE 0x4000D239 RL_VALUE_UBYTE 0 NO_COMPU_METHOD 0 255 /end CHARACTERISTIC
/begin CHARACTERISTIC CAL_obd_ii_P0601 "Calibration: OBD-II P0601 (OBD-II monitor enable level)." VALUE 0x4000D23A RL_VALUE_UBYTE 0 NO_COMPU_METHOD 0 255 /end CHARACTERISTIC
/begin CHARACTERISTIC CAL_obd_ii_P0606 "Calibration: OBD-II P0606 (OBD-II monitor enable level)." VALUE 0x4000D23B RL_VALUE_UBYTE 0 NO_COMPU_METHOD 0 255 /end CHARACTERISTIC
/begin CHARACTERISTIC CAL_obd_ii_P0455 "Calibration: OBD-II P0455 (OBD-II monitor enable level)." VALUE 0x4000D23C RL_VALUE_UBYTE 0 NO_COMPU_METHOD 0 255 /end CHARACTERISTIC
/begin CHARACTERISTIC CAL_obd_ii_P0456 "Calibration: OBD-II P0456 (OBD-II monitor enable level)." VALUE 0x4000D23D RL_VALUE_UBYTE 0 NO_COMPU_METHOD 0 255 /end CHARACTERISTIC
/begin CHARACTERISTIC CAL_obd_ii_P0016 "Calibration: OBD-II P0016 (OBD-II monitor enable level)." VALUE 0x4000D23E RL_VALUE_UBYTE 0 NO_COMPU_METHOD 0 255 /end CHARACTERISTIC
/begin CHARACTERISTIC CAL_obd_ii_P2173 "Calibration: OBD-II P2173 (OBD-II monitor enable level)." VALUE 0x4000D23F RL_VALUE_UBYTE 0 NO_COMPU_METHOD 0 255 /end CHARACTERISTIC
/begin CHARACTERISTIC CAL_obd_ii_P2104 "Calibration: OBD-II P2104 (OBD-II monitor enable level)." VALUE 0x4000D240 RL_VALUE_UBYTE 0 NO_COMPU_METHOD 0 255 /end CHARACTERISTIC
/begin CHARACTERISTIC CAL_obd_ii_P2105 "Calibration: OBD-II P2105 (OBD-II monitor enable level)." VALUE 0x4000D241 RL_VALUE_UBYTE 0 NO_COMPU_METHOD 0 255 /end CHARACTERISTIC
/begin CHARACTERISTIC CAL_obd_ii_P2106 "Calibration: OBD-II P2106 (OBD-II monitor enable level)." VALUE 0x4000D242 RL_VALUE_UBYTE 0 NO_COMPU_METHOD 0 255 /end CHARACTERISTIC
/begin CHARACTERISTIC CAL_obd_ii_P2107 "Calibration: OBD-II P2107 (OBD-II monitor enable level)." VALUE 0x4000D243 RL_VALUE_UBYTE 0 NO_COMPU_METHOD 0 255 /end CHARACTERISTIC
/begin CHARACTERISTIC CAL_obd_ii_P2100 "Calibration: OBD-II P2100 (OBD-II monitor enable level)." VALUE 0x4000D244 RL_VALUE_UBYTE 0 NO_COMPU_METHOD 0 255 /end CHARACTERISTIC
/begin CHARACTERISTIC CAL_obd_ii_P2102 "Calibration: OBD-II P2102 (OBD-II monitor enable level)." VALUE 0x4000D245 RL_VALUE_UBYTE 0 NO_COMPU_METHOD 0 255 /end CHARACTERISTIC
/begin CHARACTERISTIC CAL_obd_ii_P2103 "Calibration: OBD-II P2103 (OBD-II monitor enable level)." VALUE 0x4000D246 RL_VALUE_UBYTE 0 NO_COMPU_METHOD 0 255 /end CHARACTERISTIC
/begin CHARACTERISTIC CAL_obd_ii_P2108 "Calibration: OBD-II P2108 (OBD-II monitor enable level)." VALUE 0x4000D247 RL_VALUE_UBYTE 0 NO_COMPU_METHOD 0 255 /end CHARACTERISTIC
/begin CHARACTERISTIC CAL_obd_ii_P0151 "Calibration: OBD-II P0151 (OBD-II monitor enable level)." VALUE 0x4000D248 RL_VALUE_UBYTE 0 NO_COMPU_METHOD 0 255 /end CHARACTERISTIC
/begin CHARACTERISTIC CAL_obd_ii_P0152 "Calibration: OBD-II P0152 (OBD-II monitor enable level)." VALUE 0x4000D249 RL_VALUE_UBYTE 0 NO_COMPU_METHOD 0 255 /end CHARACTERISTIC
/begin CHARACTERISTIC CAL_obd_ii_P0153 "Calibration: OBD-II P0153 (OBD-II monitor enable level)." VALUE 0x4000D24A RL_VALUE_UBYTE 0 NO_COMPU_METHOD 0 255 /end CHARACTERISTIC
/begin CHARACTERISTIC CAL_obd_ii_P0154 "Calibration: OBD-II P0154 (OBD-II monitor enable level)." VALUE 0x4000D24B RL_VALUE_UBYTE 0 NO_COMPU_METHOD 0 255 /end CHARACTERISTIC
/begin CHARACTERISTIC CAL_obd_ii_P0155 "Calibration: OBD-II P0155 (OBD-II monitor enable level)." VALUE 0x4000D24C RL_VALUE_UBYTE 0 NO_COMPU_METHOD 0 255 /end CHARACTERISTIC
/begin CHARACTERISTIC CAL_obd_ii_P0157 "Calibration: OBD-II P0157 (OBD-II monitor enable level)." VALUE 0x4000D24D RL_VALUE_UBYTE 0 NO_COMPU_METHOD 0 255 /end CHARACTERISTIC
/begin CHARACTERISTIC CAL_obd_ii_P0158 "Calibration: OBD-II P0158 (OBD-II monitor enable level)." VALUE 0x4000D24E RL_VALUE_UBYTE 0 NO_COMPU_METHOD 0 255 /end CHARACTERISTIC
/begin CHARACTERISTIC CAL_obd_ii_P0159 "Calibration: OBD-II P0159 (OBD-II monitor enable level)." VALUE 0x4000D24F RL_VALUE_UBYTE 0 NO_COMPU_METHOD 0 255 /end CHARACTERISTIC
/begin CHARACTERISTIC CAL_obd_ii_P0160 "Calibration: OBD-II P0160 (OBD-II monitor enable level)." VALUE 0x4000D250 RL_VALUE_UBYTE 0 NO_COMPU_METHOD 0 255 /end CHARACTERISTIC
/begin CHARACTERISTIC CAL_obd_ii_P0161 "Calibration: OBD-II P0161 (OBD-II monitor enable level)." VALUE 0x4000D251 RL_VALUE_UBYTE 0 NO_COMPU_METHOD 0 255 /end CHARACTERISTIC
/begin CHARACTERISTIC CAL_obd_ii_P0174 "Calibration: OBD-II P0174 (OBD-II monitor enable level)." VALUE 0x4000D252 RL_VALUE_UBYTE 0 NO_COMPU_METHOD 0 255 /end CHARACTERISTIC
/begin CHARACTERISTIC CAL_obd_ii_P0175 "Calibration: OBD-II P0175 (OBD-II monitor enable level)." VALUE 0x4000D253 RL_VALUE_UBYTE 0 NO_COMPU_METHOD 0 255 /end CHARACTERISTIC
/begin CHARACTERISTIC CAL_obd_ii_P0332 "Calibration: OBD-II P0332 (OBD-II monitor enable level)." VALUE 0x4000D254 RL_VALUE_UBYTE 0 NO_COMPU_METHOD 0 255 /end CHARACTERISTIC
/begin CHARACTERISTIC CAL_obd_ii_P0333 "Calibration: OBD-II P0333 (OBD-II monitor enable level)." VALUE 0x4000D255 RL_VALUE_UBYTE 0 NO_COMPU_METHOD 0 255 /end CHARACTERISTIC
/begin CHARACTERISTIC CAL_obd_ii_P0021 "Calibration: OBD-II P0021 (OBD-II monitor enable level)." VALUE 0x4000D256 RL_VALUE_UBYTE 0 NO_COMPU_METHOD 0 255 /end CHARACTERISTIC
/begin CHARACTERISTIC CAL_obd_ii_P0022 "Calibration: OBD-II P0022 (OBD-II monitor enable level)." VALUE 0x4000D257 RL_VALUE_UBYTE 0 NO_COMPU_METHOD 0 255 /end CHARACTERISTIC
/begin CHARACTERISTIC CAL_obd_ii_P0017 "Calibration: OBD-II P0017 (OBD-II monitor enable level)." VALUE 0x4000D258 RL_VALUE_UBYTE 0 NO_COMPU_METHOD 0 255 /end CHARACTERISTIC
/begin CHARACTERISTIC CAL_obd_ii_P0018 "Calibration: OBD-II P0018 (OBD-II monitor enable level)." VALUE 0x4000D259 RL_VALUE_UBYTE 0 NO_COMPU_METHOD 0 255 /end CHARACTERISTIC
/begin CHARACTERISTIC CAL_obd_ii_P0019 "Calibration: OBD-II P0019 (OBD-II monitor enable level)." VALUE 0x4000D25A RL_VALUE_UBYTE 0 NO_COMPU_METHOD 0 255 /end CHARACTERISTIC
/begin CHARACTERISTIC CAL_obd_ii_P0578 "Calibration: OBD-II P0578 (OBD-II monitor enable level)." VALUE 0x4000D25B RL_VALUE_UBYTE 0 NO_COMPU_METHOD 0 255 /end CHARACTERISTIC
/begin CHARACTERISTIC CAL_obd_ii_P0564 "Calibration: OBD-II P0564 (OBD-II monitor enable level)." VALUE 0x4000D25C RL_VALUE_UBYTE 0 NO_COMPU_METHOD 0 255 /end CHARACTERISTIC
/begin CHARACTERISTIC CAL_obd_ii_P0806 "Calibration: OBD-II P0806 (OBD-II monitor enable level)." VALUE 0x4000D25D RL_VALUE_UBYTE 0 NO_COMPU_METHOD 0 255 /end CHARACTERISTIC
/begin CHARACTERISTIC CAL_obd_ii_P0807 "Calibration: OBD-II P0807 (OBD-II monitor enable level)." VALUE 0x4000D25E RL_VALUE_UBYTE 0 NO_COMPU_METHOD 0 255 /end CHARACTERISTIC
/begin CHARACTERISTIC CAL_obd_ii_P0808 "Calibration: OBD-II P0808 (OBD-II monitor enable level)." VALUE 0x4000D25F RL_VALUE_UBYTE 0 NO_COMPU_METHOD 0 255 /end CHARACTERISTIC
/begin CHARACTERISTIC CAL_obd_ii_P2612 "Calibration: OBD-II P2612 (OBD-II monitor enable level)." VALUE 0x4000D260 RL_VALUE_UBYTE 0 NO_COMPU_METHOD 0 255 /end CHARACTERISTIC
/begin CHARACTERISTIC CAL_obd_ii_P2613 "Calibration: OBD-II P2613 (OBD-II monitor enable level)." VALUE 0x4000D261 RL_VALUE_UBYTE 0 NO_COMPU_METHOD 0 255 /end CHARACTERISTIC
/begin CHARACTERISTIC CAL_obd_ii_P0537 "Calibration: OBD-II P0537 (OBD-II monitor enable level)." VALUE 0x4000D262 RL_VALUE_UBYTE 0 NO_COMPU_METHOD 0 255 /end CHARACTERISTIC
/begin CHARACTERISTIC CAL_obd_ii_P0538 "Calibration: OBD-II P0538 (OBD-II monitor enable level)." VALUE 0x4000D263 RL_VALUE_UBYTE 0 NO_COMPU_METHOD 0 255 /end CHARACTERISTIC
/begin CHARACTERISTIC CAL_obd_ii_U0155 "Calibration: OBD-II U0155 (OBD-II monitor enable level)." VALUE 0x4000D264 RL_VALUE_UBYTE 0 NO_COMPU_METHOD 0 255 /end CHARACTERISTIC
/begin CHARACTERISTIC CAL_obd_ii_U0101 "Calibration: OBD-II U0101 (OBD-II monitor enable level)." VALUE 0x4000D265 RL_VALUE_UBYTE 0 NO_COMPU_METHOD 0 255 /end CHARACTERISTIC
/begin CHARACTERISTIC CAL_obd_ii_U0122 "Calibration: OBD-II U0122 (OBD-II monitor enable level)." VALUE 0x4000D266 RL_VALUE_UBYTE 0 NO_COMPU_METHOD 0 255 /end CHARACTERISTIC
/begin CHARACTERISTIC CAL_obd_ii_U0316 "Calibration: OBD-II U0316 (OBD-II monitor enable level)." VALUE 0x4000D267 RL_VALUE_UBYTE 0 NO_COMPU_METHOD 0 255 /end CHARACTERISTIC
/begin CHARACTERISTIC CAL_obd_ii_U0141 "Calibration: OBD-II U0141 (OBD-II monitor enable level)." VALUE 0x4000D268 RL_VALUE_UBYTE 0 NO_COMPU_METHOD 0 255 /end CHARACTERISTIC
/begin CHARACTERISTIC CAL_obd_ii_U0302 "Calibration: OBD-II U0302 (OBD-II monitor enable level)." VALUE 0x4000D269 RL_VALUE_UBYTE 0 NO_COMPU_METHOD 0 255 /end CHARACTERISTIC
/begin CHARACTERISTIC CAL_obd_ii_U0416 "Calibration: OBD-II U0416 (OBD-II monitor enable level)." VALUE 0x4000D26A RL_VALUE_UBYTE 0 NO_COMPU_METHOD 0 255 /end CHARACTERISTIC
/begin CHARACTERISTIC CAL_obd_ii_U0123 "Calibration: OBD-II U0123 (OBD-II monitor enable level)." VALUE 0x4000D26B RL_VALUE_UBYTE 0 NO_COMPU_METHOD 0 255 /end CHARACTERISTIC
/begin CHARACTERISTIC CAL_obd_ii_U0513 "Calibration: OBD-II U0513 (OBD-II monitor enable level)." VALUE 0x4000D26C RL_VALUE_UBYTE 0 NO_COMPU_METHOD 0 255 /end CHARACTERISTIC
/begin CHARACTERISTIC CAL_obd_ii_U0109 "Calibration: OBD-II U0109 (OBD-II monitor enable level)." VALUE 0x4000D26D RL_VALUE_UBYTE 0 NO_COMPU_METHOD 0 255 /end CHARACTERISTIC
/begin CHARACTERISTIC CAL_obd_ii_B1422 "Calibration: OBD-II B1422 (OBD-II monitor enable level)." VALUE 0x4000D278 RL_VALUE_UBYTE 0 NO_COMPU_METHOD 0 255 /end CHARACTERISTIC
/begin CHARACTERISTIC CAL_obd_ii_P219A "Calibration: OBD-II P219A (OBD-II monitor enable level)." VALUE 0x4000D279 RL_VALUE_UBYTE 0 NO_COMPU_METHOD 0 255 /end CHARACTERISTIC
/begin CHARACTERISTIC CAL_obd_ii_P219B "Calibration: OBD-II P219B (OBD-II monitor enable level)." VALUE 0x4000D27A RL_VALUE_UBYTE 0 NO_COMPU_METHOD 0 255 /end CHARACTERISTIC
/begin CHARACTERISTIC CAL_obd_ii_P2336 "Calibration: OBD-II P2336 (OBD-II monitor enable level)." VALUE 0x4000D27B RL_VALUE_UBYTE 0 NO_COMPU_METHOD 0 255 /end CHARACTERISTIC
/begin CHARACTERISTIC CAL_obd_ii_P2337 "Calibration: OBD-II P2337 (OBD-II monitor enable level)." VALUE 0x4000D27C RL_VALUE_UBYTE 0 NO_COMPU_METHOD 0 255 /end CHARACTERISTIC
/begin CHARACTERISTIC CAL_obd_ii_P2338 "Calibration: OBD-II P2338 (OBD-II monitor enable level)." VALUE 0x4000D27D RL_VALUE_UBYTE 0 NO_COMPU_METHOD 0 255 /end CHARACTERISTIC
/begin CHARACTERISTIC CAL_obd_ii_P2339 "Calibration: OBD-II P2339 (OBD-II monitor enable level)." VALUE 0x4000D27E RL_VALUE_UBYTE 0 NO_COMPU_METHOD 0 255 /end CHARACTERISTIC
/begin CHARACTERISTIC CAL_obd_ii_P2340 "Calibration: OBD-II P2340 (OBD-II monitor enable level)." VALUE 0x4000D27F RL_VALUE_UBYTE 0 NO_COMPU_METHOD 0 255 /end CHARACTERISTIC
/begin CHARACTERISTIC CAL_obd_ii_P2341 "Calibration: OBD-II P2341 (OBD-II monitor enable level)." VALUE 0x4000D280 RL_VALUE_UBYTE 0 NO_COMPU_METHOD 0 255 /end CHARACTERISTIC
/begin CHARACTERISTIC CAL_obd_ii_P1562 "Calibration: OBD-II P1562 (OBD-II monitor enable level)." VALUE 0x4000D281 RL_VALUE_UBYTE 0 NO_COMPU_METHOD 0 255 /end CHARACTERISTIC
/begin CHARACTERISTIC CAL_obd_ii_P0097 "Calibration: OBD-II P0097 (OBD-II monitor enable level)." VALUE 0x4000D282 RL_VALUE_UBYTE 0 NO_COMPU_METHOD 0 255 /end CHARACTERISTIC
/begin CHARACTERISTIC CAL_obd_ii_P0098 "Calibration: OBD-II P0098 (OBD-II monitor enable level)." VALUE 0x4000D283 RL_VALUE_UBYTE 0 NO_COMPU_METHOD 0 255 /end CHARACTERISTIC
/begin CHARACTERISTIC CAL_obd_ii_P1107 "Calibration: OBD-II P1107 (OBD-II monitor enable level)." VALUE 0x4000D284 RL_VALUE_UBYTE 0 NO_COMPU_METHOD 0 255 /end CHARACTERISTIC
/begin CHARACTERISTIC CAL_obd_ii_P1108 "Calibration: OBD-II P1108 (OBD-II monitor enable level)." VALUE 0x4000D285 RL_VALUE_UBYTE 0 NO_COMPU_METHOD 0 255 /end CHARACTERISTIC
/begin CHARACTERISTIC CAL_obd_ii_P0522 "Calibration: OBD-II P0522 (OBD-II monitor enable level)." VALUE 0x4000D286 RL_VALUE_UBYTE 0 NO_COMPU_METHOD 0 255 /end CHARACTERISTIC
/begin CHARACTERISTIC CAL_obd_ii_P0524 "Calibration: OBD-II P0524 (OBD-II monitor enable level)." VALUE 0x4000D287 RL_VALUE_UBYTE 0 NO_COMPU_METHOD 0 255 /end CHARACTERISTIC
/begin CHARACTERISTIC CAL_obd_ii_P0192 "Calibration: OBD-II P0192 (OBD-II monitor enable level)." VALUE 0x4000D288 RL_VALUE_UBYTE 0 NO_COMPU_METHOD 0 255 /end CHARACTERISTIC
/begin CHARACTERISTIC CAL_obd_ii_P0193 "Calibration: OBD-II P0193 (OBD-II monitor enable level)." VALUE 0x4000D289 RL_VALUE_UBYTE 0 NO_COMPU_METHOD 0 255 /end CHARACTERISTIC
/begin CHARACTERISTIC CAL_obd_ii_P023B "Calibration: OBD-II P023B (OBD-II monitor enable level)." VALUE 0x4000D28A RL_VALUE_UBYTE 0 NO_COMPU_METHOD 0 255 /end CHARACTERISTIC
/begin CHARACTERISTIC CAL_obd_ii_P023C "Calibration: OBD-II P023C (OBD-II monitor enable level)." VALUE 0x4000D28B RL_VALUE_UBYTE 0 NO_COMPU_METHOD 0 255 /end CHARACTERISTIC
/begin CHARACTERISTIC CAL_obd_ii_P123B "Calibration: OBD-II P123B (OBD-II monitor enable level)." VALUE 0x4000D28C RL_VALUE_UBYTE 0 NO_COMPU_METHOD 0 255 /end CHARACTERISTIC
/begin CHARACTERISTIC CAL_obd_ii_P123C "Calibration: OBD-II P123C (OBD-II monitor enable level)." VALUE 0x4000D28D RL_VALUE_UBYTE 0 NO_COMPU_METHOD 0 255 /end CHARACTERISTIC
/begin CHARACTERISTIC CAL_obd_ii_P0087 "Calibration: OBD-II P0087 (OBD-II monitor enable level)." VALUE 0x4000D28E RL_VALUE_UBYTE 0 NO_COMPU_METHOD 0 255 /end CHARACTERISTIC
/begin CHARACTERISTIC CAL_obd_ii_P0088 "Calibration: OBD-II P0088 (OBD-II monitor enable level)." VALUE 0x4000D28F RL_VALUE_UBYTE 0 NO_COMPU_METHOD 0 255 /end CHARACTERISTIC
/begin CHARACTERISTIC CAL_obd_ii_P0191 "Calibration: OBD-II P0191 (OBD-II monitor enable level)." VALUE 0x4000D290 RL_VALUE_UBYTE 0 NO_COMPU_METHOD 0 255 /end CHARACTERISTIC
/begin CHARACTERISTIC CAL_obd_ii_P2754 "Calibration: OBD-II P2754 (OBD-II monitor enable level)." VALUE 0x4000D291 RL_VALUE_UBYTE 0 NO_COMPU_METHOD 0 255 /end CHARACTERISTIC
/begin CHARACTERISTIC CAL_obd_ii_P2755 "Calibration: OBD-II P2755 (OBD-II monitor enable level)." VALUE 0x4000D292 RL_VALUE_UBYTE 0 NO_COMPU_METHOD 0 255 /end CHARACTERISTIC
/begin CHARACTERISTIC CAL_obd_ii_P0897 "Calibration: OBD-II P0897 (OBD-II monitor enable level)." VALUE 0x4000D293 RL_VALUE_UBYTE 0 NO_COMPU_METHOD 0 255 /end CHARACTERISTIC
/begin CHARACTERISTIC CAL_obd_ii_P2797 "Calibration: OBD-II P2797 (OBD-II monitor enable level)." VALUE 0x4000D294 RL_VALUE_UBYTE 0 NO_COMPU_METHOD 0 255 /end CHARACTERISTIC
/begin CHARACTERISTIC CAL_obd_ii_P0101_ips "Calibration: OBD-II P0101 IPS (OBD-II monitor enable level)." VALUE 0x4000D295 RL_VALUE_UBYTE 0 NO_COMPU_METHOD 0 255 /end CHARACTERISTIC
/begin CHARACTERISTIC CAL_obd_ii_P0014_maturing_limit "undefined1" VALUE 0x4000D3A6 RL_VALUE_UBYTE 0 NO_COMPU_METHOD 0 255 /end CHARACTERISTIC
/begin CHARACTERISTIC CAL_obd_ii_P0015_maturing_limit "undefined1" VALUE 0x4000D3AA RL_VALUE_UBYTE 0 NO_COMPU_METHOD 0 255 /end CHARACTERISTIC
/begin CHARACTERISTIC CAL_obd_ii_P0024_maturing_limit "undefined1" VALUE 0x4000D3AE RL_VALUE_UBYTE 0 NO_COMPU_METHOD 0 255 /end CHARACTERISTIC
/begin CHARACTERISTIC CAL_obd_ii_P0132_fail_count "undefined1" VALUE 0x4000D3B7 RL_VALUE_UBYTE 0 NO_COMPU_METHOD 0 255 /end CHARACTERISTIC
/begin CHARACTERISTIC CAL_obd_ii_P0137_fail_count "undefined1" VALUE 0x4000D3B8 RL_VALUE_UBYTE 0 NO_COMPU_METHOD 0 255 /end CHARACTERISTIC
/begin CHARACTERISTIC CAL_obd_ii_P0138_fail_count "undefined1" VALUE 0x4000D3B9 RL_VALUE_UBYTE 0 NO_COMPU_METHOD 0 255 /end CHARACTERISTIC
/begin CHARACTERISTIC CAL_obd_monitor_sentinel_init "undefined1" VALUE 0x4000D3BC RL_VALUE_UBYTE 0 NO_COMPU_METHOD 0 255 /end CHARACTERISTIC
/begin CHARACTERISTIC CAL_obd_ii_P0128_fail_count "undefined1" VALUE 0x4000D3BE RL_VALUE_UBYTE 0 NO_COMPU_METHOD 0 255 /end CHARACTERISTIC
/begin CHARACTERISTIC CAL_obd_ii_P0076_debounce_count "undefined1" VALUE 0x4000D3BF RL_VALUE_UBYTE 0 NO_COMPU_METHOD 0 255 /end CHARACTERISTIC
/begin CHARACTERISTIC CAL_obd_ii_P0077_debounce_count "undefined1" VALUE 0x4000D3C0 RL_VALUE_UBYTE 0 NO_COMPU_METHOD 0 255 /end CHARACTERISTIC
/begin CHARACTERISTIC CAL_idle_unknown10 "undefined1" VALUE 0x4000D409 RL_VALUE_UBYTE 0 NO_COMPU_METHOD 0 255 /end CHARACTERISTIC
/begin CHARACTERISTIC CAL_obd_ii_P0151_fail_count "undefined1" VALUE 0x4000D426 RL_VALUE_UBYTE 0 NO_COMPU_METHOD 0 255 /end CHARACTERISTIC
/begin CHARACTERISTIC CAL_obd_ii_P0152_fail_count "undefined1" VALUE 0x4000D427 RL_VALUE_UBYTE 0 NO_COMPU_METHOD 0 255 /end CHARACTERISTIC
/begin CHARACTERISTIC CAL_obd_ii_P0157_fail_count "undefined1" VALUE 0x4000D428 RL_VALUE_UBYTE 0 NO_COMPU_METHOD 0 255 /end CHARACTERISTIC
/begin CHARACTERISTIC CAL_obd_ii_P0158_fail_count "undefined1" VALUE 0x4000D429 RL_VALUE_UBYTE 0 NO_COMPU_METHOD 0 255 /end CHARACTERISTIC
/begin CHARACTERISTIC CAL_obd_ii_U0316_debounce_count "undefined1" VALUE 0x4000D44F RL_VALUE_UBYTE 0 NO_COMPU_METHOD 0 255 /end CHARACTERISTIC
/begin CHARACTERISTIC CAL_obd_ii_P0141_debounce_count "undefined1" VALUE 0x4000D450 RL_VALUE_UBYTE 0 NO_COMPU_METHOD 0 255 /end CHARACTERISTIC
/begin CHARACTERISTIC CAL_obd_ii_P050B_maturing_limit "undefined1" VALUE 0x4000D453 RL_VALUE_UBYTE 0 NO_COMPU_METHOD 0 255 /end CHARACTERISTIC
/begin CHARACTERISTIC CAL_obd_ii_P2336_maturing_limit "undefined1" VALUE 0x4000D45E RL_VALUE_UBYTE 0 NO_COMPU_METHOD 0 255 /end CHARACTERISTIC
/begin CHARACTERISTIC CAL_obd_ii_P2337_maturing_limit "undefined1" VALUE 0x4000D45F RL_VALUE_UBYTE 0 NO_COMPU_METHOD 0 255 /end CHARACTERISTIC
/begin CHARACTERISTIC CAL_obd_ii_P2338_maturing_limit "undefined1" VALUE 0x4000D460 RL_VALUE_UBYTE 0 NO_COMPU_METHOD 0 255 /end CHARACTERISTIC
/begin CHARACTERISTIC CAL_obd_ii_P2339_maturing_limit "undefined1" VALUE 0x4000D461 RL_VALUE_UBYTE 0 NO_COMPU_METHOD 0 255 /end CHARACTERISTIC
/begin AXIS_PTS CAL_misfire_comp_maf_manual_X_coolant_temp "Calibration: X-axis (coolant temp) for the misfire compensation MAF manual table (°C = val*5/8−40; 4-element array)." 0x4000D5A0 coolant_temp_engine_stopped RL_AXIS_UWORD 0 CM_u8_temp_5_8_40c 4 -40 40919.375 /end AXIS_PTS
/begin AXIS_PTS CAL_misfire_comp_maf_manual_Y_maf_accum "Calibration: Y-axis (maf accum) for the misfire compensation MAF manual table (mg; 5-element array)." 0x4000D5A8 maf_accumulated_since_start_raw RL_AXIS_UWORD 0 CM_u16_mass_mg 5 0 65535 /end AXIS_PTS
/begin CHARACTERISTIC CAL_misfire_comp_maf_manual "Calibration: misfire compensation MAF manual (20-element array)." MAP 0x4000D5B2 RL_VALUE_UWORD 0 NO_COMPU_METHOD 0 65535
 /begin AXIS_DESCR COM_AXIS coolant_temp_engine_stopped CM_u8_temp_5_8_40c 4 -40 40919.375 AXIS_PTS_REF CAL_misfire_comp_maf_manual_X_coolant_temp /end AXIS_DESCR
 /begin AXIS_DESCR COM_AXIS maf_accumulated_since_start_raw CM_u16_mass_mg 5 0 65535 AXIS_PTS_REF CAL_misfire_comp_maf_manual_Y_maf_accum /end AXIS_DESCR
/end CHARACTERISTIC
/begin AXIS_PTS CAL_misfire_comp_maf_ips_X_coolant_temp "Calibration: X-axis (coolant temp) for the misfire compensation MAF IPS table (°C = val*5/8−40; 4-element array)." 0x4000D5DA coolant_temp_engine_stopped RL_AXIS_UWORD 0 CM_u8_temp_5_8_40c 4 -40 40919.375 /end AXIS_PTS
/begin AXIS_PTS CAL_misfire_comp_maf_ips_Y_maf_accum "Calibration: Y-axis (maf accum) for the misfire compensation MAF IPS table (mg; 5-element array)." 0x4000D5E2 maf_accumulated_since_start_raw RL_AXIS_UWORD 0 CM_u16_mass_mg 5 0 65535 /end AXIS_PTS
/begin CHARACTERISTIC CAL_misfire_comp_maf_ips "Calibration: misfire compensation MAF IPS (20-element array)." MAP 0x4000D5EC RL_VALUE_SWORD 0 NO_COMPU_METHOD -32768 32767
 /begin AXIS_DESCR COM_AXIS coolant_temp_engine_stopped CM_u8_temp_5_8_40c 4 -40 40919.375 AXIS_PTS_REF CAL_misfire_comp_maf_ips_X_coolant_temp /end AXIS_DESCR
 /begin AXIS_DESCR COM_AXIS maf_accumulated_since_start_raw CM_u16_mass_mg 5 0 65535 AXIS_PTS_REF CAL_misfire_comp_maf_ips_Y_maf_accum /end AXIS_DESCR
/end CHARACTERISTIC
/begin AXIS_PTS CAL_dpm_slip_target_base_X_dpm_level "Calibration: X-axis (dpm level) for the driver performance mode slip target base table (16-element array)." 0x4000D644 dpm_mode_index RL_AXIS_UBYTE 0 NO_COMPU_METHOD 16 0 255 /end AXIS_PTS
/begin CHARACTERISTIC CAL_dpm_slip_target_base "Calibration: driver performance mode slip target base (% = val/8; 16-element array)." CURVE 0x4000D654 RL_VALUE_UBYTE 0 CM_u16_slip_1_8pct 0 31.875
 /begin AXIS_DESCR COM_AXIS dpm_mode_index NO_COMPU_METHOD 16 0 255 AXIS_PTS_REF CAL_dpm_slip_target_base_X_dpm_level /end AXIS_DESCR
/end CHARACTERISTIC
/begin AXIS_PTS CAL_cooling_fan_duty_cycle_stopped_X_coolant_temp "Calibration: X-axis (coolant temp) for the cooling fan duty cycle stopped table (°C = val*5/8−40; 8-element array)." 0x4000D6B4 coolant_temp RL_AXIS_UBYTE 0 CM_u8_temp_5_8_40c 8 -40 119.375 /end AXIS_PTS
/begin CHARACTERISTIC CAL_cooling_fan_duty_cycle_stopped "Calibration: cooling fan duty cycle stopped (% = val*100/255; 8-element array)." CURVE 0x4000D6BC RL_VALUE_UBYTE 0 CM_u8_factor_1_255 0 100
 /begin AXIS_DESCR COM_AXIS coolant_temp CM_u8_temp_5_8_40c 8 -40 119.375 AXIS_PTS_REF CAL_cooling_fan_duty_cycle_stopped_X_coolant_temp /end AXIS_DESCR
/end CHARACTERISTIC
/begin AXIS_PTS CAL_cooling_fan_ac_off_X_air_temp "Calibration: X-axis (air temp) for the cooling fan A/C off table (°C = val*5/8−40; 8-element array)." 0x4000D6C4 temp_engine_air_cooling_control RL_AXIS_UBYTE 0 CM_u8_temp_5_8_40c 8 -40 119.375 /end AXIS_PTS
/begin AXIS_PTS CAL_cooling_fan_ac_off_Y_carspeed "Calibration: Y-axis (carspeed) for the cooling fan A/C off table (8-element array)." 0x4000D6CC NO_INPUT_QUANTITY RL_AXIS_UBYTE 0 NO_COMPU_METHOD 8 0 255 /end AXIS_PTS
/begin CHARACTERISTIC CAL_cooling_fan_ac_off "Calibration: cooling fan A/C off (% = val*100/255; 64-element array)." MAP 0x4000D6D4 RL_VALUE_UBYTE 0 CM_u8_factor_1_255 0 100
 /begin AXIS_DESCR COM_AXIS temp_engine_air_cooling_control CM_u8_temp_5_8_40c 8 -40 119.375 AXIS_PTS_REF CAL_cooling_fan_ac_off_X_air_temp /end AXIS_DESCR
 /begin AXIS_DESCR COM_AXIS NO_INPUT_QUANTITY NO_COMPU_METHOD 8 0 255 AXIS_PTS_REF CAL_cooling_fan_ac_off_Y_carspeed /end AXIS_DESCR
/end CHARACTERISTIC
/begin AXIS_PTS CAL_cooling_fan_scaling_X_dutycycle "Calibration: X-axis (dutycycle) for the cooling fan scaling table (% = val*100/255; 8-element array)." 0x4000D714 radiator_fan_duty_cycle_target RL_AXIS_UBYTE 0 CM_u8_factor_1_255 8 0 100 /end AXIS_PTS
/begin CHARACTERISTIC CAL_cooling_fan_scaling "Calibration: cooling fan scaling (8-element array)." CURVE 0x4000D71C RL_VALUE_UBYTE 0 NO_COMPU_METHOD 0 255
 /begin AXIS_DESCR COM_AXIS radiator_fan_duty_cycle_target CM_u8_factor_1_255 8 0 100 AXIS_PTS_REF CAL_cooling_fan_scaling_X_dutycycle /end AXIS_DESCR
/end CHARACTERISTIC
/begin AXIS_PTS CAL_misfire_sensitivity_manual_X_rpm "Calibration: X-axis (rpm) for the misfire sensitivity manual table (RPM; 8-element array)." 0x4000D78C engine_speed_16bit RL_AXIS_UWORD 0 CM_u16_rspeed_rpm 8 0 65535 /end AXIS_PTS
/begin AXIS_PTS CAL_misfire_sensitivity_manual_Y_load "Calibration: Y-axis (load) for the misfire sensitivity manual table (mg/stroke; 8-element array)." 0x4000D79C V_CAL_misfire_sensitivity_manual_Y_load RL_AXIS_UWORD 0 CM_u16_load_mg_stroke 8 0 65535 /end AXIS_PTS
/begin CHARACTERISTIC CAL_misfire_sensitivity_manual "Calibration: misfire sensitivity manual (64-element array)." MAP 0x4000D7AC RL_VALUE_UWORD 0 NO_COMPU_METHOD 0 65535
 /begin AXIS_DESCR COM_AXIS engine_speed_16bit CM_u16_rspeed_rpm 8 0 65535 AXIS_PTS_REF CAL_misfire_sensitivity_manual_X_rpm /end AXIS_DESCR
 /begin AXIS_DESCR COM_AXIS V_CAL_misfire_sensitivity_manual_Y_load CM_u16_load_mg_stroke 8 0 65535 AXIS_PTS_REF CAL_misfire_sensitivity_manual_Y_load /end AXIS_DESCR
/end CHARACTERISTIC
/begin AXIS_PTS CAL_misfire_sensitivity_ips_X_rpm "Calibration: X-axis (rpm) for the misfire sensitivity IPS table (RPM; 8-element array)." 0x4000D82C engine_speed_16bit RL_AXIS_UWORD 0 CM_u16_rspeed_rpm 8 0 65535 /end AXIS_PTS
/begin AXIS_PTS CAL_misfire_sensitivity_ips_Y_load "Calibration: Y-axis (load) for the misfire sensitivity IPS table (mg/stroke; 8-element array)." 0x4000D83C V_CAL_misfire_sensitivity_ips_Y_load RL_AXIS_UWORD 0 CM_u16_load_mg_stroke 8 0 65535 /end AXIS_PTS
/begin CHARACTERISTIC CAL_misfire_sensitivity_ips "Calibration: misfire sensitivity IPS (64-element array)." MAP 0x4000D84C RL_VALUE_UWORD 0 NO_COMPU_METHOD 0 65535
 /begin AXIS_DESCR COM_AXIS engine_speed_16bit CM_u16_rspeed_rpm 8 0 65535 AXIS_PTS_REF CAL_misfire_sensitivity_ips_X_rpm /end AXIS_DESCR
 /begin AXIS_DESCR COM_AXIS V_CAL_misfire_sensitivity_ips_Y_load CM_u16_load_mg_stroke 8 0 65535 AXIS_PTS_REF CAL_misfire_sensitivity_ips_Y_load /end AXIS_DESCR
/end CHARACTERISTIC
/begin AXIS_PTS CAL_obd_cat_monitor_threshold_ips_X_maf_flow "Calibration: X-axis (maf flow) for the emissions compensation IPS table (g; 8-element array)." 0x4000D8CC NO_INPUT_QUANTITY RL_AXIS_UBYTE 0 CM_u8_mass_g 8 0 255 /end AXIS_PTS
/begin CHARACTERISTIC CAL_obd_cat_monitor_threshold_ips "Calibration: MAF compensation IPS (8-element array)." CURVE 0x4000D8D4 RL_VALUE_UBYTE 0 NO_COMPU_METHOD 0 255
 /begin AXIS_DESCR COM_AXIS NO_INPUT_QUANTITY CM_u8_mass_g 8 0 255 AXIS_PTS_REF CAL_obd_cat_monitor_threshold_ips_X_maf_flow /end AXIS_DESCR
/end CHARACTERISTIC
/begin AXIS_PTS CAL_slip_comp_maf_accum_manual_X_maf_accum "Calibration: X-axis (maf accum) for the slip compensation MAF accum manual table (mg; 4-element array)." 0x4000D95C maf_accumulated_since_start_raw RL_AXIS_UWORD 0 CM_u16_mass_mg 4 0 65535 /end AXIS_PTS
/begin CHARACTERISTIC CAL_slip_comp_maf_accum_manual "Calibration: slip compensation MAF accum manual (4-element array)." CURVE 0x4000D964 RL_VALUE_UWORD 0 NO_COMPU_METHOD 0 65535
 /begin AXIS_DESCR COM_AXIS maf_accumulated_since_start_raw CM_u16_mass_mg 4 0 65535 AXIS_PTS_REF CAL_slip_comp_maf_accum_manual_X_maf_accum /end AXIS_DESCR
/end CHARACTERISTIC
/begin AXIS_PTS CAL_slip_power_based_rpm_thresholds_X_power "Calibration: X-axis (power) for the slip power based RPM thresholds table (kW = val/100; 8-element array)." 0x4000D96C engine_power_corrected RL_AXIS_UWORD 0 CM_u16_power_1_100kw 8 0 655.35 /end AXIS_PTS
/begin CHARACTERISTIC CAL_slip_power_based_rpm_thresholds "Calibration: slip power based RPM thresholds (RPM; 8-element array)." CURVE 0x4000D97C RL_VALUE_UWORD 0 CM_u16_rspeed_rpm 0 65535
 /begin AXIS_DESCR COM_AXIS engine_power_corrected CM_u16_power_1_100kw 8 0 655.35 AXIS_PTS_REF CAL_slip_power_based_rpm_thresholds_X_power /end AXIS_DESCR
/end CHARACTERISTIC
/begin AXIS_PTS CAL_misfire_detect_torque_threshold_X_rpm "Calibration: X-axis (rpm) for the misfire detect torque threshold table (RPM = val*125/4+500; 8-element array)." 0x4000D9DC engine_speed_8bit RL_AXIS_UBYTE 0 CM_u8_rspeed_125_4_500rpm 8 500 8468.75 /end AXIS_PTS
/begin CHARACTERISTIC CAL_misfire_detect_torque_threshold "Calibration: misfire detect torque threshold (Nm; 8-element array)." CURVE 0x4000D9E4 RL_VALUE_UBYTE 0 CM_u8_torque_nm 0 255
 /begin AXIS_DESCR COM_AXIS engine_speed_8bit CM_u8_rspeed_125_4_500rpm 8 500 8468.75 AXIS_PTS_REF CAL_misfire_detect_torque_threshold_X_rpm /end AXIS_DESCR
/end CHARACTERISTIC
/begin AXIS_PTS CAL_misfire_base_threshold_manual_X_rpm "Calibration: X-axis (rpm) for the misfire base threshold manual table (RPM; 16-element array)." 0x4000DA10 engine_speed_16bit RL_AXIS_UWORD 0 CM_u16_rspeed_rpm 16 0 65535 /end AXIS_PTS
/begin AXIS_PTS CAL_misfire_base_threshold_manual_Y_load "Calibration: Y-axis (load) for the misfire base threshold manual table (mg/stroke; 16-element array)." 0x4000DA30 V_CAL_misfire_base_threshold_manual_Y_load RL_AXIS_UWORD 0 CM_u16_load_mg_stroke 16 0 65535 /end AXIS_PTS
/begin CHARACTERISTIC CAL_misfire_base_threshold_manual "Calibration: misfire base threshold manual (256-element array)." MAP 0x4000DA50 RL_VALUE_UWORD 0 NO_COMPU_METHOD 0 65535
 /begin AXIS_DESCR COM_AXIS engine_speed_16bit CM_u16_rspeed_rpm 16 0 65535 AXIS_PTS_REF CAL_misfire_base_threshold_manual_X_rpm /end AXIS_DESCR
 /begin AXIS_DESCR COM_AXIS V_CAL_misfire_base_threshold_manual_Y_load CM_u16_load_mg_stroke 16 0 65535 AXIS_PTS_REF CAL_misfire_base_threshold_manual_Y_load /end AXIS_DESCR
/end CHARACTERISTIC
/begin AXIS_PTS CAL_misfire_cat_damage_limit_X_rpm "Calibration: X-axis (rpm) for the misfire cat damage limit table (RPM = val*125/4+500; 8-element array)." 0x4000DC50 engine_speed_8bit RL_AXIS_UBYTE 0 CM_u8_rspeed_125_4_500rpm 8 500 8468.75 /end AXIS_PTS
/begin AXIS_PTS CAL_misfire_cat_damage_limit_Y_load "Calibration: Y-axis (load) for the misfire cat damage limit table (mg/stroke = val*4; 8-element array)." 0x4000DC58 load_mass_per_stroke RL_AXIS_UBYTE 0 CM_u8_load_4mg_stroke 8 0 1020 /end AXIS_PTS
/begin CHARACTERISTIC CAL_misfire_cat_damage_limit "Calibration: misfire cat damage limit (64-element array)." MAP 0x4000DC60 RL_VALUE_UBYTE 0 NO_COMPU_METHOD 0 255
 /begin AXIS_DESCR COM_AXIS engine_speed_8bit CM_u8_rspeed_125_4_500rpm 8 500 8468.75 AXIS_PTS_REF CAL_misfire_cat_damage_limit_X_rpm /end AXIS_DESCR
 /begin AXIS_DESCR COM_AXIS load_mass_per_stroke CM_u8_load_4mg_stroke 8 0 1020 AXIS_PTS_REF CAL_misfire_cat_damage_limit_Y_load /end AXIS_DESCR
/end CHARACTERISTIC
/begin AXIS_PTS CAL_misfire_base_threshold_ips_X_rpm "Calibration: X-axis (rpm) for the misfire base threshold IPS table (RPM; 16-element array)." 0x4000DCA0 engine_speed_16bit RL_AXIS_UWORD 0 CM_u16_rspeed_rpm 16 0 65535 /end AXIS_PTS
/begin AXIS_PTS CAL_misfire_base_threshold_ips_Y_load "Calibration: Y-axis (load) for the misfire base threshold IPS table (mg/stroke; 16-element array)." 0x4000DCC0 V_CAL_misfire_base_threshold_ips_Y_load RL_AXIS_UWORD 0 CM_u16_load_mg_stroke 16 0 65535 /end AXIS_PTS
/begin CHARACTERISTIC CAL_misfire_base_threshold_ips "Calibration: misfire base threshold IPS (256-element array)." MAP 0x4000DCE0 RL_VALUE_SWORD 0 NO_COMPU_METHOD -32768 32767
 /begin AXIS_DESCR COM_AXIS engine_speed_16bit CM_u16_rspeed_rpm 16 0 65535 AXIS_PTS_REF CAL_misfire_base_threshold_ips_X_rpm /end AXIS_DESCR
 /begin AXIS_DESCR COM_AXIS V_CAL_misfire_base_threshold_ips_Y_load CM_u16_load_mg_stroke 16 0 65535 AXIS_PTS_REF CAL_misfire_base_threshold_ips_Y_load /end AXIS_DESCR
/end CHARACTERISTIC
/begin AXIS_PTS CAL_emissions_cat_efficiency_unknown1_X_coolant_temp "Calibration: X-axis (coolant temp) for the emissions cat efficiency unknown1 table (°C = val*5/8−40; 8-element array)." 0x4000DEE0 coolant_temp_engine_stopped RL_AXIS_UBYTE 0 CM_u8_temp_5_8_40c 8 -40 119.375 /end AXIS_PTS
/begin CHARACTERISTIC CAL_emissions_cat_efficiency_unknown1 "Calibration: emissions cat efficiency unknown1 (8-element array)." CURVE 0x4000DEE8 RL_VALUE_UBYTE 0 NO_COMPU_METHOD 0 255
 /begin AXIS_DESCR COM_AXIS coolant_temp_engine_stopped CM_u8_temp_5_8_40c 8 -40 119.375 AXIS_PTS_REF CAL_emissions_cat_efficiency_unknown1_X_coolant_temp /end AXIS_DESCR
/end CHARACTERISTIC
/begin AXIS_PTS CAL_obd_cat_monitor_threshold_manual_X_maf_flow "Calibration: X-axis (maf flow) for the emissions compensation manual table (g; 8-element array)." 0x4000DEF0 NO_INPUT_QUANTITY RL_AXIS_UBYTE 0 CM_u8_mass_g 8 0 255 /end AXIS_PTS
/begin CHARACTERISTIC CAL_obd_cat_monitor_threshold_manual "Calibration: MAF compensation manual (8-element array)." CURVE 0x4000DEF8 RL_VALUE_UBYTE 0 NO_COMPU_METHOD 0 255
 /begin AXIS_DESCR COM_AXIS NO_INPUT_QUANTITY CM_u8_mass_g 8 0 255 AXIS_PTS_REF CAL_obd_cat_monitor_threshold_manual_X_maf_flow /end AXIS_DESCR
/end CHARACTERISTIC
/begin AXIS_PTS CAL_cooling_thermostat_warmup_load_factor_X_load "Calibration: X-axis (load) for the cooling thermostat warmup load factor table (mg/stroke = val*4; 8-element array)." 0x4000DFD8 load_mass_per_stroke RL_AXIS_UBYTE 0 CM_u8_load_4mg_stroke 8 0 1020 /end AXIS_PTS
/begin CHARACTERISTIC CAL_cooling_thermostat_warmup_load_factor "Calibration: cooling thermostat warmup load factor (8-element array)." CURVE 0x4000DFE0 RL_VALUE_UBYTE 0 NO_COMPU_METHOD 0 255
 /begin AXIS_DESCR COM_AXIS load_mass_per_stroke CM_u8_load_4mg_stroke 8 0 1020 AXIS_PTS_REF CAL_cooling_thermostat_warmup_load_factor_X_load /end AXIS_DESCR
/end CHARACTERISTIC
/begin AXIS_PTS CAL_idle_air_warmup_factor_ips_X_coolant_temp "u8_temp_5/8-40c[16]" 0x4000E190 NO_INPUT_QUANTITY RL_AXIS_UBYTE 0 CM_u8_temp_5_8_40c 16 -40 119.375 /end AXIS_PTS
/begin CHARACTERISTIC CAL_idle_air_warmup_factor_ips_Y_maf_accum "undefined" VALUE 0x4000E1A0 RL_VALUE_ULONG 0 NO_COMPU_METHOD 0 4294967295 /end CHARACTERISTIC
/begin CHARACTERISTIC CAL_idle_air_warmup_factor_ips "undefined" VALUE 0x4000E1A8 RL_VALUE_ULONG 0 NO_COMPU_METHOD 0 4294967295 /end CHARACTERISTIC
/begin AXIS_PTS CAL_dpm_slip_filter_coeff_X_carspeed "Calibration: X-axis (carspeed) for the driver performance mode slip filter coeff table (km/h; 8-element array)." 0x4000E2B8 dpm_vehicle_speed_kph RL_AXIS_UBYTE 0 CM_u8_speed_kph 8 0 255 /end AXIS_PTS
/begin CHARACTERISTIC CAL_dpm_slip_filter_coeff "Calibration: driver performance mode slip filter coeff (val/255; 8-element array)." CURVE 0x4000E2C0 RL_VALUE_UBYTE 0 CM_u8_factor_1_255 0 100
 /begin AXIS_DESCR COM_AXIS dpm_vehicle_speed_kph CM_u8_speed_kph 8 0 255 AXIS_PTS_REF CAL_dpm_slip_filter_coeff_X_carspeed /end AXIS_DESCR
/end CHARACTERISTIC
/begin AXIS_PTS CAL_exhaust_flap_state_control_tour_X_rpm "Calibration: X-axis (rpm) for the exhaust flap state control tour table (RPM = val*50; 8-element array)." 0x4000E2C8 V_CAL_exhaust_flap_state_control_tour_X_rpm RL_AXIS_UBYTE 0 CM_u8_rspeed_50rpm 8 0 12750 /end AXIS_PTS
/begin AXIS_PTS CAL_exhaust_flap_state_control_tour_Y_accel_pedal "Calibration: Y-axis (accel pedal) for the exhaust flap state control tour table (val/255; 8-element array)." 0x4000E2D0 NO_INPUT_QUANTITY RL_AXIS_UBYTE 0 CM_u8_factor_1_255 8 0 100 /end AXIS_PTS
/begin CHARACTERISTIC CAL_exhaust_flap_state_control_tour "Calibration: exhaust flap state control tour (64-element array)." MAP 0x4000E2D8 RL_VALUE_UBYTE 0 NO_COMPU_METHOD 0 255
 /begin AXIS_DESCR COM_AXIS V_CAL_exhaust_flap_state_control_tour_X_rpm CM_u8_rspeed_50rpm 8 0 12750 AXIS_PTS_REF CAL_exhaust_flap_state_control_tour_X_rpm /end AXIS_DESCR
 /begin AXIS_DESCR COM_AXIS NO_INPUT_QUANTITY CM_u8_factor_1_255 8 0 100 AXIS_PTS_REF CAL_exhaust_flap_state_control_tour_Y_accel_pedal /end AXIS_DESCR
/end CHARACTERISTIC
/begin AXIS_PTS CAL_exhaust_flap_state_control_sport_X_rpm "Calibration: X-axis (rpm) for the exhaust flap state control sport table (RPM = val*50; 8-element array)." 0x4000E318 V_CAL_exhaust_flap_state_control_sport_X_rpm RL_AXIS_UBYTE 0 CM_u8_rspeed_50rpm 8 0 12750 /end AXIS_PTS
/begin AXIS_PTS CAL_exhaust_flap_state_control_sport_Y_accel_pedal "Calibration: Y-axis (accel pedal) for the exhaust flap state control sport table (val/255; 8-element array)." 0x4000E320 NO_INPUT_QUANTITY RL_AXIS_UBYTE 0 CM_u8_factor_1_255 8 0 100 /end AXIS_PTS
/begin CHARACTERISTIC CAL_exhaust_flap_state_control_sport "Calibration: exhaust flap state control sport (64-element array)." MAP 0x4000E328 RL_VALUE_UBYTE 0 NO_COMPU_METHOD 0 255
 /begin AXIS_DESCR COM_AXIS V_CAL_exhaust_flap_state_control_sport_X_rpm CM_u8_rspeed_50rpm 8 0 12750 AXIS_PTS_REF CAL_exhaust_flap_state_control_sport_X_rpm /end AXIS_DESCR
 /begin AXIS_DESCR COM_AXIS NO_INPUT_QUANTITY CM_u8_factor_1_255 8 0 100 AXIS_PTS_REF CAL_exhaust_flap_state_control_sport_Y_accel_pedal /end AXIS_DESCR
/end CHARACTERISTIC
/begin AXIS_PTS CAL_idle_comp_timer_carspeed_ips_X_airtemp "Calibration: X-axis (airtemp) for the idle compensation timer carspeed IPS table (°C = val*5/8−40; 8-element array)." 0x4000E368 NO_INPUT_QUANTITY RL_AXIS_UBYTE 0 CM_u8_temp_5_8_40c 8 -40 119.375 /end AXIS_PTS
/begin AXIS_PTS CAL_idle_comp_timer_carspeed_ips_Y_time_above_speed "Calibration: Y-axis (time above speed) for the idle compensation timer carspeed IPS table (8-element array)." 0x4000E370 timer_above_min_carspeed RL_AXIS_UBYTE 0 NO_COMPU_METHOD 8 0 255 /end AXIS_PTS
/begin CHARACTERISTIC CAL_idle_comp_timer_carspeed_ips "Calibration: idle compensation timer carspeed IPS (RPM = val*8; 64-element array)." MAP 0x4000E378 RL_VALUE_UBYTE 0 CM_u8_rspeed_8rpm 0 2040
 /begin AXIS_DESCR COM_AXIS NO_INPUT_QUANTITY CM_u8_temp_5_8_40c 8 -40 119.375 AXIS_PTS_REF CAL_idle_comp_timer_carspeed_ips_X_airtemp /end AXIS_DESCR
 /begin AXIS_DESCR COM_AXIS timer_above_min_carspeed NO_COMPU_METHOD 8 0 255 AXIS_PTS_REF CAL_idle_comp_timer_carspeed_ips_Y_time_above_speed /end AXIS_DESCR
/end CHARACTERISTIC
/begin AXIS_PTS CAL_torque_external_request_overshoot_margin_X_rpm "Calibration: X-axis (rpm) for the torque external request overshoot margin table (RPM = val*125/4+500; 16-element array)." 0x4000E4E8 engine_speed_8bit RL_AXIS_UBYTE 0 CM_u8_rspeed_125_4_500rpm 16 500 8468.75 /end AXIS_PTS
/begin AXIS_PTS CAL_torque_external_request_overshoot_margin_Y_torque "Calibration: Y-axis (torque) for the torque external request overshoot margin table (Nm = val*4; 16-element array)." 0x4000E4F8 NO_INPUT_QUANTITY RL_AXIS_UBYTE 0 CM_u8_torque_4nm 16 0 1020 /end AXIS_PTS
/begin CHARACTERISTIC CAL_torque_external_request_overshoot_margin "Calibration: torque external request overshoot margin (val/100; 256-element array)." MAP 0x4000E508 RL_VALUE_UBYTE 0 CM_u8_factor_1_100 0 255
 /begin AXIS_DESCR COM_AXIS engine_speed_8bit CM_u8_rspeed_125_4_500rpm 16 500 8468.75 AXIS_PTS_REF CAL_torque_external_request_overshoot_margin_X_rpm /end AXIS_DESCR
 /begin AXIS_DESCR COM_AXIS NO_INPUT_QUANTITY CM_u8_torque_4nm 16 0 1020 AXIS_PTS_REF CAL_torque_external_request_overshoot_margin_Y_torque /end AXIS_DESCR
/end CHARACTERISTIC
/begin AXIS_PTS CAL_exhaust_flap_state_control_race_X_rpm "Calibration: X-axis (rpm) for the exhaust flap state control race table (RPM = val*50; 8-element array)." 0x4000E7CC V_CAL_exhaust_flap_state_control_race_X_rpm RL_AXIS_UBYTE 0 CM_u8_rspeed_50rpm 8 0 12750 /end AXIS_PTS
/begin AXIS_PTS CAL_exhaust_flap_state_control_race_Y_accel_pedal "Calibration: Y-axis (accel pedal) for the exhaust flap state control race table (val/255; 8-element array)." 0x4000E7D4 NO_INPUT_QUANTITY RL_AXIS_UBYTE 0 CM_u8_factor_1_255 8 0 100 /end AXIS_PTS
/begin CHARACTERISTIC CAL_exhaust_flap_state_control_race "Calibration: exhaust flap state control race (64-element array)." MAP 0x4000E7DC RL_VALUE_UBYTE 0 NO_COMPU_METHOD 0 255
 /begin AXIS_DESCR COM_AXIS V_CAL_exhaust_flap_state_control_race_X_rpm CM_u8_rspeed_50rpm 8 0 12750 AXIS_PTS_REF CAL_exhaust_flap_state_control_race_X_rpm /end AXIS_DESCR
 /begin AXIS_DESCR COM_AXIS NO_INPUT_QUANTITY CM_u8_factor_1_255 8 0 100 AXIS_PTS_REF CAL_exhaust_flap_state_control_race_Y_accel_pedal /end AXIS_DESCR
/end CHARACTERISTIC
/begin AXIS_PTS CAL_cooling_fan_base_engine_on_X_coolant_temp "Calibration: X-axis (coolant temp) for the cooling fan base engine on table (°C = val*5/8−40; 6-element array)." 0x4000EB1C coolant_temp RL_AXIS_UBYTE 0 CM_u8_temp_5_8_40c 6 -40 119.375 /end AXIS_PTS
/begin AXIS_PTS CAL_cooling_fan_base_engine_on_Y_carspeed "Calibration: Y-axis (carspeed) for the cooling fan base engine on table (km/h; 6-element array)." 0x4000EB22 NO_INPUT_QUANTITY RL_AXIS_UBYTE 0 CM_u8_speed_kph 6 0 255 /end AXIS_PTS
/begin CHARACTERISTIC CAL_cooling_fan_base_engine_on "Calibration: cooling fan base engine on (% = val*100/255; 36-element array)." MAP 0x4000EB28 RL_VALUE_UBYTE 0 CM_u8_factor_1_255 0 100
 /begin AXIS_DESCR COM_AXIS coolant_temp CM_u8_temp_5_8_40c 6 -40 119.375 AXIS_PTS_REF CAL_cooling_fan_base_engine_on_X_coolant_temp /end AXIS_DESCR
 /begin AXIS_DESCR COM_AXIS NO_INPUT_QUANTITY CM_u8_speed_kph 6 0 255 AXIS_PTS_REF CAL_cooling_fan_base_engine_on_Y_carspeed /end AXIS_DESCR
/end CHARACTERISTIC
/begin CHARACTERISTIC CAL_trans_cooler_temp_scaling "Calibration: transmission cooler temperature scaling." VALUE 0x4000ED69 RL_VALUE_UBYTE 0 NO_COMPU_METHOD 0 255 /end CHARACTERISTIC
/begin GROUP G_Idle "Idle" ROOT
 /begin REF_CHARACTERISTIC CAL_idle_air_control_proportional CAL_idle_air_control_proportional_X_speed_error CAL_idle_air_control_unknown CAL_idle_air_fast_decay_period CAL_idle_air_warmup_factor_ips CAL_idle_air_warmup_factor_ips_X_coolant_temp CAL_idle_air_warmup_factor_ips_Y_maf_accum CAL_idle_air_warmup_factor_manual CAL_idle_air_warmup_factor_manual_X_coolant_temp CAL_idle_air_warmup_factor_manual_Y_maf_accumulated CAL_idle_airflow_expected CAL_idle_airflow_expected_X_rpm CAL_idle_car_moving_threshold CAL_idle_clutch_antistall_speed_threshold CAL_idle_comp_ac CAL_idle_comp_ac_X_ac_load CAL_idle_comp_accel_pedal_pos CAL_idle_comp_accel_pedal_pos_X_pps CAL_idle_comp_baro2 CAL_idle_comp_baro2_X_ambient_baro CAL_idle_comp_carspeed_ips CAL_idle_comp_carspeed_ips_X_carspeed CAL_idle_comp_carspeed_manual CAL_idle_comp_carspeed_manual_X_carspeed CAL_idle_comp_ecu_voltage CAL_idle_comp_ecu_voltage_X_voltage CAL_idle_comp_fan CAL_idle_comp_fan_X_duty_cycle CAL_idle_comp_iat CAL_idle_comp_iat_X_iat CAL_idle_comp_misfire CAL_idle_comp_misfire_X_failed_cyl_count CAL_idle_comp_steering CAL_idle_comp_steering_X_steering_load CAL_idle_comp_timer_carspeed_ips CAL_idle_comp_timer_carspeed_ips_X_airtemp CAL_idle_comp_timer_carspeed_ips_Y_time_above_speed CAL_idle_comp_timer_carspeed_manual CAL_idle_comp_timer_carspeed_manual_X_airtemp CAL_idle_comp_timer_carspeed_manual_Y_time_above_speed CAL_idle_comp_tps_while_cranking CAL_idle_comp_tps_while_cranking_X_baro CAL_idle_comp_tps_while_cranking_Y_coolant_temp CAL_idle_comp_vehicle_speed_ips CAL_idle_comp_vehicle_speed_ips_X_vehicle_speed CAL_idle_comp_vehicle_speed_manual CAL_idle_comp_vehicle_speed_manual_X_carspeed CAL_idle_comp_while_moving CAL_idle_comp_while_moving_X_rpm CAL_idle_error_correction_unknown CAL_idle_error_correction_unknown_X_speed_error CAL_idle_exit_rpm_offset CAL_idle_flow_adj1_maf_accum_max CAL_idle_learn_ac_on_param CAL_idle_learn_integral_max CAL_idle_learn_integral_min CAL_idle_learn_temp_range CAL_idle_low_car_speed_enter CAL_idle_low_car_speed_exit CAL_idle_rpm_ramp_step CAL_idle_rpm_ramp_step_ips CAL_idle_sensor_fault_coolant_temp CAL_idle_target_ips CAL_idle_target_ips_X_coolant_temp CAL_idle_target_ips_coolant_fallback CAL_idle_target_ips_coolant_fallback_X_coolant_temp CAL_idle_target_manual_sport CAL_idle_target_manual_sport_X_coolant_temp CAL_idle_target_manual_tour CAL_idle_target_manual_tour_X_coolant_temp CAL_idle_tps_max_opening CAL_idle_unknown1 CAL_idle_unknown10 CAL_idle_unknown2 CAL_idle_unknown3 CAL_idle_unknown4 CAL_idle_unknown6 /end REF_CHARACTERISTIC
/end GROUP
/begin GROUP G_Torque "Torque and limits" ROOT
 /begin SUB_GROUP G_Torque_dpm G_Torque_revlimit G_Torque_slip G_Torque_torque G_Torque_wheel /end SUB_GROUP
/end GROUP
/begin GROUP G_Torque_dpm "dpm"
 /begin REF_CHARACTERISTIC CAL_dpm_cornering_detect_delay CAL_dpm_cornering_lr_speed_diff_threshold CAL_dpm_cornering_release_delay CAL_dpm_integral_update_period CAL_dpm_intervention_threshold CAL_dpm_max_vehicle_speed CAL_dpm_min_engine_rpm CAL_dpm_min_vehicle_speed CAL_dpm_slip_filter_coeff CAL_dpm_slip_filter_coeff_X_carspeed CAL_dpm_slip_target_base CAL_dpm_slip_target_base_X_dpm_level CAL_dpm_slip_target_from_pedal CAL_dpm_slip_target_from_pedal_X_carspeed CAL_dpm_slip_target_from_pedal_Y_pps CAL_dpm_slip_target_straight_line_offset CAL_dpm_torque_cut_i_gain CAL_dpm_torque_cut_i_limit CAL_dpm_torque_cut_p_term CAL_dpm_torque_cut_p_term_X_carspeed CAL_dpm_torque_cut_p_term_Y_slip CAL_dpm_torque_margin_factor CAL_dpm_torque_min_allowed /end REF_CHARACTERISTIC
/end GROUP
/begin GROUP G_Torque_revlimit "revlimit"
 /begin REF_CHARACTERISTIC CAL_revlimit_airflow_gain_from_integrator CAL_revlimit_airflow_gain_from_integrator_X_gear CAL_revlimit_airflow_gain_from_rpm CAL_revlimit_airflow_gain_from_rpm_X_gear CAL_revlimit_airflow_gain_from_rpm_delta CAL_revlimit_airflow_gain_from_rpm_delta_X_gear CAL_revlimit_airflow_threshold CAL_revlimit_airflow_threshold_X_gear CAL_revlimit_coldstart_rpm_envelope CAL_revlimit_coldstart_rpm_envelope_X_index CAL_revlimit_coolant_coldstart_threshold CAL_revlimit_enforce_delay_after_start CAL_revlimit_escalation_integrator_step CAL_revlimit_escalation_integrator_step_X_gear CAL_revlimit_flow_integral_limit CAL_revlimit_flow_proportional_limit CAL_revlimit_flow_rpm_rate_limit CAL_revlimit_fuelcut_hysteresis CAL_revlimit_integrator_limit CAL_revlimit_limp_mode CAL_revlimit_maf_error_max_10g CAL_revlimit_max_with_speedlimit CAL_revlimit_overrun_count_threshold CAL_revlimit_overspeed_time CAL_revlimit_release_rpm_delta CAL_revlimit_rpm_rate_limit CAL_revlimit_speedbase_ips_sport CAL_revlimit_speedbase_ips_sport_X_coolant_temp CAL_revlimit_speedbase_ips_sport_Y_timer CAL_revlimit_speedbase_ips_tour CAL_revlimit_speedbase_ips_tour_X_coolant_temp CAL_revlimit_speedbase_ips_tour_Y_timer CAL_revlimit_speedbase_manual_sport CAL_revlimit_speedbase_manual_sport_X_coolant_temp CAL_revlimit_speedbase_manual_sport_Y_timer CAL_revlimit_speedbase_manual_tour CAL_revlimit_speedbase_manual_tour_X_coolant_temp CAL_revlimit_speedbase_manual_tour_Y_timer CAL_revlimit_startup_delay CAL_revlimit_startup_offset_decrement CAL_revlimit_throttle_clamp CAL_revlimit_torque_limit_confirmation_threshold CAL_revlimit_trim_per_gear CAL_revlimit_trim_per_gear_X_gear /end REF_CHARACTERISTIC
/end GROUP
/begin GROUP G_Torque_slip "slip"
 /begin REF_CHARACTERISTIC CAL_slip_car_speed_unknown1 CAL_slip_coldstart_coolant_threshold CAL_slip_comp_maf_accum_manual CAL_slip_comp_maf_accum_manual_X_maf_accum CAL_slip_detect_mode CAL_slip_enable_speed CAL_slip_gear_offset_unknown CAL_slip_gear_speed_ratios_cr CAL_slip_gear_speed_ratios_ips CAL_slip_gear_speed_ratios_long CAL_slip_inhibit_accel_pedal_min CAL_slip_inhibit_accel_pedal_timer CAL_slip_inhibit_cornering_base CAL_slip_inhibit_cornering_offset CAL_slip_power_based_rpm_thresholds CAL_slip_power_based_rpm_thresholds_X_power CAL_slip_slip_threshold_per_gear_ips CAL_slip_steering_angle_max_unknown CAL_slip_steering_angle_smooth_factor CAL_slip_steering_increase_factor_min CAL_slip_steering_rate_factor CAL_slip_threshold_1st_Gear CAL_slip_threshold_car_speed CAL_slip_threshold_hysteresis_offset CAL_slip_threshold_per_gear_manual CAL_slip_timer_intervention2 CAL_slip_timer_per_gear_intervention CAL_slip_wheelspeed_front_accel_threshold /end REF_CHARACTERISTIC
/end GROUP
/begin GROUP G_Torque_torque "torque"
 /begin REF_CHARACTERISTIC CAL_torque_engine_ac_load_base CAL_torque_engine_ac_load_base_X_ac CAL_torque_engine_ac_load_scaler CAL_torque_engine_ac_load_scaler_X_engine_speed CAL_torque_engine_friction_speed_component CAL_torque_engine_friction_speed_component_X_engine_speed CAL_torque_engine_friction_speed_component_Y_load CAL_torque_engine_friction_temp_component CAL_torque_engine_friction_temp_component_X_coolant CAL_torque_engine_friction_temp_component_Y_load CAL_torque_estimate_min_ips CAL_torque_ext_torque_limit_hold_count CAL_torque_external_request_overshoot_margin CAL_torque_external_request_overshoot_margin_X_rpm CAL_torque_external_request_overshoot_margin_Y_torque CAL_torque_hysteresis_threshold1 CAL_torque_ign_retard_base CAL_torque_ign_retard_base_X_engine_speed CAL_torque_ign_retard_base_Y_torque_reduction_factor CAL_torque_integral_limit_negative CAL_torque_integral_limit_positive CAL_torque_limit_base_factor CAL_torque_limit_base_factor_X_rpm CAL_torque_limit_base_factor_Y_load CAL_torque_limit_by_coolant CAL_torque_limit_by_coolant_X_coolant CAL_torque_limit_by_rpm CAL_torque_limit_by_rpm_X_gear CAL_torque_limit_by_rpm_Y_rpm CAL_torque_limit_cooldown_timer CAL_torque_limit_cooldown_tps_rate_threshold CAL_torque_limit_integral CAL_torque_limit_integral_X_load_error CAL_torque_limit_integral_deadband CAL_torque_limit_integral_update_period CAL_torque_limit_low_speed_min_torque CAL_torque_limit_low_speed_rpm_threshold CAL_torque_limit_proportional CAL_torque_limit_proportional_X_load_error CAL_torque_limit_tps_filter_coeff CAL_torque_limit_tps_rate_limit CAL_torque_load_to_torque CAL_torque_load_to_torque_X_engine_speed CAL_torque_load_to_torque_Y_load CAL_torque_proportional_limit_negative CAL_torque_proportional_limit_positive CAL_torque_spark_efficiency CAL_torque_spark_efficiency_X_rpm CAL_torque_spark_efficiency_Y_ign_retard_from_mbt CAL_torque_spark_efficiency_slope CAL_torque_spark_efficiency_slope_X_rpm CAL_torque_spark_efficiency_slope_Y_load CAL_torque_torque_to_load CAL_torque_torque_to_load_X_engine_speed CAL_torque_torque_to_load_Y_torque CAL_torque_torque_to_tps_scaling_rpm_range CAL_torque_tps_gain /end REF_CHARACTERISTIC
/end GROUP
/begin GROUP G_Torque_wheel "wheel"
 /begin REF_CHARACTERISTIC CAL_wheel_speed_front_dvdt_scaling CAL_wheel_speed_min CAL_wheel_speed_multiplier_front CAL_wheel_speed_multiplier_rear CAL_wheel_speed_rate_min CAL_wheel_speed_smoothing /end REF_CHARACTERISTIC
/end GROUP
/begin GROUP G_Vvt "Variable valve timing" ROOT
 /begin REF_CHARACTERISTIC CAL_vvt_cam_park_offset_max CAL_vvt_error_gain_startup CAL_vvt_exhaust_advance_base CAL_vvt_exhaust_advance_base_X_engine_speed CAL_vvt_exhaust_advance_base_Y_load CAL_vvt_exhaust_advance_base_low_load CAL_vvt_exhaust_advance_base_low_load_X_engine_speed CAL_vvt_exhaust_advance_base_low_load_Y_load CAL_vvt_exhaust_comp_temp CAL_vvt_exhaust_comp_temp_X_coolant_temp CAL_vvt_intake_advance_base CAL_vvt_intake_advance_base_X_engine_speed CAL_vvt_intake_advance_base_Y_load CAL_vvt_intake_advance_base_low_load CAL_vvt_intake_advance_base_low_load_X_engine_speed CAL_vvt_intake_advance_base_low_load_Y_load CAL_vvt_intake_advance_coolant_offset CAL_vvt_intake_advance_coolant_offset_X_temp CAL_vvt_integral_gain CAL_vvt_low_load_disable CAL_vvt_low_load_ips_enable CAL_vvt_low_load_map_enable_temp CAL_vvt_pwm_driver_divisor CAL_vvt_start_timer CAL_vvt_start_timer_X_coolant_temp CAL_vvt_zero_target_timeout /end REF_CHARACTERISTIC
/end GROUP
/begin GROUP G_Cooling "Cooling and temperatures" ROOT
 /begin SUB_GROUP G_Cooling_coolant G_Cooling_cooling G_Cooling_engine G_Cooling_oil /end SUB_GROUP
/end GROUP
/begin GROUP G_Cooling_coolant "coolant" /begin REF_CHARACTERISTIC CAL_coolant_temp_limit_2 CAL_coolant_temp_threshold /end REF_CHARACTERISTIC /end GROUP
/begin GROUP G_Cooling_cooling "cooling"
 /begin REF_CHARACTERISTIC CAL_cooling_engine_bay_fan_enable_delay CAL_cooling_fan_ac_off CAL_cooling_fan_ac_off_X_air_temp CAL_cooling_fan_ac_off_Y_carspeed CAL_cooling_fan_ac_on CAL_cooling_fan_ac_on_X_air_temp CAL_cooling_fan_ac_on_Y_carspeed CAL_cooling_fan_afterrun CAL_cooling_fan_afterrun_X_air_temp CAL_cooling_fan_afterrun_Y_coolant_temp CAL_cooling_fan_base_engine_on CAL_cooling_fan_base_engine_on_X_coolant_temp CAL_cooling_fan_base_engine_on_Y_carspeed CAL_cooling_fan_duty_cycle_stopped CAL_cooling_fan_duty_cycle_stopped_X_coolant_temp CAL_cooling_fan_engine_bay_airtemp_enable CAL_cooling_fan_engine_bay_radfan_threshold_disable CAL_cooling_fan_engine_bay_radfan_threshold_enable CAL_cooling_fan_hotstart_dutycycle CAL_cooling_fan_hotstart_temp CAL_cooling_fan_inhibit_resample_period_100ms CAL_cooling_fan_inhibit_temp_drop_threshold CAL_cooling_fan_inhibit_window_end_5s CAL_cooling_fan_inhibit_window_start_5s CAL_cooling_fan_low_rpm_hysteresis_threshold CAL_cooling_fan_scaling CAL_cooling_fan_scaling_X_dutycycle CAL_cooling_fan_speed_disable_speed CAL_cooling_fan_startup_time CAL_cooling_recirc_airtemp_disable_engine_on CAL_cooling_recirc_enable_airtemp CAL_cooling_recirc_enginespeed_disable_engine_on CAL_cooling_recirc_reset_coolant_temp CAL_cooling_recirc_rpm_enable_engine_on CAL_cooling_recirc_timer CAL_cooling_thermostat_open CAL_cooling_thermostat_warmup_load_factor CAL_cooling_thermostat_warmup_load_factor_X_load /end REF_CHARACTERISTIC
/end GROUP
/begin GROUP G_Cooling_engine "engine"
 /begin REF_CHARACTERISTIC CAL_engine_speed_3_limit_0 CAL_engine_speed_3_threshold_2 CAL_engine_speed_3_threshold_3 CAL_engine_speed_3_threshold_4 CAL_engine_speed_avg_samples /end REF_CHARACTERISTIC
/end GROUP
/begin GROUP G_Cooling_oil "oil"
 /begin REF_CHARACTERISTIC CAL_oil_pressure_low_timer_threshold CAL_oil_pressure_switch_offset CAL_oil_pressure_switch_startup_time CAL_oil_pressure_switch_voltage_scaling CAL_oil_pressure_warning_light_mode /end REF_CHARACTERISTIC
/end GROUP
/begin GROUP G_Emissions "Emissions and evaporative" ROOT
 /begin SUB_GROUP G_Emissions_cat G_Emissions_emissions G_Emissions_evap G_Emissions_exhaust G_Emissions_misfire /end SUB_GROUP
/end GROUP
/begin GROUP G_Emissions_cat "cat" /begin REF_CHARACTERISTIC CAL_cat_check_unknown4 /end REF_CHARACTERISTIC /end GROUP
/begin GROUP G_Emissions_emissions "emissions"
 /begin REF_CHARACTERISTIC CAL_emissions_cat_efficiency_unknown1 CAL_emissions_cat_efficiency_unknown1_X_coolant_temp /end REF_CHARACTERISTIC
/end GROUP
/begin GROUP G_Emissions_evap "evap"
 /begin REF_CHARACTERISTIC CAL_evap_canister_purge_solenoid_timer_init CAL_evap_commanded_purge_unknown CAL_evap_leak_test_fuel_level_max CAL_evap_leak_test_purge_settle_delay CAL_evap_leak_test_settle_samples CAL_evap_pressure_deviation_max CAL_evap_pressure_filter_coeff CAL_evap_purge_conditioning_timer_100ms CAL_evap_purge_duty_ramp_up_min CAL_evap_purge_filter_alpha CAL_evap_purge_flow_coefficient CAL_evap_purge_flow_coefficient_X_dutycycle CAL_evap_purge_flow_coefficient_Y_vacuum CAL_evap_purge_flow_state_timer_init CAL_evap_purge_flow_vacuum_min CAL_evap_purge_idle_duty_max CAL_evap_purge_min_inj_pulse_enter CAL_evap_purge_min_inj_pulse_exit CAL_evap_purge_min_load CAL_evap_purge_power_enrich_suspend_timeout CAL_evap_purge_pressure_offset CAL_evap_purge_vacuum_min CAL_evap_purge_warmup_time CAL_evap_purge_warmup_time_X_coolant_temp CAL_evap_system_state_flags_param CAL_evap_tank_vacuum_flow_threshold /end REF_CHARACTERISTIC
/end GROUP
/begin GROUP G_Emissions_exhaust "exhaust"
 /begin REF_CHARACTERISTIC CAL_exhaust_flap_RPM_threshold_close CAL_exhaust_flap_RPM_threshold_open CAL_exhaust_flap_load_threshold_close CAL_exhaust_flap_load_threshold_open CAL_exhaust_flap_sport_mode_enable CAL_exhaust_flap_startup_threshold CAL_exhaust_flap_state_control_race CAL_exhaust_flap_state_control_race_X_rpm CAL_exhaust_flap_state_control_race_Y_accel_pedal CAL_exhaust_flap_state_control_sport CAL_exhaust_flap_state_control_sport_X_rpm CAL_exhaust_flap_state_control_sport_Y_accel_pedal CAL_exhaust_flap_state_control_tour CAL_exhaust_flap_state_control_tour_X_rpm CAL_exhaust_flap_state_control_tour_Y_accel_pedal CAL_exhaust_flap_stationary_override_enable CAL_exhaust_flap_tour_mode_enable /end REF_CHARACTERISTIC
/end GROUP
/begin GROUP G_Emissions_misfire "misfire"
 /begin REF_CHARACTERISTIC CAL_misfire_base_threshold_ips CAL_misfire_base_threshold_ips_X_rpm CAL_misfire_base_threshold_ips_Y_load CAL_misfire_base_threshold_manual CAL_misfire_base_threshold_manual_X_rpm CAL_misfire_base_threshold_manual_Y_load CAL_misfire_cat_damage_limit CAL_misfire_cat_damage_limit_X_rpm CAL_misfire_cat_damage_limit_Y_load CAL_misfire_comp_maf_ips CAL_misfire_comp_maf_ips_X_coolant_temp CAL_misfire_comp_maf_ips_Y_maf_accum CAL_misfire_comp_maf_manual CAL_misfire_comp_maf_manual_X_coolant_temp CAL_misfire_comp_maf_manual_Y_maf_accum CAL_misfire_detect_torque_threshold CAL_misfire_detect_torque_threshold_X_rpm CAL_misfire_emissions_limit CAL_misfire_enable_coolant_max CAL_misfire_enable_coolant_min CAL_misfire_enable_rpm_max CAL_misfire_enable_rpm_min CAL_misfire_failed_bank_scaling CAL_misfire_sensitivity_ips CAL_misfire_sensitivity_ips_X_rpm CAL_misfire_sensitivity_ips_Y_load CAL_misfire_sensitivity_manual CAL_misfire_sensitivity_manual_X_rpm CAL_misfire_sensitivity_manual_Y_load /end REF_CHARACTERISTIC
/end GROUP
/begin GROUP G_Diagnostics "OBD-II diagnostics" ROOT
 /begin REF_CHARACTERISTIC CAL_obd_P0171_learn_time_threshold CAL_obd_P0171_ltft_limit CAL_obd_P0172_learn_time_threshold CAL_obd_P0172_ltft_limit CAL_obd_ac_load_diag_tolerance_pct CAL_obd_cat_monitor_threshold_ips CAL_obd_cat_monitor_threshold_ips_X_maf_flow CAL_obd_cat_monitor_threshold_manual CAL_obd_cat_monitor_threshold_manual_X_maf_flow CAL_obd_evap_entry_settle_delay CAL_obd_high_load_monitor_load_max CAL_obd_ii_B1422 CAL_obd_ii_P0011 CAL_obd_ii_P0012 CAL_obd_ii_P0014 CAL_obd_ii_P0014_maturing_limit CAL_obd_ii_P0015 CAL_obd_ii_P0015_maturing_limit CAL_obd_ii_P0016 CAL_obd_ii_P0017 CAL_obd_ii_P0018 CAL_obd_ii_P0019 CAL_obd_ii_P0021 CAL_obd_ii_P0022 CAL_obd_ii_P0024 CAL_obd_ii_P0024_maturing_limit CAL_obd_ii_P0025 CAL_obd_ii_P0071 CAL_obd_ii_P0072 CAL_obd_ii_P0073 CAL_obd_ii_P0076 CAL_obd_ii_P0076_debounce_count CAL_obd_ii_P0077 CAL_obd_ii_P0077_debounce_count CAL_obd_ii_P0079 CAL_obd_ii_P0080 CAL_obd_ii_P0082 CAL_obd_ii_P0083 CAL_obd_ii_P0085 CAL_obd_ii_P0086 CAL_obd_ii_P0087 CAL_obd_ii_P0088 CAL_obd_ii_P0096 CAL_obd_ii_P0097 CAL_obd_ii_P0098 CAL_obd_ii_P0101_ips CAL_obd_ii_P0101_manual CAL_obd_ii_P0101_plausibility_enable CAL_obd_ii_P0102 CAL_obd_ii_P0103 CAL_obd_ii_P0106 CAL_obd_ii_P0106_partload_rpm_window CAL_obd_ii_P0107 CAL_obd_ii_P0108 CAL_obd_ii_P0111 CAL_obd_ii_P0111_maf_debounce_time CAL_obd_ii_P0111_maf_low_band CAL_obd_ii_P0112 CAL_obd_ii_P0113 CAL_obd_ii_P0116 CAL_obd_ii_P0117 CAL_obd_ii_P0118 CAL_obd_ii_P0122 CAL_obd_ii_P0123 CAL_obd_ii_P0128 CAL_obd_ii_P0128_fail_count CAL_obd_ii_P0131 CAL_obd_ii_P0132 CAL_obd_ii_P0132_fail_count CAL_obd_ii_P0133 CAL_obd_ii_P0133_min_coolant_temp CAL_obd_ii_P0134 CAL_obd_ii_P0135 CAL_obd_ii_P0137 CAL_obd_ii_P0137_fail_count CAL_obd_ii_P0138 CAL_obd_ii_P0138_fail_count CAL_obd_ii_P0139 CAL_obd_ii_P0140 CAL_obd_ii_P0141 CAL_obd_ii_P0141_debounce_count CAL_obd_ii_P0151 CAL_obd_ii_P0151_fail_count CAL_obd_ii_P0152 CAL_obd_ii_P0152_fail_count CAL_obd_ii_P0153 CAL_obd_ii_P0154 CAL_obd_ii_P0155 CAL_obd_ii_P0157 CAL_obd_ii_P0157_fail_count CAL_obd_ii_P0158 CAL_obd_ii_P0158_fail_count CAL_obd_ii_P0159 CAL_obd_ii_P0160 CAL_obd_ii_P0161 CAL_obd_ii_P0171 CAL_obd_ii_P0172 CAL_obd_ii_P0174 CAL_obd_ii_P0175 CAL_obd_ii_P0191 CAL_obd_ii_P0192 CAL_obd_ii_P0193 CAL_obd_ii_P0222 CAL_obd_ii_P0223 CAL_obd_ii_P023B CAL_obd_ii_P023C CAL_obd_ii_P025C CAL_obd_ii_P025D CAL_obd_ii_P0261 CAL_obd_ii_P0262 CAL_obd_ii_P0264 CAL_obd_ii_P0265 CAL_obd_ii_P0267 CAL_obd_ii_P0268 CAL_obd_ii_P0270 CAL_obd_ii_P0271 CAL_obd_ii_P0273 CAL_obd_ii_P0274 CAL_obd_ii_P0276 CAL_obd_ii_P0277 CAL_obd_ii_P0300 CAL_obd_ii_P0301 CAL_obd_ii_P0302 CAL_obd_ii_P0303 CAL_obd_ii_P0304 CAL_obd_ii_P0305 CAL_obd_ii_P0306 CAL_obd_ii_P0327 CAL_obd_ii_P0328 CAL_obd_ii_P0332 CAL_obd_ii_P0333 CAL_obd_ii_P0335 CAL_obd_ii_P0341 CAL_obd_ii_P0346 CAL_obd_ii_P0351 CAL_obd_ii_P0352 CAL_obd_ii_P0353 CAL_obd_ii_P0354 CAL_obd_ii_P0355 CAL_obd_ii_P0356 CAL_obd_ii_P0366 CAL_obd_ii_P0391 CAL_obd_ii_P0420 CAL_obd_ii_P0420_car_speed_max CAL_obd_ii_P0420_car_speed_min CAL_obd_ii_P0420_maf_max CAL_obd_ii_P0420_maf_min CAL_obd_ii_P0430 CAL_obd_ii_P0441 CAL_obd_ii_P0442 CAL_obd_ii_P0444 CAL_obd_ii_P0445 CAL_obd_ii_P0446 CAL_obd_ii_P0447 CAL_obd_ii_P0448 CAL_obd_ii_P0451 CAL_obd_ii_P0451_debounce_count CAL_obd_ii_P0452 CAL_obd_ii_P0453 CAL_obd_ii_P0455 CAL_obd_ii_P0456 CAL_obd_ii_P0461 CAL_obd_ii_P0462 CAL_obd_ii_P0463 CAL_obd_ii_P0480 CAL_obd_ii_P0482 CAL_obd_ii_P0500 CAL_obd_ii_P0500_car_speed_min CAL_obd_ii_P0500_test_time CAL_obd_ii_P0506 CAL_obd_ii_P0507 CAL_obd_ii_P050A CAL_obd_ii_P050B CAL_obd_ii_P050B_maturing_limit CAL_obd_ii_P0522 CAL_obd_ii_P0523 CAL_obd_ii_P0524 CAL_obd_ii_P0537 CAL_obd_ii_P0538 CAL_obd_ii_P0562 CAL_obd_ii_P0563 CAL_obd_ii_P0564 CAL_obd_ii_P0571 CAL_obd_ii_P0578 CAL_obd_ii_P0579 CAL_obd_ii_P0579_stuck_timeout CAL_obd_ii_P0601 CAL_obd_ii_P0606 CAL_obd_ii_P0610 CAL_obd_ii_P0616 CAL_obd_ii_P0617 CAL_obd_ii_P0627 CAL_obd_ii_P0630 CAL_obd_ii_P0638 CAL_obd_ii_P0646 CAL_obd_ii_P0647 CAL_obd_ii_P0685 CAL_obd_ii_P0700 CAL_obd_ii_P0712 CAL_obd_ii_P0713 CAL_obd_ii_P0806 CAL_obd_ii_P0807 CAL_obd_ii_P0808 CAL_obd_ii_P0826 CAL_obd_ii_P0827 CAL_obd_ii_P0828 CAL_obd_ii_P0897 CAL_obd_ii_P1104 CAL_obd_ii_P1106 CAL_obd_ii_P1107 CAL_obd_ii_P1108 CAL_obd_ii_P1109 CAL_obd_ii_P123B CAL_obd_ii_P123C CAL_obd_ii_P1301 CAL_obd_ii_P1302 CAL_obd_ii_P1562 CAL_obd_ii_P1809 CAL_obd_ii_P2100 CAL_obd_ii_P2102 CAL_obd_ii_P2103 CAL_obd_ii_P2104 CAL_obd_ii_P2105 CAL_obd_ii_P2106 CAL_obd_ii_P2107 CAL_obd_ii_P2108 CAL_obd_ii_P2119 CAL_obd_ii_P2122 CAL_obd_ii_P2123 CAL_obd_ii_P2127 CAL_obd_ii_P2128 CAL_obd_ii_P2135 CAL_obd_ii_P2138 CAL_obd_ii_P2170 CAL_obd_ii_P2171 CAL_obd_ii_P2173 CAL_obd_ii_P2191 CAL_obd_ii_P2191_lean_confirm_time CAL_obd_ii_P2192_rich_confirm_time CAL_obd_ii_P2193 CAL_obd_ii_P219A CAL_obd_ii_P219B CAL_obd_ii_P2336 CAL_obd_ii_P2336_maturing_limit CAL_obd_ii_P2337 CAL_obd_ii_P2337_maturing_limit CAL_obd_ii_P2338 CAL_obd_ii_P2338_maturing_limit CAL_obd_ii_P2339 CAL_obd_ii_P2339_maturing_limit CAL_obd_ii_P2340 CAL_obd_ii_P2341 CAL_obd_ii_P2602 CAL_obd_ii_P2603 CAL_obd_ii_P2612 CAL_obd_ii_P2613 CAL_obd_ii_P2754 CAL_obd_ii_P2755 CAL_obd_ii_P2797 CAL_obd_ii_U0101 CAL_obd_ii_U0109 CAL_obd_ii_U0122 CAL_obd_ii_U0123 CAL_obd_ii_U0141 CAL_obd_ii_U0155 CAL_obd_ii_U0302 CAL_obd_ii_U0316 CAL_obd_ii_U0316_debounce_count CAL_obd_ii_U0416 CAL_obd_ii_U0513 CAL_obd_ii_cat_monitor_ect_min CAL_obd_ii_cat_monitor_maf_min CAL_obd_ii_cat_monitor_min_engine_runtime CAL_obd_ii_cat_monitor_stable_time CAL_obd_ii_cat_precat_o2_lean_thresh CAL_obd_ii_cat_precat_o2_rich_thresh CAL_obd_ii_cat_switch_ratio_fail_threshold CAL_obd_ii_cat_unknown3 CAL_obd_ii_commanded_evap_purge_max CAL_obd_ii_commanded_evap_purge_min CAL_obd_ii_commanded_evap_purge_threshold CAL_obd_ii_coolant_warmup_thresholds CAL_obd_ii_crank_cam_error_count_max CAL_obd_ii_diag_unknown CAL_obd_ii_drive_cycle_idle_time CAL_obd_ii_evap_purge_settle_debounce CAL_obd_ii_fuel_type CAL_obd_ii_high_load_monitor_afr_max CAL_obd_ii_high_load_monitor_load_min CAL_obd_ii_idle_error_fail_count CAL_obd_ii_idle_learn_limit CAL_obd_ii_knock_no_activity_count CAL_obd_ii_mode06_o2_switch_time_max CAL_obd_ii_mode06_o2_switch_time_min CAL_obd_ii_mode08_evap_test_duration CAL_obd_ii_mode2f_coil_test_pulse_count CAL_obd_ii_mode2f_injector_test_duration CAL_obd_ii_mode2f_injector_test_pulse_10us CAL_obd_ii_mode2f_timeout CAL_obd_ii_monitor_debounce_cycles CAL_obd_ii_monitor_rpm_delta_max CAL_obd_ii_o2_activity_rate_inband CAL_obd_ii_o2_activity_rate_outband CAL_obd_ii_o2_imbalance_accum_cap CAL_obd_ii_o2_imbalance_threshold CAL_obd_ii_o2_l2r_time_max_asym CAL_obd_ii_o2_lean_period_excess_max CAL_obd_ii_o2_period_consistency_tol CAL_obd_ii_o2_period_excess_max CAL_obd_ii_o2_postcat_activity_min CAL_obd_ii_o2_precat_activity_window CAL_obd_ii_o2_precat_diag_timer CAL_obd_ii_o2_r2l_time_max_asym CAL_obd_ii_o2_response_car_speed_max CAL_obd_ii_o2_response_car_speed_min CAL_obd_ii_o2_response_load_stability_max CAL_obd_ii_o2_rich_period_excess_max CAL_obd_ii_o2_sensor1_voltage_limit CAL_obd_ii_o2_sensor1_voltage_threshold CAL_obd_ii_o2_sensor2_voltage_limit CAL_obd_ii_o2_sensor2_voltage_threshold CAL_obd_ii_o2_sensors_present CAL_obd_ii_o2_slow_response_arm_dwell CAL_obd_ii_o2_slow_response_limit_lean_to_rich CAL_obd_ii_o2_slow_response_limit_rich_to_lean CAL_obd_ii_o2_slow_response_maf_limit_unknown CAL_obd_ii_o2_slow_response_maf_limit_unknown2 CAL_obd_ii_o2_slow_response_runtime_limit_unknown CAL_obd_ii_o2_slow_response_sample_count CAL_obd_ii_o2_switch_time_min CAL_obd_ii_o2_switch_time_threshold CAL_obd_ii_o2_transition_count CAL_obd_ii_oil_pressure_switch_low_voltage CAL_obd_ii_postcat_o2_mean_filter_gain CAL_obd_ii_postcat_o2_switch_band_lean CAL_obd_ii_postcat_o2_switch_band_rich CAL_obd_ii_similar_cond_load_window CAL_obd_ii_standards_supported CAL_obd_ii_switch_voltage_debounce CAL_obd_ii_vvt_error_fail_count CAL_obd_ii_vvt_exhaust_error_bank1_limit CAL_obd_ii_vvt_ok_pass_count CAL_obd_monitor_sentinel_init CAL_obd_o2_precat_diag_init_counter CAL_obd_o2_precat_diag_reset_counter CAL_obd_o2_tps_transient_threshold /end REF_CHARACTERISTIC
/end GROUP
/begin GROUP G_Driveline "Transmission and driveline" ROOT /begin SUB_GROUP G_Driveline_clutch G_Driveline_ips G_Driveline_trans /end SUB_GROUP /end GROUP
/begin GROUP G_Driveline_clutch "clutch"
 /begin REF_CHARACTERISTIC CAL_clutch_confidence_decrement CAL_clutch_confidence_increment CAL_clutch_pos_voltage_threshold CAL_clutch_sensor_confidence_max CAL_clutch_variance_threshold /end REF_CHARACTERISTIC
/end GROUP
/begin GROUP G_Driveline_ips "ips"
 /begin REF_CHARACTERISTIC CAL_ips_speed_match_p_gain CAL_ips_torque_reduction_slow_floor_nm_ CAL_ips_torque_reduction_slow_scale_pct /end REF_CHARACTERISTIC
/end GROUP
/begin GROUP G_Driveline_trans "trans"
 /begin REF_CHARACTERISTIC CAL_trans_cooler_temp_scaling CAL_trans_fluid_P2797_threshold CAL_trans_gear_lookup_unknown2 CAL_trans_gear_ratio_sport CAL_trans_gear_ratio_tour CAL_trans_pump_carspeed_enable CAL_trans_pump_cold_cutoff CAL_trans_pump_cool_off CAL_trans_pump_ect_off_max CAL_trans_pump_ect_off_min CAL_trans_pump_ect_on_max CAL_trans_pump_ect_on_min CAL_trans_pump_no_cool_max CAL_trans_pump_no_cool_min CAL_trans_pump_warmup_max CAL_trans_pump_warmup_min CAL_trans_temp_voltage_threshold /end REF_CHARACTERISTIC
/end GROUP
/end MODULE
/end PROJECT
