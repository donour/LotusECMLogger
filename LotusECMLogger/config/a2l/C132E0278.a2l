ASAP2_VERSION 1 61
/begin PROJECT C132E0278 "Lotus T6 C132E0278"
/begin HEADER "" VERSION "generated v1" /end HEADER
/begin MODULE C132E0278 ""
/begin MOD_COMMON "" BYTE_ORDER MSB_FIRST ALIGNMENT_BYTE 1 ALIGNMENT_WORD 2 ALIGNMENT_LONG 4 /end MOD_COMMON
/begin RECORD_LAYOUT RL_VALUE_SLONG FNC_VALUES 1 SLONG ROW_DIR DIRECT /end RECORD_LAYOUT
/begin RECORD_LAYOUT RL_AXIS_SLONG AXIS_PTS_X 1 SLONG INDEX_INCR DIRECT /end RECORD_LAYOUT
/begin COMPU_METHOD CM_i16_factor_1_20 "i16_factor_1/20" RAT_FUNC "%8.0" "%" COEFFS 0 1 0 0 0 5 /end COMPU_METHOD
/begin COMPU_METHOD CM_i16_flow_100_1024mg_s "i16_flow_100/1024mg/s" RAT_FUNC "%12.4" "mg/s" COEFFS 0 1 0 0 0 0.09765625 /end COMPU_METHOD
/begin COMPU_METHOD CM_u16_distance_10cm "u16_distance_10cm" RAT_FUNC "%8.0" "cm" COEFFS 0 1 0 0 0 10 /end COMPU_METHOD
/begin COMPU_METHOD CM_u16_distance_km "u16_distance_km" RAT_FUNC "%8.0" "km" COEFFS 0 1 0 0 0 1 /end COMPU_METHOD
/begin COMPU_METHOD CM_u16_factor_1_1000 "u16_factor_1/1000" RAT_FUNC "%9.1" "%" COEFFS 0 1 0 0 0 0.1 /end COMPU_METHOD
/begin COMPU_METHOD CM_u16_factor_1_10000 "u16_factor_1/10000" RAT_FUNC "%10.2" "%" COEFFS 0 1 0 0 0 0.01 /end COMPU_METHOD
/begin COMPU_METHOD CM_u16_flow_10mg_s "u16_flow_10mg/s" RAT_FUNC "%8.0" "mg/s" COEFFS 0 1 0 0 0 10 /end COMPU_METHOD
/begin COMPU_METHOD CM_u16_lambda_1_32768 "u16_lambda_1/32768" RAT_FUNC "%12.4" "λ" COEFFS 0 1 0 0 0 3.0517578125E-05 /end COMPU_METHOD
/begin COMPU_METHOD CM_u16_rspeed_1_4rpm "u16_rspeed_1/4rpm" RAT_FUNC "%10.2" "rpm" COEFFS 0 1 0 0 0 0.25 /end COMPU_METHOD
/begin COMPU_METHOD CM_u16_voltage_18_1023v "u16_voltage_18/1023v" RAT_FUNC "%12.4" "V" COEFFS 0 1 0 0 0 0.0175953079178886 /end COMPU_METHOD
/begin COMPU_METHOD CM_u16_voltage_5_1023v "u16_voltage_5/1023v" RAT_FUNC "%12.4" "V" COEFFS 0 1 0 0 0 0.00488758553274682 /end COMPU_METHOD
/begin COMPU_METHOD CM_u16_voltage_5_4095v "u16_voltage_5/4095v" RAT_FUNC "%12.4" "V" COEFFS 0 1 0 0 0 0.00122100122100122 /end COMPU_METHOD
/begin COMPU_METHOD CM_u16_voltage_mv "u16_voltage_mv" RAT_FUNC "%8.0" "mv" COEFFS 0 1 0 0 0 1 /end COMPU_METHOD
/begin COMPU_METHOD CM_u32_distance_1_112500km "u32_distance_1/112500km" RAT_FUNC "%12.4" "km" COEFFS 0 1 0 0 0 8.88888888888889E-06 /end COMPU_METHOD
/begin COMPU_METHOD CM_u8_accel_1_100g "u8_accel_1/100g" RAT_FUNC "%10.2" "g" COEFFS 0 1 0 0 0 0.01 /end COMPU_METHOD
/begin COMPU_METHOD CM_u8_angle_1_2_64deg "u8_angle_1/2-64deg" RAT_FUNC "%9.1" "deg" COEFFS 0 1 64 0 0 0.5 /end COMPU_METHOD
/begin COMPU_METHOD CM_u8_factor_1_100 "u8_factor_1/100" RAT_FUNC "%8.0" "%" COEFFS 0 1 0 0 0 1 /end COMPU_METHOD
/begin COMPU_METHOD CM_u8_factor_1_255 "u8_factor_1/255" RAT_FUNC "%12.4" "%" COEFFS 0 1 0 0 0 0.392156862745098 /end COMPU_METHOD
/begin COMPU_METHOD CM_u8_load_mg_stroke "u8_load_mg/stroke" RAT_FUNC "%8.0" "mg/stroke" COEFFS 0 1 0 0 0 1 /end COMPU_METHOD
/begin COMPU_METHOD CM_u8_percent_100_128_100 "u8_percent_100/128-100" RAT_FUNC "%12.4" "%" COEFFS 0 1 100 0 0 0.78125 /end COMPU_METHOD
/begin COMPU_METHOD CM_u8_pressure_3kpa "u8_pressure_3kpa" RAT_FUNC "%8.0" "kpa" COEFFS 0 1 0 0 0 3 /end COMPU_METHOD
/begin COMPU_METHOD CM_u8_pressure_kpa "u8_pressure_kpa" RAT_FUNC "%8.0" "kpa" COEFFS 0 1 0 0 0 1 /end COMPU_METHOD
/begin COMPU_METHOD CM_u8_speed_kph "u8_speed_kph" RAT_FUNC "%8.0" "km/h" COEFFS 0 1 0 0 0 1 /end COMPU_METHOD
/begin COMPU_METHOD CM_u8_temp_5_8_40c "u8_temp_5/8-40c" RAT_FUNC "%11.3" "°C" COEFFS 0 1 40 0 0 0.625 /end COMPU_METHOD
/begin COMPU_METHOD CM_u8_temp__40c "u8_temp_-40c" RAT_FUNC "%8.0" "°C" COEFFS 0 1 40 0 0 1 /end COMPU_METHOD
/begin COMPU_METHOD CM_u8_time_100ms "u8_time_100ms" RAT_FUNC "%8.0" "ms" COEFFS 0 1 0 0 0 100 /end COMPU_METHOD
/begin COMPU_METHOD CM_u8_time_5ms "u8_time_5ms" RAT_FUNC "%8.0" "ms" COEFFS 0 1 0 0 0 5 /end COMPU_METHOD
/begin COMPU_METHOD CM_u8_time_s "u8_time_s" RAT_FUNC "%8.0" "s" COEFFS 0 1 0 0 0 1 /end COMPU_METHOD
/begin COMPU_METHOD CM_u8_volume_1_10gallon "u8_volume_1/10gallon" RAT_FUNC "%9.1" "gallon" COEFFS 0 1 0 0 0 0.1 /end COMPU_METHOD
/begin MEASUREMENT LEA_high_lat_accel_event3_lat_accel_peak "High-lateral-g event 3: peak lateral accel (g = val/100)." SWORD CM_u8_accel_1_100g 0 0 -327.68 327.67 ECU_ADDRESS 0x400040C4 /end MEASUREMENT
/begin MEASUREMENT LEA_high_lat_accel_event3_runtime "(0091)" ULONG CM_u8_time_100ms 0 0 0 429496729500 ECU_ADDRESS 0x400040C8 /end MEASUREMENT
/begin MEASUREMENT LEA_tps_both_sensors_invalid_count "Both TPS sensors invalid count (saturating)." UWORD NO_COMPU_METHOD 0 0 0 65535 ECU_ADDRESS 0x400040CC /end MEASUREMENT
/begin MEASUREMENT LEA_fuel_pump_adapt_trim "Learned fuel pump long-term adaptation term (added to pump PID correction; stepped +/-1, limited by CAL_fuel_pump_adapt_max/min*100). 0278-only." SWORD CM_u16_factor_1_10000 0 0 -327.68 327.67 ECU_ADDRESS 0x400040CE /end MEASUREMENT
/begin MEASUREMENT LEA_engine_breakin_distance_accum "Break-in distance (10 cm units; compared /10000 with CAL_ecu_engine_breakin_distance km; capped 4e9)." ULONG CM_u16_distance_10cm 0 0 0 42949672950 ECU_ADDRESS 0x400040D0 /end MEASUREMENT
/begin MEASUREMENT engine_breakin_distance_complete "Engine breakin distance complete (boolean flag)." UBYTE NO_COMPU_METHOD 0 0 0 255 ECU_ADDRESS 0x400040D4 /end MEASUREMENT
/begin MEASUREMENT LEA_cal_version_stamp "Calibration version stamp stored with LEA. (0091)" UWORD NO_COMPU_METHOD 0 0 0 65535 ECU_ADDRESS 0x4000471A /end MEASUREMENT
/begin MEASUREMENT LEA_core_size "LEA core block size used for the CRC (0x1638). Was lea_base_size. (0091)" ULONG NO_COMPU_METHOD 0 0 0 4294967295 ECU_ADDRESS 0x4000471C /end MEASUREMENT
/begin MEASUREMENT LEA_crc_core "CRC16 of the LEA core block. Was lea_crc_core. (0091)" ULONG NO_COMPU_METHOD 0 0 0 4294967295 ECU_ADDRESS 0x40004720 /end MEASUREMENT
/begin MEASUREMENT LEA_obd_ii_J1979_IGN_CNTR "J1979 IUMPR ignition cycle counter (Mode 09)." UWORD NO_COMPU_METHOD 0 0 0 65535 ECU_ADDRESS 0x40004770 /end MEASUREMENT
/begin MEASUREMENT LEA_obd_ii_J1979_OBDCOND "J1979 IUMPR OBD conditions counter (Mode 09)." UWORD NO_COMPU_METHOD 0 0 0 65535 ECU_ADDRESS 0x40004772 /end MEASUREMENT
/begin MEASUREMENT LEA_idle_learn_warm_ac_on_max "Max of LEA_idle_learn_ac_on (warm). (mg/s = val*100/1024)" SWORD CM_i16_flow_100_1024mg_s 0 0 -3200 3199.90234375 ECU_ADDRESS 0x400047C4 /end MEASUREMENT
/begin MEASUREMENT LEA_idle_learn_warm_ac_on_min "Min of LEA_idle_learn_ac_on (warm). (mg/s = val*100/1024)" SWORD CM_i16_flow_100_1024mg_s 0 0 -3200 3199.90234375 ECU_ADDRESS 0x400047C6 /end MEASUREMENT
/begin MEASUREMENT LEA_idle_learn_warm_max "Max of LEA_obd_ii_idle_learn (warm). (mg/s = val*100/1024)" SWORD CM_i16_flow_100_1024mg_s 0 0 -3200 3199.90234375 ECU_ADDRESS 0x400047C8 /end MEASUREMENT
/begin MEASUREMENT LEA_idle_learn_warm_min "Min of LEA_obd_ii_idle_learn (warm). (mg/s = val*100/1024)" SWORD CM_i16_flow_100_1024mg_s 0 0 -3200 3199.90234375 ECU_ADDRESS 0x400047CA /end MEASUREMENT
/begin MEASUREMENT LEA_idle_learn_cold_ac_on_max "Max of LEA_idle_cold_learning_coolant_ac_on. (mg/s = val*100/1024)" SWORD CM_i16_flow_100_1024mg_s 0 0 -3200 3199.90234375 ECU_ADDRESS 0x400047CC /end MEASUREMENT
/begin MEASUREMENT LEA_idle_learn_cold_ac_on_min "Min of LEA_idle_cold_learning_coolant_ac_on. (mg/s = val*100/1024)" SWORD CM_i16_flow_100_1024mg_s 0 0 -3200 3199.90234375 ECU_ADDRESS 0x400047CE /end MEASUREMENT
/begin MEASUREMENT LEA_idle_learn_cold_max "Max of LEA_idle_cold_learning_coolant. (mg/s = val*100/1024)" SWORD CM_i16_flow_100_1024mg_s 0 0 -3200 3199.90234375 ECU_ADDRESS 0x400047D0 /end MEASUREMENT
/begin MEASUREMENT LEA_idle_learn_cold_min "Min of LEA_idle_cold_learning_coolant. (mg/s = val*100/1024)" SWORD CM_i16_flow_100_1024mg_s 0 0 -3200 3199.90234375 ECU_ADDRESS 0x400047D2 /end MEASUREMENT
/begin MEASUREMENT LEA_obd_ii_P0139_P0159_debounce_min "Was LEA_obd_ii_monitor_sentinel. (0091)" UBYTE NO_COMPU_METHOD 0 0 0 255 ECU_ADDRESS 0x4000489C /end MEASUREMENT
/begin MEASUREMENT LEA_pad_4000489d "Padding." UBYTE NO_COMPU_METHOD 0 0 0 255 ECU_ADDRESS 0x4000489D /end MEASUREMENT
/begin MEASUREMENT LEA_tps_track_a_closed_count "Learned TPS track A closed-position ADC count (12-bit)." UWORD CM_u16_voltage_5_4095v 0 0 0 80.018315018315 ECU_ADDRESS 0x4000489E /end MEASUREMENT
/begin MEASUREMENT LEA_tps_track_b_closed_count "Learned TPS track B closed-position ADC count (12-bit; default 0x725)." UWORD CM_u16_voltage_5_4095v 0 0 0 80.018315018315 ECU_ADDRESS 0x400048A0 /end MEASUREMENT
/begin MEASUREMENT LEA_tps_calib_ok_ecu_voltage "ECU voltage captured at last good TPS calibration. (0091)" UWORD CM_u16_voltage_18_1023v 0 0 0 1153.10850439883 ECU_ADDRESS 0x400048A2 /end MEASUREMENT
/begin MEASUREMENT LEA_tps_calib_ok_adc_ch3 "ADC ch3 captured at last good TPS calibration. (0091)" UWORD NO_COMPU_METHOD 0 0 0 65535 ECU_ADDRESS 0x400048A4 /end MEASUREMENT
/begin MEASUREMENT LEA_hc08_sf_mode_event_count "HC08 safe-mode event count. (0091)" UBYTE NO_COMPU_METHOD 0 0 0 255 ECU_ADDRESS 0x400048A6 /end MEASUREMENT
/begin MEASUREMENT LEA_tps_calib_ok_etb_duty_pct "ETB duty % (etb_pwm_duty_percent = on*100/CAL_etb_pwm_period)." UBYTE CM_u8_factor_1_100 0 0 0 255 ECU_ADDRESS 0x400048A7 /end MEASUREMENT
/begin MEASUREMENT LEA_hc08_sf_mode_max_duration "Longest HC08 safety-fallback episode seen (100 ms), persisted." UWORD CM_u8_time_100ms 0 0 0 6553500 ECU_ADDRESS 0x400048A8 /end MEASUREMENT
/begin MEASUREMENT LEA_cod_changed "Learned/adaptive value: cod changed (boolean flag)." UBYTE NO_COMPU_METHOD 0 0 0 255 ECU_ADDRESS 0x400048AA /end MEASUREMENT
/begin MEASUREMENT LEA_obd_ii_cat_b1_flow_bins_seen "Bitmask of flow bins covered, bank 1 (0xFF = all)." UBYTE NO_COMPU_METHOD 0 0 0 255 ECU_ADDRESS 0x400048EB /end MEASUREMENT
/begin MEASUREMENT LEA_obd_ii_cat_b2_flow_bins_seen "Bitmask of flow bins covered, bank 2 (0xFF = all)." UBYTE NO_COMPU_METHOD 0 0 0 255 ECU_ADDRESS 0x400048EC /end MEASUREMENT
/begin MEASUREMENT LEA_pad_400048ed "Padding." UBYTE NO_COMPU_METHOD 0 0 0 255 ECU_ADDRESS 0x400048ED /end MEASUREMENT
/begin MEASUREMENT obd_ii_DTC_causing_FF "DTC that caused the freeze frame." UWORD NO_COMPU_METHOD 0 0 0 65535 ECU_ADDRESS 0x400048EE /end MEASUREMENT
/begin MEASUREMENT LEA_obd_ii_FF_priority "Freeze-frame priority/config of the stored DTC (bit 0x80 compared). (0091)" UBYTE NO_COMPU_METHOD 0 0 0 255 ECU_ADDRESS 0x400048F0 /end MEASUREMENT
/begin MEASUREMENT LEA_pad_400048f1 "Padding." UBYTE NO_COMPU_METHOD 0 0 0 255 ECU_ADDRESS 0x400048F1 /end MEASUREMENT
/begin MEASUREMENT obd_ii_FF_fuel_system_status "Freeze frame PID 03 fuel system status." UWORD NO_COMPU_METHOD 0 0 0 65535 ECU_ADDRESS 0x400048F2 /end MEASUREMENT
/begin MEASUREMENT obd_ii_FF_calc_engine_load "Freeze frame PID 04 calculated load." UBYTE CM_u8_factor_1_255 0 0 0 100 ECU_ADDRESS 0x400048F4 /end MEASUREMENT
/begin MEASUREMENT obd_ii_FF_coolant_temp "Freeze frame PID 05 coolant (A-40 C)." UBYTE CM_u8_temp__40c 0 0 -40 215 ECU_ADDRESS 0x400048F5 /end MEASUREMENT
/begin MEASUREMENT obd_ii_FF_stft_bank1 "Freeze frame PID 06." UBYTE CM_u8_percent_100_128_100 0 0 -100 99.21875 ECU_ADDRESS 0x400048F6 /end MEASUREMENT
/begin MEASUREMENT obd_ii_FF_ltft_bank1 "Freeze frame PID 07." UBYTE CM_u8_percent_100_128_100 0 0 -100 99.21875 ECU_ADDRESS 0x400048F7 /end MEASUREMENT
/begin MEASUREMENT obd_ii_FF_stft_bank2 "Freeze frame PID 08." UBYTE CM_u8_percent_100_128_100 0 0 -100 99.21875 ECU_ADDRESS 0x400048F8 /end MEASUREMENT
/begin MEASUREMENT obd_ii_FF_ltft_bank2 "Freeze frame PID 09." UBYTE CM_u8_percent_100_128_100 0 0 -100 99.21875 ECU_ADDRESS 0x400048F9 /end MEASUREMENT
/begin MEASUREMENT obd_ii_FF_fuel_pressure "Freeze frame PID 0A fuel rail gauge pressure ((rail-baro)/30 mbar = 3 kPa units)." UBYTE CM_u8_pressure_3kpa 0 0 0 765 ECU_ADDRESS 0x400048FA /end MEASUREMENT
/begin MEASUREMENT obd_ii_FF_map "Freeze frame PID 0B manifold pressure (mbar/10 = kPa)." UBYTE CM_u8_pressure_kpa 0 0 0 255 ECU_ADDRESS 0x400048FB /end MEASUREMENT
/begin MEASUREMENT obd_ii_FF_engine_speed "Freeze frame PID 0C engine speed." UWORD CM_u16_rspeed_1_4rpm 0 0 0 16383.75 ECU_ADDRESS 0x400048FC /end MEASUREMENT
/begin MEASUREMENT obd_ii_FF_car_speed "Freeze frame PID 0D vehicle speed." UBYTE CM_u8_speed_kph 0 0 0 255 ECU_ADDRESS 0x400048FE /end MEASUREMENT
/begin MEASUREMENT obd_ii_FF_ign_advance "Freeze frame PID 0E timing advance (A/2 - 64 deg)." UBYTE CM_u8_angle_1_2_64deg 0 0 -64 63.5 ECU_ADDRESS 0x400048FF /end MEASUREMENT
/begin MEASUREMENT obd_ii_FF_iat "Freeze frame PID 0F intake air temp." UBYTE CM_u8_temp__40c 0 0 -40 215 ECU_ADDRESS 0x40004900 /end MEASUREMENT
/begin MEASUREMENT LEA_pad_40004901 "Padding." UBYTE NO_COMPU_METHOD 0 0 0 255 ECU_ADDRESS 0x40004901 /end MEASUREMENT
/begin MEASUREMENT obd_ii_FF_maf_flow_1 "Freeze frame PID 10 MAF (g/s x100)." UWORD CM_u16_flow_10mg_s 0 0 0 655350 ECU_ADDRESS 0x40004902 /end MEASUREMENT
/begin MEASUREMENT obd_ii_FF_tps_x4 "Freeze frame PID 11 throttle position." UBYTE CM_u8_factor_1_255 0 0 0 100 ECU_ADDRESS 0x40004904 /end MEASUREMENT
/begin MEASUREMENT LEA_pad_40004905 "Padding." UBYTE NO_COMPU_METHOD 0 0 0 255 ECU_ADDRESS 0x40004905 /end MEASUREMENT
/begin MEASUREMENT obd_ii_FF_runtime_since_start "Freeze frame PID 1F runtime since start (s)." UWORD CM_u8_time_s 0 0 0 65535 ECU_ADDRESS 0x40004906 /end MEASUREMENT
/begin MEASUREMENT obd_ii_ff_commanded_evap_purge "Freeze frame PID 2E commanded evap purge." UBYTE CM_u8_factor_1_255 0 0 0 100 ECU_ADDRESS 0x40004908 /end MEASUREMENT
/begin MEASUREMENT obd_ii_FF_fuel_level "Freeze frame PID 2F fuel level." UBYTE CM_u8_factor_1_255 0 0 0 100 ECU_ADDRESS 0x40004909 /end MEASUREMENT
/begin MEASUREMENT obd_ii_FF_atmo_pressure "Freeze frame PID 33 baro (kPa)." UBYTE CM_u8_pressure_kpa 0 0 0 255 ECU_ADDRESS 0x4000490A /end MEASUREMENT
/begin MEASUREMENT LEA_pad_4000490b "Padding." UBYTE NO_COMPU_METHOD 0 0 0 255 ECU_ADDRESS 0x4000490B /end MEASUREMENT
/begin MEASUREMENT obd_ii_FF_ecu_voltage "Freeze frame PID 42 control module voltage (mV)." UWORD CM_u16_voltage_mv 0 0 0 65535 ECU_ADDRESS 0x4000490C /end MEASUREMENT
/begin MEASUREMENT obd_ii_FF_load_abs_percentage "Freeze frame PID 43 absolute load." UWORD CM_u8_factor_1_255 0 0 0 25700 ECU_ADDRESS 0x4000490E /end MEASUREMENT
/begin MEASUREMENT obd_ii_FF_afr_commanded "Freeze frame PID 44 commanded equivalence ratio." UWORD CM_u16_lambda_1_32768 0 0 0 1.99996948242188 ECU_ADDRESS 0x40004910 /end MEASUREMENT
/begin MEASUREMENT obd_ii_FF_relative_tps "Freeze frame PID 45 relative throttle position." UBYTE CM_u8_factor_1_255 0 0 0 100 ECU_ADDRESS 0x40004912 /end MEASUREMENT
/begin MEASUREMENT obd_ii_FF_ambient_air_temp "Freeze frame PID 46 ambient air temp (A-40 C)." UBYTE CM_u8_temp__40c 0 0 -40 215 ECU_ADDRESS 0x40004913 /end MEASUREMENT
/begin MEASUREMENT obd_ii_FF_abs_throttle_pos_b "Freeze frame PID 47 absolute throttle position B." UBYTE CM_u8_factor_1_255 0 0 0 100 ECU_ADDRESS 0x40004914 /end MEASUREMENT
/begin MEASUREMENT obd_ii_FF_accelerator_pos_d "Freeze frame PID 49 accelerator pedal D." UBYTE CM_u8_factor_1_255 0 0 0 100 ECU_ADDRESS 0x40004915 /end MEASUREMENT
/begin MEASUREMENT obd_ii_FF_accelerator_pos_e "Freeze frame PID 4A accelerator pedal E." UBYTE CM_u8_factor_1_255 0 0 0 100 ECU_ADDRESS 0x40004916 /end MEASUREMENT
/begin MEASUREMENT obd_ii_FF_throttle_target_pos "Freeze frame PID 4C commanded throttle actuator." UBYTE CM_u8_factor_1_255 0 0 0 100 ECU_ADDRESS 0x40004917 /end MEASUREMENT
/begin MEASUREMENT obd_ii_FF_chargecooler_temp "Freeze frame charge-cooler temperature (A-40 C)." UBYTE CM_u8_temp__40c 0 0 -40 215 ECU_ADDRESS 0x40004918 /end MEASUREMENT
/begin MEASUREMENT LEA_pad_40004919 "Padding." UBYTE NO_COMPU_METHOD 0 0 0 255 ECU_ADDRESS 0x40004919 /end MEASUREMENT
/begin MEASUREMENT LEA_pad_40004933 "Padding." UBYTE NO_COMPU_METHOD 0 0 0 255 ECU_ADDRESS 0x40004933 /end MEASUREMENT
/begin MEASUREMENT LEA_obd_ii_monitor_complete_cycle_count "Incremented when monitors completed this drive cycle reach CAL_obd_ii_monitors_completed_min." UBYTE NO_COMPU_METHOD 0 0 0 255 ECU_ADDRESS 0x40004948 /end MEASUREMENT
/begin MEASUREMENT obd_ii_engine_tests_completeness "Mode 01 monitor completeness bits (bits cleared as monitors complete)." UBYTE NO_COMPU_METHOD 0 0 0 255 ECU_ADDRESS 0x40004949 /end MEASUREMENT
/begin MEASUREMENT LEA_obd_ii_ff2_dtc_packed "FF2: (code<<3) | type (low 3 bits)." UWORD NO_COMPU_METHOD 0 0 0 65535 ECU_ADDRESS 0x4000494A /end MEASUREMENT
/begin MEASUREMENT LEA_obd_ii_ff2_engine_speed "FF2: engine speed. Was obd_ii_car_speed_freeze_frame (stores obd_ii_engine_speed)." UWORD CM_u16_rspeed_1_4rpm 0 0 0 16383.75 ECU_ADDRESS 0x4000494C /end MEASUREMENT
/begin MEASUREMENT LEA_obd_ii_ff2_maf_flow "FF2: MAF. Was obd_ii_maf_flow_freeze_frame." UWORD CM_u16_flow_10mg_s 0 0 0 655350 ECU_ADDRESS 0x4000494E /end MEASUREMENT
/begin MEASUREMENT LEA_obd_ii_ff2_stft_bank1 "FF2: STFT bank 1." SWORD CM_i16_factor_1_20 0 0 -163840 163835 ECU_ADDRESS 0x40004950 /end MEASUREMENT
/begin MEASUREMENT LEA_obd_ii_ff2_stft_bank2 "FF2: STFT bank 2." SWORD CM_i16_factor_1_20 0 0 -163840 163835 ECU_ADDRESS 0x40004952 /end MEASUREMENT
/begin MEASUREMENT LEA_obd_ii_ff2_ltft_bank1 "FF2: LTFT bank 1." SWORD CM_u16_factor_1_1000 0 0 -3276.8 3276.7 ECU_ADDRESS 0x40004954 /end MEASUREMENT
/begin MEASUREMENT LEA_obd_ii_ff2_ltft_bank2 "FF2: LTFT bank 2." SWORD CM_u16_factor_1_1000 0 0 -3276.8 3276.7 ECU_ADDRESS 0x40004956 /end MEASUREMENT
/begin MEASUREMENT LEA_obd_ii_ff2_coolant_temp "FF2: coolant." UBYTE CM_u8_temp_5_8_40c 0 0 -40 119.375 ECU_ADDRESS 0x40004958 /end MEASUREMENT
/begin MEASUREMENT LEA_obd_ii_ff2_coolant_engine_stopped "FF2: coolant at engine-off." UBYTE CM_u8_temp_5_8_40c 0 0 -40 119.375 ECU_ADDRESS 0x40004959 /end MEASUREMENT
/begin MEASUREMENT LEA_obd_ii_ff2_engine_air_temp "FF2: engine air temp." UBYTE CM_u8_temp_5_8_40c 0 0 -40 119.375 ECU_ADDRESS 0x4000495A /end MEASUREMENT
/begin MEASUREMENT LEA_obd_ii_ff2_tps "FF2: TPS (8-bit)." UBYTE CM_u8_factor_1_255 0 0 0 100 ECU_ADDRESS 0x4000495B /end MEASUREMENT
/begin MEASUREMENT LEA_obd_ii_ff2_runtime_since_start "FF2: runtime since start." ULONG CM_u8_time_5ms 0 0 0 21474836475 ECU_ADDRESS 0x4000495C /end MEASUREMENT
/begin MEASUREMENT LEA_obd_ii_ff2_o2_s1_voltage "FF2: O2 sensor 1 (B1 pre-cat)." UWORD CM_u16_voltage_5_1023v 0 0 0 320.307917888563 ECU_ADDRESS 0x40004960 /end MEASUREMENT
/begin MEASUREMENT LEA_obd_ii_ff2_o2_s5_voltage "FF2: O2 sensor 5 (B2 pre-cat)." UWORD CM_u16_voltage_5_1023v 0 0 0 320.307917888563 ECU_ADDRESS 0x40004962 /end MEASUREMENT
/begin MEASUREMENT LEA_obd_ii_ff2_o2_s2_voltage "FF2: O2 sensor 2 (B1 post-cat)." UWORD CM_u16_voltage_5_1023v 0 0 0 320.307917888563 ECU_ADDRESS 0x40004964 /end MEASUREMENT
/begin MEASUREMENT LEA_obd_ii_ff2_o2_s6_voltage "FF2: O2 sensor 6 (B2 post-cat)." UWORD CM_u16_voltage_5_1023v 0 0 0 320.307917888563 ECU_ADDRESS 0x40004966 /end MEASUREMENT
/begin MEASUREMENT LEA_unused_40004968 "Only cleared (clear_obd_dtc_and_ff); never read." ULONG NO_COMPU_METHOD 0 0 0 4294967295 ECU_ADDRESS 0x40004968 /end MEASUREMENT
/begin MEASUREMENT LEA_obd_ii_ff2_car_speed "FF2: car speed (car_speed_u8). Was wrongly LEA_unused_4000496c." UBYTE CM_u8_speed_kph 0 0 0 255 ECU_ADDRESS 0x4000496C /end MEASUREMENT
/begin MEASUREMENT LEA_pad_4000496d "Padding." UBYTE NO_COMPU_METHOD 0 0 0 255 ECU_ADDRESS 0x4000496D /end MEASUREMENT
/begin MEASUREMENT LEA_unused_4000496e "Only reset to 0x3F5 (1013) on DTC clear; never read." UWORD NO_COMPU_METHOD 0 0 0 65535 ECU_ADDRESS 0x4000496E /end MEASUREMENT
/begin MEASUREMENT LEA_obd_ii_distance_with_mil "Distance with MIL on (10 cm units; capped 65535 km = 0x270FD8F0). Was obd_ii_distance_traveled_with_MIL. (0091)" ULONG CM_u16_distance_10cm 0 0 0 42949672950 ECU_ADDRESS 0x40004970 /end MEASUREMENT
/begin MEASUREMENT obd_ii_warmups_since_code_cleared "OBD-II: warmups since code cleared." UBYTE NO_COMPU_METHOD 0 0 0 255 ECU_ADDRESS 0x40004974 /end MEASUREMENT
/begin MEASUREMENT LEA_pad_40004975 "Padding." UBYTE NO_COMPU_METHOD 0 0 0 255 ECU_ADDRESS 0x40004975 /end MEASUREMENT
/begin MEASUREMENT obd_ii_distance_since_codes_cleared_km "OBD-II: distance since codes cleared km (km)." UWORD CM_u16_distance_km 0 0 0 65535 ECU_ADDRESS 0x40004976 /end MEASUREMENT
/begin MEASUREMENT LEA_obd_ii_engine_run_cycle_count "Incremented each drive cycle where the engine has run." UBYTE NO_COMPU_METHOD 0 0 0 255 ECU_ADDRESS 0x40004978 /end MEASUREMENT
/begin MEASUREMENT LEA_pad_40004979 "Padding." UBYTE NO_COMPU_METHOD 0 0 0 255 ECU_ADDRESS 0x40004979 /end MEASUREMENT
/begin MEASUREMENT LEA_obd_ii_precat_b1_l2r_time "Pre-cat B1 lean-to-rich time (avg); feeds LEA_obd_ii_precat_b1_l2r_time_top10. (0091)" UWORD CM_u8_time_5ms 0 0 0 327675 ECU_ADDRESS 0x4000497A /end MEASUREMENT
/begin MEASUREMENT LEA_obd_ii_precat_b1_r2l_time "Pre-cat B1 rich-to-lean time (avg); feeds _r2l_time_top10. (0091)" UWORD CM_u8_time_5ms 0 0 0 327675 ECU_ADDRESS 0x4000497C /end MEASUREMENT
/begin MEASUREMENT LEA_obd_ii_precat_b1_r2l_l2r_ratio "r2l*100/l2r, bank 1. (0091)" UWORD CM_u8_factor_1_100 0 0 0 65535 ECU_ADDRESS 0x4000497E /end MEASUREMENT
/begin MEASUREMENT LEA_obd_ii_o2_b1_period_avg1 "O2 switch period average 1, bank 1 (Mode 06 x5)." UWORD CM_u8_time_5ms 0 0 0 327675 ECU_ADDRESS 0x40004980 /end MEASUREMENT
/begin MEASUREMENT LEA_obd_ii_o2_b1_period_avg2 "O2 switch period average 2, bank 1." UWORD CM_u8_time_5ms 0 0 0 327675 ECU_ADDRESS 0x40004982 /end MEASUREMENT
/begin MEASUREMENT LEA_obd_ii_o2_b2_period_avg1 "O2 switch period average 1, bank 2." UWORD CM_u8_time_5ms 0 0 0 327675 ECU_ADDRESS 0x40004984 /end MEASUREMENT
/begin MEASUREMENT LEA_obd_ii_o2_b2_period_avg2 "O2 switch period average 2, bank 2." UWORD CM_u8_time_5ms 0 0 0 327675 ECU_ADDRESS 0x40004986 /end MEASUREMENT
/begin MEASUREMENT LEA_obd_ii_cat_b1_o2_voltage_max "Cat monitor bank 1 O2 max tracker (reset 0)." UWORD CM_u16_voltage_5_1023v 0 0 0 320.307917888563 ECU_ADDRESS 0x40004988 /end MEASUREMENT
/begin MEASUREMENT LEA_obd_ii_cat_b1_o2_voltage_min "Cat monitor bank 1 O2 min tracker (reset 0x3FF)." UWORD CM_u16_voltage_5_1023v 0 0 0 320.307917888563 ECU_ADDRESS 0x4000498A /end MEASUREMENT
/begin MEASUREMENT LEA_obd_ii_cat_b1_switch_ratio "Bank 1 post/pre switch ratio x1000 (vs CAL_obd_ii_cat_switch_ratio_fail_threshold); max in LEA_obd_ii_monitor_11." UWORD CM_u16_factor_1_1000 0 0 0 6553.5 ECU_ADDRESS 0x4000498C /end MEASUREMENT
/begin MEASUREMENT LEA_obd_ii_precat_b2_l2r_time "Pre-cat B2 lean-to-rich time (avg). (0091)" UWORD CM_u8_time_5ms 0 0 0 327675 ECU_ADDRESS 0x4000498E /end MEASUREMENT
/begin MEASUREMENT LEA_obd_ii_precat_b2_r2l_time "Pre-cat B2 rich-to-lean time (avg). (0091)" UWORD CM_u8_time_5ms 0 0 0 327675 ECU_ADDRESS 0x40004990 /end MEASUREMENT
/begin MEASUREMENT LEA_obd_ii_precat_b2_r2l_l2r_ratio "r2l*100/l2r, bank 2. (0091)" UWORD CM_u8_factor_1_100 0 0 0 65535 ECU_ADDRESS 0x40004992 /end MEASUREMENT
/begin MEASUREMENT LEA_obd_ii_cat_b2_o2_voltage_max "Cat monitor bank 2 O2 max tracker (reset 0)." UWORD CM_u16_voltage_5_1023v 0 0 0 320.307917888563 ECU_ADDRESS 0x40004994 /end MEASUREMENT
/begin MEASUREMENT LEA_obd_ii_cat_b2_o2_voltage_min "Cat monitor bank 2 O2 min tracker (reset 0x3FF)." UWORD CM_u16_voltage_5_1023v 0 0 0 320.307917888563 ECU_ADDRESS 0x40004996 /end MEASUREMENT
/begin MEASUREMENT LEA_obd_ii_cat_b2_switch_ratio "Bank 2 post/pre switch ratio x1000; max in LEA_obd_ii_monitor_12." UWORD CM_u16_factor_1_1000 0 0 0 6553.5 ECU_ADDRESS 0x40004998 /end MEASUREMENT
/begin MEASUREMENT LEA_obd_ii_cat_mode06_result1 "Cat monitor Mode 06 time result (x5 ms)." UWORD CM_u8_time_5ms 0 0 0 327675 ECU_ADDRESS 0x4000499A /end MEASUREMENT
/begin MEASUREMENT LEA_obd_ii_cat_mode06_result2 "Cat monitor Mode 06 time result (x5 ms)." UWORD CM_u8_time_5ms 0 0 0 327675 ECU_ADDRESS 0x4000499C /end MEASUREMENT
/begin MEASUREMENT LEA_obd_ii_cat_mode06_result3 "Cat monitor Mode 06 time result (x5 ms)." UWORD CM_u8_time_5ms 0 0 0 327675 ECU_ADDRESS 0x4000499E /end MEASUREMENT
/begin MEASUREMENT LEA_obd_ii_cat_mode06_result4 "Cat monitor Mode 06 time result (x5 ms)." UWORD CM_u8_time_5ms 0 0 0 327675 ECU_ADDRESS 0x400049A0 /end MEASUREMENT
/begin MEASUREMENT LEA_obd_ii_evap_P0441_test_result "Evap P0441 purge-flow test result (0xFF = not run; Mode 06). Was evap_p0441_test_result_pressure." UWORD NO_COMPU_METHOD 0 0 0 65535 ECU_ADDRESS 0x400049A2 /end MEASUREMENT
/begin MEASUREMENT LEA_obd_ii_evap_leak_test_result "Evap leak test result: 1 = fail, 0 = pass, 0xFF = not run." UBYTE NO_COMPU_METHOD 0 0 0 255 ECU_ADDRESS 0x400049A4 /end MEASUREMENT
/begin MEASUREMENT LEA_obd_ii_fuel_trim_mode06_flags "Fuel trim monitor Mode 06 flags (bits 0/1)." UBYTE NO_COMPU_METHOD 0 0 0 255 ECU_ADDRESS 0x400049A5 /end MEASUREMENT
/begin MEASUREMENT LEA_unused_400049a6 "Only reset; never read." UWORD NO_COMPU_METHOD 0 0 0 65535 ECU_ADDRESS 0x400049A6 /end MEASUREMENT
/begin MEASUREMENT LEA_obd_ii_evap_leak_check_result "Evap leak check result (obd_ii_eval_leak_check_result; Mode 06 x40)." SWORD NO_COMPU_METHOD 0 0 -32768 32767 ECU_ADDRESS 0x400049A8 /end MEASUREMENT
/begin MEASUREMENT LEA_obd_ii_evap_leak_check_value2 "Evap leak check second value (DAT_40001e74; Mode 06 x40)." SWORD NO_COMPU_METHOD 0 0 -32768 32767 ECU_ADDRESS 0x400049AA /end MEASUREMENT
/begin MEASUREMENT LEA_obd_ii_evap_P0442_decay_limit "Evap P0442 decay limit used (Mode 06 x40)." UBYTE NO_COMPU_METHOD 0 0 0 255 ECU_ADDRESS 0x400049AC /end MEASUREMENT
/begin MEASUREMENT LEA_obd_ii_evap_P0456_decay_limit "Evap P0456 decay limit used (Mode 06 x40)." UBYTE NO_COMPU_METHOD 0 0 0 255 ECU_ADDRESS 0x400049AD /end MEASUREMENT
/begin MEASUREMENT LEA_obd_ii_misfire_results_valid "Misfire Mode 06 results valid. (0091)" UBYTE NO_COMPU_METHOD 0 0 0 255 ECU_ADDRESS 0x400049AE /end MEASUREMENT
/begin MEASUREMENT LEA_pad_400049af "Padding." UBYTE NO_COMPU_METHOD 0 0 0 255 ECU_ADDRESS 0x400049AF /end MEASUREMENT
/begin MEASUREMENT LEA_obd_ii_vvt_mode06_result1 "VVT Mode 06 error count (vs CAL_obd_ii_vvt_error_fail_count; 0xFF = not tested)." UBYTE NO_COMPU_METHOD 0 0 0 255 ECU_ADDRESS 0x400049BC /end MEASUREMENT
/begin MEASUREMENT LEA_obd_ii_vvt_mode06_result2 "VVT Mode 06 error count (vs CAL_obd_ii_vvt_error_fail_count; 0xFF = not tested)." UBYTE NO_COMPU_METHOD 0 0 0 255 ECU_ADDRESS 0x400049BD /end MEASUREMENT
/begin MEASUREMENT LEA_obd_ii_vvt_mode06_result3 "VVT Mode 06 error count (vs CAL_obd_ii_vvt_error_fail_count; 0xFF = not tested)." UBYTE NO_COMPU_METHOD 0 0 0 255 ECU_ADDRESS 0x400049BE /end MEASUREMENT
/begin MEASUREMENT LEA_obd_ii_vvt_mode06_result4 "VVT Mode 06 error count (vs CAL_obd_ii_vvt_error_fail_count; 0xFF = not tested)." UBYTE NO_COMPU_METHOD 0 0 0 255 ECU_ADDRESS 0x400049BF /end MEASUREMENT
/begin MEASUREMENT LEA_misfire_baseline_set "Misfire baselines initialised (compared with CAL_lea_misfire_baseline_set on load). Was lea_misfire_baseline_set." UBYTE NO_COMPU_METHOD 0 0 0 255 ECU_ADDRESS 0x400049C0 /end MEASUREMENT
/begin MEASUREMENT LEA_hc08_status_byte11_min "Min of HC08 status value (DAT_40004f3b) seen after start (reset 0xFF). (0091 name)" UBYTE NO_COMPU_METHOD 0 0 0 255 ECU_ADDRESS 0x400049C1 /end MEASUREMENT
/begin MEASUREMENT LEA_fuel_level_check_fuel_used "Evap monitor fuel used accumulator (sum of fuel_usage_instantaneous; window 60e6). (0091)" ULONG NO_COMPU_METHOD 0 0 0 4294967295 ECU_ADDRESS 0x400049E4 /end MEASUREMENT
/begin MEASUREMENT LEA_fuel_level_check_level_min "Min raw fuel level in the check window. (0091)" UBYTE CM_u8_volume_1_10gallon 0 0 0 25.5 ECU_ADDRESS 0x400049E8 /end MEASUREMENT
/begin MEASUREMENT LEA_fuel_level_check_level_max "Max raw fuel level in the check window. (0091)" UBYTE CM_u8_volume_1_10gallon 0 0 0 25.5 ECU_ADDRESS 0x400049E9 /end MEASUREMENT
/begin MEASUREMENT LEA_fuel_level_check_state "Fuel level check state (0..3)." UBYTE NO_COMPU_METHOD 0 0 0 255 ECU_ADDRESS 0x400049EA /end MEASUREMENT
/begin MEASUREMENT LEA_pad_400049eb "Padding." UBYTE NO_COMPU_METHOD 0 0 0 255 ECU_ADDRESS 0x400049EB /end MEASUREMENT
/begin MEASUREMENT LEA_fuel_level_check_fuel_used_window "Fuel-used window target (CAL_evap_fuel_used_window_level_* x100000)." ULONG NO_COMPU_METHOD 0 0 0 4294967295 ECU_ADDRESS 0x400049EC /end MEASUREMENT
/begin MEASUREMENT LEA_obd_ii_fuel_trim_mode06_result1 "Fuel trim Mode 06 result (from DAT_40001d88)." SWORD NO_COMPU_METHOD 0 0 -32768 32767 ECU_ADDRESS 0x400049F0 /end MEASUREMENT
/begin MEASUREMENT LEA_obd_ii_fuel_trim_mode06_result2 "Fuel trim Mode 06 result (from DAT_40001d7c)." SWORD NO_COMPU_METHOD 0 0 -32768 32767 ECU_ADDRESS 0x400049F2 /end MEASUREMENT
/begin MEASUREMENT LEA_circuit_fault_history_bits "Electrical circuit monitor fault history bits (Mode 22 readout). Was wrongly LEA_unused_400049f4." UWORD NO_COMPU_METHOD 0 0 0 65535 ECU_ADDRESS 0x400049F4 /end MEASUREMENT
/begin MEASUREMENT LEA_fuel_pump_fault_history_bits "Fuel pump monitor fault-state history bits (Mode 22). Was fuel_system_diagnostic." UBYTE NO_COMPU_METHOD 0 0 0 255 ECU_ADDRESS 0x400049F6 /end MEASUREMENT
/begin MEASUREMENT LEA_pad_400049f7 "Padding." UBYTE NO_COMPU_METHOD 0 0 0 255 ECU_ADDRESS 0x400049F7 /end MEASUREMENT
/begin MEASUREMENT LEA_fuel_usage_running_total_avg_trip "Fuel used accumulator for average economy (fuel_usage_instantaneous>>1 per 100 ms)." ULONG NO_COMPU_METHOD 0 0 0 4294967295 ECU_ADDRESS 0x400049F8 /end MEASUREMENT
/begin MEASUREMENT car_speed_running_total_avg_trip "Car speed running total avg trip (km = val/112500)." ULONG CM_u32_distance_1_112500km 0 0 0 38177.4870666667 ECU_ADDRESS 0x400049FC /end MEASUREMENT
/begin MEASUREMENT LEA_fuel_usage_running_total_range_to_empty "Fuel used accumulator for range-to-empty economy factor." ULONG NO_COMPU_METHOD 0 0 0 4294967295 ECU_ADDRESS 0x40004A00 /end MEASUREMENT
/begin MEASUREMENT car_speed_running_total_range_to_empty "Car speed running total range to empty (km = val/112500)." ULONG CM_u32_distance_1_112500km 0 0 0 38177.4870666667 ECU_ADDRESS 0x40004A04 /end MEASUREMENT
/begin MEASUREMENT LEA_fuel_economy_factor_smoothed "Smoothed fuel economy factor for range-to-empty (reset 10000; range = factor*(level-zero)/3000 km)." UWORD NO_COMPU_METHOD 0 0 0 65535 ECU_ADDRESS 0x40004A08 /end MEASUREMENT
/begin MEASUREMENT LEA_fuel_range_smoothed "Learned/adaptive value: fuel range smoothed (km)." UWORD CM_u16_distance_km 0 0 0 65535 ECU_ADDRESS 0x40004A0A /end MEASUREMENT
/begin MEASUREMENT LEA_hc08_status_max_byte16 "Max of HC08 status byte 0x10 received." UBYTE NO_COMPU_METHOD 0 0 0 255 ECU_ADDRESS 0x40004A0C /end MEASUREMENT
/begin MEASUREMENT LEA_hc08_status_max_byte17 "Max of HC08 status byte 0x11 received." UBYTE NO_COMPU_METHOD 0 0 0 255 ECU_ADDRESS 0x40004A0D /end MEASUREMENT
/begin MEASUREMENT LEA_hc08_status_max_byte18 "Max of HC08 status byte 0x12 received." UBYTE NO_COMPU_METHOD 0 0 0 255 ECU_ADDRESS 0x40004A0E /end MEASUREMENT
/begin MEASUREMENT LEA_hc08_status_max_byte19 "Max of HC08 status byte 0x13 received." UBYTE NO_COMPU_METHOD 0 0 0 255 ECU_ADDRESS 0x40004A0F /end MEASUREMENT
/begin MEASUREMENT LEA_hc08_status_max_byte20 "Max of HC08 status byte 0x14 received." UBYTE NO_COMPU_METHOD 0 0 0 255 ECU_ADDRESS 0x40004A10 /end MEASUREMENT
/begin MEASUREMENT LEA_obd_ii_mat_heatsoak_flag "Set when manifold temp - ambient > CAL_obd_ii_mat_ambient_heatsoak_delta (thermostat logic)." UBYTE NO_COMPU_METHOD 0 0 0 255 ECU_ADDRESS 0x40004A11 /end MEASUREMENT
/begin MEASUREMENT LEA_obd_ii_engine_off_soak_count "Engine-off soak counter (0xFFFF = unknown)." UWORD NO_COMPU_METHOD 0 0 0 65535 ECU_ADDRESS 0x40004A12 /end MEASUREMENT
/begin MEASUREMENT LEA_obd_ii_P0011_dtc_state "Learned/adaptive value: OBD-II P0011 DTC state." UBYTE NO_COMPU_METHOD 0 0 0 255 ECU_ADDRESS 0x40004A14 /end MEASUREMENT
/begin MEASUREMENT LEA_obd_ii_P0011_fail_counter "Learned/adaptive value: OBD-II P0011 fail counter." UBYTE NO_COMPU_METHOD 0 0 0 255 ECU_ADDRESS 0x40004A15 /end MEASUREMENT
/begin MEASUREMENT LEA_obd_ii_P0011_pass_counter "Learned/adaptive value: OBD-II P0011 pass counter." UBYTE NO_COMPU_METHOD 0 0 0 255 ECU_ADDRESS 0x40004A16 /end MEASUREMENT
/begin MEASUREMENT LEA_obd_ii_P0012_dtc_state "Learned/adaptive value: OBD-II P0012 DTC state." UBYTE NO_COMPU_METHOD 0 0 0 255 ECU_ADDRESS 0x40004A17 /end MEASUREMENT
/begin MEASUREMENT LEA_obd_ii_P0012_fail_counter "Learned/adaptive value: OBD-II P0012 fail counter." UBYTE NO_COMPU_METHOD 0 0 0 255 ECU_ADDRESS 0x40004A18 /end MEASUREMENT
/begin MEASUREMENT LEA_obd_ii_P0012_pass_counter "Learned/adaptive value: OBD-II P0012 pass counter." UBYTE NO_COMPU_METHOD 0 0 0 255 ECU_ADDRESS 0x40004A19 /end MEASUREMENT
/begin MEASUREMENT LEA_obd_ii_P0021_dtc_state "Learned/adaptive value: OBD-II P0021 DTC state." UBYTE NO_COMPU_METHOD 0 0 0 255 ECU_ADDRESS 0x40004A1A /end MEASUREMENT
/begin MEASUREMENT LEA_obd_ii_P0021_fail_counter "Learned/adaptive value: OBD-II P0021 fail counter." UBYTE NO_COMPU_METHOD 0 0 0 255 ECU_ADDRESS 0x40004A1B /end MEASUREMENT
/begin MEASUREMENT LEA_obd_ii_P0021_pass_counter "Learned/adaptive value: OBD-II P0021 pass counter." UBYTE NO_COMPU_METHOD 0 0 0 255 ECU_ADDRESS 0x40004A1C /end MEASUREMENT
/begin MEASUREMENT LEA_obd_ii_P0022_dtc_state "Learned/adaptive value: OBD-II P0022 DTC state." UBYTE NO_COMPU_METHOD 0 0 0 255 ECU_ADDRESS 0x40004A1D /end MEASUREMENT
/begin MEASUREMENT LEA_obd_ii_P0022_fail_counter "Learned/adaptive value: OBD-II P0022 fail counter." UBYTE NO_COMPU_METHOD 0 0 0 255 ECU_ADDRESS 0x40004A1E /end MEASUREMENT
/begin MEASUREMENT LEA_obd_ii_P0022_pass_counter "Learned/adaptive value: OBD-II P0022 pass counter." UBYTE NO_COMPU_METHOD 0 0 0 255 ECU_ADDRESS 0x40004A1F /end MEASUREMENT
/begin MEASUREMENT LEA_obd_ii_P0014_dtc_state "Learned/adaptive value: OBD-II P0014 DTC state." UBYTE NO_COMPU_METHOD 0 0 0 255 ECU_ADDRESS 0x40004A20 /end MEASUREMENT
/begin MEASUREMENT LEA_obd_ii_P0014_fail_counter "Learned/adaptive value: OBD-II P0014 fail counter." UBYTE NO_COMPU_METHOD 0 0 0 255 ECU_ADDRESS 0x40004A21 /end MEASUREMENT
/begin MEASUREMENT LEA_obd_ii_P0014_pass_counter "Learned/adaptive value: OBD-II P0014 pass counter." UBYTE NO_COMPU_METHOD 0 0 0 255 ECU_ADDRESS 0x40004A22 /end MEASUREMENT
/begin MEASUREMENT LEA_obd_ii_P0015_dtc_state "Learned/adaptive value: OBD-II P0015 DTC state." UBYTE NO_COMPU_METHOD 0 0 0 255 ECU_ADDRESS 0x40004A23 /end MEASUREMENT
/begin MEASUREMENT LEA_obd_ii_P0015_fail_counter "Learned/adaptive value: OBD-II P0015 fail counter." UBYTE NO_COMPU_METHOD 0 0 0 255 ECU_ADDRESS 0x40004A24 /end MEASUREMENT
/begin MEASUREMENT LEA_obd_ii_P0015_pass_counter "Learned/adaptive value: OBD-II P0015 pass counter." UBYTE NO_COMPU_METHOD 0 0 0 255 ECU_ADDRESS 0x40004A25 /end MEASUREMENT
/begin MEASUREMENT LEA_obd_ii_P0024_dtc_state "Learned/adaptive value: OBD-II P0024 DTC state." UBYTE NO_COMPU_METHOD 0 0 0 255 ECU_ADDRESS 0x40004A26 /end MEASUREMENT
/begin MEASUREMENT LEA_obd_ii_P0024_fail_counter "Learned/adaptive value: OBD-II P0024 fail counter." UBYTE NO_COMPU_METHOD 0 0 0 255 ECU_ADDRESS 0x40004A27 /end MEASUREMENT
/begin MEASUREMENT LEA_obd_ii_P0024_pass_counter "Learned/adaptive value: OBD-II P0024 pass counter." UBYTE NO_COMPU_METHOD 0 0 0 255 ECU_ADDRESS 0x40004A28 /end MEASUREMENT
/begin MEASUREMENT LEA_obd_ii_P0025_dtc_state "Learned/adaptive value: OBD-II P0025 DTC state." UBYTE NO_COMPU_METHOD 0 0 0 255 ECU_ADDRESS 0x40004A29 /end MEASUREMENT
/begin MEASUREMENT LEA_obd_ii_P0025_fail_counter "Learned/adaptive value: OBD-II P0025 fail counter." UBYTE NO_COMPU_METHOD 0 0 0 255 ECU_ADDRESS 0x40004A2A /end MEASUREMENT
/begin MEASUREMENT LEA_obd_ii_P0025_pass_counter "Learned/adaptive value: OBD-II P0025 pass counter." UBYTE NO_COMPU_METHOD 0 0 0 255 ECU_ADDRESS 0x40004A2B /end MEASUREMENT
/begin MEASUREMENT LEA_obd_ii_P0016_dtc_state "Learned/adaptive value: OBD-II P0016 DTC state." UBYTE NO_COMPU_METHOD 0 0 0 255 ECU_ADDRESS 0x40004A2C /end MEASUREMENT
/begin MEASUREMENT LEA_obd_ii_P0016_fail_counter "Learned/adaptive value: OBD-II P0016 fail counter." UBYTE NO_COMPU_METHOD 0 0 0 255 ECU_ADDRESS 0x40004A2D /end MEASUREMENT
/begin MEASUREMENT LEA_obd_ii_P0016_pass_counter "Learned/adaptive value: OBD-II P0016 pass counter." UBYTE NO_COMPU_METHOD 0 0 0 255 ECU_ADDRESS 0x40004A2E /end MEASUREMENT
/begin MEASUREMENT LEA_obd_ii_P0017_dtc_state "Learned/adaptive value: OBD-II P0017 DTC state." UBYTE NO_COMPU_METHOD 0 0 0 255 ECU_ADDRESS 0x40004A2F /end MEASUREMENT
/begin MEASUREMENT LEA_obd_ii_P0017_fail_counter "Learned/adaptive value: OBD-II P0017 fail counter." UBYTE NO_COMPU_METHOD 0 0 0 255 ECU_ADDRESS 0x40004A30 /end MEASUREMENT
/begin MEASUREMENT LEA_obd_ii_P0017_pass_counter "Learned/adaptive value: OBD-II P0017 pass counter." UBYTE NO_COMPU_METHOD 0 0 0 255 ECU_ADDRESS 0x40004A31 /end MEASUREMENT
/begin MEASUREMENT LEA_obd_ii_P0018_dtc_state "Learned/adaptive value: OBD-II P0018 DTC state." UBYTE NO_COMPU_METHOD 0 0 0 255 ECU_ADDRESS 0x40004A32 /end MEASUREMENT
/begin MEASUREMENT LEA_obd_ii_P0018_fail_counter "Learned/adaptive value: OBD-II P0018 fail counter." UBYTE NO_COMPU_METHOD 0 0 0 255 ECU_ADDRESS 0x40004A33 /end MEASUREMENT
/begin MEASUREMENT LEA_obd_ii_P0018_pass_counter "Learned/adaptive value: OBD-II P0018 pass counter." UBYTE NO_COMPU_METHOD 0 0 0 255 ECU_ADDRESS 0x40004A34 /end MEASUREMENT
/begin MEASUREMENT LEA_obd_ii_P0019_dtc_state "Learned/adaptive value: OBD-II P0019 DTC state." UBYTE NO_COMPU_METHOD 0 0 0 255 ECU_ADDRESS 0x40004A35 /end MEASUREMENT
/begin MEASUREMENT LEA_obd_ii_P0019_fail_counter "Learned/adaptive value: OBD-II P0019 fail counter." UBYTE NO_COMPU_METHOD 0 0 0 255 ECU_ADDRESS 0x40004A36 /end MEASUREMENT
/begin MEASUREMENT LEA_obd_ii_P0019_pass_counter "Learned/adaptive value: OBD-II P0019 pass counter." UBYTE NO_COMPU_METHOD 0 0 0 255 ECU_ADDRESS 0x40004A37 /end MEASUREMENT
/begin MEASUREMENT LEA_obd_ii_P0076_dtc_state "Learned/adaptive value: OBD-II P0076 DTC state." UBYTE NO_COMPU_METHOD 0 0 0 255 ECU_ADDRESS 0x40004A38 /end MEASUREMENT
/begin MEASUREMENT LEA_obd_ii_P0076_fail_counter "Learned/adaptive value: OBD-II P0076 fail counter." UBYTE NO_COMPU_METHOD 0 0 0 255 ECU_ADDRESS 0x40004A39 /end MEASUREMENT
/begin MEASUREMENT LEA_obd_ii_P0076_pass_counter "Learned/adaptive value: OBD-II P0076 pass counter." UBYTE NO_COMPU_METHOD 0 0 0 255 ECU_ADDRESS 0x40004A3A /end MEASUREMENT
/begin MEASUREMENT LEA_obd_ii_P0077_dtc_state "Learned/adaptive value: OBD-II P0077 DTC state." UBYTE NO_COMPU_METHOD 0 0 0 255 ECU_ADDRESS 0x40004A3B /end MEASUREMENT
/begin MEASUREMENT LEA_obd_ii_P0077_fail_counter "Learned/adaptive value: OBD-II P0077 fail counter." UBYTE NO_COMPU_METHOD 0 0 0 255 ECU_ADDRESS 0x40004A3C /end MEASUREMENT
/begin MEASUREMENT LEA_obd_ii_P0077_pass_counter "Learned/adaptive value: OBD-II P0077 pass counter." UBYTE NO_COMPU_METHOD 0 0 0 255 ECU_ADDRESS 0x40004A3D /end MEASUREMENT
/begin MEASUREMENT LEA_obd_ii_P0079_dtc_state "Learned/adaptive value: OBD-II P0079 DTC state." UBYTE NO_COMPU_METHOD 0 0 0 255 ECU_ADDRESS 0x40004A3E /end MEASUREMENT
/begin MEASUREMENT LEA_obd_ii_P0079_fail_counter "Learned/adaptive value: OBD-II P0079 fail counter." UBYTE NO_COMPU_METHOD 0 0 0 255 ECU_ADDRESS 0x40004A3F /end MEASUREMENT
/begin MEASUREMENT LEA_obd_ii_P0079_pass_counter "Learned/adaptive value: OBD-II P0079 pass counter." UBYTE NO_COMPU_METHOD 0 0 0 255 ECU_ADDRESS 0x40004A40 /end MEASUREMENT
/begin MEASUREMENT LEA_obd_ii_P0080_dtc_state "Learned/adaptive value: OBD-II P0080 DTC state." UBYTE NO_COMPU_METHOD 0 0 0 255 ECU_ADDRESS 0x40004A41 /end MEASUREMENT
/begin MEASUREMENT LEA_obd_ii_P0080_fail_counter "Learned/adaptive value: OBD-II P0080 fail counter." UBYTE NO_COMPU_METHOD 0 0 0 255 ECU_ADDRESS 0x40004A42 /end MEASUREMENT
/begin MEASUREMENT LEA_obd_ii_P0080_pass_counter "Learned/adaptive value: OBD-II P0080 pass counter." UBYTE NO_COMPU_METHOD 0 0 0 255 ECU_ADDRESS 0x40004A43 /end MEASUREMENT
/begin MEASUREMENT LEA_obd_ii_P0082_dtc_state "Learned/adaptive value: OBD-II P0082 DTC state." UBYTE NO_COMPU_METHOD 0 0 0 255 ECU_ADDRESS 0x40004A44 /end MEASUREMENT
/begin MEASUREMENT LEA_obd_ii_P0082_fail_counter "Learned/adaptive value: OBD-II P0082 fail counter." UBYTE NO_COMPU_METHOD 0 0 0 255 ECU_ADDRESS 0x40004A45 /end MEASUREMENT
/begin MEASUREMENT LEA_obd_ii_P0082_pass_counter "Learned/adaptive value: OBD-II P0082 pass counter." UBYTE NO_COMPU_METHOD 0 0 0 255 ECU_ADDRESS 0x40004A46 /end MEASUREMENT
/begin MEASUREMENT LEA_obd_ii_P0083_dtc_state "Learned/adaptive value: OBD-II P0083 DTC state." UBYTE NO_COMPU_METHOD 0 0 0 255 ECU_ADDRESS 0x40004A47 /end MEASUREMENT
/begin MEASUREMENT LEA_obd_ii_P0083_fail_counter "Learned/adaptive value: OBD-II P0083 fail counter." UBYTE NO_COMPU_METHOD 0 0 0 255 ECU_ADDRESS 0x40004A48 /end MEASUREMENT
/begin MEASUREMENT LEA_obd_ii_P0083_pass_counter "Learned/adaptive value: OBD-II P0083 pass counter." UBYTE NO_COMPU_METHOD 0 0 0 255 ECU_ADDRESS 0x40004A49 /end MEASUREMENT
/begin MEASUREMENT LEA_obd_ii_P0085_dtc_state "Learned/adaptive value: OBD-II P0085 DTC state." UBYTE NO_COMPU_METHOD 0 0 0 255 ECU_ADDRESS 0x40004A4A /end MEASUREMENT
/begin MEASUREMENT LEA_obd_ii_P0085_fail_counter "Learned/adaptive value: OBD-II P0085 fail counter." UBYTE NO_COMPU_METHOD 0 0 0 255 ECU_ADDRESS 0x40004A4B /end MEASUREMENT
/begin MEASUREMENT LEA_obd_ii_P0085_pass_counter "Learned/adaptive value: OBD-II P0085 pass counter." UBYTE NO_COMPU_METHOD 0 0 0 255 ECU_ADDRESS 0x40004A4C /end MEASUREMENT
/begin MEASUREMENT LEA_obd_ii_P0086_dtc_state "Learned/adaptive value: OBD-II P0086 DTC state." UBYTE NO_COMPU_METHOD 0 0 0 255 ECU_ADDRESS 0x40004A4D /end MEASUREMENT
/begin MEASUREMENT LEA_obd_ii_P0086_fail_counter "Learned/adaptive value: OBD-II P0086 fail counter." UBYTE NO_COMPU_METHOD 0 0 0 255 ECU_ADDRESS 0x40004A4E /end MEASUREMENT
/begin MEASUREMENT LEA_obd_ii_P0086_pass_counter "Learned/adaptive value: OBD-II P0086 pass counter." UBYTE NO_COMPU_METHOD 0 0 0 255 ECU_ADDRESS 0x40004A4F /end MEASUREMENT
/begin MEASUREMENT LEA_obd_ii_P0087_dtc_state "Learned/adaptive value: OBD-II P0087 DTC state." UBYTE NO_COMPU_METHOD 0 0 0 255 ECU_ADDRESS 0x40004A50 /end MEASUREMENT
/begin MEASUREMENT LEA_obd_ii_P0087_fail_counter "Learned/adaptive value: OBD-II P0087 fail counter." UBYTE NO_COMPU_METHOD 0 0 0 255 ECU_ADDRESS 0x40004A51 /end MEASUREMENT
/begin MEASUREMENT LEA_obd_ii_P0087_pass_counter "Learned/adaptive value: OBD-II P0087 pass counter." UBYTE NO_COMPU_METHOD 0 0 0 255 ECU_ADDRESS 0x40004A52 /end MEASUREMENT
/begin MEASUREMENT LEA_obd_ii_P0088_dtc_state "Learned/adaptive value: OBD-II P0088 DTC state." UBYTE NO_COMPU_METHOD 0 0 0 255 ECU_ADDRESS 0x40004A53 /end MEASUREMENT
/begin MEASUREMENT LEA_obd_ii_P0088_fail_counter "Learned/adaptive value: OBD-II P0088 fail counter." UBYTE NO_COMPU_METHOD 0 0 0 255 ECU_ADDRESS 0x40004A54 /end MEASUREMENT
/begin MEASUREMENT LEA_obd_ii_P0088_pass_counter "Learned/adaptive value: OBD-II P0088 pass counter." UBYTE NO_COMPU_METHOD 0 0 0 255 ECU_ADDRESS 0x40004A55 /end MEASUREMENT
/begin MEASUREMENT LEA_obd_ii_P0096_dtc_state "Learned/adaptive value: OBD-II P0096 DTC state." UBYTE NO_COMPU_METHOD 0 0 0 255 ECU_ADDRESS 0x40004A56 /end MEASUREMENT
/begin MEASUREMENT LEA_obd_ii_P0096_fail_counter "Learned/adaptive value: OBD-II P0096 fail counter." UBYTE NO_COMPU_METHOD 0 0 0 255 ECU_ADDRESS 0x40004A57 /end MEASUREMENT
/begin MEASUREMENT LEA_obd_ii_P0096_pass_counter "Learned/adaptive value: OBD-II P0096 pass counter." UBYTE NO_COMPU_METHOD 0 0 0 255 ECU_ADDRESS 0x40004A58 /end MEASUREMENT
/begin MEASUREMENT LEA_obd_ii_P0097_dtc_state "Learned/adaptive value: OBD-II P0097 DTC state." UBYTE NO_COMPU_METHOD 0 0 0 255 ECU_ADDRESS 0x40004A59 /end MEASUREMENT
/begin MEASUREMENT LEA_obd_ii_P0097_fail_counter "Learned/adaptive value: OBD-II P0097 fail counter." UBYTE NO_COMPU_METHOD 0 0 0 255 ECU_ADDRESS 0x40004A5A /end MEASUREMENT
/begin MEASUREMENT LEA_obd_ii_P0097_pass_counter "Learned/adaptive value: OBD-II P0097 pass counter." UBYTE NO_COMPU_METHOD 0 0 0 255 ECU_ADDRESS 0x40004A5B /end MEASUREMENT
/begin MEASUREMENT LEA_obd_ii_P0098_dtc_state "Learned/adaptive value: OBD-II P0098 DTC state." UBYTE NO_COMPU_METHOD 0 0 0 255 ECU_ADDRESS 0x40004A5C /end MEASUREMENT
/begin MEASUREMENT LEA_obd_ii_P0098_fail_counter "Learned/adaptive value: OBD-II P0098 fail counter." UBYTE NO_COMPU_METHOD 0 0 0 255 ECU_ADDRESS 0x40004A5D /end MEASUREMENT
/begin MEASUREMENT LEA_obd_ii_P0098_pass_counter "Learned/adaptive value: OBD-II P0098 pass counter." UBYTE NO_COMPU_METHOD 0 0 0 255 ECU_ADDRESS 0x40004A5E /end MEASUREMENT
/begin MEASUREMENT LEA_obd_ii_P0101_dtc_state "Learned/adaptive value: OBD-II P0101 DTC state." UBYTE NO_COMPU_METHOD 0 0 0 255 ECU_ADDRESS 0x40004A5F /end MEASUREMENT
/begin MEASUREMENT LEA_obd_ii_P0101_fail_counter "Learned/adaptive value: OBD-II P0101 fail counter." UBYTE NO_COMPU_METHOD 0 0 0 255 ECU_ADDRESS 0x40004A60 /end MEASUREMENT
/begin MEASUREMENT LEA_obd_ii_P0101_pass_counter "Learned/adaptive value: OBD-II P0101 pass counter." UBYTE NO_COMPU_METHOD 0 0 0 255 ECU_ADDRESS 0x40004A61 /end MEASUREMENT
/begin MEASUREMENT LEA_obd_ii_P0102_dtc_state "Learned/adaptive value: OBD-II P0102 DTC state." UBYTE NO_COMPU_METHOD 0 0 0 255 ECU_ADDRESS 0x40004A62 /end MEASUREMENT
/begin MEASUREMENT LEA_obd_ii_P0102_fail_counter "Learned/adaptive value: OBD-II P0102 fail counter." UBYTE NO_COMPU_METHOD 0 0 0 255 ECU_ADDRESS 0x40004A63 /end MEASUREMENT
/begin MEASUREMENT LEA_obd_ii_P0102_pass_counter "Learned/adaptive value: OBD-II P0102 pass counter." UBYTE NO_COMPU_METHOD 0 0 0 255 ECU_ADDRESS 0x40004A64 /end MEASUREMENT
/begin MEASUREMENT LEA_obd_ii_P0103_dtc_state "Learned/adaptive value: OBD-II P0103 DTC state." UBYTE NO_COMPU_METHOD 0 0 0 255 ECU_ADDRESS 0x40004A65 /end MEASUREMENT
/begin MEASUREMENT LEA_obd_ii_P0103_fail_counter "Learned/adaptive value: OBD-II P0103 fail counter." UBYTE NO_COMPU_METHOD 0 0 0 255 ECU_ADDRESS 0x40004A66 /end MEASUREMENT
/begin MEASUREMENT LEA_obd_ii_P0103_pass_counter "Learned/adaptive value: OBD-II P0103 pass counter." UBYTE NO_COMPU_METHOD 0 0 0 255 ECU_ADDRESS 0x40004A67 /end MEASUREMENT
/begin MEASUREMENT LEA_obd_ii_P0106_dtc_state "Learned/adaptive value: OBD-II P0106 DTC state." UBYTE NO_COMPU_METHOD 0 0 0 255 ECU_ADDRESS 0x40004A68 /end MEASUREMENT
/begin MEASUREMENT LEA_obd_ii_P0106_fail_counter "Learned/adaptive value: OBD-II P0106 fail counter." UBYTE NO_COMPU_METHOD 0 0 0 255 ECU_ADDRESS 0x40004A69 /end MEASUREMENT
/begin MEASUREMENT LEA_obd_ii_P0106_pass_counter "Learned/adaptive value: OBD-II P0106 pass counter." UBYTE NO_COMPU_METHOD 0 0 0 255 ECU_ADDRESS 0x40004A6A /end MEASUREMENT
/begin MEASUREMENT LEA_obd_ii_P0107_dtc_state "Learned/adaptive value: OBD-II P0107 DTC state." UBYTE NO_COMPU_METHOD 0 0 0 255 ECU_ADDRESS 0x40004A6B /end MEASUREMENT
/begin MEASUREMENT LEA_obd_ii_P0107_fail_counter "Learned/adaptive value: OBD-II P0107 fail counter." UBYTE NO_COMPU_METHOD 0 0 0 255 ECU_ADDRESS 0x40004A6C /end MEASUREMENT
/begin MEASUREMENT LEA_obd_ii_P0107_pass_counter "Learned/adaptive value: OBD-II P0107 pass counter." UBYTE NO_COMPU_METHOD 0 0 0 255 ECU_ADDRESS 0x40004A6D /end MEASUREMENT
/begin MEASUREMENT LEA_obd_ii_P0108_dtc_state "Learned/adaptive value: OBD-II P0108 DTC state." UBYTE NO_COMPU_METHOD 0 0 0 255 ECU_ADDRESS 0x40004A6E /end MEASUREMENT
/begin MEASUREMENT LEA_obd_ii_P0108_fail_counter "Learned/adaptive value: OBD-II P0108 fail counter." UBYTE NO_COMPU_METHOD 0 0 0 255 ECU_ADDRESS 0x40004A6F /end MEASUREMENT
/begin MEASUREMENT LEA_obd_ii_P0108_pass_counter "Learned/adaptive value: OBD-II P0108 pass counter." UBYTE NO_COMPU_METHOD 0 0 0 255 ECU_ADDRESS 0x40004A70 /end MEASUREMENT
/begin MEASUREMENT LEA_obd_ii_P0111_dtc_state "Learned/adaptive value: OBD-II P0111 DTC state." UBYTE NO_COMPU_METHOD 0 0 0 255 ECU_ADDRESS 0x40004A71 /end MEASUREMENT
/begin MEASUREMENT LEA_obd_ii_P0111_fail_counter "Learned/adaptive value: OBD-II P0111 fail counter." UBYTE NO_COMPU_METHOD 0 0 0 255 ECU_ADDRESS 0x40004A72 /end MEASUREMENT
/begin MEASUREMENT LEA_obd_ii_P0111_pass_counter "Learned/adaptive value: OBD-II P0111 pass counter." UBYTE NO_COMPU_METHOD 0 0 0 255 ECU_ADDRESS 0x40004A73 /end MEASUREMENT
/begin MEASUREMENT LEA_obd_ii_P0112_dtc_state "Learned/adaptive value: OBD-II P0112 DTC state." UBYTE NO_COMPU_METHOD 0 0 0 255 ECU_ADDRESS 0x40004A74 /end MEASUREMENT
/begin MEASUREMENT LEA_obd_ii_P0112_fail_counter "Learned/adaptive value: OBD-II P0112 fail counter." UBYTE NO_COMPU_METHOD 0 0 0 255 ECU_ADDRESS 0x40004A75 /end MEASUREMENT
/begin MEASUREMENT LEA_obd_ii_P0112_pass_counter "Learned/adaptive value: OBD-II P0112 pass counter." UBYTE NO_COMPU_METHOD 0 0 0 255 ECU_ADDRESS 0x40004A76 /end MEASUREMENT
/begin MEASUREMENT LEA_obd_ii_P0113_dtc_state "Learned/adaptive value: OBD-II P0113 DTC state." UBYTE NO_COMPU_METHOD 0 0 0 255 ECU_ADDRESS 0x40004A77 /end MEASUREMENT
/begin MEASUREMENT LEA_obd_ii_P0113_fail_counter "Learned/adaptive value: OBD-II P0113 fail counter." UBYTE NO_COMPU_METHOD 0 0 0 255 ECU_ADDRESS 0x40004A78 /end MEASUREMENT
/begin MEASUREMENT LEA_obd_ii_P0113_pass_counter "Learned/adaptive value: OBD-II P0113 pass counter." UBYTE NO_COMPU_METHOD 0 0 0 255 ECU_ADDRESS 0x40004A79 /end MEASUREMENT
/begin MEASUREMENT LEA_obd_ii_P0071_dtc_state "Learned/adaptive value: OBD-II P0071 DTC state." UBYTE NO_COMPU_METHOD 0 0 0 255 ECU_ADDRESS 0x40004A7A /end MEASUREMENT
/begin MEASUREMENT LEA_obd_ii_P0071_fail_counter "Learned/adaptive value: OBD-II P0071 fail counter." UBYTE NO_COMPU_METHOD 0 0 0 255 ECU_ADDRESS 0x40004A7B /end MEASUREMENT
/begin MEASUREMENT LEA_obd_ii_P0071_pass_counter "Learned/adaptive value: OBD-II P0071 pass counter." UBYTE NO_COMPU_METHOD 0 0 0 255 ECU_ADDRESS 0x40004A7C /end MEASUREMENT
/begin MEASUREMENT LEA_obd_ii_P0072_dtc_state "Learned/adaptive value: OBD-II P0072 DTC state." UBYTE NO_COMPU_METHOD 0 0 0 255 ECU_ADDRESS 0x40004A7D /end MEASUREMENT
/begin MEASUREMENT LEA_obd_ii_P0072_fail_counter "Learned/adaptive value: OBD-II P0072 fail counter." UBYTE NO_COMPU_METHOD 0 0 0 255 ECU_ADDRESS 0x40004A7E /end MEASUREMENT
/begin MEASUREMENT LEA_obd_ii_P0072_pass_counter "Learned/adaptive value: OBD-II P0072 pass counter." UBYTE NO_COMPU_METHOD 0 0 0 255 ECU_ADDRESS 0x40004A7F /end MEASUREMENT
/begin MEASUREMENT LEA_obd_ii_P0073_dtc_state "Learned/adaptive value: OBD-II P0073 DTC state." UBYTE NO_COMPU_METHOD 0 0 0 255 ECU_ADDRESS 0x40004A80 /end MEASUREMENT
/begin MEASUREMENT LEA_obd_ii_P0073_fail_counter "Learned/adaptive value: OBD-II P0073 fail counter." UBYTE NO_COMPU_METHOD 0 0 0 255 ECU_ADDRESS 0x40004A81 /end MEASUREMENT
/begin MEASUREMENT LEA_obd_ii_P0073_pass_counter "Learned/adaptive value: OBD-II P0073 pass counter." UBYTE NO_COMPU_METHOD 0 0 0 255 ECU_ADDRESS 0x40004A82 /end MEASUREMENT
/begin MEASUREMENT LEA_obd_ii_P0116_dtc_state "Learned/adaptive value: OBD-II P0116 DTC state." UBYTE NO_COMPU_METHOD 0 0 0 255 ECU_ADDRESS 0x40004A83 /end MEASUREMENT
/begin MEASUREMENT LEA_obd_ii_P0116_fail_counter "Learned/adaptive value: OBD-II P0116 fail counter." UBYTE NO_COMPU_METHOD 0 0 0 255 ECU_ADDRESS 0x40004A84 /end MEASUREMENT
/begin MEASUREMENT LEA_obd_ii_P0116_pass_counter "Learned/adaptive value: OBD-II P0116 pass counter." UBYTE NO_COMPU_METHOD 0 0 0 255 ECU_ADDRESS 0x40004A85 /end MEASUREMENT
/begin MEASUREMENT LEA_obd_ii_P0117_dtc_state "Learned/adaptive value: OBD-II P0117 DTC state." UBYTE NO_COMPU_METHOD 0 0 0 255 ECU_ADDRESS 0x40004A86 /end MEASUREMENT
/begin MEASUREMENT LEA_obd_ii_P0117_fail_counter "Learned/adaptive value: OBD-II P0117 fail counter." UBYTE NO_COMPU_METHOD 0 0 0 255 ECU_ADDRESS 0x40004A87 /end MEASUREMENT
/begin MEASUREMENT LEA_obd_ii_P0117_pass_counter "Learned/adaptive value: OBD-II P0117 pass counter." UBYTE NO_COMPU_METHOD 0 0 0 255 ECU_ADDRESS 0x40004A88 /end MEASUREMENT
/begin MEASUREMENT LEA_obd_ii_P0118_dtc_state "Learned/adaptive value: OBD-II P0118 DTC state." UBYTE NO_COMPU_METHOD 0 0 0 255 ECU_ADDRESS 0x40004A89 /end MEASUREMENT
/begin MEASUREMENT LEA_obd_ii_P0118_fail_counter "Learned/adaptive value: OBD-II P0118 fail counter." UBYTE NO_COMPU_METHOD 0 0 0 255 ECU_ADDRESS 0x40004A8A /end MEASUREMENT
/begin MEASUREMENT LEA_obd_ii_P0118_pass_counter "Learned/adaptive value: OBD-II P0118 pass counter." UBYTE NO_COMPU_METHOD 0 0 0 255 ECU_ADDRESS 0x40004A8B /end MEASUREMENT
/begin MEASUREMENT LEA_obd_ii_P0122_dtc_state "Learned/adaptive value: OBD-II P0122 DTC state." UBYTE NO_COMPU_METHOD 0 0 0 255 ECU_ADDRESS 0x40004A8C /end MEASUREMENT
/begin MEASUREMENT LEA_obd_ii_P0122_fail_counter "Learned/adaptive value: OBD-II P0122 fail counter." UBYTE NO_COMPU_METHOD 0 0 0 255 ECU_ADDRESS 0x40004A8D /end MEASUREMENT
/begin MEASUREMENT LEA_obd_ii_P0122_pass_counter "Learned/adaptive value: OBD-II P0122 pass counter." UBYTE NO_COMPU_METHOD 0 0 0 255 ECU_ADDRESS 0x40004A8E /end MEASUREMENT
/begin MEASUREMENT LEA_obd_ii_P0123_dtc_state "Learned/adaptive value: OBD-II P0123 DTC state." UBYTE NO_COMPU_METHOD 0 0 0 255 ECU_ADDRESS 0x40004A8F /end MEASUREMENT
/begin MEASUREMENT LEA_obd_ii_P0123_fail_counter "Learned/adaptive value: OBD-II P0123 fail counter." UBYTE NO_COMPU_METHOD 0 0 0 255 ECU_ADDRESS 0x40004A90 /end MEASUREMENT
/begin MEASUREMENT LEA_obd_ii_P0123_pass_counter "Learned/adaptive value: OBD-II P0123 pass counter." UBYTE NO_COMPU_METHOD 0 0 0 255 ECU_ADDRESS 0x40004A91 /end MEASUREMENT
/begin MEASUREMENT LEA_obd_ii_P0128_dtc_state "Learned/adaptive value: OBD-II P0128 DTC state." UBYTE NO_COMPU_METHOD 0 0 0 255 ECU_ADDRESS 0x40004A92 /end MEASUREMENT
/begin MEASUREMENT LEA_obd_ii_P0128_fail_counter "Learned/adaptive value: OBD-II P0128 fail counter." UBYTE NO_COMPU_METHOD 0 0 0 255 ECU_ADDRESS 0x40004A93 /end MEASUREMENT
/begin MEASUREMENT LEA_obd_ii_P0128_pass_counter "Learned/adaptive value: OBD-II P0128 pass counter." UBYTE NO_COMPU_METHOD 0 0 0 255 ECU_ADDRESS 0x40004A94 /end MEASUREMENT
/begin MEASUREMENT LEA_obd_ii_P0131_dtc_state "Learned/adaptive value: OBD-II P0131 DTC state." UBYTE NO_COMPU_METHOD 0 0 0 255 ECU_ADDRESS 0x40004A95 /end MEASUREMENT
/begin MEASUREMENT LEA_obd_ii_P0131_fail_counter "Learned/adaptive value: OBD-II P0131 fail counter." UBYTE NO_COMPU_METHOD 0 0 0 255 ECU_ADDRESS 0x40004A96 /end MEASUREMENT
/begin MEASUREMENT LEA_obd_ii_P0131_pass_counter "Learned/adaptive value: OBD-II P0131 pass counter." UBYTE NO_COMPU_METHOD 0 0 0 255 ECU_ADDRESS 0x40004A97 /end MEASUREMENT
/begin MEASUREMENT LEA_obd_ii_P0132_dtc_state "Learned/adaptive value: OBD-II P0132 DTC state." UBYTE NO_COMPU_METHOD 0 0 0 255 ECU_ADDRESS 0x40004A98 /end MEASUREMENT
/begin MEASUREMENT LEA_obd_ii_P0132_fail_counter "Learned/adaptive value: OBD-II P0132 fail counter." UBYTE NO_COMPU_METHOD 0 0 0 255 ECU_ADDRESS 0x40004A99 /end MEASUREMENT
/begin MEASUREMENT LEA_obd_ii_P0132_pass_counter "Learned/adaptive value: OBD-II P0132 pass counter." UBYTE NO_COMPU_METHOD 0 0 0 255 ECU_ADDRESS 0x40004A9A /end MEASUREMENT
/begin MEASUREMENT LEA_obd_ii_P0133_dtc_state "Learned/adaptive value: OBD-II P0133 DTC state." UBYTE NO_COMPU_METHOD 0 0 0 255 ECU_ADDRESS 0x40004A9B /end MEASUREMENT
/begin MEASUREMENT LEA_obd_ii_P0133_fail_counter "Learned/adaptive value: OBD-II P0133 fail counter." UBYTE NO_COMPU_METHOD 0 0 0 255 ECU_ADDRESS 0x40004A9C /end MEASUREMENT
/begin MEASUREMENT LEA_obd_ii_P0133_pass_counter "Learned/adaptive value: OBD-II P0133 pass counter." UBYTE NO_COMPU_METHOD 0 0 0 255 ECU_ADDRESS 0x40004A9D /end MEASUREMENT
/begin MEASUREMENT LEA_obd_ii_P0134_dtc_state "Learned/adaptive value: OBD-II P0134 DTC state." UBYTE NO_COMPU_METHOD 0 0 0 255 ECU_ADDRESS 0x40004A9E /end MEASUREMENT
/begin MEASUREMENT LEA_obd_ii_P0134_fail_counter "Learned/adaptive value: OBD-II P0134 fail counter." UBYTE NO_COMPU_METHOD 0 0 0 255 ECU_ADDRESS 0x40004A9F /end MEASUREMENT
/begin MEASUREMENT LEA_obd_ii_P0134_pass_counter "Learned/adaptive value: OBD-II P0134 pass counter." UBYTE NO_COMPU_METHOD 0 0 0 255 ECU_ADDRESS 0x40004AA0 /end MEASUREMENT
/begin MEASUREMENT LEA_obd_ii_P0135_dtc_state "Learned/adaptive value: OBD-II P0135 DTC state." UBYTE NO_COMPU_METHOD 0 0 0 255 ECU_ADDRESS 0x40004AA1 /end MEASUREMENT
/begin MEASUREMENT LEA_obd_ii_P0135_fail_counter "Learned/adaptive value: OBD-II P0135 fail counter." UBYTE NO_COMPU_METHOD 0 0 0 255 ECU_ADDRESS 0x40004AA2 /end MEASUREMENT
/begin MEASUREMENT LEA_obd_ii_P0135_pass_counter "Learned/adaptive value: OBD-II P0135 pass counter." UBYTE NO_COMPU_METHOD 0 0 0 255 ECU_ADDRESS 0x40004AA3 /end MEASUREMENT
/begin MEASUREMENT LEA_obd_ii_P0137_dtc_state "Learned/adaptive value: OBD-II P0137 DTC state." UBYTE NO_COMPU_METHOD 0 0 0 255 ECU_ADDRESS 0x40004AA4 /end MEASUREMENT
/begin MEASUREMENT LEA_obd_ii_P0137_fail_counter "Learned/adaptive value: OBD-II P0137 fail counter." UBYTE NO_COMPU_METHOD 0 0 0 255 ECU_ADDRESS 0x40004AA5 /end MEASUREMENT
/begin MEASUREMENT LEA_obd_ii_P0137_pass_counter "Learned/adaptive value: OBD-II P0137 pass counter." UBYTE NO_COMPU_METHOD 0 0 0 255 ECU_ADDRESS 0x40004AA6 /end MEASUREMENT
/begin MEASUREMENT LEA_obd_ii_P0138_dtc_state "Learned/adaptive value: OBD-II P0138 DTC state." UBYTE NO_COMPU_METHOD 0 0 0 255 ECU_ADDRESS 0x40004AA7 /end MEASUREMENT
/begin MEASUREMENT LEA_obd_ii_P0138_fail_counter "Learned/adaptive value: OBD-II P0138 fail counter." UBYTE NO_COMPU_METHOD 0 0 0 255 ECU_ADDRESS 0x40004AA8 /end MEASUREMENT
/begin MEASUREMENT LEA_obd_ii_P0138_pass_counter "Learned/adaptive value: OBD-II P0138 pass counter." UBYTE NO_COMPU_METHOD 0 0 0 255 ECU_ADDRESS 0x40004AA9 /end MEASUREMENT
/begin MEASUREMENT LEA_obd_ii_P0139_dtc_state "Learned/adaptive value: OBD-II P0139 DTC state." UBYTE NO_COMPU_METHOD 0 0 0 255 ECU_ADDRESS 0x40004AAA /end MEASUREMENT
/begin MEASUREMENT LEA_obd_ii_P0139_fail_counter "Learned/adaptive value: OBD-II P0139 fail counter." UBYTE NO_COMPU_METHOD 0 0 0 255 ECU_ADDRESS 0x40004AAB /end MEASUREMENT
/begin MEASUREMENT LEA_obd_ii_P0139_pass_counter "Learned/adaptive value: OBD-II P0139 pass counter." UBYTE NO_COMPU_METHOD 0 0 0 255 ECU_ADDRESS 0x40004AAC /end MEASUREMENT
/begin MEASUREMENT LEA_obd_ii_P0140_dtc_state "Learned/adaptive value: OBD-II P0140 DTC state." UBYTE NO_COMPU_METHOD 0 0 0 255 ECU_ADDRESS 0x40004AAD /end MEASUREMENT
/begin MEASUREMENT LEA_obd_ii_P0140_fail_counter "Learned/adaptive value: OBD-II P0140 fail counter." UBYTE NO_COMPU_METHOD 0 0 0 255 ECU_ADDRESS 0x40004AAE /end MEASUREMENT
/begin MEASUREMENT LEA_obd_ii_P0140_pass_counter "Learned/adaptive value: OBD-II P0140 pass counter." UBYTE NO_COMPU_METHOD 0 0 0 255 ECU_ADDRESS 0x40004AAF /end MEASUREMENT
/begin MEASUREMENT LEA_obd_ii_P0141_dtc_state "Learned/adaptive value: OBD-II P0141 DTC state." UBYTE NO_COMPU_METHOD 0 0 0 255 ECU_ADDRESS 0x40004AB0 /end MEASUREMENT
/begin MEASUREMENT LEA_obd_ii_P0141_fail_counter "Learned/adaptive value: OBD-II P0141 fail counter." UBYTE NO_COMPU_METHOD 0 0 0 255 ECU_ADDRESS 0x40004AB1 /end MEASUREMENT
/begin MEASUREMENT LEA_obd_ii_P0141_pass_counter "Learned/adaptive value: OBD-II P0141 pass counter." UBYTE NO_COMPU_METHOD 0 0 0 255 ECU_ADDRESS 0x40004AB2 /end MEASUREMENT
/begin MEASUREMENT LEA_obd_ii_P0151_dtc_state "Learned/adaptive value: OBD-II P0151 DTC state." UBYTE NO_COMPU_METHOD 0 0 0 255 ECU_ADDRESS 0x40004AB3 /end MEASUREMENT
/begin MEASUREMENT LEA_obd_ii_P0151_fail_counter "Learned/adaptive value: OBD-II P0151 fail counter." UBYTE NO_COMPU_METHOD 0 0 0 255 ECU_ADDRESS 0x40004AB4 /end MEASUREMENT
/begin MEASUREMENT LEA_obd_ii_P0151_pass_counter "Learned/adaptive value: OBD-II P0151 pass counter." UBYTE NO_COMPU_METHOD 0 0 0 255 ECU_ADDRESS 0x40004AB5 /end MEASUREMENT
/begin MEASUREMENT LEA_obd_ii_P0152_dtc_state "Learned/adaptive value: OBD-II P0152 DTC state." UBYTE NO_COMPU_METHOD 0 0 0 255 ECU_ADDRESS 0x40004AB6 /end MEASUREMENT
/begin MEASUREMENT LEA_obd_ii_P0152_fail_counter "Learned/adaptive value: OBD-II P0152 fail counter." UBYTE NO_COMPU_METHOD 0 0 0 255 ECU_ADDRESS 0x40004AB7 /end MEASUREMENT
/begin MEASUREMENT LEA_obd_ii_P0152_pass_counter "Learned/adaptive value: OBD-II P0152 pass counter." UBYTE NO_COMPU_METHOD 0 0 0 255 ECU_ADDRESS 0x40004AB8 /end MEASUREMENT
/begin MEASUREMENT LEA_obd_ii_P0153_dtc_state "Learned/adaptive value: OBD-II P0153 DTC state." UBYTE NO_COMPU_METHOD 0 0 0 255 ECU_ADDRESS 0x40004AB9 /end MEASUREMENT
/begin MEASUREMENT LEA_obd_ii_P0153_fail_counter "Learned/adaptive value: OBD-II P0153 fail counter." UBYTE NO_COMPU_METHOD 0 0 0 255 ECU_ADDRESS 0x40004ABA /end MEASUREMENT
/begin MEASUREMENT LEA_obd_ii_P0153_pass_counter "Learned/adaptive value: OBD-II P0153 pass counter." UBYTE NO_COMPU_METHOD 0 0 0 255 ECU_ADDRESS 0x40004ABB /end MEASUREMENT
/begin MEASUREMENT LEA_obd_ii_P0154_dtc_state "Learned/adaptive value: OBD-II P0154 DTC state." UBYTE NO_COMPU_METHOD 0 0 0 255 ECU_ADDRESS 0x40004ABC /end MEASUREMENT
/begin MEASUREMENT LEA_obd_ii_P0154_fail_counter "Learned/adaptive value: OBD-II P0154 fail counter." UBYTE NO_COMPU_METHOD 0 0 0 255 ECU_ADDRESS 0x40004ABD /end MEASUREMENT
/begin MEASUREMENT LEA_obd_ii_P0154_pass_counter "Learned/adaptive value: OBD-II P0154 pass counter." UBYTE NO_COMPU_METHOD 0 0 0 255 ECU_ADDRESS 0x40004ABE /end MEASUREMENT
/begin MEASUREMENT LEA_obd_ii_P0155_dtc_state "Learned/adaptive value: OBD-II P0155 DTC state." UBYTE NO_COMPU_METHOD 0 0 0 255 ECU_ADDRESS 0x40004ABF /end MEASUREMENT
/begin MEASUREMENT LEA_obd_ii_P0155_fail_counter "Learned/adaptive value: OBD-II P0155 fail counter." UBYTE NO_COMPU_METHOD 0 0 0 255 ECU_ADDRESS 0x40004AC0 /end MEASUREMENT
/begin MEASUREMENT LEA_obd_ii_P0155_pass_counter "Learned/adaptive value: OBD-II P0155 pass counter." UBYTE NO_COMPU_METHOD 0 0 0 255 ECU_ADDRESS 0x40004AC1 /end MEASUREMENT
/begin MEASUREMENT LEA_obd_ii_P0157_dtc_state "Learned/adaptive value: OBD-II P0157 DTC state." UBYTE NO_COMPU_METHOD 0 0 0 255 ECU_ADDRESS 0x40004AC2 /end MEASUREMENT
/begin MEASUREMENT LEA_obd_ii_P0157_fail_counter "Learned/adaptive value: OBD-II P0157 fail counter." UBYTE NO_COMPU_METHOD 0 0 0 255 ECU_ADDRESS 0x40004AC3 /end MEASUREMENT
/begin MEASUREMENT LEA_obd_ii_P0157_pass_counter "Learned/adaptive value: OBD-II P0157 pass counter." UBYTE NO_COMPU_METHOD 0 0 0 255 ECU_ADDRESS 0x40004AC4 /end MEASUREMENT
/begin MEASUREMENT LEA_obd_ii_P0158_dtc_state "Learned/adaptive value: OBD-II P0158 DTC state." UBYTE NO_COMPU_METHOD 0 0 0 255 ECU_ADDRESS 0x40004AC5 /end MEASUREMENT
/begin MEASUREMENT LEA_obd_ii_P0158_fail_counter "Learned/adaptive value: OBD-II P0158 fail counter." UBYTE NO_COMPU_METHOD 0 0 0 255 ECU_ADDRESS 0x40004AC6 /end MEASUREMENT
/begin MEASUREMENT LEA_obd_ii_P0158_pass_counter "Learned/adaptive value: OBD-II P0158 pass counter." UBYTE NO_COMPU_METHOD 0 0 0 255 ECU_ADDRESS 0x40004AC7 /end MEASUREMENT
/begin MEASUREMENT LEA_obd_ii_P0159_dtc_state "Learned/adaptive value: OBD-II P0159 DTC state." UBYTE NO_COMPU_METHOD 0 0 0 255 ECU_ADDRESS 0x40004AC8 /end MEASUREMENT
/begin MEASUREMENT LEA_obd_ii_P0159_fail_counter "Learned/adaptive value: OBD-II P0159 fail counter." UBYTE NO_COMPU_METHOD 0 0 0 255 ECU_ADDRESS 0x40004AC9 /end MEASUREMENT
/begin MEASUREMENT LEA_obd_ii_P0159_pass_counter "Learned/adaptive value: OBD-II P0159 pass counter." UBYTE NO_COMPU_METHOD 0 0 0 255 ECU_ADDRESS 0x40004ACA /end MEASUREMENT
/begin MEASUREMENT LEA_obd_ii_P0160_dtc_state "Learned/adaptive value: OBD-II P0160 DTC state." UBYTE NO_COMPU_METHOD 0 0 0 255 ECU_ADDRESS 0x40004ACB /end MEASUREMENT
/begin MEASUREMENT LEA_obd_ii_P0160_fail_counter "Learned/adaptive value: OBD-II P0160 fail counter." UBYTE NO_COMPU_METHOD 0 0 0 255 ECU_ADDRESS 0x40004ACC /end MEASUREMENT
/begin MEASUREMENT LEA_obd_ii_P0160_pass_counter "Learned/adaptive value: OBD-II P0160 pass counter." UBYTE NO_COMPU_METHOD 0 0 0 255 ECU_ADDRESS 0x40004ACD /end MEASUREMENT
/begin MEASUREMENT LEA_obd_ii_P0161_dtc_state "Learned/adaptive value: OBD-II P0161 DTC state." UBYTE NO_COMPU_METHOD 0 0 0 255 ECU_ADDRESS 0x40004ACE /end MEASUREMENT
/begin MEASUREMENT LEA_obd_ii_P0161_fail_counter "Learned/adaptive value: OBD-II P0161 fail counter." UBYTE NO_COMPU_METHOD 0 0 0 255 ECU_ADDRESS 0x40004ACF /end MEASUREMENT
/begin MEASUREMENT LEA_obd_ii_P0161_pass_counter "Learned/adaptive value: OBD-II P0161 pass counter." UBYTE NO_COMPU_METHOD 0 0 0 255 ECU_ADDRESS 0x40004AD0 /end MEASUREMENT
/begin MEASUREMENT LEA_obd_ii_P0171_dtc_state "Learned/adaptive value: OBD-II P0171 DTC state." UBYTE NO_COMPU_METHOD 0 0 0 255 ECU_ADDRESS 0x40004AD1 /end MEASUREMENT
/begin MEASUREMENT LEA_obd_ii_P0171_fail_counter "Learned/adaptive value: OBD-II P0171 fail counter." UBYTE NO_COMPU_METHOD 0 0 0 255 ECU_ADDRESS 0x40004AD2 /end MEASUREMENT
/begin MEASUREMENT LEA_obd_ii_P0171_pass_counter "Learned/adaptive value: OBD-II P0171 pass counter." UBYTE NO_COMPU_METHOD 0 0 0 255 ECU_ADDRESS 0x40004AD3 /end MEASUREMENT
/begin MEASUREMENT LEA_obd_ii_P0172_dtc_state "Learned/adaptive value: OBD-II P0172 DTC state." UBYTE NO_COMPU_METHOD 0 0 0 255 ECU_ADDRESS 0x40004AD4 /end MEASUREMENT
/begin MEASUREMENT LEA_obd_ii_P0172_fail_counter "Learned/adaptive value: OBD-II P0172 fail counter." UBYTE NO_COMPU_METHOD 0 0 0 255 ECU_ADDRESS 0x40004AD5 /end MEASUREMENT
/begin MEASUREMENT LEA_obd_ii_P0172_pass_counter "Learned/adaptive value: OBD-II P0172 pass counter." UBYTE NO_COMPU_METHOD 0 0 0 255 ECU_ADDRESS 0x40004AD6 /end MEASUREMENT
/begin MEASUREMENT LEA_obd_ii_P0174_dtc_state "Learned/adaptive value: OBD-II P0174 DTC state." UBYTE NO_COMPU_METHOD 0 0 0 255 ECU_ADDRESS 0x40004AD7 /end MEASUREMENT
/begin MEASUREMENT LEA_obd_ii_P0174_fail_counter "Learned/adaptive value: OBD-II P0174 fail counter." UBYTE NO_COMPU_METHOD 0 0 0 255 ECU_ADDRESS 0x40004AD8 /end MEASUREMENT
/begin MEASUREMENT LEA_obd_ii_P0174_pass_counter "Learned/adaptive value: OBD-II P0174 pass counter." UBYTE NO_COMPU_METHOD 0 0 0 255 ECU_ADDRESS 0x40004AD9 /end MEASUREMENT
/begin MEASUREMENT LEA_obd_ii_P0175_dtc_state "Learned/adaptive value: OBD-II P0175 DTC state." UBYTE NO_COMPU_METHOD 0 0 0 255 ECU_ADDRESS 0x40004ADA /end MEASUREMENT
/begin MEASUREMENT LEA_obd_ii_P0175_fail_counter "Learned/adaptive value: OBD-II P0175 fail counter." UBYTE NO_COMPU_METHOD 0 0 0 255 ECU_ADDRESS 0x40004ADB /end MEASUREMENT
/begin MEASUREMENT LEA_obd_ii_P0175_pass_counter "Learned/adaptive value: OBD-II P0175 pass counter." UBYTE NO_COMPU_METHOD 0 0 0 255 ECU_ADDRESS 0x40004ADC /end MEASUREMENT
/begin MEASUREMENT LEA_obd_ii_P0191_dtc_state "Learned/adaptive value: OBD-II P0191 DTC state." UBYTE NO_COMPU_METHOD 0 0 0 255 ECU_ADDRESS 0x40004ADD /end MEASUREMENT
/begin MEASUREMENT LEA_obd_ii_P0191_fail_counter "Learned/adaptive value: OBD-II P0191 fail counter." UBYTE NO_COMPU_METHOD 0 0 0 255 ECU_ADDRESS 0x40004ADE /end MEASUREMENT
/begin MEASUREMENT LEA_obd_ii_P0191_pass_counter "Learned/adaptive value: OBD-II P0191 pass counter." UBYTE NO_COMPU_METHOD 0 0 0 255 ECU_ADDRESS 0x40004ADF /end MEASUREMENT
/begin MEASUREMENT LEA_obd_ii_P0192_dtc_state "Learned/adaptive value: OBD-II P0192 DTC state." UBYTE NO_COMPU_METHOD 0 0 0 255 ECU_ADDRESS 0x40004AE0 /end MEASUREMENT
/begin MEASUREMENT LEA_obd_ii_P0192_fail_counter "Learned/adaptive value: OBD-II P0192 fail counter." UBYTE NO_COMPU_METHOD 0 0 0 255 ECU_ADDRESS 0x40004AE1 /end MEASUREMENT
/begin MEASUREMENT LEA_obd_ii_P0192_pass_counter "Learned/adaptive value: OBD-II P0192 pass counter." UBYTE NO_COMPU_METHOD 0 0 0 255 ECU_ADDRESS 0x40004AE2 /end MEASUREMENT
/begin MEASUREMENT LEA_obd_ii_P0193_dtc_state "Learned/adaptive value: OBD-II P0193 DTC state." UBYTE NO_COMPU_METHOD 0 0 0 255 ECU_ADDRESS 0x40004AE3 /end MEASUREMENT
/begin MEASUREMENT LEA_obd_ii_P0193_fail_counter "Learned/adaptive value: OBD-II P0193 fail counter." UBYTE NO_COMPU_METHOD 0 0 0 255 ECU_ADDRESS 0x40004AE4 /end MEASUREMENT
/begin MEASUREMENT LEA_obd_ii_P0193_pass_counter "Learned/adaptive value: OBD-II P0193 pass counter." UBYTE NO_COMPU_METHOD 0 0 0 255 ECU_ADDRESS 0x40004AE5 /end MEASUREMENT
/begin MEASUREMENT LEA_obd_ii_P0222_dtc_state "Learned/adaptive value: OBD-II P0222 DTC state." UBYTE NO_COMPU_METHOD 0 0 0 255 ECU_ADDRESS 0x40004AE6 /end MEASUREMENT
/begin MEASUREMENT LEA_obd_ii_P0222_fail_counter "Learned/adaptive value: OBD-II P0222 fail counter." UBYTE NO_COMPU_METHOD 0 0 0 255 ECU_ADDRESS 0x40004AE7 /end MEASUREMENT
/begin MEASUREMENT LEA_obd_ii_P0222_pass_counter "Learned/adaptive value: OBD-II P0222 pass counter." UBYTE NO_COMPU_METHOD 0 0 0 255 ECU_ADDRESS 0x40004AE8 /end MEASUREMENT
/begin MEASUREMENT LEA_obd_ii_P0223_dtc_state "Learned/adaptive value: OBD-II P0223 DTC state." UBYTE NO_COMPU_METHOD 0 0 0 255 ECU_ADDRESS 0x40004AE9 /end MEASUREMENT
/begin MEASUREMENT LEA_obd_ii_P0223_fail_counter "Learned/adaptive value: OBD-II P0223 fail counter." UBYTE NO_COMPU_METHOD 0 0 0 255 ECU_ADDRESS 0x40004AEA /end MEASUREMENT
/begin MEASUREMENT LEA_obd_ii_P0223_pass_counter "Learned/adaptive value: OBD-II P0223 pass counter." UBYTE NO_COMPU_METHOD 0 0 0 255 ECU_ADDRESS 0x40004AEB /end MEASUREMENT
/begin MEASUREMENT LEA_obd_ii_P025C_dtc_state "Learned/adaptive value: OBD-II P025C DTC state." UBYTE NO_COMPU_METHOD 0 0 0 255 ECU_ADDRESS 0x40004AEC /end MEASUREMENT
/begin MEASUREMENT LEA_obd_ii_P025C_fail_counter "Learned/adaptive value: OBD-II P025C fail counter." UBYTE NO_COMPU_METHOD 0 0 0 255 ECU_ADDRESS 0x40004AED /end MEASUREMENT
/begin MEASUREMENT LEA_obd_ii_P025C_pass_counter "Learned/adaptive value: OBD-II P025C pass counter." UBYTE NO_COMPU_METHOD 0 0 0 255 ECU_ADDRESS 0x40004AEE /end MEASUREMENT
/begin MEASUREMENT LEA_obd_ii_P025D_dtc_state "Learned/adaptive value: OBD-II P025D DTC state." UBYTE NO_COMPU_METHOD 0 0 0 255 ECU_ADDRESS 0x40004AEF /end MEASUREMENT
/begin MEASUREMENT LEA_obd_ii_P025D_fail_counter "Learned/adaptive value: OBD-II P025D fail counter." UBYTE NO_COMPU_METHOD 0 0 0 255 ECU_ADDRESS 0x40004AF0 /end MEASUREMENT
/begin MEASUREMENT LEA_obd_ii_P025D_pass_counter "Learned/adaptive value: OBD-II P025D pass counter." UBYTE NO_COMPU_METHOD 0 0 0 255 ECU_ADDRESS 0x40004AF1 /end MEASUREMENT
/begin MEASUREMENT LEA_obd_ii_P0261_dtc_state "Learned/adaptive value: OBD-II P0261 DTC state." UBYTE NO_COMPU_METHOD 0 0 0 255 ECU_ADDRESS 0x40004AF2 /end MEASUREMENT
/begin MEASUREMENT LEA_obd_ii_P0261_fail_counter "Learned/adaptive value: OBD-II P0261 fail counter." UBYTE NO_COMPU_METHOD 0 0 0 255 ECU_ADDRESS 0x40004AF3 /end MEASUREMENT
/begin MEASUREMENT LEA_obd_ii_P0261_pass_counter "Learned/adaptive value: OBD-II P0261 pass counter." UBYTE NO_COMPU_METHOD 0 0 0 255 ECU_ADDRESS 0x40004AF4 /end MEASUREMENT
/begin MEASUREMENT LEA_obd_ii_P0262_dtc_state "Learned/adaptive value: OBD-II P0262 DTC state." UBYTE NO_COMPU_METHOD 0 0 0 255 ECU_ADDRESS 0x40004AF5 /end MEASUREMENT
/begin MEASUREMENT LEA_obd_ii_P0262_fail_counter "Learned/adaptive value: OBD-II P0262 fail counter." UBYTE NO_COMPU_METHOD 0 0 0 255 ECU_ADDRESS 0x40004AF6 /end MEASUREMENT
/begin MEASUREMENT LEA_obd_ii_P0262_pass_counter "Learned/adaptive value: OBD-II P0262 pass counter." UBYTE NO_COMPU_METHOD 0 0 0 255 ECU_ADDRESS 0x40004AF7 /end MEASUREMENT
/begin MEASUREMENT LEA_obd_ii_P0264_dtc_state "Learned/adaptive value: OBD-II P0264 DTC state." UBYTE NO_COMPU_METHOD 0 0 0 255 ECU_ADDRESS 0x40004AF8 /end MEASUREMENT
/begin MEASUREMENT LEA_obd_ii_P0264_fail_counter "Learned/adaptive value: OBD-II P0264 fail counter." UBYTE NO_COMPU_METHOD 0 0 0 255 ECU_ADDRESS 0x40004AF9 /end MEASUREMENT
/begin MEASUREMENT LEA_obd_ii_P0264_pass_counter "Learned/adaptive value: OBD-II P0264 pass counter." UBYTE NO_COMPU_METHOD 0 0 0 255 ECU_ADDRESS 0x40004AFA /end MEASUREMENT
/begin MEASUREMENT LEA_obd_ii_P0265_dtc_state "Learned/adaptive value: OBD-II P0265 DTC state." UBYTE NO_COMPU_METHOD 0 0 0 255 ECU_ADDRESS 0x40004AFB /end MEASUREMENT
/begin MEASUREMENT LEA_obd_ii_P0265_fail_counter "Learned/adaptive value: OBD-II P0265 fail counter." UBYTE NO_COMPU_METHOD 0 0 0 255 ECU_ADDRESS 0x40004AFC /end MEASUREMENT
/begin MEASUREMENT LEA_obd_ii_P0265_pass_counter "Learned/adaptive value: OBD-II P0265 pass counter." UBYTE NO_COMPU_METHOD 0 0 0 255 ECU_ADDRESS 0x40004AFD /end MEASUREMENT
/begin MEASUREMENT LEA_obd_ii_P0267_dtc_state "Learned/adaptive value: OBD-II P0267 DTC state." UBYTE NO_COMPU_METHOD 0 0 0 255 ECU_ADDRESS 0x40004AFE /end MEASUREMENT
/begin MEASUREMENT LEA_obd_ii_P0267_fail_counter "Learned/adaptive value: OBD-II P0267 fail counter." UBYTE NO_COMPU_METHOD 0 0 0 255 ECU_ADDRESS 0x40004AFF /end MEASUREMENT
/begin MEASUREMENT LEA_obd_ii_P0267_pass_counter "Learned/adaptive value: OBD-II P0267 pass counter." UBYTE NO_COMPU_METHOD 0 0 0 255 ECU_ADDRESS 0x40004B00 /end MEASUREMENT
/begin MEASUREMENT LEA_obd_ii_P0268_dtc_state "Learned/adaptive value: OBD-II P0268 DTC state." UBYTE NO_COMPU_METHOD 0 0 0 255 ECU_ADDRESS 0x40004B01 /end MEASUREMENT
/begin MEASUREMENT LEA_obd_ii_P0268_fail_counter "Learned/adaptive value: OBD-II P0268 fail counter." UBYTE NO_COMPU_METHOD 0 0 0 255 ECU_ADDRESS 0x40004B02 /end MEASUREMENT
/begin MEASUREMENT LEA_obd_ii_P0268_pass_counter "Learned/adaptive value: OBD-II P0268 pass counter." UBYTE NO_COMPU_METHOD 0 0 0 255 ECU_ADDRESS 0x40004B03 /end MEASUREMENT
/begin MEASUREMENT LEA_obd_ii_P0270_dtc_state "Learned/adaptive value: OBD-II P0270 DTC state." UBYTE NO_COMPU_METHOD 0 0 0 255 ECU_ADDRESS 0x40004B04 /end MEASUREMENT
/begin MEASUREMENT LEA_obd_ii_P0270_fail_counter "Learned/adaptive value: OBD-II P0270 fail counter." UBYTE NO_COMPU_METHOD 0 0 0 255 ECU_ADDRESS 0x40004B05 /end MEASUREMENT
/begin MEASUREMENT LEA_obd_ii_P0270_pass_counter "Learned/adaptive value: OBD-II P0270 pass counter." UBYTE NO_COMPU_METHOD 0 0 0 255 ECU_ADDRESS 0x40004B06 /end MEASUREMENT
/begin MEASUREMENT LEA_obd_ii_P0271_dtc_state "Learned/adaptive value: OBD-II P0271 DTC state." UBYTE NO_COMPU_METHOD 0 0 0 255 ECU_ADDRESS 0x40004B07 /end MEASUREMENT
/begin MEASUREMENT LEA_obd_ii_P0271_fail_counter "Learned/adaptive value: OBD-II P0271 fail counter." UBYTE NO_COMPU_METHOD 0 0 0 255 ECU_ADDRESS 0x40004B08 /end MEASUREMENT
/begin MEASUREMENT LEA_obd_ii_P0271_pass_counter "Learned/adaptive value: OBD-II P0271 pass counter." UBYTE NO_COMPU_METHOD 0 0 0 255 ECU_ADDRESS 0x40004B09 /end MEASUREMENT
/begin MEASUREMENT LEA_obd_ii_P0273_dtc_state "Learned/adaptive value: OBD-II P0273 DTC state." UBYTE NO_COMPU_METHOD 0 0 0 255 ECU_ADDRESS 0x40004B0A /end MEASUREMENT
/begin MEASUREMENT LEA_obd_ii_P0273_fail_counter "Learned/adaptive value: OBD-II P0273 fail counter." UBYTE NO_COMPU_METHOD 0 0 0 255 ECU_ADDRESS 0x40004B0B /end MEASUREMENT
/begin MEASUREMENT LEA_obd_ii_P0273_pass_counter "Learned/adaptive value: OBD-II P0273 pass counter." UBYTE NO_COMPU_METHOD 0 0 0 255 ECU_ADDRESS 0x40004B0C /end MEASUREMENT
/begin MEASUREMENT LEA_obd_ii_P0274_dtc_state "Learned/adaptive value: OBD-II P0274 DTC state." UBYTE NO_COMPU_METHOD 0 0 0 255 ECU_ADDRESS 0x40004B0D /end MEASUREMENT
/begin MEASUREMENT LEA_obd_ii_P0274_fail_counter "Learned/adaptive value: OBD-II P0274 fail counter." UBYTE NO_COMPU_METHOD 0 0 0 255 ECU_ADDRESS 0x40004B0E /end MEASUREMENT
/begin MEASUREMENT LEA_obd_ii_P0274_pass_counter "Learned/adaptive value: OBD-II P0274 pass counter." UBYTE NO_COMPU_METHOD 0 0 0 255 ECU_ADDRESS 0x40004B0F /end MEASUREMENT
/begin MEASUREMENT LEA_obd_ii_P0276_dtc_state "Learned/adaptive value: OBD-II P0276 DTC state." UBYTE NO_COMPU_METHOD 0 0 0 255 ECU_ADDRESS 0x40004B10 /end MEASUREMENT
/begin MEASUREMENT LEA_obd_ii_P0276_fail_counter "Learned/adaptive value: OBD-II P0276 fail counter." UBYTE NO_COMPU_METHOD 0 0 0 255 ECU_ADDRESS 0x40004B11 /end MEASUREMENT
/begin MEASUREMENT LEA_obd_ii_P0276_pass_counter "Learned/adaptive value: OBD-II P0276 pass counter." UBYTE NO_COMPU_METHOD 0 0 0 255 ECU_ADDRESS 0x40004B12 /end MEASUREMENT
/begin MEASUREMENT LEA_obd_ii_P0277_dtc_state "Learned/adaptive value: OBD-II P0277 DTC state." UBYTE NO_COMPU_METHOD 0 0 0 255 ECU_ADDRESS 0x40004B13 /end MEASUREMENT
/begin MEASUREMENT LEA_obd_ii_P0277_fail_counter "Learned/adaptive value: OBD-II P0277 fail counter." UBYTE NO_COMPU_METHOD 0 0 0 255 ECU_ADDRESS 0x40004B14 /end MEASUREMENT
/begin MEASUREMENT LEA_obd_ii_P0277_pass_counter "Learned/adaptive value: OBD-II P0277 pass counter." UBYTE NO_COMPU_METHOD 0 0 0 255 ECU_ADDRESS 0x40004B15 /end MEASUREMENT
/begin MEASUREMENT LEA_obd_ii_unused_slot_40004b16_dtc_state "Spare DTC slot: only cleared, never set by a monitor." UBYTE NO_COMPU_METHOD 0 0 0 255 ECU_ADDRESS 0x40004B16 /end MEASUREMENT
/begin MEASUREMENT LEA_obd_ii_unused_slot_40004b16_fail_counter "Spare DTC slot (reset 3)." UBYTE NO_COMPU_METHOD 0 0 0 255 ECU_ADDRESS 0x40004B17 /end MEASUREMENT
/begin MEASUREMENT LEA_obd_ii_unused_slot_40004b16_pass_counter "Spare DTC slot (reset 40)." UBYTE NO_COMPU_METHOD 0 0 0 255 ECU_ADDRESS 0x40004B18 /end MEASUREMENT
/begin MEASUREMENT LEA_obd_ii_unused_slot_40004b19_dtc_state "Spare DTC slot: only cleared, never set by a monitor." UBYTE NO_COMPU_METHOD 0 0 0 255 ECU_ADDRESS 0x40004B19 /end MEASUREMENT
/begin MEASUREMENT LEA_obd_ii_unused_slot_40004b19_fail_counter "Spare DTC slot (reset 3)." UBYTE NO_COMPU_METHOD 0 0 0 255 ECU_ADDRESS 0x40004B1A /end MEASUREMENT
/begin MEASUREMENT LEA_obd_ii_unused_slot_40004b19_pass_counter "Spare DTC slot (reset 40)." UBYTE NO_COMPU_METHOD 0 0 0 255 ECU_ADDRESS 0x40004B1B /end MEASUREMENT
/begin MEASUREMENT LEA_obd_ii_P023B_dtc_state "Learned/adaptive value: OBD-II P023B DTC state." UBYTE NO_COMPU_METHOD 0 0 0 255 ECU_ADDRESS 0x40004B1C /end MEASUREMENT
/begin MEASUREMENT LEA_obd_ii_P023B_fail_counter "Learned/adaptive value: OBD-II P023B fail counter." UBYTE NO_COMPU_METHOD 0 0 0 255 ECU_ADDRESS 0x40004B1D /end MEASUREMENT
/begin MEASUREMENT LEA_obd_ii_P023B_pass_counter "Learned/adaptive value: OBD-II P023B pass counter." UBYTE NO_COMPU_METHOD 0 0 0 255 ECU_ADDRESS 0x40004B1E /end MEASUREMENT
/begin MEASUREMENT LEA_obd_ii_P023C_dtc_state "Learned/adaptive value: OBD-II P023C DTC state." UBYTE NO_COMPU_METHOD 0 0 0 255 ECU_ADDRESS 0x40004B1F /end MEASUREMENT
/begin MEASUREMENT LEA_obd_ii_P023C_fail_counter "Learned/adaptive value: OBD-II P023C fail counter." UBYTE NO_COMPU_METHOD 0 0 0 255 ECU_ADDRESS 0x40004B20 /end MEASUREMENT
/begin MEASUREMENT LEA_obd_ii_P023C_pass_counter "Learned/adaptive value: OBD-II P023C pass counter." UBYTE NO_COMPU_METHOD 0 0 0 255 ECU_ADDRESS 0x40004B21 /end MEASUREMENT
/begin MEASUREMENT LEA_obd_ii_P0300_dtc_state "Learned/adaptive value: OBD-II P0300 DTC state." UBYTE NO_COMPU_METHOD 0 0 0 255 ECU_ADDRESS 0x40004B22 /end MEASUREMENT
/begin MEASUREMENT LEA_obd_ii_P0300_fail_counter "Learned/adaptive value: OBD-II P0300 fail counter." UBYTE NO_COMPU_METHOD 0 0 0 255 ECU_ADDRESS 0x40004B23 /end MEASUREMENT
/begin MEASUREMENT LEA_obd_ii_P0300_pass_counter "Learned/adaptive value: OBD-II P0300 pass counter." UBYTE NO_COMPU_METHOD 0 0 0 255 ECU_ADDRESS 0x40004B24 /end MEASUREMENT
/begin MEASUREMENT LEA_obd_ii_P0301_dtc_state "Learned/adaptive value: OBD-II P0301 DTC state." UBYTE NO_COMPU_METHOD 0 0 0 255 ECU_ADDRESS 0x40004B25 /end MEASUREMENT
/begin MEASUREMENT LEA_obd_ii_P0301_fail_counter "Learned/adaptive value: OBD-II P0301 fail counter." UBYTE NO_COMPU_METHOD 0 0 0 255 ECU_ADDRESS 0x40004B26 /end MEASUREMENT
/begin MEASUREMENT LEA_obd_ii_P0301_pass_counter "Learned/adaptive value: OBD-II P0301 pass counter." UBYTE NO_COMPU_METHOD 0 0 0 255 ECU_ADDRESS 0x40004B27 /end MEASUREMENT
/begin MEASUREMENT LEA_obd_ii_P0302_dtc_state "Learned/adaptive value: OBD-II P0302 DTC state." UBYTE NO_COMPU_METHOD 0 0 0 255 ECU_ADDRESS 0x40004B28 /end MEASUREMENT
/begin MEASUREMENT LEA_obd_ii_P0302_fail_counter "Learned/adaptive value: OBD-II P0302 fail counter." UBYTE NO_COMPU_METHOD 0 0 0 255 ECU_ADDRESS 0x40004B29 /end MEASUREMENT
/begin MEASUREMENT LEA_obd_ii_P0302_pass_counter "Learned/adaptive value: OBD-II P0302 pass counter." UBYTE NO_COMPU_METHOD 0 0 0 255 ECU_ADDRESS 0x40004B2A /end MEASUREMENT
/begin MEASUREMENT LEA_obd_ii_P0303_dtc_state "Learned/adaptive value: OBD-II P0303 DTC state." UBYTE NO_COMPU_METHOD 0 0 0 255 ECU_ADDRESS 0x40004B2B /end MEASUREMENT
/begin MEASUREMENT LEA_obd_ii_P0303_fail_counter "Learned/adaptive value: OBD-II P0303 fail counter." UBYTE NO_COMPU_METHOD 0 0 0 255 ECU_ADDRESS 0x40004B2C /end MEASUREMENT
/begin MEASUREMENT LEA_obd_ii_P0303_pass_counter "Learned/adaptive value: OBD-II P0303 pass counter." UBYTE NO_COMPU_METHOD 0 0 0 255 ECU_ADDRESS 0x40004B2D /end MEASUREMENT
/begin MEASUREMENT LEA_obd_ii_P0304_dtc_state "Learned/adaptive value: OBD-II P0304 DTC state." UBYTE NO_COMPU_METHOD 0 0 0 255 ECU_ADDRESS 0x40004B2E /end MEASUREMENT
/begin MEASUREMENT LEA_obd_ii_P0304_fail_counter "Learned/adaptive value: OBD-II P0304 fail counter." UBYTE NO_COMPU_METHOD 0 0 0 255 ECU_ADDRESS 0x40004B2F /end MEASUREMENT
/begin MEASUREMENT LEA_obd_ii_P0304_pass_counter "Learned/adaptive value: OBD-II P0304 pass counter." UBYTE NO_COMPU_METHOD 0 0 0 255 ECU_ADDRESS 0x40004B30 /end MEASUREMENT
/begin MEASUREMENT LEA_obd_ii_P0305_dtc_state "Learned/adaptive value: OBD-II P0305 DTC state." UBYTE NO_COMPU_METHOD 0 0 0 255 ECU_ADDRESS 0x40004B31 /end MEASUREMENT
/begin MEASUREMENT LEA_obd_ii_P0305_fail_counter "Learned/adaptive value: OBD-II P0305 fail counter." UBYTE NO_COMPU_METHOD 0 0 0 255 ECU_ADDRESS 0x40004B32 /end MEASUREMENT
/begin MEASUREMENT LEA_obd_ii_P0305_pass_counter "Learned/adaptive value: OBD-II P0305 pass counter." UBYTE NO_COMPU_METHOD 0 0 0 255 ECU_ADDRESS 0x40004B33 /end MEASUREMENT
/begin MEASUREMENT LEA_obd_ii_P0306_dtc_state "Learned/adaptive value: OBD-II P0306 DTC state." UBYTE NO_COMPU_METHOD 0 0 0 255 ECU_ADDRESS 0x40004B34 /end MEASUREMENT
/begin MEASUREMENT LEA_obd_ii_P0306_fail_counter "Learned/adaptive value: OBD-II P0306 fail counter." UBYTE NO_COMPU_METHOD 0 0 0 255 ECU_ADDRESS 0x40004B35 /end MEASUREMENT
/begin MEASUREMENT LEA_obd_ii_P0306_pass_counter "Learned/adaptive value: OBD-II P0306 pass counter." UBYTE NO_COMPU_METHOD 0 0 0 255 ECU_ADDRESS 0x40004B36 /end MEASUREMENT
/begin MEASUREMENT LEA_obd_ii_P0327_dtc_state "Learned/adaptive value: OBD-II P0327 DTC state." UBYTE NO_COMPU_METHOD 0 0 0 255 ECU_ADDRESS 0x40004B37 /end MEASUREMENT
/begin MEASUREMENT LEA_obd_ii_P0327_fail_counter "Learned/adaptive value: OBD-II P0327 fail counter." UBYTE NO_COMPU_METHOD 0 0 0 255 ECU_ADDRESS 0x40004B38 /end MEASUREMENT
/begin MEASUREMENT LEA_obd_ii_P0327_pass_counter "Learned/adaptive value: OBD-II P0327 pass counter." UBYTE NO_COMPU_METHOD 0 0 0 255 ECU_ADDRESS 0x40004B39 /end MEASUREMENT
/begin MEASUREMENT LEA_obd_ii_P0328_dtc_state "Learned/adaptive value: OBD-II P0328 DTC state." UBYTE NO_COMPU_METHOD 0 0 0 255 ECU_ADDRESS 0x40004B3A /end MEASUREMENT
/begin MEASUREMENT LEA_obd_ii_P0328_fail_counter "Learned/adaptive value: OBD-II P0328 fail counter." UBYTE NO_COMPU_METHOD 0 0 0 255 ECU_ADDRESS 0x40004B3B /end MEASUREMENT
/begin MEASUREMENT LEA_obd_ii_P0328_pass_counter "Learned/adaptive value: OBD-II P0328 pass counter." UBYTE NO_COMPU_METHOD 0 0 0 255 ECU_ADDRESS 0x40004B3C /end MEASUREMENT
/begin MEASUREMENT LEA_obd_ii_P0332_dtc_state "Learned/adaptive value: OBD-II P0332 DTC state." UBYTE NO_COMPU_METHOD 0 0 0 255 ECU_ADDRESS 0x40004B3D /end MEASUREMENT
/begin MEASUREMENT LEA_obd_ii_P0332_fail_counter "Learned/adaptive value: OBD-II P0332 fail counter." UBYTE NO_COMPU_METHOD 0 0 0 255 ECU_ADDRESS 0x40004B3E /end MEASUREMENT
/begin MEASUREMENT LEA_obd_ii_P0332_pass_counter "Learned/adaptive value: OBD-II P0332 pass counter." UBYTE NO_COMPU_METHOD 0 0 0 255 ECU_ADDRESS 0x40004B3F /end MEASUREMENT
/begin MEASUREMENT LEA_obd_ii_P0333_dtc_state "Learned/adaptive value: OBD-II P0333 DTC state." UBYTE NO_COMPU_METHOD 0 0 0 255 ECU_ADDRESS 0x40004B40 /end MEASUREMENT
/begin MEASUREMENT LEA_obd_ii_P0333_fail_counter "Learned/adaptive value: OBD-II P0333 fail counter." UBYTE NO_COMPU_METHOD 0 0 0 255 ECU_ADDRESS 0x40004B41 /end MEASUREMENT
/begin MEASUREMENT LEA_obd_ii_P0333_pass_counter "Learned/adaptive value: OBD-II P0333 pass counter." UBYTE NO_COMPU_METHOD 0 0 0 255 ECU_ADDRESS 0x40004B42 /end MEASUREMENT
/begin MEASUREMENT LEA_obd_ii_P0335_dtc_state "Learned/adaptive value: OBD-II P0335 DTC state." UBYTE NO_COMPU_METHOD 0 0 0 255 ECU_ADDRESS 0x40004B43 /end MEASUREMENT
/begin MEASUREMENT LEA_obd_ii_P0335_fail_counter "Learned/adaptive value: OBD-II P0335 fail counter." UBYTE NO_COMPU_METHOD 0 0 0 255 ECU_ADDRESS 0x40004B44 /end MEASUREMENT
/begin MEASUREMENT LEA_obd_ii_P0335_pass_counter "Learned/adaptive value: OBD-II P0335 pass counter." UBYTE NO_COMPU_METHOD 0 0 0 255 ECU_ADDRESS 0x40004B45 /end MEASUREMENT
/begin MEASUREMENT LEA_obd_ii_P0341_dtc_state "Learned/adaptive value: OBD-II P0341 DTC state." UBYTE NO_COMPU_METHOD 0 0 0 255 ECU_ADDRESS 0x40004B46 /end MEASUREMENT
/begin MEASUREMENT LEA_obd_ii_P0341_fail_counter "Learned/adaptive value: OBD-II P0341 fail counter." UBYTE NO_COMPU_METHOD 0 0 0 255 ECU_ADDRESS 0x40004B47 /end MEASUREMENT
/begin MEASUREMENT LEA_obd_ii_P0341_pass_counter "Learned/adaptive value: OBD-II P0341 pass counter." UBYTE NO_COMPU_METHOD 0 0 0 255 ECU_ADDRESS 0x40004B48 /end MEASUREMENT
/begin MEASUREMENT LEA_obd_ii_P0346_dtc_state "Learned/adaptive value: OBD-II P0346 DTC state." UBYTE NO_COMPU_METHOD 0 0 0 255 ECU_ADDRESS 0x40004B49 /end MEASUREMENT
/begin MEASUREMENT LEA_obd_ii_P0346_fail_counter "Learned/adaptive value: OBD-II P0346 fail counter." UBYTE NO_COMPU_METHOD 0 0 0 255 ECU_ADDRESS 0x40004B4A /end MEASUREMENT
/begin MEASUREMENT LEA_obd_ii_P0346_pass_counter "Learned/adaptive value: OBD-II P0346 pass counter." UBYTE NO_COMPU_METHOD 0 0 0 255 ECU_ADDRESS 0x40004B4B /end MEASUREMENT
/begin MEASUREMENT LEA_obd_ii_P0366_dtc_state "Learned/adaptive value: OBD-II P0366 DTC state." UBYTE NO_COMPU_METHOD 0 0 0 255 ECU_ADDRESS 0x40004B4C /end MEASUREMENT
/begin MEASUREMENT LEA_obd_ii_P0366_fail_counter "Learned/adaptive value: OBD-II P0366 fail counter." UBYTE NO_COMPU_METHOD 0 0 0 255 ECU_ADDRESS 0x40004B4D /end MEASUREMENT
/begin MEASUREMENT LEA_obd_ii_P0366_pass_counter "Learned/adaptive value: OBD-II P0366 pass counter." UBYTE NO_COMPU_METHOD 0 0 0 255 ECU_ADDRESS 0x40004B4E /end MEASUREMENT
/begin MEASUREMENT LEA_obd_ii_P0391_dtc_state "Learned/adaptive value: OBD-II P0391 DTC state." UBYTE NO_COMPU_METHOD 0 0 0 255 ECU_ADDRESS 0x40004B4F /end MEASUREMENT
/begin MEASUREMENT LEA_obd_ii_P0391_fail_counter "Learned/adaptive value: OBD-II P0391 fail counter." UBYTE NO_COMPU_METHOD 0 0 0 255 ECU_ADDRESS 0x40004B50 /end MEASUREMENT
/begin MEASUREMENT LEA_obd_ii_P0391_pass_counter "Learned/adaptive value: OBD-II P0391 pass counter." UBYTE NO_COMPU_METHOD 0 0 0 255 ECU_ADDRESS 0x40004B51 /end MEASUREMENT
/begin MEASUREMENT LEA_obd_ii_P0351_dtc_state "Learned/adaptive value: OBD-II P0351 DTC state." UBYTE NO_COMPU_METHOD 0 0 0 255 ECU_ADDRESS 0x40004B52 /end MEASUREMENT
/begin MEASUREMENT LEA_obd_ii_P0351_fail_counter "Learned/adaptive value: OBD-II P0351 fail counter." UBYTE NO_COMPU_METHOD 0 0 0 255 ECU_ADDRESS 0x40004B53 /end MEASUREMENT
/begin MEASUREMENT LEA_obd_ii_P0351_pass_counter "Learned/adaptive value: OBD-II P0351 pass counter." UBYTE NO_COMPU_METHOD 0 0 0 255 ECU_ADDRESS 0x40004B54 /end MEASUREMENT
/begin MEASUREMENT LEA_obd_ii_P0352_dtc_state "Learned/adaptive value: OBD-II P0352 DTC state." UBYTE NO_COMPU_METHOD 0 0 0 255 ECU_ADDRESS 0x40004B55 /end MEASUREMENT
/begin MEASUREMENT LEA_obd_ii_P0352_fail_counter "Learned/adaptive value: OBD-II P0352 fail counter." UBYTE NO_COMPU_METHOD 0 0 0 255 ECU_ADDRESS 0x40004B56 /end MEASUREMENT
/begin MEASUREMENT LEA_obd_ii_P0352_pass_counter "Learned/adaptive value: OBD-II P0352 pass counter." UBYTE NO_COMPU_METHOD 0 0 0 255 ECU_ADDRESS 0x40004B57 /end MEASUREMENT
/begin MEASUREMENT LEA_obd_ii_P0353_dtc_state "Learned/adaptive value: OBD-II P0353 DTC state." UBYTE NO_COMPU_METHOD 0 0 0 255 ECU_ADDRESS 0x40004B58 /end MEASUREMENT
/begin MEASUREMENT LEA_obd_ii_P0353_fail_counter "Learned/adaptive value: OBD-II P0353 fail counter." UBYTE NO_COMPU_METHOD 0 0 0 255 ECU_ADDRESS 0x40004B59 /end MEASUREMENT
/begin MEASUREMENT LEA_obd_ii_P0353_pass_counter "Learned/adaptive value: OBD-II P0353 pass counter." UBYTE NO_COMPU_METHOD 0 0 0 255 ECU_ADDRESS 0x40004B5A /end MEASUREMENT
/begin MEASUREMENT LEA_obd_ii_P0354_dtc_state "Learned/adaptive value: OBD-II P0354 DTC state." UBYTE NO_COMPU_METHOD 0 0 0 255 ECU_ADDRESS 0x40004B5B /end MEASUREMENT
/begin MEASUREMENT LEA_obd_ii_P0354_fail_counter "Learned/adaptive value: OBD-II P0354 fail counter." UBYTE NO_COMPU_METHOD 0 0 0 255 ECU_ADDRESS 0x40004B5C /end MEASUREMENT
/begin MEASUREMENT LEA_obd_ii_P0354_pass_counter "Learned/adaptive value: OBD-II P0354 pass counter." UBYTE NO_COMPU_METHOD 0 0 0 255 ECU_ADDRESS 0x40004B5D /end MEASUREMENT
/begin MEASUREMENT LEA_obd_ii_P0355_dtc_state "Learned/adaptive value: OBD-II P0355 DTC state." UBYTE NO_COMPU_METHOD 0 0 0 255 ECU_ADDRESS 0x40004B5E /end MEASUREMENT
/begin MEASUREMENT LEA_obd_ii_P0355_fail_counter "Learned/adaptive value: OBD-II P0355 fail counter." UBYTE NO_COMPU_METHOD 0 0 0 255 ECU_ADDRESS 0x40004B5F /end MEASUREMENT
/begin MEASUREMENT LEA_obd_ii_P0355_pass_counter "Learned/adaptive value: OBD-II P0355 pass counter." UBYTE NO_COMPU_METHOD 0 0 0 255 ECU_ADDRESS 0x40004B60 /end MEASUREMENT
/begin MEASUREMENT LEA_obd_ii_P0356_dtc_state "Learned/adaptive value: OBD-II P0356 DTC state." UBYTE NO_COMPU_METHOD 0 0 0 255 ECU_ADDRESS 0x40004B61 /end MEASUREMENT
/begin MEASUREMENT LEA_obd_ii_P0356_fail_counter "Learned/adaptive value: OBD-II P0356 fail counter." UBYTE NO_COMPU_METHOD 0 0 0 255 ECU_ADDRESS 0x40004B62 /end MEASUREMENT
/begin MEASUREMENT LEA_obd_ii_P0356_pass_counter "Learned/adaptive value: OBD-II P0356 pass counter." UBYTE NO_COMPU_METHOD 0 0 0 255 ECU_ADDRESS 0x40004B63 /end MEASUREMENT
/begin MEASUREMENT LEA_obd_ii_P1301_dtc_state "Learned/adaptive value: OBD-II P1301 DTC state." UBYTE NO_COMPU_METHOD 0 0 0 255 ECU_ADDRESS 0x40004B64 /end MEASUREMENT
/begin MEASUREMENT LEA_obd_ii_P1301_fail_counter "Learned/adaptive value: OBD-II P1301 fail counter." UBYTE NO_COMPU_METHOD 0 0 0 255 ECU_ADDRESS 0x40004B65 /end MEASUREMENT
/begin MEASUREMENT LEA_obd_ii_P1301_pass_counter "Learned/adaptive value: OBD-II P1301 pass counter." UBYTE NO_COMPU_METHOD 0 0 0 255 ECU_ADDRESS 0x40004B66 /end MEASUREMENT
/begin MEASUREMENT LEA_obd_ii_P1302_dtc_state "Learned/adaptive value: OBD-II P1302 DTC state." UBYTE NO_COMPU_METHOD 0 0 0 255 ECU_ADDRESS 0x40004B67 /end MEASUREMENT
/begin MEASUREMENT LEA_obd_ii_P1302_fail_counter "Learned/adaptive value: OBD-II P1302 fail counter." UBYTE NO_COMPU_METHOD 0 0 0 255 ECU_ADDRESS 0x40004B68 /end MEASUREMENT
/begin MEASUREMENT LEA_obd_ii_P1302_pass_counter "Learned/adaptive value: OBD-II P1302 pass counter." UBYTE NO_COMPU_METHOD 0 0 0 255 ECU_ADDRESS 0x40004B69 /end MEASUREMENT
/begin MEASUREMENT LEA_obd_ii_P0420_dtc_state "Learned/adaptive value: OBD-II P0420 DTC state." UBYTE NO_COMPU_METHOD 0 0 0 255 ECU_ADDRESS 0x40004B6A /end MEASUREMENT
/begin MEASUREMENT LEA_obd_ii_P0420_fail_counter "Learned/adaptive value: OBD-II P0420 fail counter." UBYTE NO_COMPU_METHOD 0 0 0 255 ECU_ADDRESS 0x40004B6B /end MEASUREMENT
/begin MEASUREMENT LEA_obd_ii_P0420_pass_counter "Learned/adaptive value: OBD-II P0420 pass counter." UBYTE NO_COMPU_METHOD 0 0 0 255 ECU_ADDRESS 0x40004B6C /end MEASUREMENT
/begin MEASUREMENT LEA_obd_ii_P0430_dtc_state "Learned/adaptive value: OBD-II P0430 DTC state." UBYTE NO_COMPU_METHOD 0 0 0 255 ECU_ADDRESS 0x40004B6D /end MEASUREMENT
/begin MEASUREMENT LEA_obd_ii_P0430_fail_counter "Learned/adaptive value: OBD-II P0430 fail counter." UBYTE NO_COMPU_METHOD 0 0 0 255 ECU_ADDRESS 0x40004B6E /end MEASUREMENT
/begin MEASUREMENT LEA_obd_ii_P0430_pass_counter "Learned/adaptive value: OBD-II P0430 pass counter." UBYTE NO_COMPU_METHOD 0 0 0 255 ECU_ADDRESS 0x40004B6F /end MEASUREMENT
/begin MEASUREMENT LEA_obd_ii_P0441_dtc_state "Learned/adaptive value: OBD-II P0441 DTC state." UBYTE NO_COMPU_METHOD 0 0 0 255 ECU_ADDRESS 0x40004B70 /end MEASUREMENT
/begin MEASUREMENT LEA_obd_ii_P0441_fail_counter "Learned/adaptive value: OBD-II P0441 fail counter." UBYTE NO_COMPU_METHOD 0 0 0 255 ECU_ADDRESS 0x40004B71 /end MEASUREMENT
/begin MEASUREMENT LEA_obd_ii_P0441_pass_counter "Learned/adaptive value: OBD-II P0441 pass counter." UBYTE NO_COMPU_METHOD 0 0 0 255 ECU_ADDRESS 0x40004B72 /end MEASUREMENT
/begin MEASUREMENT LEA_obd_ii_P0442_dtc_state "Learned/adaptive value: OBD-II P0442 DTC state." UBYTE NO_COMPU_METHOD 0 0 0 255 ECU_ADDRESS 0x40004B73 /end MEASUREMENT
/begin MEASUREMENT LEA_obd_ii_P0442_fail_counter "Learned/adaptive value: OBD-II P0442 fail counter." UBYTE NO_COMPU_METHOD 0 0 0 255 ECU_ADDRESS 0x40004B74 /end MEASUREMENT
/begin MEASUREMENT LEA_obd_ii_P0442_pass_counter "Learned/adaptive value: OBD-II P0442 pass counter." UBYTE NO_COMPU_METHOD 0 0 0 255 ECU_ADDRESS 0x40004B75 /end MEASUREMENT
/begin MEASUREMENT LEA_obd_ii_P0444_dtc_state "Learned/adaptive value: OBD-II P0444 DTC state." UBYTE NO_COMPU_METHOD 0 0 0 255 ECU_ADDRESS 0x40004B76 /end MEASUREMENT
/begin MEASUREMENT LEA_obd_ii_P0444_fail_counter "Learned/adaptive value: OBD-II P0444 fail counter." UBYTE NO_COMPU_METHOD 0 0 0 255 ECU_ADDRESS 0x40004B77 /end MEASUREMENT
/begin MEASUREMENT LEA_obd_ii_P0444_pass_counter "Learned/adaptive value: OBD-II P0444 pass counter." UBYTE NO_COMPU_METHOD 0 0 0 255 ECU_ADDRESS 0x40004B78 /end MEASUREMENT
/begin MEASUREMENT LEA_obd_ii_P0445_dtc_state "Learned/adaptive value: OBD-II P0445 DTC state." UBYTE NO_COMPU_METHOD 0 0 0 255 ECU_ADDRESS 0x40004B79 /end MEASUREMENT
/begin MEASUREMENT LEA_obd_ii_P0445_fail_counter "Learned/adaptive value: OBD-II P0445 fail counter." UBYTE NO_COMPU_METHOD 0 0 0 255 ECU_ADDRESS 0x40004B7A /end MEASUREMENT
/begin MEASUREMENT LEA_obd_ii_P0445_pass_counter "Learned/adaptive value: OBD-II P0445 pass counter." UBYTE NO_COMPU_METHOD 0 0 0 255 ECU_ADDRESS 0x40004B7B /end MEASUREMENT
/begin MEASUREMENT LEA_obd_ii_P0446_dtc_state "Learned/adaptive value: OBD-II P0446 DTC state." UBYTE NO_COMPU_METHOD 0 0 0 255 ECU_ADDRESS 0x40004B7C /end MEASUREMENT
/begin MEASUREMENT LEA_obd_ii_P0446_fail_counter "Learned/adaptive value: OBD-II P0446 fail counter." UBYTE NO_COMPU_METHOD 0 0 0 255 ECU_ADDRESS 0x40004B7D /end MEASUREMENT
/begin MEASUREMENT LEA_obd_ii_P0446_pass_counter "Learned/adaptive value: OBD-II P0446 pass counter." UBYTE NO_COMPU_METHOD 0 0 0 255 ECU_ADDRESS 0x40004B7E /end MEASUREMENT
/begin MEASUREMENT LEA_obd_ii_P0447_dtc_state "Learned/adaptive value: OBD-II P0447 DTC state." UBYTE NO_COMPU_METHOD 0 0 0 255 ECU_ADDRESS 0x40004B7F /end MEASUREMENT
/begin MEASUREMENT LEA_obd_ii_P0447_fail_counter "Learned/adaptive value: OBD-II P0447 fail counter." UBYTE NO_COMPU_METHOD 0 0 0 255 ECU_ADDRESS 0x40004B80 /end MEASUREMENT
/begin MEASUREMENT LEA_obd_ii_P0447_pass_counter "Learned/adaptive value: OBD-II P0447 pass counter." UBYTE NO_COMPU_METHOD 0 0 0 255 ECU_ADDRESS 0x40004B81 /end MEASUREMENT
/begin MEASUREMENT LEA_obd_ii_P0448_dtc_state "Learned/adaptive value: OBD-II P0448 DTC state." UBYTE NO_COMPU_METHOD 0 0 0 255 ECU_ADDRESS 0x40004B82 /end MEASUREMENT
/begin MEASUREMENT LEA_obd_ii_P0448_fail_counter "Learned/adaptive value: OBD-II P0448 fail counter." UBYTE NO_COMPU_METHOD 0 0 0 255 ECU_ADDRESS 0x40004B83 /end MEASUREMENT
/begin MEASUREMENT LEA_obd_ii_P0448_pass_counter "Learned/adaptive value: OBD-II P0448 pass counter." UBYTE NO_COMPU_METHOD 0 0 0 255 ECU_ADDRESS 0x40004B84 /end MEASUREMENT
/begin MEASUREMENT LEA_obd_ii_P0451_dtc_state "Learned/adaptive value: OBD-II P0451 DTC state." UBYTE NO_COMPU_METHOD 0 0 0 255 ECU_ADDRESS 0x40004B85 /end MEASUREMENT
/begin MEASUREMENT LEA_obd_ii_P0451_fail_counter "Learned/adaptive value: OBD-II P0451 fail counter." UBYTE NO_COMPU_METHOD 0 0 0 255 ECU_ADDRESS 0x40004B86 /end MEASUREMENT
/begin MEASUREMENT LEA_obd_ii_P0451_pass_counter "Learned/adaptive value: OBD-II P0451 pass counter." UBYTE NO_COMPU_METHOD 0 0 0 255 ECU_ADDRESS 0x40004B87 /end MEASUREMENT
/begin MEASUREMENT LEA_obd_ii_P0452_dtc_state "Learned/adaptive value: OBD-II P0452 DTC state." UBYTE NO_COMPU_METHOD 0 0 0 255 ECU_ADDRESS 0x40004B88 /end MEASUREMENT
/begin MEASUREMENT LEA_obd_ii_P0452_fail_counter "Learned/adaptive value: OBD-II P0452 fail counter." UBYTE NO_COMPU_METHOD 0 0 0 255 ECU_ADDRESS 0x40004B89 /end MEASUREMENT
/begin MEASUREMENT LEA_obd_ii_P0452_pass_counter "Learned/adaptive value: OBD-II P0452 pass counter." UBYTE NO_COMPU_METHOD 0 0 0 255 ECU_ADDRESS 0x40004B8A /end MEASUREMENT
/begin MEASUREMENT LEA_obd_ii_P0453_dtc_state "Learned/adaptive value: OBD-II P0453 DTC state." UBYTE NO_COMPU_METHOD 0 0 0 255 ECU_ADDRESS 0x40004B8B /end MEASUREMENT
/begin MEASUREMENT LEA_obd_ii_P0453_fail_counter "Learned/adaptive value: OBD-II P0453 fail counter." UBYTE NO_COMPU_METHOD 0 0 0 255 ECU_ADDRESS 0x40004B8C /end MEASUREMENT
/begin MEASUREMENT LEA_obd_ii_P0453_pass_counter "Learned/adaptive value: OBD-II P0453 pass counter." UBYTE NO_COMPU_METHOD 0 0 0 255 ECU_ADDRESS 0x40004B8D /end MEASUREMENT
/begin MEASUREMENT LEA_obd_ii_P0455_dtc_state "Learned/adaptive value: OBD-II P0455 DTC state." UBYTE NO_COMPU_METHOD 0 0 0 255 ECU_ADDRESS 0x40004B8E /end MEASUREMENT
/begin MEASUREMENT LEA_obd_ii_P0455_fail_counter "Learned/adaptive value: OBD-II P0455 fail counter." UBYTE NO_COMPU_METHOD 0 0 0 255 ECU_ADDRESS 0x40004B8F /end MEASUREMENT
/begin MEASUREMENT LEA_obd_ii_P0455_pass_counter "Learned/adaptive value: OBD-II P0455 pass counter." UBYTE NO_COMPU_METHOD 0 0 0 255 ECU_ADDRESS 0x40004B90 /end MEASUREMENT
/begin MEASUREMENT LEA_obd_ii_P0456_dtc_state "Learned/adaptive value: OBD-II P0456 DTC state." UBYTE NO_COMPU_METHOD 0 0 0 255 ECU_ADDRESS 0x40004B91 /end MEASUREMENT
/begin MEASUREMENT LEA_obd_ii_P0456_fail_counter "Learned/adaptive value: OBD-II P0456 fail counter." UBYTE NO_COMPU_METHOD 0 0 0 255 ECU_ADDRESS 0x40004B92 /end MEASUREMENT
/begin MEASUREMENT LEA_obd_ii_P0456_pass_counter "Learned/adaptive value: OBD-II P0456 pass counter." UBYTE NO_COMPU_METHOD 0 0 0 255 ECU_ADDRESS 0x40004B93 /end MEASUREMENT
/begin MEASUREMENT LEA_obd_ii_P0461_dtc_state "Learned/adaptive value: OBD-II P0461 DTC state." UBYTE NO_COMPU_METHOD 0 0 0 255 ECU_ADDRESS 0x40004B94 /end MEASUREMENT
/begin MEASUREMENT LEA_obd_ii_P0461_fail_counter "Learned/adaptive value: OBD-II P0461 fail counter." UBYTE NO_COMPU_METHOD 0 0 0 255 ECU_ADDRESS 0x40004B95 /end MEASUREMENT
/begin MEASUREMENT LEA_obd_ii_P0461_pass_counter "Learned/adaptive value: OBD-II P0461 pass counter." UBYTE NO_COMPU_METHOD 0 0 0 255 ECU_ADDRESS 0x40004B96 /end MEASUREMENT
/begin MEASUREMENT LEA_obd_ii_P0462_dtc_state "Learned/adaptive value: OBD-II P0462 DTC state." UBYTE NO_COMPU_METHOD 0 0 0 255 ECU_ADDRESS 0x40004B97 /end MEASUREMENT
/begin MEASUREMENT LEA_obd_ii_P0462_fail_counter "Learned/adaptive value: OBD-II P0462 fail counter." UBYTE NO_COMPU_METHOD 0 0 0 255 ECU_ADDRESS 0x40004B98 /end MEASUREMENT
/begin MEASUREMENT LEA_obd_ii_P0462_pass_counter "Learned/adaptive value: OBD-II P0462 pass counter." UBYTE NO_COMPU_METHOD 0 0 0 255 ECU_ADDRESS 0x40004B99 /end MEASUREMENT
/begin MEASUREMENT LEA_obd_ii_P0463_dtc_state "Learned/adaptive value: OBD-II P0463 DTC state." UBYTE NO_COMPU_METHOD 0 0 0 255 ECU_ADDRESS 0x40004B9A /end MEASUREMENT
/begin MEASUREMENT LEA_obd_ii_P0463_fail_counter "Learned/adaptive value: OBD-II P0463 fail counter." UBYTE NO_COMPU_METHOD 0 0 0 255 ECU_ADDRESS 0x40004B9B /end MEASUREMENT
/begin MEASUREMENT LEA_obd_ii_P0463_pass_counter "Learned/adaptive value: OBD-II P0463 pass counter." UBYTE NO_COMPU_METHOD 0 0 0 255 ECU_ADDRESS 0x40004B9C /end MEASUREMENT
/begin MEASUREMENT LEA_obd_ii_P0480_dtc_state "Learned/adaptive value: OBD-II P0480 DTC state." UBYTE NO_COMPU_METHOD 0 0 0 255 ECU_ADDRESS 0x40004B9D /end MEASUREMENT
/begin MEASUREMENT LEA_obd_ii_P0480_fail_counter "Learned/adaptive value: OBD-II P0480 fail counter." UBYTE NO_COMPU_METHOD 0 0 0 255 ECU_ADDRESS 0x40004B9E /end MEASUREMENT
/begin MEASUREMENT LEA_obd_ii_P0480_pass_counter "Learned/adaptive value: OBD-II P0480 pass counter." UBYTE NO_COMPU_METHOD 0 0 0 255 ECU_ADDRESS 0x40004B9F /end MEASUREMENT
/begin MEASUREMENT LEA_obd_ii_P0482_dtc_state "Learned/adaptive value: OBD-II P0482 DTC state." UBYTE NO_COMPU_METHOD 0 0 0 255 ECU_ADDRESS 0x40004BA0 /end MEASUREMENT
/begin MEASUREMENT LEA_obd_ii_P0482_fail_counter "Learned/adaptive value: OBD-II P0482 fail counter." UBYTE NO_COMPU_METHOD 0 0 0 255 ECU_ADDRESS 0x40004BA1 /end MEASUREMENT
/begin MEASUREMENT LEA_obd_ii_P0482_pass_counter "Learned/adaptive value: OBD-II P0482 pass counter." UBYTE NO_COMPU_METHOD 0 0 0 255 ECU_ADDRESS 0x40004BA2 /end MEASUREMENT
/begin MEASUREMENT LEA_obd_ii_P0500_dtc_state "Learned/adaptive value: OBD-II P0500 DTC state." UBYTE NO_COMPU_METHOD 0 0 0 255 ECU_ADDRESS 0x40004BA3 /end MEASUREMENT
/begin MEASUREMENT LEA_obd_ii_P0500_fail_counter "Learned/adaptive value: OBD-II P0500 fail counter." UBYTE NO_COMPU_METHOD 0 0 0 255 ECU_ADDRESS 0x40004BA4 /end MEASUREMENT
/begin MEASUREMENT LEA_obd_ii_P0500_pass_counter "Learned/adaptive value: OBD-II P0500 pass counter." UBYTE NO_COMPU_METHOD 0 0 0 255 ECU_ADDRESS 0x40004BA5 /end MEASUREMENT
/begin MEASUREMENT LEA_obd_ii_P0506_dtc_state "Learned/adaptive value: OBD-II P0506 DTC state." UBYTE NO_COMPU_METHOD 0 0 0 255 ECU_ADDRESS 0x40004BA6 /end MEASUREMENT
/begin MEASUREMENT LEA_obd_ii_P0506_fail_counter "Learned/adaptive value: OBD-II P0506 fail counter." UBYTE NO_COMPU_METHOD 0 0 0 255 ECU_ADDRESS 0x40004BA7 /end MEASUREMENT
/begin MEASUREMENT LEA_obd_ii_P0506_pass_counter "Learned/adaptive value: OBD-II P0506 pass counter." UBYTE NO_COMPU_METHOD 0 0 0 255 ECU_ADDRESS 0x40004BA8 /end MEASUREMENT
/begin MEASUREMENT LEA_obd_ii_P0507_dtc_state "Learned/adaptive value: OBD-II P0507 DTC state." UBYTE NO_COMPU_METHOD 0 0 0 255 ECU_ADDRESS 0x40004BA9 /end MEASUREMENT
/begin MEASUREMENT LEA_obd_ii_P0507_fail_counter "Learned/adaptive value: OBD-II P0507 fail counter." UBYTE NO_COMPU_METHOD 0 0 0 255 ECU_ADDRESS 0x40004BAA /end MEASUREMENT
/begin MEASUREMENT LEA_obd_ii_P0507_pass_counter "Learned/adaptive value: OBD-II P0507 pass counter." UBYTE NO_COMPU_METHOD 0 0 0 255 ECU_ADDRESS 0x40004BAB /end MEASUREMENT
/begin MEASUREMENT LEA_obd_ii_P050A_dtc_state "Learned/adaptive value: OBD-II P050A DTC state." UBYTE NO_COMPU_METHOD 0 0 0 255 ECU_ADDRESS 0x40004BAC /end MEASUREMENT
/begin MEASUREMENT LEA_obd_ii_P050A_fail_counter "Learned/adaptive value: OBD-II P050A fail counter." UBYTE NO_COMPU_METHOD 0 0 0 255 ECU_ADDRESS 0x40004BAD /end MEASUREMENT
/begin MEASUREMENT LEA_obd_ii_P050A_pass_counter "Learned/adaptive value: OBD-II P050A pass counter." UBYTE NO_COMPU_METHOD 0 0 0 255 ECU_ADDRESS 0x40004BAE /end MEASUREMENT
/begin MEASUREMENT LEA_obd_ii_P050B_dtc_state "Learned/adaptive value: OBD-II P050B DTC state." UBYTE NO_COMPU_METHOD 0 0 0 255 ECU_ADDRESS 0x40004BAF /end MEASUREMENT
/begin MEASUREMENT LEA_obd_ii_P050B_fail_counter "Learned/adaptive value: OBD-II P050B fail counter." UBYTE NO_COMPU_METHOD 0 0 0 255 ECU_ADDRESS 0x40004BB0 /end MEASUREMENT
/begin MEASUREMENT LEA_obd_ii_P050B_pass_counter "Learned/adaptive value: OBD-II P050B pass counter." UBYTE NO_COMPU_METHOD 0 0 0 255 ECU_ADDRESS 0x40004BB1 /end MEASUREMENT
/begin MEASUREMENT LEA_obd_ii_P0522_dtc_state "Learned/adaptive value: OBD-II P0522 DTC state." UBYTE NO_COMPU_METHOD 0 0 0 255 ECU_ADDRESS 0x40004BB2 /end MEASUREMENT
/begin MEASUREMENT LEA_obd_ii_P0522_fail_counter "Learned/adaptive value: OBD-II P0522 fail counter." UBYTE NO_COMPU_METHOD 0 0 0 255 ECU_ADDRESS 0x40004BB3 /end MEASUREMENT
/begin MEASUREMENT LEA_obd_ii_P0522_pass_counter "Learned/adaptive value: OBD-II P0522 pass counter." UBYTE NO_COMPU_METHOD 0 0 0 255 ECU_ADDRESS 0x40004BB4 /end MEASUREMENT
/begin MEASUREMENT LEA_obd_ii_P0523_dtc_state "Learned/adaptive value: OBD-II P0523 DTC state." UBYTE NO_COMPU_METHOD 0 0 0 255 ECU_ADDRESS 0x40004BB5 /end MEASUREMENT
/begin MEASUREMENT LEA_obd_ii_P0523_fail_counter "Learned/adaptive value: OBD-II P0523 fail counter." UBYTE NO_COMPU_METHOD 0 0 0 255 ECU_ADDRESS 0x40004BB6 /end MEASUREMENT
/begin MEASUREMENT LEA_obd_ii_P0523_pass_counter "Learned/adaptive value: OBD-II P0523 pass counter." UBYTE NO_COMPU_METHOD 0 0 0 255 ECU_ADDRESS 0x40004BB7 /end MEASUREMENT
/begin MEASUREMENT LEA_obd_ii_P0524_dtc_state "Learned/adaptive value: OBD-II P0524 DTC state." UBYTE NO_COMPU_METHOD 0 0 0 255 ECU_ADDRESS 0x40004BB8 /end MEASUREMENT
/begin MEASUREMENT LEA_obd_ii_P0524_fail_counter "Learned/adaptive value: OBD-II P0524 fail counter." UBYTE NO_COMPU_METHOD 0 0 0 255 ECU_ADDRESS 0x40004BB9 /end MEASUREMENT
/begin MEASUREMENT LEA_obd_ii_P0524_pass_counter "Learned/adaptive value: OBD-II P0524 pass counter." UBYTE NO_COMPU_METHOD 0 0 0 255 ECU_ADDRESS 0x40004BBA /end MEASUREMENT
/begin MEASUREMENT LEA_obd_ii_P0537_dtc_state "Learned/adaptive value: OBD-II P0537 DTC state." UBYTE NO_COMPU_METHOD 0 0 0 255 ECU_ADDRESS 0x40004BBB /end MEASUREMENT
/begin MEASUREMENT LEA_obd_ii_P0537_fail_counter "Learned/adaptive value: OBD-II P0537 fail counter." UBYTE NO_COMPU_METHOD 0 0 0 255 ECU_ADDRESS 0x40004BBC /end MEASUREMENT
/begin MEASUREMENT LEA_obd_ii_P0537_pass_counter "Learned/adaptive value: OBD-II P0537 pass counter." UBYTE NO_COMPU_METHOD 0 0 0 255 ECU_ADDRESS 0x40004BBD /end MEASUREMENT
/begin MEASUREMENT LEA_obd_ii_P0538_dtc_state "Learned/adaptive value: OBD-II P0538 DTC state." UBYTE NO_COMPU_METHOD 0 0 0 255 ECU_ADDRESS 0x40004BBE /end MEASUREMENT
/begin MEASUREMENT LEA_obd_ii_P0538_fail_counter "Learned/adaptive value: OBD-II P0538 fail counter." UBYTE NO_COMPU_METHOD 0 0 0 255 ECU_ADDRESS 0x40004BBF /end MEASUREMENT
/begin MEASUREMENT LEA_obd_ii_P0538_pass_counter "Learned/adaptive value: OBD-II P0538 pass counter." UBYTE NO_COMPU_METHOD 0 0 0 255 ECU_ADDRESS 0x40004BC0 /end MEASUREMENT
/begin MEASUREMENT LEA_obd_ii_P0562_dtc_state "Learned/adaptive value: OBD-II P0562 DTC state." UBYTE NO_COMPU_METHOD 0 0 0 255 ECU_ADDRESS 0x40004BC1 /end MEASUREMENT
/begin MEASUREMENT LEA_obd_ii_P0562_fail_counter "Learned/adaptive value: OBD-II P0562 fail counter." UBYTE NO_COMPU_METHOD 0 0 0 255 ECU_ADDRESS 0x40004BC2 /end MEASUREMENT
/begin MEASUREMENT LEA_obd_ii_P0562_pass_counter "Learned/adaptive value: OBD-II P0562 pass counter." UBYTE NO_COMPU_METHOD 0 0 0 255 ECU_ADDRESS 0x40004BC3 /end MEASUREMENT
/begin MEASUREMENT LEA_obd_ii_P0563_dtc_state "Learned/adaptive value: OBD-II P0563 DTC state." UBYTE NO_COMPU_METHOD 0 0 0 255 ECU_ADDRESS 0x40004BC4 /end MEASUREMENT
/begin MEASUREMENT LEA_obd_ii_P0563_fail_counter "Learned/adaptive value: OBD-II P0563 fail counter." UBYTE NO_COMPU_METHOD 0 0 0 255 ECU_ADDRESS 0x40004BC5 /end MEASUREMENT
/begin MEASUREMENT LEA_obd_ii_P0563_pass_counter "Learned/adaptive value: OBD-II P0563 pass counter." UBYTE NO_COMPU_METHOD 0 0 0 255 ECU_ADDRESS 0x40004BC6 /end MEASUREMENT
/begin MEASUREMENT LEA_obd_ii_P0571_dtc_state "Learned/adaptive value: OBD-II P0571 DTC state." UBYTE NO_COMPU_METHOD 0 0 0 255 ECU_ADDRESS 0x40004BC7 /end MEASUREMENT
/begin MEASUREMENT LEA_obd_ii_P0571_fail_counter "Learned/adaptive value: OBD-II P0571 fail counter." UBYTE NO_COMPU_METHOD 0 0 0 255 ECU_ADDRESS 0x40004BC8 /end MEASUREMENT
/begin MEASUREMENT LEA_obd_ii_P0571_pass_counter "Learned/adaptive value: OBD-II P0571 pass counter." UBYTE NO_COMPU_METHOD 0 0 0 255 ECU_ADDRESS 0x40004BC9 /end MEASUREMENT
/begin MEASUREMENT LEA_obd_ii_P0578_dtc_state "Learned/adaptive value: OBD-II P0578 DTC state." UBYTE NO_COMPU_METHOD 0 0 0 255 ECU_ADDRESS 0x40004BCA /end MEASUREMENT
/begin MEASUREMENT LEA_obd_ii_P0578_fail_counter "Learned/adaptive value: OBD-II P0578 fail counter." UBYTE NO_COMPU_METHOD 0 0 0 255 ECU_ADDRESS 0x40004BCB /end MEASUREMENT
/begin MEASUREMENT LEA_obd_ii_P0578_pass_counter "Learned/adaptive value: OBD-II P0578 pass counter." UBYTE NO_COMPU_METHOD 0 0 0 255 ECU_ADDRESS 0x40004BCC /end MEASUREMENT
/begin MEASUREMENT LEA_obd_ii_P0579_dtc_state "Learned/adaptive value: OBD-II P0579 DTC state." UBYTE NO_COMPU_METHOD 0 0 0 255 ECU_ADDRESS 0x40004BCD /end MEASUREMENT
/begin MEASUREMENT LEA_obd_ii_P0579_fail_counter "Learned/adaptive value: OBD-II P0579 fail counter." UBYTE NO_COMPU_METHOD 0 0 0 255 ECU_ADDRESS 0x40004BCE /end MEASUREMENT
/begin MEASUREMENT LEA_obd_ii_P0579_pass_counter "Learned/adaptive value: OBD-II P0579 pass counter." UBYTE NO_COMPU_METHOD 0 0 0 255 ECU_ADDRESS 0x40004BCF /end MEASUREMENT
/begin MEASUREMENT LEA_obd_ii_P0564_dtc_state "Learned/adaptive value: OBD-II P0564 DTC state." UBYTE NO_COMPU_METHOD 0 0 0 255 ECU_ADDRESS 0x40004BD0 /end MEASUREMENT
/begin MEASUREMENT LEA_obd_ii_P0564_fail_counter "Learned/adaptive value: OBD-II P0564 fail counter." UBYTE NO_COMPU_METHOD 0 0 0 255 ECU_ADDRESS 0x40004BD1 /end MEASUREMENT
/begin MEASUREMENT LEA_obd_ii_P0564_pass_counter "Learned/adaptive value: OBD-II P0564 pass counter." UBYTE NO_COMPU_METHOD 0 0 0 255 ECU_ADDRESS 0x40004BD2 /end MEASUREMENT
/begin MEASUREMENT LEA_obd_ii_P0601_dtc_state "Learned/adaptive value: OBD-II P0601 DTC state." UBYTE NO_COMPU_METHOD 0 0 0 255 ECU_ADDRESS 0x40004BD3 /end MEASUREMENT
/begin MEASUREMENT LEA_obd_ii_P0601_fail_counter "Learned/adaptive value: OBD-II P0601 fail counter." UBYTE NO_COMPU_METHOD 0 0 0 255 ECU_ADDRESS 0x40004BD4 /end MEASUREMENT
/begin MEASUREMENT LEA_obd_ii_P0601_pass_counter "Learned/adaptive value: OBD-II P0601 pass counter." UBYTE NO_COMPU_METHOD 0 0 0 255 ECU_ADDRESS 0x40004BD5 /end MEASUREMENT
/begin MEASUREMENT LEA_obd_ii_P0606_dtc_state "Learned/adaptive value: OBD-II P0606 DTC state." UBYTE NO_COMPU_METHOD 0 0 0 255 ECU_ADDRESS 0x40004BD6 /end MEASUREMENT
/begin MEASUREMENT LEA_obd_ii_P0606_fail_counter "Learned/adaptive value: OBD-II P0606 fail counter." UBYTE NO_COMPU_METHOD 0 0 0 255 ECU_ADDRESS 0x40004BD7 /end MEASUREMENT
/begin MEASUREMENT LEA_obd_ii_P0606_pass_counter "Learned/adaptive value: OBD-II P0606 pass counter." UBYTE NO_COMPU_METHOD 0 0 0 255 ECU_ADDRESS 0x40004BD8 /end MEASUREMENT
/begin MEASUREMENT LEA_obd_ii_P0610_dtc_state "Learned/adaptive value: OBD-II P0610 DTC state." UBYTE NO_COMPU_METHOD 0 0 0 255 ECU_ADDRESS 0x40004BD9 /end MEASUREMENT
/begin MEASUREMENT LEA_obd_ii_P0610_fail_counter "Learned/adaptive value: OBD-II P0610 fail counter." UBYTE NO_COMPU_METHOD 0 0 0 255 ECU_ADDRESS 0x40004BDA /end MEASUREMENT
/begin MEASUREMENT LEA_obd_ii_P0610_pass_counter "Learned/adaptive value: OBD-II P0610 pass counter." UBYTE NO_COMPU_METHOD 0 0 0 255 ECU_ADDRESS 0x40004BDB /end MEASUREMENT
/begin MEASUREMENT LEA_obd_ii_U0141_dtc_state "Learned/adaptive value: OBD-II U0141 DTC state." UBYTE NO_COMPU_METHOD 0 0 0 255 ECU_ADDRESS 0x40004BDC /end MEASUREMENT
/begin MEASUREMENT LEA_obd_ii_U0141_fail_counter "Learned/adaptive value: OBD-II U0141 fail counter." UBYTE NO_COMPU_METHOD 0 0 0 255 ECU_ADDRESS 0x40004BDD /end MEASUREMENT
/begin MEASUREMENT LEA_obd_ii_U0141_pass_counter "Learned/adaptive value: OBD-II U0141 pass counter." UBYTE NO_COMPU_METHOD 0 0 0 255 ECU_ADDRESS 0x40004BDE /end MEASUREMENT
/begin MEASUREMENT LEA_obd_ii_P0627_dtc_state "Learned/adaptive value: OBD-II P0627 DTC state." UBYTE NO_COMPU_METHOD 0 0 0 255 ECU_ADDRESS 0x40004BDF /end MEASUREMENT
/begin MEASUREMENT LEA_obd_ii_P0627_fail_counter "Learned/adaptive value: OBD-II P0627 fail counter." UBYTE NO_COMPU_METHOD 0 0 0 255 ECU_ADDRESS 0x40004BE0 /end MEASUREMENT
/begin MEASUREMENT LEA_obd_ii_P0627_pass_counter "Learned/adaptive value: OBD-II P0627 pass counter." UBYTE NO_COMPU_METHOD 0 0 0 255 ECU_ADDRESS 0x40004BE1 /end MEASUREMENT
/begin MEASUREMENT LEA_obd_ii_P0630_dtc_state "Learned/adaptive value: OBD-II P0630 DTC state." UBYTE NO_COMPU_METHOD 0 0 0 255 ECU_ADDRESS 0x40004BE2 /end MEASUREMENT
/begin MEASUREMENT LEA_obd_ii_P0630_fail_counter "Learned/adaptive value: OBD-II P0630 fail counter." UBYTE NO_COMPU_METHOD 0 0 0 255 ECU_ADDRESS 0x40004BE3 /end MEASUREMENT
/begin MEASUREMENT LEA_obd_ii_P0630_pass_counter "Learned/adaptive value: OBD-II P0630 pass counter." UBYTE NO_COMPU_METHOD 0 0 0 255 ECU_ADDRESS 0x40004BE4 /end MEASUREMENT
/begin MEASUREMENT LEA_obd_ii_P0638_dtc_state "Learned/adaptive value: OBD-II P0638 DTC state." UBYTE NO_COMPU_METHOD 0 0 0 255 ECU_ADDRESS 0x40004BE5 /end MEASUREMENT
/begin MEASUREMENT LEA_obd_ii_P0638_fail_counter "Learned/adaptive value: OBD-II P0638 fail counter." UBYTE NO_COMPU_METHOD 0 0 0 255 ECU_ADDRESS 0x40004BE6 /end MEASUREMENT
/begin MEASUREMENT LEA_obd_ii_P0638_pass_counter "Learned/adaptive value: OBD-II P0638 pass counter." UBYTE NO_COMPU_METHOD 0 0 0 255 ECU_ADDRESS 0x40004BE7 /end MEASUREMENT
/begin MEASUREMENT LEA_obd_ii_P0647_dtc_state "Learned/adaptive value: OBD-II P0647 DTC state." UBYTE NO_COMPU_METHOD 0 0 0 255 ECU_ADDRESS 0x40004BE8 /end MEASUREMENT
/begin MEASUREMENT LEA_obd_ii_P0647_fail_counter "Learned/adaptive value: OBD-II P0647 fail counter." UBYTE NO_COMPU_METHOD 0 0 0 255 ECU_ADDRESS 0x40004BE9 /end MEASUREMENT
/begin MEASUREMENT LEA_obd_ii_P0647_pass_counter "Learned/adaptive value: OBD-II P0647 pass counter." UBYTE NO_COMPU_METHOD 0 0 0 255 ECU_ADDRESS 0x40004BEA /end MEASUREMENT
/begin MEASUREMENT LEA_obd_ii_P0646_dtc_state "Learned/adaptive value: OBD-II P0646 DTC state." UBYTE NO_COMPU_METHOD 0 0 0 255 ECU_ADDRESS 0x40004BEB /end MEASUREMENT
/begin MEASUREMENT LEA_obd_ii_P0646_fail_counter "Learned/adaptive value: OBD-II P0646 fail counter." UBYTE NO_COMPU_METHOD 0 0 0 255 ECU_ADDRESS 0x40004BEC /end MEASUREMENT
/begin MEASUREMENT LEA_obd_ii_P0646_pass_counter "Learned/adaptive value: OBD-II P0646 pass counter." UBYTE NO_COMPU_METHOD 0 0 0 255 ECU_ADDRESS 0x40004BED /end MEASUREMENT
/begin MEASUREMENT LEA_obd_ii_P0685_dtc_state "Learned/adaptive value: OBD-II P0685 DTC state." UBYTE NO_COMPU_METHOD 0 0 0 255 ECU_ADDRESS 0x40004BEE /end MEASUREMENT
/begin MEASUREMENT LEA_obd_ii_P0685_fail_counter "Learned/adaptive value: OBD-II P0685 fail counter." UBYTE NO_COMPU_METHOD 0 0 0 255 ECU_ADDRESS 0x40004BEF /end MEASUREMENT
/begin MEASUREMENT LEA_obd_ii_P0685_pass_counter "Learned/adaptive value: OBD-II P0685 pass counter." UBYTE NO_COMPU_METHOD 0 0 0 255 ECU_ADDRESS 0x40004BF0 /end MEASUREMENT
/begin MEASUREMENT LEA_obd_ii_P0700_dtc_state "Learned/adaptive value: OBD-II P0700 DTC state." UBYTE NO_COMPU_METHOD 0 0 0 255 ECU_ADDRESS 0x40004BF1 /end MEASUREMENT
/begin MEASUREMENT LEA_obd_ii_P0700_fail_counter "Learned/adaptive value: OBD-II P0700 fail counter." UBYTE NO_COMPU_METHOD 0 0 0 255 ECU_ADDRESS 0x40004BF2 /end MEASUREMENT
/begin MEASUREMENT LEA_obd_ii_P0700_pass_counter "Learned/adaptive value: OBD-II P0700 pass counter." UBYTE NO_COMPU_METHOD 0 0 0 255 ECU_ADDRESS 0x40004BF3 /end MEASUREMENT
/begin MEASUREMENT LEA_obd_ii_P0712_dtc_state "Learned/adaptive value: OBD-II P0712 DTC state." UBYTE NO_COMPU_METHOD 0 0 0 255 ECU_ADDRESS 0x40004BF4 /end MEASUREMENT
/begin MEASUREMENT LEA_obd_ii_P0712_fail_counter "Learned/adaptive value: OBD-II P0712 fail counter." UBYTE NO_COMPU_METHOD 0 0 0 255 ECU_ADDRESS 0x40004BF5 /end MEASUREMENT
/begin MEASUREMENT LEA_obd_ii_P0712_pass_counter "Learned/adaptive value: OBD-II P0712 pass counter." UBYTE NO_COMPU_METHOD 0 0 0 255 ECU_ADDRESS 0x40004BF6 /end MEASUREMENT
/begin MEASUREMENT LEA_obd_ii_P0713_dtc_state "Learned/adaptive value: OBD-II P0713 DTC state." UBYTE NO_COMPU_METHOD 0 0 0 255 ECU_ADDRESS 0x40004BF7 /end MEASUREMENT
/begin MEASUREMENT LEA_obd_ii_P0713_fail_counter "Learned/adaptive value: OBD-II P0713 fail counter." UBYTE NO_COMPU_METHOD 0 0 0 255 ECU_ADDRESS 0x40004BF8 /end MEASUREMENT
/begin MEASUREMENT LEA_obd_ii_P0713_pass_counter "Learned/adaptive value: OBD-II P0713 pass counter." UBYTE NO_COMPU_METHOD 0 0 0 255 ECU_ADDRESS 0x40004BF9 /end MEASUREMENT
/begin MEASUREMENT LEA_obd_ii_P0806_dtc_state "Learned/adaptive value: OBD-II P0806 DTC state." UBYTE NO_COMPU_METHOD 0 0 0 255 ECU_ADDRESS 0x40004BFA /end MEASUREMENT
/begin MEASUREMENT LEA_obd_ii_P0806_fail_counter "Learned/adaptive value: OBD-II P0806 fail counter." UBYTE NO_COMPU_METHOD 0 0 0 255 ECU_ADDRESS 0x40004BFB /end MEASUREMENT
/begin MEASUREMENT LEA_obd_ii_P0806_pass_counter "Learned/adaptive value: OBD-II P0806 pass counter." UBYTE NO_COMPU_METHOD 0 0 0 255 ECU_ADDRESS 0x40004BFC /end MEASUREMENT
/begin MEASUREMENT LEA_obd_ii_P1809_dtc_state "Learned/adaptive value: OBD-II P1809 DTC state." UBYTE NO_COMPU_METHOD 0 0 0 255 ECU_ADDRESS 0x40004BFD /end MEASUREMENT
/begin MEASUREMENT LEA_obd_ii_P1809_fail_counter "Learned/adaptive value: OBD-II P1809 fail counter." UBYTE NO_COMPU_METHOD 0 0 0 255 ECU_ADDRESS 0x40004BFE /end MEASUREMENT
/begin MEASUREMENT LEA_obd_ii_P1809_pass_counter "Learned/adaptive value: OBD-II P1809 pass counter." UBYTE NO_COMPU_METHOD 0 0 0 255 ECU_ADDRESS 0x40004BFF /end MEASUREMENT
/begin MEASUREMENT LEA_obd_ii_P0807_dtc_state "Learned/adaptive value: OBD-II P0807 DTC state." UBYTE NO_COMPU_METHOD 0 0 0 255 ECU_ADDRESS 0x40004C00 /end MEASUREMENT
/begin MEASUREMENT LEA_obd_ii_P0807_fail_counter "Learned/adaptive value: OBD-II P0807 fail counter." UBYTE NO_COMPU_METHOD 0 0 0 255 ECU_ADDRESS 0x40004C01 /end MEASUREMENT
/begin MEASUREMENT LEA_obd_ii_P0807_pass_counter "Learned/adaptive value: OBD-II P0807 pass counter." UBYTE NO_COMPU_METHOD 0 0 0 255 ECU_ADDRESS 0x40004C02 /end MEASUREMENT
/begin MEASUREMENT LEA_obd_ii_P0808_dtc_state "Learned/adaptive value: OBD-II P0808 DTC state." UBYTE NO_COMPU_METHOD 0 0 0 255 ECU_ADDRESS 0x40004C03 /end MEASUREMENT
/begin MEASUREMENT LEA_obd_ii_P0808_fail_counter "Learned/adaptive value: OBD-II P0808 fail counter." UBYTE NO_COMPU_METHOD 0 0 0 255 ECU_ADDRESS 0x40004C04 /end MEASUREMENT
/begin MEASUREMENT LEA_obd_ii_P0808_pass_counter "Learned/adaptive value: OBD-II P0808 pass counter." UBYTE NO_COMPU_METHOD 0 0 0 255 ECU_ADDRESS 0x40004C05 /end MEASUREMENT
/begin MEASUREMENT LEA_obd_ii_P1106_dtc_state "Learned/adaptive value: OBD-II P1106 DTC state." UBYTE NO_COMPU_METHOD 0 0 0 255 ECU_ADDRESS 0x40004C06 /end MEASUREMENT
/begin MEASUREMENT LEA_obd_ii_P1106_fail_counter "Learned/adaptive value: OBD-II P1106 fail counter." UBYTE NO_COMPU_METHOD 0 0 0 255 ECU_ADDRESS 0x40004C07 /end MEASUREMENT
/begin MEASUREMENT LEA_obd_ii_P1106_pass_counter "Learned/adaptive value: OBD-II P1106 pass counter." UBYTE NO_COMPU_METHOD 0 0 0 255 ECU_ADDRESS 0x40004C08 /end MEASUREMENT
/begin MEASUREMENT LEA_obd_ii_P123B_dtc_state "Learned/adaptive value: OBD-II P123B DTC state." UBYTE NO_COMPU_METHOD 0 0 0 255 ECU_ADDRESS 0x40004C09 /end MEASUREMENT
/begin MEASUREMENT LEA_obd_ii_P123B_fail_counter "Learned/adaptive value: OBD-II P123B fail counter." UBYTE NO_COMPU_METHOD 0 0 0 255 ECU_ADDRESS 0x40004C0A /end MEASUREMENT
/begin MEASUREMENT LEA_obd_ii_P123B_pass_counter "Learned/adaptive value: OBD-II P123B pass counter." UBYTE NO_COMPU_METHOD 0 0 0 255 ECU_ADDRESS 0x40004C0B /end MEASUREMENT
/begin MEASUREMENT LEA_obd_ii_P123C_dtc_state "Learned/adaptive value: OBD-II P123C DTC state." UBYTE NO_COMPU_METHOD 0 0 0 255 ECU_ADDRESS 0x40004C0C /end MEASUREMENT
/begin MEASUREMENT LEA_obd_ii_P123C_fail_counter "Learned/adaptive value: OBD-II P123C fail counter." UBYTE NO_COMPU_METHOD 0 0 0 255 ECU_ADDRESS 0x40004C0D /end MEASUREMENT
/begin MEASUREMENT LEA_obd_ii_P123C_pass_counter "Learned/adaptive value: OBD-II P123C pass counter." UBYTE NO_COMPU_METHOD 0 0 0 255 ECU_ADDRESS 0x40004C0E /end MEASUREMENT
/begin MEASUREMENT LEA_obd_ii_P1562_dtc_state "Learned/adaptive value: OBD-II P1562 DTC state." UBYTE NO_COMPU_METHOD 0 0 0 255 ECU_ADDRESS 0x40004C0F /end MEASUREMENT
/begin MEASUREMENT LEA_obd_ii_P1562_fail_counter "Learned/adaptive value: OBD-II P1562 fail counter." UBYTE NO_COMPU_METHOD 0 0 0 255 ECU_ADDRESS 0x40004C10 /end MEASUREMENT
/begin MEASUREMENT LEA_obd_ii_P1562_pass_counter "Learned/adaptive value: OBD-II P1562 pass counter." UBYTE NO_COMPU_METHOD 0 0 0 255 ECU_ADDRESS 0x40004C11 /end MEASUREMENT
/begin MEASUREMENT LEA_obd_ii_P2122_dtc_state "Learned/adaptive value: OBD-II P2122 DTC state." UBYTE NO_COMPU_METHOD 0 0 0 255 ECU_ADDRESS 0x40004C12 /end MEASUREMENT
/begin MEASUREMENT LEA_obd_ii_P2122_fail_counter "Learned/adaptive value: OBD-II P2122 fail counter." UBYTE NO_COMPU_METHOD 0 0 0 255 ECU_ADDRESS 0x40004C13 /end MEASUREMENT
/begin MEASUREMENT LEA_obd_ii_P2122_pass_counter "Learned/adaptive value: OBD-II P2122 pass counter." UBYTE NO_COMPU_METHOD 0 0 0 255 ECU_ADDRESS 0x40004C14 /end MEASUREMENT
/begin MEASUREMENT LEA_obd_ii_P2123_dtc_state "Learned/adaptive value: OBD-II P2123 DTC state." UBYTE NO_COMPU_METHOD 0 0 0 255 ECU_ADDRESS 0x40004C15 /end MEASUREMENT
/begin MEASUREMENT LEA_obd_ii_P2123_fail_counter "Learned/adaptive value: OBD-II P2123 fail counter." UBYTE NO_COMPU_METHOD 0 0 0 255 ECU_ADDRESS 0x40004C16 /end MEASUREMENT
/begin MEASUREMENT LEA_obd_ii_P2123_pass_counter "Learned/adaptive value: OBD-II P2123 pass counter." UBYTE NO_COMPU_METHOD 0 0 0 255 ECU_ADDRESS 0x40004C17 /end MEASUREMENT
/begin MEASUREMENT LEA_obd_ii_P2127_dtc_state "Learned/adaptive value: OBD-II P2127 DTC state." UBYTE NO_COMPU_METHOD 0 0 0 255 ECU_ADDRESS 0x40004C18 /end MEASUREMENT
/begin MEASUREMENT LEA_obd_ii_P2127_fail_counter "Learned/adaptive value: OBD-II P2127 fail counter." UBYTE NO_COMPU_METHOD 0 0 0 255 ECU_ADDRESS 0x40004C19 /end MEASUREMENT
/begin MEASUREMENT LEA_obd_ii_P2127_pass_counter "Learned/adaptive value: OBD-II P2127 pass counter." UBYTE NO_COMPU_METHOD 0 0 0 255 ECU_ADDRESS 0x40004C1A /end MEASUREMENT
/begin MEASUREMENT LEA_obd_ii_P2128_dtc_state "Learned/adaptive value: OBD-II P2128 DTC state." UBYTE NO_COMPU_METHOD 0 0 0 255 ECU_ADDRESS 0x40004C1B /end MEASUREMENT
/begin MEASUREMENT LEA_obd_ii_P2128_fail_counter "Learned/adaptive value: OBD-II P2128 fail counter." UBYTE NO_COMPU_METHOD 0 0 0 255 ECU_ADDRESS 0x40004C1C /end MEASUREMENT
/begin MEASUREMENT LEA_obd_ii_P2128_pass_counter "Learned/adaptive value: OBD-II P2128 pass counter." UBYTE NO_COMPU_METHOD 0 0 0 255 ECU_ADDRESS 0x40004C1D /end MEASUREMENT
/begin MEASUREMENT LEA_obd_ii_P2135_dtc_state "Learned/adaptive value: OBD-II P2135 DTC state." UBYTE NO_COMPU_METHOD 0 0 0 255 ECU_ADDRESS 0x40004C1E /end MEASUREMENT
/begin MEASUREMENT LEA_obd_ii_P2135_fail_counter "Learned/adaptive value: OBD-II P2135 fail counter." UBYTE NO_COMPU_METHOD 0 0 0 255 ECU_ADDRESS 0x40004C1F /end MEASUREMENT
/begin MEASUREMENT LEA_obd_ii_P2135_pass_counter "Learned/adaptive value: OBD-II P2135 pass counter." UBYTE NO_COMPU_METHOD 0 0 0 255 ECU_ADDRESS 0x40004C20 /end MEASUREMENT
/begin MEASUREMENT LEA_obd_ii_P2138_dtc_state "Learned/adaptive value: OBD-II P2138 DTC state." UBYTE NO_COMPU_METHOD 0 0 0 255 ECU_ADDRESS 0x40004C21 /end MEASUREMENT
/begin MEASUREMENT LEA_obd_ii_P2138_fail_counter "Learned/adaptive value: OBD-II P2138 fail counter." UBYTE NO_COMPU_METHOD 0 0 0 255 ECU_ADDRESS 0x40004C22 /end MEASUREMENT
/begin MEASUREMENT LEA_obd_ii_P2138_pass_counter "Learned/adaptive value: OBD-II P2138 pass counter." UBYTE NO_COMPU_METHOD 0 0 0 255 ECU_ADDRESS 0x40004C23 /end MEASUREMENT
/begin MEASUREMENT LEA_obd_ii_P2173_dtc_state "Learned/adaptive value: OBD-II P2173 DTC state." UBYTE NO_COMPU_METHOD 0 0 0 255 ECU_ADDRESS 0x40004C24 /end MEASUREMENT
/begin MEASUREMENT LEA_obd_ii_P2173_fail_counter "Learned/adaptive value: OBD-II P2173 fail counter." UBYTE NO_COMPU_METHOD 0 0 0 255 ECU_ADDRESS 0x40004C25 /end MEASUREMENT
/begin MEASUREMENT LEA_obd_ii_P2173_pass_counter "Learned/adaptive value: OBD-II P2173 pass counter." UBYTE NO_COMPU_METHOD 0 0 0 255 ECU_ADDRESS 0x40004C26 /end MEASUREMENT
/begin MEASUREMENT LEA_obd_ii_P2602_dtc_state "Learned/adaptive value: OBD-II P2602 DTC state." UBYTE NO_COMPU_METHOD 0 0 0 255 ECU_ADDRESS 0x40004C27 /end MEASUREMENT
/begin MEASUREMENT LEA_obd_ii_P2602_fail_counter "Learned/adaptive value: OBD-II P2602 fail counter." UBYTE NO_COMPU_METHOD 0 0 0 255 ECU_ADDRESS 0x40004C28 /end MEASUREMENT
/begin MEASUREMENT LEA_obd_ii_P2602_pass_counter "Learned/adaptive value: OBD-II P2602 pass counter." UBYTE NO_COMPU_METHOD 0 0 0 255 ECU_ADDRESS 0x40004C29 /end MEASUREMENT
/begin MEASUREMENT LEA_obd_ii_P2603_dtc_state "Learned/adaptive value: OBD-II P2603 DTC state." UBYTE NO_COMPU_METHOD 0 0 0 255 ECU_ADDRESS 0x40004C2A /end MEASUREMENT
/begin MEASUREMENT LEA_obd_ii_P2603_fail_counter "Learned/adaptive value: OBD-II P2603 fail counter." UBYTE NO_COMPU_METHOD 0 0 0 255 ECU_ADDRESS 0x40004C2B /end MEASUREMENT
/begin MEASUREMENT LEA_obd_ii_P2603_pass_counter "Learned/adaptive value: OBD-II P2603 pass counter." UBYTE NO_COMPU_METHOD 0 0 0 255 ECU_ADDRESS 0x40004C2C /end MEASUREMENT
/begin MEASUREMENT LEA_obd_ii_unused_slot_40004c2d_dtc_state "Spare DTC slot after P2603 (as in 0091): only cleared." UBYTE NO_COMPU_METHOD 0 0 0 255 ECU_ADDRESS 0x40004C2D /end MEASUREMENT
/begin MEASUREMENT LEA_obd_ii_unused_slot_40004c2d_fail_counter "Spare DTC slot (reset 3)." UBYTE NO_COMPU_METHOD 0 0 0 255 ECU_ADDRESS 0x40004C2E /end MEASUREMENT
/begin MEASUREMENT LEA_obd_ii_unused_slot_40004c2d_pass_counter "Spare DTC slot (reset 40)." UBYTE NO_COMPU_METHOD 0 0 0 255 ECU_ADDRESS 0x40004C2F /end MEASUREMENT
/begin MEASUREMENT LEA_obd_ii_unused_slot_40004c30_dtc_state "Spare DTC slot: only cleared." UBYTE NO_COMPU_METHOD 0 0 0 255 ECU_ADDRESS 0x40004C30 /end MEASUREMENT
/begin MEASUREMENT LEA_obd_ii_unused_slot_40004c30_fail_counter "Spare DTC slot (reset 3)." UBYTE NO_COMPU_METHOD 0 0 0 255 ECU_ADDRESS 0x40004C31 /end MEASUREMENT
/begin MEASUREMENT LEA_obd_ii_unused_slot_40004c30_pass_counter "Spare DTC slot (reset 40)." UBYTE NO_COMPU_METHOD 0 0 0 255 ECU_ADDRESS 0x40004C32 /end MEASUREMENT
/begin MEASUREMENT LEA_unused_byte6 "Learned/adaptive value: unused byte6." UBYTE NO_COMPU_METHOD 0 0 0 255 ECU_ADDRESS 0x40004C33 /end MEASUREMENT
/begin MEASUREMENT LEA_unused_byte5 "Learned/adaptive value: unused byte5." UBYTE NO_COMPU_METHOD 0 0 0 255 ECU_ADDRESS 0x40004C34 /end MEASUREMENT
/begin MEASUREMENT LEA_unused_byte4 "Learned/adaptive value: unused byte4." UBYTE NO_COMPU_METHOD 0 0 0 255 ECU_ADDRESS 0x40004C35 /end MEASUREMENT
/begin MEASUREMENT LEA_unused_40004c36 "No references. Was duplicate LEA_unused_byte3." UBYTE NO_COMPU_METHOD 0 0 0 255 ECU_ADDRESS 0x40004C36 /end MEASUREMENT
/begin MEASUREMENT LEA_unused_40004c37 "No references. Was duplicate LEA_unused_byte3." UBYTE NO_COMPU_METHOD 0 0 0 255 ECU_ADDRESS 0x40004C37 /end MEASUREMENT
/begin MEASUREMENT LEA_unused_byte2 "Learned/adaptive value: unused byte2." UBYTE NO_COMPU_METHOD 0 0 0 255 ECU_ADDRESS 0x40004C38 /end MEASUREMENT
/begin MEASUREMENT LEA_obd_ii_P2104_dtc_state "Learned/adaptive value: OBD-II P2104 DTC state." UBYTE NO_COMPU_METHOD 0 0 0 255 ECU_ADDRESS 0x40004C39 /end MEASUREMENT
/begin MEASUREMENT LEA_obd_ii_P2104_fail_counter "Learned/adaptive value: OBD-II P2104 fail counter." UBYTE NO_COMPU_METHOD 0 0 0 255 ECU_ADDRESS 0x40004C3A /end MEASUREMENT
/begin MEASUREMENT LEA_obd_ii_P2104_pass_counter "Learned/adaptive value: OBD-II P2104 pass counter." UBYTE NO_COMPU_METHOD 0 0 0 255 ECU_ADDRESS 0x40004C3B /end MEASUREMENT
/begin MEASUREMENT LEA_obd_ii_P1104_dtc_state "Learned/adaptive value: OBD-II P1104 DTC state." UBYTE NO_COMPU_METHOD 0 0 0 255 ECU_ADDRESS 0x40004C3C /end MEASUREMENT
/begin MEASUREMENT LEA_obd_ii_P1104_fail_counter "Learned/adaptive value: OBD-II P1104 fail counter." UBYTE NO_COMPU_METHOD 0 0 0 255 ECU_ADDRESS 0x40004C3D /end MEASUREMENT
/begin MEASUREMENT LEA_obd_ii_P1104_pass_counter "Learned/adaptive value: OBD-II P1104 pass counter." UBYTE NO_COMPU_METHOD 0 0 0 255 ECU_ADDRESS 0x40004C3E /end MEASUREMENT
/begin MEASUREMENT LEA_obd_ii_P2105_dtc_state "Learned/adaptive value: OBD-II P2105 DTC state." UBYTE NO_COMPU_METHOD 0 0 0 255 ECU_ADDRESS 0x40004C3F /end MEASUREMENT
/begin MEASUREMENT LEA_obd_ii_P2105_fail_counter "Learned/adaptive value: OBD-II P2105 fail counter." UBYTE NO_COMPU_METHOD 0 0 0 255 ECU_ADDRESS 0x40004C40 /end MEASUREMENT
/begin MEASUREMENT LEA_obd_ii_P2105_pass_counter "Learned/adaptive value: OBD-II P2105 pass counter." UBYTE NO_COMPU_METHOD 0 0 0 255 ECU_ADDRESS 0x40004C41 /end MEASUREMENT
/begin MEASUREMENT LEA_obd_ii_P2106_dtc_state "Learned/adaptive value: OBD-II P2106 DTC state." UBYTE NO_COMPU_METHOD 0 0 0 255 ECU_ADDRESS 0x40004C42 /end MEASUREMENT
/begin MEASUREMENT LEA_obd_ii_P2106_fail_counter "Learned/adaptive value: OBD-II P2106 fail counter." UBYTE NO_COMPU_METHOD 0 0 0 255 ECU_ADDRESS 0x40004C43 /end MEASUREMENT
/begin MEASUREMENT LEA_obd_ii_P2106_pass_counter "Learned/adaptive value: OBD-II P2106 pass counter." UBYTE NO_COMPU_METHOD 0 0 0 255 ECU_ADDRESS 0x40004C44 /end MEASUREMENT
/begin MEASUREMENT LEA_obd_ii_P2107_dtc_state "Learned/adaptive value: OBD-II P2107 DTC state." UBYTE NO_COMPU_METHOD 0 0 0 255 ECU_ADDRESS 0x40004C45 /end MEASUREMENT
/begin MEASUREMENT LEA_obd_ii_P2107_fail_counter "Learned/adaptive value: OBD-II P2107 fail counter." UBYTE NO_COMPU_METHOD 0 0 0 255 ECU_ADDRESS 0x40004C46 /end MEASUREMENT
/begin MEASUREMENT LEA_obd_ii_P2107_pass_counter "Learned/adaptive value: OBD-II P2107 pass counter." UBYTE NO_COMPU_METHOD 0 0 0 255 ECU_ADDRESS 0x40004C47 /end MEASUREMENT
/begin MEASUREMENT LEA_obd_ii_P2100_dtc_state "Learned/adaptive value: OBD-II P2100 DTC state." UBYTE NO_COMPU_METHOD 0 0 0 255 ECU_ADDRESS 0x40004C48 /end MEASUREMENT
/begin MEASUREMENT LEA_obd_ii_P2100_fail_counter "Learned/adaptive value: OBD-II P2100 fail counter." UBYTE NO_COMPU_METHOD 0 0 0 255 ECU_ADDRESS 0x40004C49 /end MEASUREMENT
/begin MEASUREMENT LEA_obd_ii_P2100_pass_counter "Learned/adaptive value: OBD-II P2100 pass counter." UBYTE NO_COMPU_METHOD 0 0 0 255 ECU_ADDRESS 0x40004C4A /end MEASUREMENT
/begin MEASUREMENT LEA_obd_ii_P2102_dtc_state "Learned/adaptive value: OBD-II P2102 DTC state." UBYTE NO_COMPU_METHOD 0 0 0 255 ECU_ADDRESS 0x40004C4B /end MEASUREMENT
/begin MEASUREMENT LEA_obd_ii_P2102_fail_counter "Learned/adaptive value: OBD-II P2102 fail counter." UBYTE NO_COMPU_METHOD 0 0 0 255 ECU_ADDRESS 0x40004C4C /end MEASUREMENT
/begin MEASUREMENT LEA_obd_ii_P2102_pass_counter "Learned/adaptive value: OBD-II P2102 pass counter." UBYTE NO_COMPU_METHOD 0 0 0 255 ECU_ADDRESS 0x40004C4D /end MEASUREMENT
/begin MEASUREMENT LEA_obd_ii_P2103_dtc_state "Learned/adaptive value: OBD-II P2103 DTC state." UBYTE NO_COMPU_METHOD 0 0 0 255 ECU_ADDRESS 0x40004C4E /end MEASUREMENT
/begin MEASUREMENT LEA_obd_ii_P2103_fail_counter "Learned/adaptive value: OBD-II P2103 fail counter." UBYTE NO_COMPU_METHOD 0 0 0 255 ECU_ADDRESS 0x40004C4F /end MEASUREMENT
/begin MEASUREMENT LEA_obd_ii_P2103_pass_counter "Learned/adaptive value: OBD-II P2103 pass counter." UBYTE NO_COMPU_METHOD 0 0 0 255 ECU_ADDRESS 0x40004C50 /end MEASUREMENT
/begin MEASUREMENT LEA_obd_ii_P2108_dtc_state "Learned/adaptive value: OBD-II P2108 DTC state." UBYTE NO_COMPU_METHOD 0 0 0 255 ECU_ADDRESS 0x40004C51 /end MEASUREMENT
/begin MEASUREMENT LEA_obd_ii_P2108_fail_counter "Learned/adaptive value: OBD-II P2108 fail counter." UBYTE NO_COMPU_METHOD 0 0 0 255 ECU_ADDRESS 0x40004C52 /end MEASUREMENT
/begin MEASUREMENT LEA_obd_ii_P2108_pass_counter "Learned/adaptive value: OBD-II P2108 pass counter." UBYTE NO_COMPU_METHOD 0 0 0 255 ECU_ADDRESS 0x40004C53 /end MEASUREMENT
/begin MEASUREMENT LEA_obd_ii_P2612_dtc_state "Learned/adaptive value: OBD-II P2612 DTC state." UBYTE NO_COMPU_METHOD 0 0 0 255 ECU_ADDRESS 0x40004C54 /end MEASUREMENT
/begin MEASUREMENT LEA_obd_ii_P2612_fail_counter "Learned/adaptive value: OBD-II P2612 fail counter." UBYTE NO_COMPU_METHOD 0 0 0 255 ECU_ADDRESS 0x40004C55 /end MEASUREMENT
/begin MEASUREMENT LEA_obd_ii_P2612_pass_counter "Learned/adaptive value: OBD-II P2612 pass counter." UBYTE NO_COMPU_METHOD 0 0 0 255 ECU_ADDRESS 0x40004C56 /end MEASUREMENT
/begin MEASUREMENT LEA_obd_ii_P2613_dtc_state "Learned/adaptive value: OBD-II P2613 DTC state." UBYTE NO_COMPU_METHOD 0 0 0 255 ECU_ADDRESS 0x40004C57 /end MEASUREMENT
/begin MEASUREMENT LEA_obd_ii_P2613_fail_counter "Learned/adaptive value: OBD-II P2613 fail counter." UBYTE NO_COMPU_METHOD 0 0 0 255 ECU_ADDRESS 0x40004C58 /end MEASUREMENT
/begin MEASUREMENT LEA_obd_ii_P2613_pass_counter "Learned/adaptive value: OBD-II P2613 pass counter." UBYTE NO_COMPU_METHOD 0 0 0 255 ECU_ADDRESS 0x40004C59 /end MEASUREMENT
/begin MEASUREMENT LEA_obd_ii_P0616_dtc_state "Learned/adaptive value: OBD-II P0616 DTC state." UBYTE NO_COMPU_METHOD 0 0 0 255 ECU_ADDRESS 0x40004C5A /end MEASUREMENT
/begin MEASUREMENT LEA_obd_ii_P0616_fail_counter "Learned/adaptive value: OBD-II P0616 fail counter." UBYTE NO_COMPU_METHOD 0 0 0 255 ECU_ADDRESS 0x40004C5B /end MEASUREMENT
/begin MEASUREMENT LEA_obd_ii_P0616_pass_counter "Learned/adaptive value: OBD-II P0616 pass counter." UBYTE NO_COMPU_METHOD 0 0 0 255 ECU_ADDRESS 0x40004C5C /end MEASUREMENT
/begin MEASUREMENT LEA_obd_ii_P0617_dtc_state "Learned/adaptive value: OBD-II P0617 DTC state." UBYTE NO_COMPU_METHOD 0 0 0 255 ECU_ADDRESS 0x40004C5D /end MEASUREMENT
/begin MEASUREMENT LEA_obd_ii_P0617_fail_counter "Learned/adaptive value: OBD-II P0617 fail counter." UBYTE NO_COMPU_METHOD 0 0 0 255 ECU_ADDRESS 0x40004C5E /end MEASUREMENT
/begin MEASUREMENT LEA_obd_ii_P0617_pass_counter "Learned/adaptive value: OBD-II P0617 pass counter." UBYTE NO_COMPU_METHOD 0 0 0 255 ECU_ADDRESS 0x40004C5F /end MEASUREMENT
/begin MEASUREMENT LEA_obd_ii_P2119_dtc_state "Learned/adaptive value: OBD-II P2119 DTC state." UBYTE NO_COMPU_METHOD 0 0 0 255 ECU_ADDRESS 0x40004C60 /end MEASUREMENT
/begin MEASUREMENT LEA_obd_ii_P2119_fail_counter "Learned/adaptive value: OBD-II P2119 fail counter." UBYTE NO_COMPU_METHOD 0 0 0 255 ECU_ADDRESS 0x40004C61 /end MEASUREMENT
/begin MEASUREMENT LEA_obd_ii_P2119_pass_counter "Learned/adaptive value: OBD-II P2119 pass counter." UBYTE NO_COMPU_METHOD 0 0 0 255 ECU_ADDRESS 0x40004C62 /end MEASUREMENT
/begin MEASUREMENT LEA_obd_ii_P2170_dtc_state "Learned/adaptive value: OBD-II P2170 DTC state." UBYTE NO_COMPU_METHOD 0 0 0 255 ECU_ADDRESS 0x40004C63 /end MEASUREMENT
/begin MEASUREMENT LEA_obd_ii_P2170_fail_counter "Learned/adaptive value: OBD-II P2170 fail counter." UBYTE NO_COMPU_METHOD 0 0 0 255 ECU_ADDRESS 0x40004C64 /end MEASUREMENT
/begin MEASUREMENT LEA_obd_ii_P2170_pass_counter "Learned/adaptive value: OBD-II P2170 pass counter." UBYTE NO_COMPU_METHOD 0 0 0 255 ECU_ADDRESS 0x40004C65 /end MEASUREMENT
/begin MEASUREMENT LEA_obd_ii_P2171_dtc_state "Learned/adaptive value: OBD-II P2171 DTC state." UBYTE NO_COMPU_METHOD 0 0 0 255 ECU_ADDRESS 0x40004C66 /end MEASUREMENT
/begin MEASUREMENT LEA_obd_ii_P2171_fail_counter "Learned/adaptive value: OBD-II P2171 fail counter." UBYTE NO_COMPU_METHOD 0 0 0 255 ECU_ADDRESS 0x40004C67 /end MEASUREMENT
/begin MEASUREMENT LEA_obd_ii_P2171_pass_counter "Learned/adaptive value: OBD-II P2171 pass counter." UBYTE NO_COMPU_METHOD 0 0 0 255 ECU_ADDRESS 0x40004C68 /end MEASUREMENT
/begin MEASUREMENT LEA_obd_ii_P0826_dtc_state "Learned/adaptive value: OBD-II P0826 DTC state." UBYTE NO_COMPU_METHOD 0 0 0 255 ECU_ADDRESS 0x40004C69 /end MEASUREMENT
/begin MEASUREMENT LEA_obd_ii_P0826_fail_counter "Learned/adaptive value: OBD-II P0826 fail counter." UBYTE NO_COMPU_METHOD 0 0 0 255 ECU_ADDRESS 0x40004C6A /end MEASUREMENT
/begin MEASUREMENT LEA_obd_ii_P0826_pass_counter "Learned/adaptive value: OBD-II P0826 pass counter." UBYTE NO_COMPU_METHOD 0 0 0 255 ECU_ADDRESS 0x40004C6B /end MEASUREMENT
/begin MEASUREMENT LEA_obd_ii_P0827_dtc_state "Learned/adaptive value: OBD-II P0827 DTC state." UBYTE NO_COMPU_METHOD 0 0 0 255 ECU_ADDRESS 0x40004C6C /end MEASUREMENT
/begin MEASUREMENT LEA_obd_ii_P0827_fail_counter "Learned/adaptive value: OBD-II P0827 fail counter." UBYTE NO_COMPU_METHOD 0 0 0 255 ECU_ADDRESS 0x40004C6D /end MEASUREMENT
/begin MEASUREMENT LEA_obd_ii_P0827_pass_counter "Learned/adaptive value: OBD-II P0827 pass counter." UBYTE NO_COMPU_METHOD 0 0 0 255 ECU_ADDRESS 0x40004C6E /end MEASUREMENT
/begin MEASUREMENT LEA_obd_ii_P0828_dtc_state "Learned/adaptive value: OBD-II P0828 DTC state." UBYTE NO_COMPU_METHOD 0 0 0 255 ECU_ADDRESS 0x40004C6F /end MEASUREMENT
/begin MEASUREMENT LEA_obd_ii_P0828_fail_counter "Learned/adaptive value: OBD-II P0828 fail counter." UBYTE NO_COMPU_METHOD 0 0 0 255 ECU_ADDRESS 0x40004C70 /end MEASUREMENT
/begin MEASUREMENT LEA_obd_ii_P0828_pass_counter "Learned/adaptive value: OBD-II P0828 pass counter." UBYTE NO_COMPU_METHOD 0 0 0 255 ECU_ADDRESS 0x40004C71 /end MEASUREMENT
/begin MEASUREMENT LEA_obd_ii_P2191_dtc_state "Learned/adaptive value: OBD-II P2191 DTC state." UBYTE NO_COMPU_METHOD 0 0 0 255 ECU_ADDRESS 0x40004C72 /end MEASUREMENT
/begin MEASUREMENT LEA_obd_ii_P2191_fail_counter "Learned/adaptive value: OBD-II P2191 fail counter." UBYTE NO_COMPU_METHOD 0 0 0 255 ECU_ADDRESS 0x40004C73 /end MEASUREMENT
/begin MEASUREMENT LEA_obd_ii_P2191_pass_counter "Learned/adaptive value: OBD-II P2191 pass counter." UBYTE NO_COMPU_METHOD 0 0 0 255 ECU_ADDRESS 0x40004C74 /end MEASUREMENT
/begin MEASUREMENT LEA_obd_ii_P2193_dtc_state "Learned/adaptive value: OBD-II P2193 DTC state." UBYTE NO_COMPU_METHOD 0 0 0 255 ECU_ADDRESS 0x40004C75 /end MEASUREMENT
/begin MEASUREMENT LEA_obd_ii_P2193_fail_counter "Learned/adaptive value: OBD-II P2193 fail counter." UBYTE NO_COMPU_METHOD 0 0 0 255 ECU_ADDRESS 0x40004C76 /end MEASUREMENT
/begin MEASUREMENT LEA_obd_ii_P2193_pass_counter "Learned/adaptive value: OBD-II P2193 pass counter." UBYTE NO_COMPU_METHOD 0 0 0 255 ECU_ADDRESS 0x40004C77 /end MEASUREMENT
/begin MEASUREMENT LEA_obd_ii_P219A_dtc_state "Learned/adaptive value: OBD-II P219A DTC state." UBYTE NO_COMPU_METHOD 0 0 0 255 ECU_ADDRESS 0x40004C78 /end MEASUREMENT
/begin MEASUREMENT LEA_obd_ii_P219A_fail_counter "Learned/adaptive value: OBD-II P219A fail counter." UBYTE NO_COMPU_METHOD 0 0 0 255 ECU_ADDRESS 0x40004C79 /end MEASUREMENT
/begin MEASUREMENT LEA_obd_ii_P219A_pass_counter "Learned/adaptive value: OBD-II P219A pass counter." UBYTE NO_COMPU_METHOD 0 0 0 255 ECU_ADDRESS 0x40004C7A /end MEASUREMENT
/begin MEASUREMENT LEA_obd_ii_P219B_dtc_state "Learned/adaptive value: OBD-II P219B DTC state." UBYTE NO_COMPU_METHOD 0 0 0 255 ECU_ADDRESS 0x40004C7B /end MEASUREMENT
/begin MEASUREMENT LEA_obd_ii_P219B_fail_counter "Learned/adaptive value: OBD-II P219B fail counter." UBYTE NO_COMPU_METHOD 0 0 0 255 ECU_ADDRESS 0x40004C7C /end MEASUREMENT
/begin MEASUREMENT LEA_obd_ii_P219B_pass_counter "Learned/adaptive value: OBD-II P219B pass counter." UBYTE NO_COMPU_METHOD 0 0 0 255 ECU_ADDRESS 0x40004C7D /end MEASUREMENT
/begin MEASUREMENT LEA_obd_ii_P2336_dtc_state "Learned/adaptive value: OBD-II P2336 DTC state." UBYTE NO_COMPU_METHOD 0 0 0 255 ECU_ADDRESS 0x40004C7E /end MEASUREMENT
/begin MEASUREMENT LEA_obd_ii_P2336_fail_counter "Learned/adaptive value: OBD-II P2336 fail counter." UBYTE NO_COMPU_METHOD 0 0 0 255 ECU_ADDRESS 0x40004C7F /end MEASUREMENT
/begin MEASUREMENT LEA_obd_ii_P2336_pass_counter "Learned/adaptive value: OBD-II P2336 pass counter." UBYTE NO_COMPU_METHOD 0 0 0 255 ECU_ADDRESS 0x40004C80 /end MEASUREMENT
/begin MEASUREMENT LEA_obd_ii_P2337_dtc_state "Learned/adaptive value: OBD-II P2337 DTC state." UBYTE NO_COMPU_METHOD 0 0 0 255 ECU_ADDRESS 0x40004C81 /end MEASUREMENT
/begin MEASUREMENT LEA_obd_ii_P2337_fail_counter "Learned/adaptive value: OBD-II P2337 fail counter." UBYTE NO_COMPU_METHOD 0 0 0 255 ECU_ADDRESS 0x40004C82 /end MEASUREMENT
/begin MEASUREMENT LEA_obd_ii_P2337_pass_counter "Learned/adaptive value: OBD-II P2337 pass counter." UBYTE NO_COMPU_METHOD 0 0 0 255 ECU_ADDRESS 0x40004C83 /end MEASUREMENT
/begin MEASUREMENT LEA_obd_ii_P2338_dtc_state "Learned/adaptive value: OBD-II P2338 DTC state." UBYTE NO_COMPU_METHOD 0 0 0 255 ECU_ADDRESS 0x40004C84 /end MEASUREMENT
/begin MEASUREMENT LEA_obd_ii_P2338_fail_counter "Learned/adaptive value: OBD-II P2338 fail counter." UBYTE NO_COMPU_METHOD 0 0 0 255 ECU_ADDRESS 0x40004C85 /end MEASUREMENT
/begin MEASUREMENT LEA_obd_ii_P2338_pass_counter "Learned/adaptive value: OBD-II P2338 pass counter." UBYTE NO_COMPU_METHOD 0 0 0 255 ECU_ADDRESS 0x40004C86 /end MEASUREMENT
/begin MEASUREMENT LEA_obd_ii_P2339_dtc_state "Learned/adaptive value: OBD-II P2339 DTC state." UBYTE NO_COMPU_METHOD 0 0 0 255 ECU_ADDRESS 0x40004C87 /end MEASUREMENT
/begin MEASUREMENT LEA_obd_ii_P2339_fail_counter "Learned/adaptive value: OBD-II P2339 fail counter." UBYTE NO_COMPU_METHOD 0 0 0 255 ECU_ADDRESS 0x40004C88 /end MEASUREMENT
/begin MEASUREMENT LEA_obd_ii_P2339_pass_counter "Learned/adaptive value: OBD-II P2339 pass counter." UBYTE NO_COMPU_METHOD 0 0 0 255 ECU_ADDRESS 0x40004C89 /end MEASUREMENT
/begin MEASUREMENT LEA_obd_ii_P2340_dtc_state "Learned/adaptive value: OBD-II P2340 DTC state." UBYTE NO_COMPU_METHOD 0 0 0 255 ECU_ADDRESS 0x40004C8A /end MEASUREMENT
/begin MEASUREMENT LEA_obd_ii_P2340_fail_counter "Learned/adaptive value: OBD-II P2340 fail counter." UBYTE NO_COMPU_METHOD 0 0 0 255 ECU_ADDRESS 0x40004C8B /end MEASUREMENT
/begin MEASUREMENT LEA_obd_ii_P2340_pass_counter "Learned/adaptive value: OBD-II P2340 pass counter." UBYTE NO_COMPU_METHOD 0 0 0 255 ECU_ADDRESS 0x40004C8C /end MEASUREMENT
/begin MEASUREMENT LEA_obd_ii_P2341_dtc_state "Learned/adaptive value: OBD-II P2341 DTC state." UBYTE NO_COMPU_METHOD 0 0 0 255 ECU_ADDRESS 0x40004C8D /end MEASUREMENT
/begin MEASUREMENT LEA_obd_ii_P2341_fail_counter "Learned/adaptive value: OBD-II P2341 fail counter." UBYTE NO_COMPU_METHOD 0 0 0 255 ECU_ADDRESS 0x40004C8E /end MEASUREMENT
/begin MEASUREMENT LEA_obd_ii_P2341_pass_counter "Learned/adaptive value: OBD-II P2341 pass counter." UBYTE NO_COMPU_METHOD 0 0 0 255 ECU_ADDRESS 0x40004C8F /end MEASUREMENT
/begin MEASUREMENT LEA_obd_ii_P1107_dtc_state "Learned/adaptive value: OBD-II P1107 DTC state." UBYTE NO_COMPU_METHOD 0 0 0 255 ECU_ADDRESS 0x40004C90 /end MEASUREMENT
/begin MEASUREMENT LEA_obd_ii_P1107_fail_counter "Learned/adaptive value: OBD-II P1107 fail counter." UBYTE NO_COMPU_METHOD 0 0 0 255 ECU_ADDRESS 0x40004C91 /end MEASUREMENT
/begin MEASUREMENT LEA_obd_ii_P1107_pass_counter "Learned/adaptive value: OBD-II P1107 pass counter." UBYTE NO_COMPU_METHOD 0 0 0 255 ECU_ADDRESS 0x40004C92 /end MEASUREMENT
/begin MEASUREMENT LEA_obd_ii_P1108_dtc_state "Learned/adaptive value: OBD-II P1108 DTC state." UBYTE NO_COMPU_METHOD 0 0 0 255 ECU_ADDRESS 0x40004C93 /end MEASUREMENT
/begin MEASUREMENT LEA_obd_ii_P1108_fail_counter "Learned/adaptive value: OBD-II P1108 fail counter." UBYTE NO_COMPU_METHOD 0 0 0 255 ECU_ADDRESS 0x40004C94 /end MEASUREMENT
/begin MEASUREMENT LEA_obd_ii_P1108_pass_counter "Learned/adaptive value: OBD-II P1108 pass counter." UBYTE NO_COMPU_METHOD 0 0 0 255 ECU_ADDRESS 0x40004C95 /end MEASUREMENT
/begin MEASUREMENT LEA_obd_ii_P1109_dtc_state "Learned/adaptive value: OBD-II P1109 DTC state." UBYTE NO_COMPU_METHOD 0 0 0 255 ECU_ADDRESS 0x40004C96 /end MEASUREMENT
/begin MEASUREMENT LEA_obd_ii_P1109_fail_counter "Learned/adaptive value: OBD-II P1109 fail counter." UBYTE NO_COMPU_METHOD 0 0 0 255 ECU_ADDRESS 0x40004C97 /end MEASUREMENT
/begin MEASUREMENT LEA_obd_ii_P1109_pass_counter "Learned/adaptive value: OBD-II P1109 pass counter." UBYTE NO_COMPU_METHOD 0 0 0 255 ECU_ADDRESS 0x40004C98 /end MEASUREMENT
/begin MEASUREMENT LEA_obd_ii_P2754_dtc_state "Learned/adaptive value: OBD-II P2754 DTC state." UBYTE NO_COMPU_METHOD 0 0 0 255 ECU_ADDRESS 0x40004C99 /end MEASUREMENT
/begin MEASUREMENT LEA_obd_ii_P2754_fail_counter "Learned/adaptive value: OBD-II P2754 fail counter." UBYTE NO_COMPU_METHOD 0 0 0 255 ECU_ADDRESS 0x40004C9A /end MEASUREMENT
/begin MEASUREMENT LEA_obd_ii_P2754_pass_counter "Learned/adaptive value: OBD-II P2754 pass counter." UBYTE NO_COMPU_METHOD 0 0 0 255 ECU_ADDRESS 0x40004C9B /end MEASUREMENT
/begin MEASUREMENT LEA_obd_ii_P2755_dtc_state "Learned/adaptive value: OBD-II P2755 DTC state." UBYTE NO_COMPU_METHOD 0 0 0 255 ECU_ADDRESS 0x40004C9C /end MEASUREMENT
/begin MEASUREMENT LEA_obd_ii_P2755_fail_counter "Learned/adaptive value: OBD-II P2755 fail counter." UBYTE NO_COMPU_METHOD 0 0 0 255 ECU_ADDRESS 0x40004C9D /end MEASUREMENT
/begin MEASUREMENT LEA_obd_ii_P2755_pass_counter "Learned/adaptive value: OBD-II P2755 pass counter." UBYTE NO_COMPU_METHOD 0 0 0 255 ECU_ADDRESS 0x40004C9E /end MEASUREMENT
/begin MEASUREMENT LEA_obd_ii_P0897_dtc_state "Learned/adaptive value: OBD-II P0897 DTC state." UBYTE NO_COMPU_METHOD 0 0 0 255 ECU_ADDRESS 0x40004C9F /end MEASUREMENT
/begin MEASUREMENT LEA_obd_ii_P0897_fail_counter "Learned/adaptive value: OBD-II P0897 fail counter." UBYTE NO_COMPU_METHOD 0 0 0 255 ECU_ADDRESS 0x40004CA0 /end MEASUREMENT
/begin MEASUREMENT LEA_obd_ii_P0897_pass_counter "Learned/adaptive value: OBD-II P0897 pass counter." UBYTE NO_COMPU_METHOD 0 0 0 255 ECU_ADDRESS 0x40004CA1 /end MEASUREMENT
/begin MEASUREMENT LEA_obd_ii_P2797_dtc_state "Learned/adaptive value: OBD-II P2797 DTC state." UBYTE NO_COMPU_METHOD 0 0 0 255 ECU_ADDRESS 0x40004CA2 /end MEASUREMENT
/begin MEASUREMENT LEA_obd_ii_P2797_fail_counter "Learned/adaptive value: OBD-II P2797 fail counter." UBYTE NO_COMPU_METHOD 0 0 0 255 ECU_ADDRESS 0x40004CA3 /end MEASUREMENT
/begin MEASUREMENT LEA_obd_ii_P2797_pass_counter "Learned/adaptive value: OBD-II P2797 pass counter." UBYTE NO_COMPU_METHOD 0 0 0 255 ECU_ADDRESS 0x40004CA4 /end MEASUREMENT
/begin MEASUREMENT LEA_obd_ii_B1422_dtc_state "Learned/adaptive value: OBD-II B1422 DTC state." UBYTE NO_COMPU_METHOD 0 0 0 255 ECU_ADDRESS 0x40004CA5 /end MEASUREMENT
/begin MEASUREMENT LEA_obd_ii_B1422_fail_counter "Learned/adaptive value: OBD-II B1422 fail counter." UBYTE NO_COMPU_METHOD 0 0 0 255 ECU_ADDRESS 0x40004CA6 /end MEASUREMENT
/begin MEASUREMENT LEA_obd_ii_B1422_pass_counter "Learned/adaptive value: OBD-II B1422 pass counter." UBYTE NO_COMPU_METHOD 0 0 0 255 ECU_ADDRESS 0x40004CA7 /end MEASUREMENT
/begin MEASUREMENT LEA_obd_ii_U0101_dtc_state "Learned/adaptive value: OBD-II U0101 DTC state." UBYTE NO_COMPU_METHOD 0 0 0 255 ECU_ADDRESS 0x40004CA8 /end MEASUREMENT
/begin MEASUREMENT LEA_obd_ii_U0101_fail_counter "Learned/adaptive value: OBD-II U0101 fail counter." UBYTE NO_COMPU_METHOD 0 0 0 255 ECU_ADDRESS 0x40004CA9 /end MEASUREMENT
/begin MEASUREMENT LEA_obd_ii_U0101_pass_counter "Learned/adaptive value: OBD-II U0101 pass counter." UBYTE NO_COMPU_METHOD 0 0 0 255 ECU_ADDRESS 0x40004CAA /end MEASUREMENT
/begin MEASUREMENT LEA_obd_ii_U0109_dtc_state "Learned/adaptive value: OBD-II U0109 DTC state." UBYTE NO_COMPU_METHOD 0 0 0 255 ECU_ADDRESS 0x40004CAB /end MEASUREMENT
/begin MEASUREMENT LEA_obd_ii_U0109_fail_counter "Learned/adaptive value: OBD-II U0109 fail counter." UBYTE NO_COMPU_METHOD 0 0 0 255 ECU_ADDRESS 0x40004CAC /end MEASUREMENT
/begin MEASUREMENT LEA_obd_ii_U0109_pass_counter "Learned/adaptive value: OBD-II U0109 pass counter." UBYTE NO_COMPU_METHOD 0 0 0 255 ECU_ADDRESS 0x40004CAD /end MEASUREMENT
/begin MEASUREMENT LEA_obd_ii_U0122_dtc_state "Learned/adaptive value: OBD-II U0122 DTC state." UBYTE NO_COMPU_METHOD 0 0 0 255 ECU_ADDRESS 0x40004CAE /end MEASUREMENT
/begin MEASUREMENT LEA_obd_ii_U0122_fail_counter "Learned/adaptive value: OBD-II U0122 fail counter." UBYTE NO_COMPU_METHOD 0 0 0 255 ECU_ADDRESS 0x40004CAF /end MEASUREMENT
/begin MEASUREMENT LEA_obd_ii_U0122_pass_counter "Learned/adaptive value: OBD-II U0122 pass counter." UBYTE NO_COMPU_METHOD 0 0 0 255 ECU_ADDRESS 0x40004CB0 /end MEASUREMENT
/begin MEASUREMENT LEA_obd_ii_U0123_dtc_state "Learned/adaptive value: OBD-II U0123 DTC state." UBYTE NO_COMPU_METHOD 0 0 0 255 ECU_ADDRESS 0x40004CB1 /end MEASUREMENT
/begin MEASUREMENT LEA_obd_ii_U0123_fail_counter "Learned/adaptive value: OBD-II U0123 fail counter." UBYTE NO_COMPU_METHOD 0 0 0 255 ECU_ADDRESS 0x40004CB2 /end MEASUREMENT
/begin MEASUREMENT LEA_obd_ii_U0123_pass_counter "Learned/adaptive value: OBD-II U0123 pass counter." UBYTE NO_COMPU_METHOD 0 0 0 255 ECU_ADDRESS 0x40004CB3 /end MEASUREMENT
/begin MEASUREMENT LEA_obd_ii_U0155_dtc_state "Learned/adaptive value: OBD-II U0155 DTC state." UBYTE NO_COMPU_METHOD 0 0 0 255 ECU_ADDRESS 0x40004CB4 /end MEASUREMENT
/begin MEASUREMENT LEA_obd_ii_U0155_fail_counter "Learned/adaptive value: OBD-II U0155 fail counter." UBYTE NO_COMPU_METHOD 0 0 0 255 ECU_ADDRESS 0x40004CB5 /end MEASUREMENT
/begin MEASUREMENT LEA_obd_ii_U0155_pass_counter "Learned/adaptive value: OBD-II U0155 pass counter." UBYTE NO_COMPU_METHOD 0 0 0 255 ECU_ADDRESS 0x40004CB6 /end MEASUREMENT
/begin MEASUREMENT LEA_obd_ii_U0302_dtc_state "Learned/adaptive value: OBD-II U0302 DTC state." UBYTE NO_COMPU_METHOD 0 0 0 255 ECU_ADDRESS 0x40004CB7 /end MEASUREMENT
/begin MEASUREMENT LEA_obd_ii_U0302_fail_counter "Learned/adaptive value: OBD-II U0302 fail counter." UBYTE NO_COMPU_METHOD 0 0 0 255 ECU_ADDRESS 0x40004CB8 /end MEASUREMENT
/begin MEASUREMENT LEA_obd_ii_U0302_pass_counter "Learned/adaptive value: OBD-II U0302 pass counter." UBYTE NO_COMPU_METHOD 0 0 0 255 ECU_ADDRESS 0x40004CB9 /end MEASUREMENT
/begin MEASUREMENT LEA_obd_ii_U0316_dtc_state "Learned/adaptive value: OBD-II U0316 DTC state." UBYTE NO_COMPU_METHOD 0 0 0 255 ECU_ADDRESS 0x40004CBA /end MEASUREMENT
/begin MEASUREMENT LEA_obd_ii_U0316_fail_counter "Learned/adaptive value: OBD-II U0316 fail counter." UBYTE NO_COMPU_METHOD 0 0 0 255 ECU_ADDRESS 0x40004CBB /end MEASUREMENT
/begin MEASUREMENT LEA_obd_ii_U0316_pass_counter "Learned/adaptive value: OBD-II U0316 pass counter." UBYTE NO_COMPU_METHOD 0 0 0 255 ECU_ADDRESS 0x40004CBC /end MEASUREMENT
/begin MEASUREMENT LEA_obd_ii_U0416_dtc_state "Learned/adaptive value: OBD-II U0416 DTC state." UBYTE NO_COMPU_METHOD 0 0 0 255 ECU_ADDRESS 0x40004CBD /end MEASUREMENT
/begin MEASUREMENT LEA_obd_ii_U0416_fail_counter "Learned/adaptive value: OBD-II U0416 fail counter." UBYTE NO_COMPU_METHOD 0 0 0 255 ECU_ADDRESS 0x40004CBE /end MEASUREMENT
/begin MEASUREMENT LEA_obd_ii_U0416_pass_counter "Learned/adaptive value: OBD-II U0416 pass counter." UBYTE NO_COMPU_METHOD 0 0 0 255 ECU_ADDRESS 0x40004CBF /end MEASUREMENT
/begin MEASUREMENT LEA_obd_ii_U0513_dtc_state "Learned/adaptive value: OBD-II U0513 DTC state." UBYTE NO_COMPU_METHOD 0 0 0 255 ECU_ADDRESS 0x40004CC0 /end MEASUREMENT
/begin MEASUREMENT LEA_obd_ii_U0513_fail_counter "Learned/adaptive value: OBD-II U0513 fail counter." UBYTE NO_COMPU_METHOD 0 0 0 255 ECU_ADDRESS 0x40004CC1 /end MEASUREMENT
/begin MEASUREMENT LEA_obd_ii_U0513_pass_counter "Learned/adaptive value: OBD-II U0513 pass counter." UBYTE NO_COMPU_METHOD 0 0 0 255 ECU_ADDRESS 0x40004CC2 /end MEASUREMENT
/begin MEASUREMENT LEA_unused_byte1 "Learned/adaptive value: unused byte1." UBYTE NO_COMPU_METHOD 0 0 0 255 ECU_ADDRESS 0x40004CC3 /end MEASUREMENT
/begin MEASUREMENT LEA_write_size "LEA write size stored for the full-block CRC check (0x1BE4). Was lea_write_size." ULONG NO_COMPU_METHOD 0 0 0 4294967295 ECU_ADDRESS 0x40004CC4 /end MEASUREMENT
/begin MEASUREMENT LEA_crc_full "CRC16 of the full LEA block. Was lea_crc_full." ULONG NO_COMPU_METHOD 0 0 0 4294967295 ECU_ADDRESS 0x40004CC8 /end MEASUREMENT
/begin MEASUREMENT inj_transient_load_alphan_hist "inj_transient_ramp_200hz: load_computed_alphaN shift history (newest first, mg/stroke); delta vs older sample feeds the transient ramp." UWORD CM_u8_load_mg_stroke 0 0 0 65535 ECU_ADDRESS 0x40004D20 /end MEASUREMENT
/begin MEASUREMENT sensor_rationality_fault_flags "Per-fault active flags indexed by the monitor record fault index." UBYTE NO_COMPU_METHOD 0 0 0 255 ECU_ADDRESS 0x40004F0C /end MEASUREMENT
/begin MEASUREMENT hc08_crc16 "uint16_t" UWORD NO_COMPU_METHOD 0 0 0 65535 ECU_ADDRESS 0x40004F30 /end MEASUREMENT
/begin MEASUREMENT throttle_actuator_state "Throttle actuator state (enumerated state)." UBYTE NO_COMPU_METHOD 0 0 0 255 ECU_ADDRESS 0x40004F32 /end MEASUREMENT
/begin MEASUREMENT hc08_obd_flags "HC08 status bits reported to OBD: bit4 safety-fallback (SF) mode active, bit6/7 HC08 / ETB module internal fault (P2107)." UBYTE NO_COMPU_METHOD 0 0 0 255 ECU_ADDRESS 0x40004F33 /end MEASUREMENT
/begin MEASUREMENT misfire_baseline_cyl6_q8 "Misfire learned baseline table cyl 6 ((LEA_misfire_baseline_cyl6 - 128) << 8)." SWORD NO_COMPU_METHOD 0 0 -32768 32767 ECU_ADDRESS 0x40005600 /end MEASUREMENT
/begin MEASUREMENT misfire_baseline_cyl5_q8 "Misfire learned baseline table cyl 5 ((LEA_misfire_baseline_cyl5 - 128) << 8)." SWORD NO_COMPU_METHOD 0 0 -32768 32767 ECU_ADDRESS 0x40005734 /end MEASUREMENT
/begin MEASUREMENT misfire_baseline_cyl4_q8 "Misfire learned baseline table cyl 4 ((LEA_misfire_baseline_cyl4 - 128) << 8)." SWORD NO_COMPU_METHOD 0 0 -32768 32767 ECU_ADDRESS 0x40005868 /end MEASUREMENT
/begin MEASUREMENT misfire_baseline_cyl3_q8 "Misfire learned baseline table cyl 3 ((LEA_misfire_baseline_cyl3 - 128) << 8)." SWORD NO_COMPU_METHOD 0 0 -32768 32767 ECU_ADDRESS 0x4000599C /end MEASUREMENT
/begin MEASUREMENT misfire_baseline_cyl2_q8 "Misfire learned baseline table cyl 2 ((LEA_misfire_baseline_cyl2 - 128) << 8)." SWORD NO_COMPU_METHOD 0 0 -32768 32767 ECU_ADDRESS 0x40005AD0 /end MEASUREMENT
/begin MEASUREMENT misfire_baseline_cyl1_q8 "Misfire learned baseline table cyl 1 ((LEA_misfire_baseline_cyl1 - 128) << 8)." SWORD NO_COMPU_METHOD 0 0 -32768 32767 ECU_ADDRESS 0x40005C04 /end MEASUREMENT
/begin MEASUREMENT obd_ii_iumpr_group_numerator "IUMPR group minimum table (stride 8): +0 numerator." UWORD NO_COMPU_METHOD 0 0 0 65535 ECU_ADDRESS 0x40005FD0 /end MEASUREMENT
/begin MEASUREMENT LEA_obd_ii_J1979_O2SCOND1 "Learned/adaptive value: OBD-II J1979 O2SCOND1." UWORD NO_COMPU_METHOD 0 0 0 65535 ECU_ADDRESS 0x40005FD2 /end MEASUREMENT
/begin MEASUREMENT LEA_obd_ii_J1979_O2SCOMP1 "Learned/adaptive value: OBD-II J1979 O2SCOMP1." UWORD NO_COMPU_METHOD 0 0 0 65535 ECU_ADDRESS 0x40005FD4 /end MEASUREMENT
/begin MEASUREMENT obd_ii_iumpr_group_denominator "IUMPR group minimum table (stride 8): +6 denominator." UWORD NO_COMPU_METHOD 0 0 0 65535 ECU_ADDRESS 0x40005FD6 /end MEASUREMENT
/begin MEASUREMENT LEA_obd_ii_J1979_O2SCOND2 "Learned/adaptive value: OBD-II J1979 O2SCOND2." UWORD NO_COMPU_METHOD 0 0 0 65535 ECU_ADDRESS 0x40005FDA /end MEASUREMENT
/begin MEASUREMENT LEA_obd_ii_J1979_O2SCOMP2 "Learned/adaptive value: OBD-II J1979 O2SCOMP2." UWORD NO_COMPU_METHOD 0 0 0 65535 ECU_ADDRESS 0x40005FDC /end MEASUREMENT
/begin MEASUREMENT LEA_obd_ii_J1979_CATCOND1 "Learned/adaptive value: OBD-II J1979 CATCOND1." UWORD NO_COMPU_METHOD 0 0 0 65535 ECU_ADDRESS 0x40005FE2 /end MEASUREMENT
/begin MEASUREMENT LEA_obd_ii_J1979_CAT_COMP1 "Learned/adaptive value: OBD-II J1979 CAT COMP1." UWORD NO_COMPU_METHOD 0 0 0 65535 ECU_ADDRESS 0x40005FE4 /end MEASUREMENT
/begin MEASUREMENT LEA_obd_ii_J1979_CATCOND2 "Learned/adaptive value: OBD-II J1979 CATCOND2." UWORD NO_COMPU_METHOD 0 0 0 65535 ECU_ADDRESS 0x40005FEA /end MEASUREMENT
/begin MEASUREMENT LEA_obd_ii_J1979_CATCOMP2 "Learned/adaptive value: OBD-II J1979 CATCOMP2." UWORD NO_COMPU_METHOD 0 0 0 65535 ECU_ADDRESS 0x40005FEC /end MEASUREMENT
/begin MEASUREMENT LEA_obd_ii_J1979_EGRCOND "Learned/adaptive value: OBD-II J1979 EGRCOND." UWORD NO_COMPU_METHOD 0 0 0 65535 ECU_ADDRESS 0x40005FF2 /end MEASUREMENT
/begin MEASUREMENT LEA_obd_ii_J1979_EGRCOMP "Learned/adaptive value: OBD-II J1979 EGRCOMP." UWORD NO_COMPU_METHOD 0 0 0 65535 ECU_ADDRESS 0x40005FF4 /end MEASUREMENT
/begin MEASUREMENT LEA_obd_ii_J1979_EVAPCOND "Learned/adaptive value: OBD-II J1979 EVAPCOND." UWORD NO_COMPU_METHOD 0 0 0 65535 ECU_ADDRESS 0x40005FFA /end MEASUREMENT
/begin MEASUREMENT LEA_obd_ii_J1979_EVAPCOMP "Learned/adaptive value: OBD-II J1979 EVAPCOMP." UWORD NO_COMPU_METHOD 0 0 0 65535 ECU_ADDRESS 0x40005FFC /end MEASUREMENT
/begin MEASUREMENT LEA_obd_ii_J1979_SO2SCOND1 "Learned/adaptive value: OBD-II J1979 SO2SCOND1." UWORD NO_COMPU_METHOD 0 0 0 65535 ECU_ADDRESS 0x40006002 /end MEASUREMENT
/begin MEASUREMENT LEA_obd_ii_J1979_SO2SCOMP1 "Learned/adaptive value: OBD-II J1979 SO2SCOMP1." UWORD NO_COMPU_METHOD 0 0 0 65535 ECU_ADDRESS 0x40006004 /end MEASUREMENT
/begin MEASUREMENT LEA_obd_ii_J1979_S02SCOND2 "Learned/adaptive value: OBD-II J1979 S02SCOND2." UWORD NO_COMPU_METHOD 0 0 0 65535 ECU_ADDRESS 0x4000600A /end MEASUREMENT
/begin MEASUREMENT LEA_obd_ii_J1979_SO2SCOMP2 "Learned/adaptive value: OBD-II J1979 SO2SCOMP2." UWORD NO_COMPU_METHOD 0 0 0 65535 ECU_ADDRESS 0x4000600C /end MEASUREMENT
/begin MEASUREMENT obd_ii_iumpr_monitors "IUMPR monitor records (stride 16): +0 u16 denominator, +2 u8 denominator incremented this cycle, +4 u16 numerator, +6 u8 numerator incremented, +8 u16 ratio, +0xa/+0xb u8 condition flags, +0xc u16 monitor id (0x85, 0x99), +0xe u8 group." UWORD NO_COMPU_METHOD 0 0 0 65535 ECU_ADDRESS 0x40006010 /end MEASUREMENT
/begin MEASUREMENT obd_ii_iumpr_denom_done "IUMPR record +2: denominator incremented this cycle." UBYTE NO_COMPU_METHOD 0 0 0 255 ECU_ADDRESS 0x40006012 /end MEASUREMENT
/begin MEASUREMENT obd_ii_iumpr_numerator "IUMPR record +4: numerator (LEA_obd_ii_iumpr_numerator)." UWORD NO_COMPU_METHOD 0 0 0 65535 ECU_ADDRESS 0x40006014 /end MEASUREMENT
/begin MEASUREMENT obd_ii_iumpr_numer_done "IUMPR record +6: numerator incremented this cycle." UBYTE NO_COMPU_METHOD 0 0 0 255 ECU_ADDRESS 0x40006016 /end MEASUREMENT
/begin MEASUREMENT obd_ii_iumpr_ratio "IUMPR record +8: numerator/denominator ratio (0xffff when undefined)." UWORD NO_COMPU_METHOD 0 0 0 65535 ECU_ADDRESS 0x40006018 /end MEASUREMENT
/begin MEASUREMENT obd_ii_iumpr_cond_a "IUMPR record +0xa: condition flag." UBYTE NO_COMPU_METHOD 0 0 0 255 ECU_ADDRESS 0x4000601A /end MEASUREMENT
/begin MEASUREMENT obd_ii_iumpr_cond_b "IUMPR record +0xb: condition flag." UBYTE NO_COMPU_METHOD 0 0 0 255 ECU_ADDRESS 0x4000601B /end MEASUREMENT
/begin MEASUREMENT obd_ii_iumpr_monitor_id "IUMPR record +0xc: monitor id (0x85, 0x99)." UWORD NO_COMPU_METHOD 0 0 0 65535 ECU_ADDRESS 0x4000601C /end MEASUREMENT
/begin MEASUREMENT obd_ii_iumpr_group "IUMPR record +0xe: group id." UBYTE NO_COMPU_METHOD 0 0 0 255 ECU_ADDRESS 0x4000601E /end MEASUREMENT
/begin MEASUREMENT throttle_cmd_lowpass_state "Biquad low-pass state for throttle_command_actuator (init_tps_biquad_filters)." ULONG NO_COMPU_METHOD 0 0 0 4294967295 ECU_ADDRESS 0x400061B0 /end MEASUREMENT
/begin MEASUREMENT tps_unknown_history "Throttle position history (structure)." ULONG NO_COMPU_METHOD 0 0 0 4294967295 ECU_ADDRESS 0x400061D4 /end MEASUREMENT
/begin MEASUREMENT tps_smooth_filter_state "Throttle position smooth filter state (structure)." ULONG NO_COMPU_METHOD 0 0 0 4294967295 ECU_ADDRESS 0x400061F8 /end MEASUREMENT
/begin MEASUREMENT knock_freq_bin_index "uint8_t" UBYTE NO_COMPU_METHOD 0 0 0 255 ECU_ADDRESS 0x40006620 /end MEASUREMENT
/begin MEASUREMENT knock_energy_sum "Knock DSP total bin energy (mode1); per-window sums in mode4." SLONG NO_COMPU_METHOD 0 0 -2147483648 2147483647 ECU_ADDRESS 0x40006848 /end MEASUREMENT
/begin MEASUREMENT knock_energy_x2_sum "Knock DSP total of knock_bin_energy_x2." SLONG NO_COMPU_METHOD 0 0 -2147483648 2147483647 ECU_ADDRESS 0x4000684C /end MEASUREMENT
/begin MEASUREMENT knock_bin_energy "int" SLONG NO_COMPU_METHOD 0 0 -2147483648 2147483647 ECU_ADDRESS 0x40006874 /end MEASUREMENT
/begin MEASUREMENT chlog_response "Channel-logger response frame byte 0 (0xff), buffer runs to 0x40007d3c." UBYTE NO_COMPU_METHOD 0 0 0 255 ECU_ADDRESS 0x400068A0 /end MEASUREMENT
/begin MEASUREMENT chlog_response_status "Channel-logger response byte 1 (status, 0x30, ...)." UBYTE NO_COMPU_METHOD 0 0 0 255 ECU_ADDRESS 0x400068A1 /end MEASUREMENT
/begin MEASUREMENT chlog_response_cmd "Channel-logger response byte 2 (echoed command)." UBYTE NO_COMPU_METHOD 0 0 0 255 ECU_ADDRESS 0x400068A2 /end MEASUREMENT
/begin MEASUREMENT chlog_response_result "Channel-logger response byte 3 (result / data)." UBYTE NO_COMPU_METHOD 0 0 0 255 ECU_ADDRESS 0x400068A3 /end MEASUREMENT
/begin MEASUREMENT chlog_response_data "Channel-logger response bytes 4..7 (data / checksum)." ULONG NO_COMPU_METHOD 0 0 0 4294967295 ECU_ADDRESS 0x400068A4 /end MEASUREMENT
/begin MEASUREMENT flexcan_tx_queue_state_flags "FlexCAN TX queue state (bit3 = CCP 0x351 TX pending)." UBYTE NO_COMPU_METHOD 0 0 0 255 ECU_ADDRESS 0x400068A8 /end MEASUREMENT
/begin MEASUREMENT chlog_flag_400068a9 "Cleared in chlog_command_dispatch." UBYTE NO_COMPU_METHOD 0 0 0 255 ECU_ADDRESS 0x400068A9 /end MEASUREMENT
/begin MEASUREMENT diag_stream_ptr "Diagnostic stream read/write pointers, indexed by stream." ULONG NO_COMPU_METHOD 0 0 0 4294967295 ECU_ADDRESS 0x400068AC /end MEASUREMENT
/begin MEASUREMENT diag_tx_ptr "diagnostic_tx_unknown source pointer (checksummed as it advances)." ULONG NO_COMPU_METHOD 0 0 0 4294967295 ECU_ADDRESS 0x400068B0 /end MEASUREMENT
/begin MEASUREMENT queue_len "Queue len." UBYTE NO_COMPU_METHOD 0 0 0 255 ECU_ADDRESS 0x400068B4 /end MEASUREMENT
/begin MEASUREMENT queue_head "uint8_t" UBYTE NO_COMPU_METHOD 0 0 0 255 ECU_ADDRESS 0x400068B5 /end MEASUREMENT
/begin MEASUREMENT queue_buffer "Queue buffer (pointer)." ULONG NO_COMPU_METHOD 0 0 0 4294967295 ECU_ADDRESS 0x400068B6 /end MEASUREMENT
/begin MEASUREMENT telemetry_queue_b4 "Telemetry queue entry byte (data[4])." UBYTE NO_COMPU_METHOD 0 0 0 255 ECU_ADDRESS 0x400068BA /end MEASUREMENT
/begin MEASUREMENT telemetry_queue_b5 "Telemetry queue entry byte." UBYTE NO_COMPU_METHOD 0 0 0 255 ECU_ADDRESS 0x400068BB /end MEASUREMENT
/begin MEASUREMENT telemetry_queue_b6 "Telemetry queue entry byte (data[6])." UBYTE NO_COMPU_METHOD 0 0 0 255 ECU_ADDRESS 0x400068BC /end MEASUREMENT
/begin MEASUREMENT telemetry_queue_b7 "Telemetry queue entry byte." UBYTE NO_COMPU_METHOD 0 0 0 255 ECU_ADDRESS 0x400068BD /end MEASUREMENT
/begin MEASUREMENT chlog_poke_dst "Channel-logger pending write target." ULONG NO_COMPU_METHOD 0 0 0 4294967295 ECU_ADDRESS 0x40006C78 /end MEASUREMENT
/begin MEASUREMENT chlog_poke_slot "Channel-logger pending slot descriptor (group*0x1ac + index*7)." ULONG NO_COMPU_METHOD 0 0 0 4294967295 ECU_ADDRESS 0x40006C7C /end MEASUREMENT
/begin MEASUREMENT chlog_groups "Channel-logger group records (stride 0x1ac)." UBYTE NO_COMPU_METHOD 0 0 0 255 ECU_ADDRESS 0x40006C80 /end MEASUREMENT
/begin MEASUREMENT chlog_group_period "Group record +0x1a4: send period reload." UWORD NO_COMPU_METHOD 0 0 0 65535 ECU_ADDRESS 0x40006E24 /end MEASUREMENT
/begin MEASUREMENT chlog_group_countdown "Group record +0x1a6: send countdown." UWORD NO_COMPU_METHOD 0 0 0 65535 ECU_ADDRESS 0x40006E26 /end MEASUREMENT
/begin MEASUREMENT chlog_group_slot "Group record +0x1a8: schedule slot." UBYTE NO_COMPU_METHOD 0 0 0 255 ECU_ADDRESS 0x40006E28 /end MEASUREMENT
/begin MEASUREMENT chlog_group_nchan "Group record +0x1a9: channel count - 1." UBYTE NO_COMPU_METHOD 0 0 0 255 ECU_ADDRESS 0x40006E29 /end MEASUREMENT
/begin MEASUREMENT chlog_group_state "Group record +0x1aa: state (bit0 running, 4 armed)." UBYTE NO_COMPU_METHOD 0 0 0 255 ECU_ADDRESS 0x40006E2A /end MEASUREMENT
/begin MEASUREMENT diag_tx_pending_len "Bytes left to send in diagnostic_tx_unknown." UWORD NO_COMPU_METHOD 0 0 0 65535 ECU_ADDRESS 0x40007D3A /end MEASUREMENT
/begin MEASUREMENT esci_a_rx_buf "eSCI A receive circular buffer." UBYTE NO_COMPU_METHOD 0 0 0 255 ECU_ADDRESS 0x40007F78 /end MEASUREMENT
/begin MEASUREMENT etb_driver_fault_debounce "struct_tps_shaping_flags" ULONG NO_COMPU_METHOD 0 0 0 4294967295 ECU_ADDRESS 0x40007FE8 /end MEASUREMENT
/begin MEASUREMENT accel_pedal_pos_d_clipped "Accelerator pedal position d clipped (structure)." ULONG NO_COMPU_METHOD 0 0 0 4294967295 ECU_ADDRESS 0x40007FFC /end MEASUREMENT
/begin MEASUREMENT accel_pedal_pos_e_clipped "Accelerator pedal position e clipped (structure)." ULONG NO_COMPU_METHOD 0 0 0 4294967295 ECU_ADDRESS 0x40008010 /end MEASUREMENT
/begin MEASUREMENT adc37_threshold "Adc37 threshold (structure)." ULONG NO_COMPU_METHOD 0 0 0 4294967295 ECU_ADDRESS 0x40008038 /end MEASUREMENT
/begin MEASUREMENT COD_base "COD base (structure)." ULONG NO_COMPU_METHOD 0 0 0 4294967295 ECU_ADDRESS 0x40008060 /end MEASUREMENT
/begin MEASUREMENT COD_VIN "char" UBYTE NO_COMPU_METHOD 0 0 0 255 ECU_ADDRESS 0x40008068 /end MEASUREMENT
/begin MEASUREMENT COD_model_name "char" UBYTE NO_COMPU_METHOD 0 0 0 255 ECU_ADDRESS 0x40008080 /end MEASUREMENT
/begin MEASUREMENT coding_crc "uint16_t" UWORD NO_COMPU_METHOD 0 0 0 65535 ECU_ADDRESS 0x400080A0 /end MEASUREMENT
/begin MEASUREMENT ips_shift_state "undefined" ULONG NO_COMPU_METHOD 0 0 0 4294967295 ECU_ADDRESS 0x400080A8 /end MEASUREMENT
/begin MEASUREMENT eh_table_base "Registered exception-handling table (eh_register_table)." ULONG NO_COMPU_METHOD 0 0 0 4294967295 ECU_ADDRESS 0x40008150 /end MEASUREMENT
/begin MEASUREMENT eh_table_size "Registered exception-handling table size." ULONG NO_COMPU_METHOD 0 0 0 4294967295 ECU_ADDRESS 0x40008154 /end MEASUREMENT
/begin MEASUREMENT eh_table_registered "Set once eh_register_table has run." ULONG NO_COMPU_METHOD 0 0 0 4294967295 ECU_ADDRESS 0x40008158 /end MEASUREMENT
/begin MEASUREMENT V_CAL_dca_tps_limit_manual_X_time "Input of CAL_dca_tps_limit_manual_X_time: (dca_tps_ramp_index >> 2) & 0xff" SLONG CM_V_CAL_dca_tps_limit_manual_X_time 0 0 -2147483648 2147483647 /begin VIRTUAL dca_tps_ramp_index /end VIRTUAL /end MEASUREMENT
/begin COMPU_METHOD CM_V_CAL_dca_tps_limit_manual_X_time "raw input of CAL_dca_tps_limit_manual_X_time" FORM "%8.0" "" /begin FORMULA "(X1 >> 2) & 0xff" /end FORMULA /end COMPU_METHOD
/begin MEASUREMENT V_CAL_dca_unknown_ips_nolc_X_time "Input of CAL_dca_unknown_ips_nolc_X_time: (dca_tps_ramp_index >> 2) & 0xff" SLONG CM_V_CAL_dca_unknown_ips_nolc_X_time 0 0 -2147483648 2147483647 /begin VIRTUAL dca_tps_ramp_index /end VIRTUAL /end MEASUREMENT
/begin COMPU_METHOD CM_V_CAL_dca_unknown_ips_nolc_X_time "raw input of CAL_dca_unknown_ips_nolc_X_time" FORM "%8.0" "" /begin FORMULA "(X1 >> 2) & 0xff" /end FORMULA /end COMPU_METHOD
/begin MEASUREMENT V_CAL_dpm_slip_target_from_pedal_Y_pps "Input of CAL_dpm_slip_target_from_pedal_Y_pps: accel_pedal_latched >> 2 & 0xff" SLONG CM_V_CAL_dpm_slip_target_from_pedal_Y_pps 0 0 -2147483648 2147483647 /begin VIRTUAL accel_pedal_latched /end VIRTUAL /end MEASUREMENT
/begin COMPU_METHOD CM_V_CAL_dpm_slip_target_from_pedal_Y_pps "raw input of CAL_dpm_slip_target_from_pedal_Y_pps" FORM "%8.0" "" /begin FORMULA "X1 >> 2 & 0xff" /end FORMULA /end COMPU_METHOD
/begin MEASUREMENT V_CAL_evap_purge_flow_coefficient_Y_vacuum "Input of CAL_evap_purge_flow_coefficient_Y_vacuum: evap_purge_vacuum_filtered >> 2 & 0xff" SLONG CM_V_CAL_evap_purge_flow_coefficient_Y_vacuum 0 0 -2147483648 2147483647 /begin VIRTUAL evap_purge_vacuum_filtered /end VIRTUAL /end MEASUREMENT
/begin COMPU_METHOD CM_V_CAL_evap_purge_flow_coefficient_Y_vacuum "raw input of CAL_evap_purge_flow_coefficient_Y_vacuum" FORM "%8.0" "" /begin FORMULA "X1 >> 2 & 0xff" /end FORMULA /end COMPU_METHOD
/begin MEASUREMENT V_CAL_exhaust_flap_state_control_race_X_rpm "Input of CAL_exhaust_flap_state_control_race_X_rpm: (engine_speed_16bit / 0x32) & 0xff" SLONG CM_V_CAL_exhaust_flap_state_control_race_X_rpm 0 0 -2147483648 2147483647 /begin VIRTUAL engine_speed_16bit /end VIRTUAL /end MEASUREMENT
/begin COMPU_METHOD CM_V_CAL_exhaust_flap_state_control_race_X_rpm "raw input of CAL_exhaust_flap_state_control_race_X_rpm" FORM "%8.0" "" /begin FORMULA "(X1 / 0x32) & 0xff" /end FORMULA /end COMPU_METHOD
/begin MEASUREMENT V_CAL_exhaust_flap_state_control_race_Y_accel_pedal "Input of CAL_exhaust_flap_state_control_race_Y_accel_pedal: (accel_pedal_latched >> 2) & 0xff" SLONG CM_V_CAL_exhaust_flap_state_control_race_Y_accel_pedal 0 0 -2147483648 2147483647 /begin VIRTUAL accel_pedal_latched /end VIRTUAL /end MEASUREMENT
/begin COMPU_METHOD CM_V_CAL_exhaust_flap_state_control_race_Y_accel_pedal "raw input of CAL_exhaust_flap_state_control_race_Y_accel_pedal" FORM "%8.0" "" /begin FORMULA "(X1 >> 2) & 0xff" /end FORMULA /end COMPU_METHOD
/begin MEASUREMENT V_CAL_exhaust_flap_state_control_sport_X_rpm "Input of CAL_exhaust_flap_state_control_sport_X_rpm: (engine_speed_16bit / 0x32) & 0xff" SLONG CM_V_CAL_exhaust_flap_state_control_sport_X_rpm 0 0 -2147483648 2147483647 /begin VIRTUAL engine_speed_16bit /end VIRTUAL /end MEASUREMENT
/begin COMPU_METHOD CM_V_CAL_exhaust_flap_state_control_sport_X_rpm "raw input of CAL_exhaust_flap_state_control_sport_X_rpm" FORM "%8.0" "" /begin FORMULA "(X1 / 0x32) & 0xff" /end FORMULA /end COMPU_METHOD
/begin MEASUREMENT V_CAL_exhaust_flap_state_control_sport_Y_accel_pedal "Input of CAL_exhaust_flap_state_control_sport_Y_accel_pedal: (accel_pedal_latched >> 2) & 0xff" SLONG CM_V_CAL_exhaust_flap_state_control_sport_Y_accel_pedal 0 0 -2147483648 2147483647 /begin VIRTUAL accel_pedal_latched /end VIRTUAL /end MEASUREMENT
/begin COMPU_METHOD CM_V_CAL_exhaust_flap_state_control_sport_Y_accel_pedal "raw input of CAL_exhaust_flap_state_control_sport_Y_accel_pedal" FORM "%8.0" "" /begin FORMULA "(X1 >> 2) & 0xff" /end FORMULA /end COMPU_METHOD
/begin MEASUREMENT V_CAL_exhaust_flap_state_control_tour_X_rpm "Input of CAL_exhaust_flap_state_control_tour_X_rpm: (engine_speed_16bit / 0x32) & 0xff" SLONG CM_V_CAL_exhaust_flap_state_control_tour_X_rpm 0 0 -2147483648 2147483647 /begin VIRTUAL engine_speed_16bit /end VIRTUAL /end MEASUREMENT
/begin COMPU_METHOD CM_V_CAL_exhaust_flap_state_control_tour_X_rpm "raw input of CAL_exhaust_flap_state_control_tour_X_rpm" FORM "%8.0" "" /begin FORMULA "(X1 / 0x32) & 0xff" /end FORMULA /end COMPU_METHOD
/begin MEASUREMENT V_CAL_exhaust_flap_state_control_tour_Y_accel_pedal "Input of CAL_exhaust_flap_state_control_tour_Y_accel_pedal: (accel_pedal_latched >> 2) & 0xff" SLONG CM_V_CAL_exhaust_flap_state_control_tour_Y_accel_pedal 0 0 -2147483648 2147483647 /begin VIRTUAL accel_pedal_latched /end VIRTUAL /end MEASUREMENT
/begin COMPU_METHOD CM_V_CAL_exhaust_flap_state_control_tour_Y_accel_pedal "raw input of CAL_exhaust_flap_state_control_tour_Y_accel_pedal" FORM "%8.0" "" /begin FORMULA "(X1 >> 2) & 0xff" /end FORMULA /end COMPU_METHOD
/begin MEASUREMENT V_CAL_fuel_pump_command_X_pressure "Input of CAL_fuel_pump_command_X_pressure: fuel_pressure_target_clamped * 0x32" SLONG CM_V_CAL_fuel_pump_command_X_pressure 0 0 -2147483648 2147483647 /begin VIRTUAL fuel_pressure_target_clamped /end VIRTUAL /end MEASUREMENT
/begin COMPU_METHOD CM_V_CAL_fuel_pump_command_X_pressure "raw input of CAL_fuel_pump_command_X_pressure" FORM "%8.0" "" /begin FORMULA "X1 * 0x32" /end FORMULA /end COMPU_METHOD
/begin MEASUREMENT V_CAL_idle_air_control_proportional_X_speed_error "Input of CAL_idle_air_control_proportional_X_speed_error: (obd_ii_idle_speed_error + 0x8000) & 0xffff" SLONG CM_V_CAL_idle_air_control_proportional_X_speed_error 0 0 -2147483648 2147483647 /begin VIRTUAL obd_ii_idle_speed_error /end VIRTUAL /end MEASUREMENT
/begin COMPU_METHOD CM_V_CAL_idle_air_control_proportional_X_speed_error "raw input of CAL_idle_air_control_proportional_X_speed_error" FORM "%8.0" "" /begin FORMULA "(X1 + 0x8000) & 0xffff" /end FORMULA /end COMPU_METHOD
/begin MEASUREMENT V_CAL_idle_comp_accel_pedal_pos_X_pps "Input of CAL_idle_comp_accel_pedal_pos_X_pps: (accel_pedal_latched >> 2) & 0xff" SLONG CM_V_CAL_idle_comp_accel_pedal_pos_X_pps 0 0 -2147483648 2147483647 /begin VIRTUAL accel_pedal_latched /end VIRTUAL /end MEASUREMENT
/begin COMPU_METHOD CM_V_CAL_idle_comp_accel_pedal_pos_X_pps "raw input of CAL_idle_comp_accel_pedal_pos_X_pps" FORM "%8.0" "" /begin FORMULA "(X1 >> 2) & 0xff" /end FORMULA /end COMPU_METHOD
/begin MEASUREMENT V_CAL_idle_error_correction_unknown_X_speed_error "Input of CAL_idle_error_correction_unknown_X_speed_error: (obd_ii_idle_speed_error + 0x8000) & 0xffff" SLONG CM_V_CAL_idle_error_correction_unknown_X_speed_error 0 0 -2147483648 2147483647 /begin VIRTUAL obd_ii_idle_speed_error /end VIRTUAL /end MEASUREMENT
/begin COMPU_METHOD CM_V_CAL_idle_error_correction_unknown_X_speed_error "raw input of CAL_idle_error_correction_unknown_X_speed_error" FORM "%8.0" "" /begin FORMULA "(X1 + 0x8000) & 0xffff" /end FORMULA /end COMPU_METHOD
/begin MEASUREMENT V_CAL_ign_comp_startup_tps_X_maf_accum "Input of CAL_ign_comp_startup_tps_X_maf_accum: (maf_accumulated_since_start_raw >> 3) & 0xff" SLONG CM_V_CAL_ign_comp_startup_tps_X_maf_accum 0 0 -2147483648 2147483647 /begin VIRTUAL maf_accumulated_since_start_raw /end VIRTUAL /end MEASUREMENT
/begin COMPU_METHOD CM_V_CAL_ign_comp_startup_tps_X_maf_accum "raw input of CAL_ign_comp_startup_tps_X_maf_accum" FORM "%8.0" "" /begin FORMULA "(X1 >> 3) & 0xff" /end FORMULA /end COMPU_METHOD
/begin MEASUREMENT V_CAL_ign_dwell_time_Y_ecu_voltage "Input of CAL_ign_dwell_time_Y_ecu_voltage: (sensor_adc_ecu_voltage >> 2) & 0xff" SLONG CM_V_CAL_ign_dwell_time_Y_ecu_voltage 0 0 -2147483648 2147483647 /begin VIRTUAL sensor_adc_ecu_voltage /end VIRTUAL /end MEASUREMENT
/begin COMPU_METHOD CM_V_CAL_ign_dwell_time_Y_ecu_voltage "raw input of CAL_ign_dwell_time_Y_ecu_voltage" FORM "%8.0" "" /begin FORMULA "(X1 >> 2) & 0xff" /end FORMULA /end COMPU_METHOD
/begin MEASUREMENT V_CAL_inj_coldstart_enrichment_Y_maf_accum "Input of CAL_inj_coldstart_enrichment_Y_maf_accum: (maf_accumulated_since_start_raw >> 4) & 0xff" SLONG CM_V_CAL_inj_coldstart_enrichment_Y_maf_accum 0 0 -2147483648 2147483647 /begin VIRTUAL maf_accumulated_since_start_raw /end VIRTUAL /end MEASUREMENT
/begin COMPU_METHOD CM_V_CAL_inj_coldstart_enrichment_Y_maf_accum "raw input of CAL_inj_coldstart_enrichment_Y_maf_accum" FORM "%8.0" "" /begin FORMULA "(X1 >> 4) & 0xff" /end FORMULA /end COMPU_METHOD
/begin MEASUREMENT V_CAL_inj_cranking_comp_air_temp_Y_maf_accum "Input of CAL_inj_cranking_comp_air_temp_Y_maf_accum: (maf_accumulated_since_start_raw >> 3) & 0xff" SLONG CM_V_CAL_inj_cranking_comp_air_temp_Y_maf_accum 0 0 -2147483648 2147483647 /begin VIRTUAL maf_accumulated_since_start_raw /end VIRTUAL /end MEASUREMENT
/begin COMPU_METHOD CM_V_CAL_inj_cranking_comp_air_temp_Y_maf_accum "raw input of CAL_inj_cranking_comp_air_temp_Y_maf_accum" FORM "%8.0" "" /begin FORMULA "(X1 >> 3) & 0xff" /end FORMULA /end COMPU_METHOD
/begin MEASUREMENT V_CAL_inj_cranking_enrichment_mass_accum_X_maf_accum "Input of CAL_inj_cranking_enrichment_mass_accum_X_maf_accum: (maf_accum_load_weighted_g >> 3) & 0xff" SLONG CM_V_CAL_inj_cranking_enrichment_mass_accum_X_maf_accum 0 0 -2147483648 2147483647 /begin VIRTUAL maf_accum_load_weighted_g /end VIRTUAL /end MEASUREMENT
/begin COMPU_METHOD CM_V_CAL_inj_cranking_enrichment_mass_accum_X_maf_accum "raw input of CAL_inj_cranking_enrichment_mass_accum_X_maf_accum" FORM "%8.0" "" /begin FORMULA "(X1 >> 3) & 0xff" /end FORMULA /end COMPU_METHOD
/begin MEASUREMENT V_CAL_inj_cranking_enrichment_soak_time_X_engine_off_time "Input of CAL_inj_cranking_enrichment_soak_time_X_engine_off_time: (engine_off_time_100ms >> 8) & 0xff" SLONG CM_V_CAL_inj_cranking_enrichment_soak_time_X_engine_off_time 0 0 -2147483648 2147483647 /begin VIRTUAL engine_off_time_100ms /end VIRTUAL /end MEASUREMENT
/begin COMPU_METHOD CM_V_CAL_inj_cranking_enrichment_soak_time_X_engine_off_time "raw input of CAL_inj_cranking_enrichment_soak_time_X_engine_off_time" FORM "%8.0" "" /begin FORMULA "(X1 >> 8) & 0xff" /end FORMULA /end COMPU_METHOD
/begin MEASUREMENT V_CAL_inj_deadtime_base_X_car_voltage "Input of CAL_inj_deadtime_base_X_car_voltage: (sensor_adc_ecu_voltage >> 2) & 0xff" SLONG CM_V_CAL_inj_deadtime_base_X_car_voltage 0 0 -2147483648 2147483647 /begin VIRTUAL sensor_adc_ecu_voltage /end VIRTUAL /end MEASUREMENT
/begin COMPU_METHOD CM_V_CAL_inj_deadtime_base_X_car_voltage "raw input of CAL_inj_deadtime_base_X_car_voltage" FORM "%8.0" "" /begin FORMULA "(X1 >> 2) & 0xff" /end FORMULA /end COMPU_METHOD
/begin MEASUREMENT V_CAL_inj_post_start_tipin_factor_X_rise_rate "Input of CAL_inj_post_start_tipin_factor_X_rise_rate: inj_load_drop >> 2" SLONG CM_V_CAL_inj_post_start_tipin_factor_X_rise_rate 0 0 -2147483648 2147483647 /begin VIRTUAL inj_load_drop /end VIRTUAL /end MEASUREMENT
/begin COMPU_METHOD CM_V_CAL_inj_post_start_tipin_factor_X_rise_rate "raw input of CAL_inj_post_start_tipin_factor_X_rise_rate" FORM "%8.0" "" /begin FORMULA "X1 >> 2" /end FORMULA /end COMPU_METHOD
/begin MEASUREMENT V_CAL_inj_post_start_tipout_factor_X_drop_rate "Input of CAL_inj_post_start_tipout_factor_X_drop_rate: - inj_load_drop >> 2" SLONG CM_V_CAL_inj_post_start_tipout_factor_X_drop_rate 0 0 -2147483648 2147483647 /begin VIRTUAL inj_load_drop /end VIRTUAL /end MEASUREMENT
/begin COMPU_METHOD CM_V_CAL_inj_post_start_tipout_factor_X_drop_rate "raw input of CAL_inj_post_start_tipout_factor_X_drop_rate" FORM "%8.0" "" /begin FORMULA "- X1 >> 2" /end FORMULA /end COMPU_METHOD
/begin MEASUREMENT V_CAL_inj_post_start_transient_scaler_X_mass_accum "Input of CAL_inj_post_start_transient_scaler_X_mass_accum: (maf_accumulated_since_start_raw >> 5) & 0xff" SLONG CM_V_CAL_inj_post_start_transient_scaler_X_mass_accum 0 0 -2147483648 2147483647 /begin VIRTUAL maf_accumulated_since_start_raw /end VIRTUAL /end MEASUREMENT
/begin COMPU_METHOD CM_V_CAL_inj_post_start_transient_scaler_X_mass_accum "raw input of CAL_inj_post_start_transient_scaler_X_mass_accum" FORM "%8.0" "" /begin FORMULA "(X1 >> 5) & 0xff" /end FORMULA /end COMPU_METHOD
/begin MEASUREMENT V_CAL_inj_post_start_trim_decay_lean_X_maf_accum "Input of CAL_inj_post_start_trim_decay_lean_X_maf_accum: (maf_accumulated_since_start_raw >> 5) & 0xff" SLONG CM_V_CAL_inj_post_start_trim_decay_lean_X_maf_accum 0 0 -2147483648 2147483647 /begin VIRTUAL maf_accumulated_since_start_raw /end VIRTUAL /end MEASUREMENT
/begin COMPU_METHOD CM_V_CAL_inj_post_start_trim_decay_lean_X_maf_accum "raw input of CAL_inj_post_start_trim_decay_lean_X_maf_accum" FORM "%8.0" "" /begin FORMULA "(X1 >> 5) & 0xff" /end FORMULA /end COMPU_METHOD
/begin MEASUREMENT V_CAL_inj_post_start_trim_decay_rich_X_mass_accum "Input of CAL_inj_post_start_trim_decay_rich_X_mass_accum: (maf_accumulated_since_start_raw >> 5) & 0xff" SLONG CM_V_CAL_inj_post_start_trim_decay_rich_X_mass_accum 0 0 -2147483648 2147483647 /begin VIRTUAL maf_accumulated_since_start_raw /end VIRTUAL /end MEASUREMENT
/begin COMPU_METHOD CM_V_CAL_inj_post_start_trim_decay_rich_X_mass_accum "raw input of CAL_inj_post_start_trim_decay_rich_X_mass_accum" FORM "%8.0" "" /begin FORMULA "(X1 >> 5) & 0xff" /end FORMULA /end COMPU_METHOD
/begin MEASUREMENT V_CAL_injtip_dfco_pedal_ramp_target_X_pps "Input of CAL_injtip_dfco_pedal_ramp_target_X_pps: (accel_pedal_latched >> 2) & 0xff" SLONG CM_V_CAL_injtip_dfco_pedal_ramp_target_X_pps 0 0 -2147483648 2147483647 /begin VIRTUAL accel_pedal_latched /end VIRTUAL /end MEASUREMENT
/begin COMPU_METHOD CM_V_CAL_injtip_dfco_pedal_ramp_target_X_pps "raw input of CAL_injtip_dfco_pedal_ramp_target_X_pps" FORM "%8.0" "" /begin FORMULA "(X1 >> 2) & 0xff" /end FORMULA /end COMPU_METHOD
/begin MEASUREMENT V_CAL_injtip_fuel_film_alpha_dec_X_mass_per_time "Input of CAL_injtip_fuel_film_alpha_dec_X_mass_per_time: airflow_rate_from_load / 200" SLONG CM_V_CAL_injtip_fuel_film_alpha_dec_X_mass_per_time 0 0 -2147483648 2147483647 /begin VIRTUAL airflow_rate_from_load /end VIRTUAL /end MEASUREMENT
/begin COMPU_METHOD CM_V_CAL_injtip_fuel_film_alpha_dec_X_mass_per_time "raw input of CAL_injtip_fuel_film_alpha_dec_X_mass_per_time" FORM "%8.0" "" /begin FORMULA "X1 / 200" /end FORMULA /end COMPU_METHOD
/begin MEASUREMENT V_CAL_injtip_fuel_film_alpha_inc_X_mass_per_time "Input of CAL_injtip_fuel_film_alpha_inc_X_mass_per_time: airflow_rate_from_load / 200" SLONG CM_V_CAL_injtip_fuel_film_alpha_inc_X_mass_per_time 0 0 -2147483648 2147483647 /begin VIRTUAL airflow_rate_from_load /end VIRTUAL /end MEASUREMENT
/begin COMPU_METHOD CM_V_CAL_injtip_fuel_film_alpha_inc_X_mass_per_time "raw input of CAL_injtip_fuel_film_alpha_inc_X_mass_per_time" FORM "%8.0" "" /begin FORMULA "X1 / 200" /end FORMULA /end COMPU_METHOD
/begin MEASUREMENT V_CAL_misfire_base_threshold_ips_Y_load "Input of CAL_misfire_base_threshold_ips_Y_load: load_mass_per_stroke_raw & 0xffff" SLONG CM_V_CAL_misfire_base_threshold_ips_Y_load 0 0 -2147483648 2147483647 /begin VIRTUAL load_mass_per_stroke_raw /end VIRTUAL /end MEASUREMENT
/begin COMPU_METHOD CM_V_CAL_misfire_base_threshold_ips_Y_load "raw input of CAL_misfire_base_threshold_ips_Y_load" FORM "%8.0" "" /begin FORMULA "X1 & 0xffff" /end FORMULA /end COMPU_METHOD
/begin MEASUREMENT V_CAL_misfire_base_threshold_manual_Y_load "Input of CAL_misfire_base_threshold_manual_Y_load: load_mass_per_stroke_raw & 0xffff" SLONG CM_V_CAL_misfire_base_threshold_manual_Y_load 0 0 -2147483648 2147483647 /begin VIRTUAL load_mass_per_stroke_raw /end VIRTUAL /end MEASUREMENT
/begin COMPU_METHOD CM_V_CAL_misfire_base_threshold_manual_Y_load "raw input of CAL_misfire_base_threshold_manual_Y_load" FORM "%8.0" "" /begin FORMULA "X1 & 0xffff" /end FORMULA /end COMPU_METHOD
/begin MEASUREMENT V_CAL_misfire_sensitivity_ips_Y_load "Input of CAL_misfire_sensitivity_ips_Y_load: load_mass_per_stroke_raw & 0xffff" SLONG CM_V_CAL_misfire_sensitivity_ips_Y_load 0 0 -2147483648 2147483647 /begin VIRTUAL load_mass_per_stroke_raw /end VIRTUAL /end MEASUREMENT
/begin COMPU_METHOD CM_V_CAL_misfire_sensitivity_ips_Y_load "raw input of CAL_misfire_sensitivity_ips_Y_load" FORM "%8.0" "" /begin FORMULA "X1 & 0xffff" /end FORMULA /end COMPU_METHOD
/begin MEASUREMENT V_CAL_misfire_sensitivity_manual_Y_load "Input of CAL_misfire_sensitivity_manual_Y_load: load_mass_per_stroke_raw & 0xffff" SLONG CM_V_CAL_misfire_sensitivity_manual_Y_load 0 0 -2147483648 2147483647 /begin VIRTUAL load_mass_per_stroke_raw /end VIRTUAL /end MEASUREMENT
/begin COMPU_METHOD CM_V_CAL_misfire_sensitivity_manual_Y_load "raw input of CAL_misfire_sensitivity_manual_Y_load" FORM "%8.0" "" /begin FORMULA "X1 & 0xffff" /end FORMULA /end COMPU_METHOD
/begin MEASUREMENT V_CAL_sensor_obd_ii_p0106_maf_pressure_correction_X_maf_flow "Input of CAL_sensor_obd_ii_p0106_maf_pressure_correction_X_maf_flow: (obd_ii_maf_flow / 200) & 0xff" SLONG CM_V_CAL_sensor_obd_ii_p0106_maf_pressure_correction_X_maf_flow 0 0 -2147483648 2147483647 /begin VIRTUAL obd_ii_maf_flow /end VIRTUAL /end MEASUREMENT
/begin COMPU_METHOD CM_V_CAL_sensor_obd_ii_p0106_maf_pressure_correction_X_maf_flow "raw input of CAL_sensor_obd_ii_p0106_maf_pressure_correction_X_maf_flow" FORM "%8.0" "" /begin FORMULA "(X1 / 200) & 0xff" /end FORMULA /end COMPU_METHOD
/begin MEASUREMENT V_CAL_torque_external_request_overshoot_margin_Y_torque "Input of CAL_torque_external_request_overshoot_margin_Y_torque: torque_limit_external_net >> 2 & 0xff" SLONG CM_V_CAL_torque_external_request_overshoot_margin_Y_torque 0 0 -2147483648 2147483647 /begin VIRTUAL torque_limit_external_net /end VIRTUAL /end MEASUREMENT
/begin COMPU_METHOD CM_V_CAL_torque_external_request_overshoot_margin_Y_torque "raw input of CAL_torque_external_request_overshoot_margin_Y_torque" FORM "%8.0" "" /begin FORMULA "X1 >> 2 & 0xff" /end FORMULA /end COMPU_METHOD
/begin MEASUREMENT V_CAL_tpssmooth_increment_parking_X_tps_diff "Input of CAL_tpssmooth_increment_parking_X_tps_diff: tps_smooth_error & 0xff" SLONG CM_V_CAL_tpssmooth_increment_parking_X_tps_diff 0 0 -2147483648 2147483647 /begin VIRTUAL tps_smooth_error /end VIRTUAL /end MEASUREMENT
/begin COMPU_METHOD CM_V_CAL_tpssmooth_increment_parking_X_tps_diff "raw input of CAL_tpssmooth_increment_parking_X_tps_diff" FORM "%8.0" "" /begin FORMULA "X1 & 0xff" /end FORMULA /end COMPU_METHOD
/begin MEASUREMENT V_CAL_tpssmooth_increment_sport_X_tps_diff "Input of CAL_tpssmooth_increment_sport_X_tps_diff: tps_smooth_error & 0xff" SLONG CM_V_CAL_tpssmooth_increment_sport_X_tps_diff 0 0 -2147483648 2147483647 /begin VIRTUAL tps_smooth_error /end VIRTUAL /end MEASUREMENT
/begin COMPU_METHOD CM_V_CAL_tpssmooth_increment_sport_X_tps_diff "raw input of CAL_tpssmooth_increment_sport_X_tps_diff" FORM "%8.0" "" /begin FORMULA "X1 & 0xff" /end FORMULA /end COMPU_METHOD
/begin MEASUREMENT V_CAL_tpssmooth_increment_tour_X_tps_diff "Input of CAL_tpssmooth_increment_tour_X_tps_diff: tps_smooth_error & 0xff" SLONG CM_V_CAL_tpssmooth_increment_tour_X_tps_diff 0 0 -2147483648 2147483647 /begin VIRTUAL tps_smooth_error /end VIRTUAL /end MEASUREMENT
/begin COMPU_METHOD CM_V_CAL_tpssmooth_increment_tour_X_tps_diff "raw input of CAL_tpssmooth_increment_tour_X_tps_diff" FORM "%8.0" "" /begin FORMULA "X1 & 0xff" /end FORMULA /end COMPU_METHOD
/end MODULE
/end PROJECT
