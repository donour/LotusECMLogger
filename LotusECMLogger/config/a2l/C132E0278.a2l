ASAP2_VERSION 1 61
/begin PROJECT C132E0278 "Lotus T6 C132E0278"
/begin HEADER "" VERSION "generated v1" /end HEADER
/begin MODULE C132E0278 ""
/begin MOD_COMMON "" BYTE_ORDER MSB_FIRST ALIGNMENT_BYTE 1 ALIGNMENT_WORD 2 ALIGNMENT_LONG 4 /end MOD_COMMON
/begin RECORD_LAYOUT RL_VALUE_UBYTE FNC_VALUES 1 UBYTE ROW_DIR DIRECT /end RECORD_LAYOUT
/begin RECORD_LAYOUT RL_AXIS_UBYTE AXIS_PTS_X 1 UBYTE INDEX_INCR DIRECT /end RECORD_LAYOUT
/begin RECORD_LAYOUT RL_AXIS_SBYTE AXIS_PTS_X 1 SBYTE INDEX_INCR DIRECT /end RECORD_LAYOUT
/begin RECORD_LAYOUT RL_VALUE_UWORD FNC_VALUES 1 UWORD ROW_DIR DIRECT /end RECORD_LAYOUT
/begin RECORD_LAYOUT RL_AXIS_UWORD AXIS_PTS_X 1 UWORD INDEX_INCR DIRECT /end RECORD_LAYOUT
/begin RECORD_LAYOUT RL_AXIS_SWORD AXIS_PTS_X 1 SWORD INDEX_INCR DIRECT /end RECORD_LAYOUT
/begin COMPU_METHOD CM_i16_accel_1_10g "i16_accel_1/10g" RAT_FUNC "%9.1" "g" COEFFS 0 1 0 0 0 0.1 /end COMPU_METHOD
/begin COMPU_METHOD CM_i16_factor_1_10pct "i16_factor_1/10pct" RAT_FUNC "%9.1" "%" COEFFS 0 1 0 0 0 0.1 /end COMPU_METHOD
/begin COMPU_METHOD CM_i16_factor_1_20 "i16_factor_1/20" RAT_FUNC "%8.0" "%" COEFFS 0 1 0 0 0 5 /end COMPU_METHOD
/begin COMPU_METHOD CM_i16_flow_400mg_s "i16_flow_400mg/s" RAT_FUNC "%8.0" "mg/s" COEFFS 0 1 0 0 0 400 /end COMPU_METHOD
/begin COMPU_METHOD CM_u16_afr_1_100 "u16_afr_1/100" RAT_FUNC "%10.2" "AFR" COEFFS 0 1 0 0 0 0.01 /end COMPU_METHOD
/begin COMPU_METHOD CM_u16_angle_1_10deg "u16_angle_1/10deg" RAT_FUNC "%9.1" "deg" COEFFS 0 1 0 0 0 0.1 /end COMPU_METHOD
/begin COMPU_METHOD CM_u16_current_mA "u16_current_mA" RAT_FUNC "%8.0" "mA" COEFFS 0 1 0 0 0 1 /end COMPU_METHOD
/begin COMPU_METHOD CM_u16_distance_km "u16_distance_km" RAT_FUNC "%8.0" "km" COEFFS 0 1 0 0 0 1 /end COMPU_METHOD
/begin COMPU_METHOD CM_u16_economy_1_10ml_per_km "u16_economy_1/10ml_per_km" RAT_FUNC "%9.1" "ml/km" COEFFS 0 1 0 0 0 0.1 /end COMPU_METHOD
/begin COMPU_METHOD CM_u16_factor_1_10000 "u16_factor_1/10000" RAT_FUNC "%10.2" "%" COEFFS 0 1 0 0 0 0.01 /end COMPU_METHOD
/begin COMPU_METHOD CM_u16_factor_1_1023 "u16_factor_1/1023" RAT_FUNC "%12.4" "%" COEFFS 0 1 0 0 0 0.0977517106549365 /end COMPU_METHOD
/begin COMPU_METHOD CM_u16_factor_1_20000 "u16_factor_1/20000" RAT_FUNC "%11.3" "%" COEFFS 0 1 0 0 0 0.005 /end COMPU_METHOD
/begin COMPU_METHOD CM_u16_factor_1_32 "u16_factor_1/32" RAT_FUNC "%11.3" "%" COEFFS 0 1 0 0 0 3.125 /end COMPU_METHOD
/begin COMPU_METHOD CM_u16_factor_1_4095 "u16_factor_1/4095" RAT_FUNC "%12.4" "%" COEFFS 0 1 0 0 0 0.0244200244200244 /end COMPU_METHOD
/begin COMPU_METHOD CM_u16_flow_100mg_s "u16_flow_100mg/s" RAT_FUNC "%8.0" "mg/s" COEFFS 0 1 0 0 0 100 /end COMPU_METHOD
/begin COMPU_METHOD CM_u16_flow_10mg_s "u16_flow_10mg/s" RAT_FUNC "%8.0" "mg/s" COEFFS 0 1 0 0 0 10 /end COMPU_METHOD
/begin COMPU_METHOD CM_u16_flow_mg_s "u16_flow_mg/s" RAT_FUNC "%8.0" "mg/s" COEFFS 0 1 0 0 0 1 /end COMPU_METHOD
/begin COMPU_METHOD CM_u16_load_mg_stroke "u16_load_mg/stroke" RAT_FUNC "%8.0" "mg/stroke" COEFFS 0 1 0 0 0 1 /end COMPU_METHOD
/begin COMPU_METHOD CM_u16_mass_100ug "u16_mass_100ug" RAT_FUNC "%8.0" "ug" COEFFS 0 1 0 0 0 100 /end COMPU_METHOD
/begin COMPU_METHOD CM_u16_mass_mg "u16_mass_mg" RAT_FUNC "%8.0" "mg" COEFFS 0 1 0 0 0 1 /end COMPU_METHOD
/begin COMPU_METHOD CM_u16_pressure_mbar "u16_pressure_mbar" RAT_FUNC "%8.0" "mbar" COEFFS 0 1 0 0 0 1 /end COMPU_METHOD
/begin COMPU_METHOD CM_u16_rspeed_1_4rpm "u16_rspeed_1/4rpm" RAT_FUNC "%10.2" "rpm" COEFFS 0 1 0 0 0 0.25 /end COMPU_METHOD
/begin COMPU_METHOD CM_u16_rspeed_rpm "u16_rspeed_rpm" RAT_FUNC "%8.0" "rpm" COEFFS 0 1 0 0 0 1 /end COMPU_METHOD
/begin COMPU_METHOD CM_u16_time_us "u16_time_us" RAT_FUNC "%8.0" "us" COEFFS 0 1 0 0 0 1 /end COMPU_METHOD
/begin COMPU_METHOD CM_u16_voltage_18_1023v "u16_voltage_18/1023v" RAT_FUNC "%12.4" "V" COEFFS 0 1 0 0 0 0.0175953079178886 /end COMPU_METHOD
/begin COMPU_METHOD CM_u16_voltage_5_1023v "u16_voltage_5/1023v" RAT_FUNC "%12.4" "V" COEFFS 0 1 0 0 0 0.00488758553274682 /end COMPU_METHOD
/begin COMPU_METHOD CM_u32_angle_1_10defg "u32_angle_1/10defg" RAT_FUNC "%9.1" "defg" COEFFS 0 1 0 0 0 0.1 /end COMPU_METHOD
/begin COMPU_METHOD CM_u32_mass_ug "u32_mass_ug" RAT_FUNC "%8.0" "ug" COEFFS 0 1 0 0 0 1 /end COMPU_METHOD
/begin COMPU_METHOD CM_u32_rspeed_1024rpm "u32_rspeed_1024rpm" RAT_FUNC "%8.0" "rpm" COEFFS 0 1 0 0 0 1024 /end COMPU_METHOD
/begin COMPU_METHOD CM_u8_accel_1_255g "u8_accel_1/255g" RAT_FUNC "%12.4" "g" COEFFS 0 1 0 0 0 0.00392156862745098 /end COMPU_METHOD
/begin COMPU_METHOD CM_u8_angle_1_4_10deg "u8_angle_1/4-10deg" RAT_FUNC "%10.2" "deg" COEFFS 0 1 10 0 0 0.25 /end COMPU_METHOD
/begin COMPU_METHOD CM_u8_angle_1_4_32deg "u8_angle_1/4-32deg" RAT_FUNC "%10.2" "deg" COEFFS 0 1 32 0 0 0.25 /end COMPU_METHOD
/begin COMPU_METHOD CM_u8_angle_1_4deg "u8_angle_1/4deg" RAT_FUNC "%10.2" "deg" COEFFS 0 1 0 0 0 0.25 /end COMPU_METHOD
/begin COMPU_METHOD CM_u8_angle_720_256deg "u8_angle_720/256deg" RAT_FUNC "%12.4" "deg" COEFFS 0 1 0 0 0 2.8125 /end COMPU_METHOD
/begin COMPU_METHOD CM_u8_factor_1_100 "u8_factor_1/100" RAT_FUNC "%8.0" "%" COEFFS 0 1 0 0 0 1 /end COMPU_METHOD
/begin COMPU_METHOD CM_u8_factor_1_128 "u8_factor_1/128" RAT_FUNC "%12.4" "%" COEFFS 0 1 0 0 0 0.78125 /end COMPU_METHOD
/begin COMPU_METHOD CM_u8_factor_1_255 "u8_factor_1/255" RAT_FUNC "%12.4" "%" COEFFS 0 1 0 0 0 0.392156862745098 /end COMPU_METHOD
/begin COMPU_METHOD CM_u8_factor_1_2560 "u8_factor_1/2560" RAT_FUNC "%12.4" "%" COEFFS 0 1 0 0 0 0.0390625 /end COMPU_METHOD
/begin COMPU_METHOD CM_u8_factor_1_64 "u8_factor_1/64" RAT_FUNC "%12.4" "%" COEFFS 0 1 0 0 0 1.5625 /end COMPU_METHOD
/begin COMPU_METHOD CM_u8_load_1173mg_255stroke "u8_load_1173mg/255stroke" RAT_FUNC "%9.1" "mg/stroke" COEFFS 0 1 0 0 0 4.6 /end COMPU_METHOD
/begin COMPU_METHOD CM_u8_load_4mg_stroke "u8_load_4mg/stroke" RAT_FUNC "%8.0" "mg/stroke" COEFFS 0 1 0 0 0 4 /end COMPU_METHOD
/begin COMPU_METHOD CM_u8_percent_100_128_100 "u8_percent_100/128-100" RAT_FUNC "%12.4" "%" COEFFS 0 1 100 0 0 0.78125 /end COMPU_METHOD
/begin COMPU_METHOD CM_u8_pressure_50mbar "u8_pressure_50mbar" RAT_FUNC "%8.0" "mbar" COEFFS 0 1 0 0 0 50 /end COMPU_METHOD
/begin COMPU_METHOD CM_u8_rspeed_125_4_500rpm "u8_rspeed_125/4+500rpm" RAT_FUNC "%10.2" "rpm" COEFFS 0 1 -500 0 0 31.25 /end COMPU_METHOD
/begin COMPU_METHOD CM_u8_rspeed_4rpm "u8_rspeed_4rpm" RAT_FUNC "%8.0" "rpm" COEFFS 0 1 0 0 0 4 /end COMPU_METHOD
/begin COMPU_METHOD CM_u8_rspeed_8rpm "u8_rspeed_8rpm" RAT_FUNC "%8.0" "rpm" COEFFS 0 1 0 0 0 8 /end COMPU_METHOD
/begin COMPU_METHOD CM_u8_speed_1_100kph "u8_speed_1/100kph" RAT_FUNC "%10.2" "km/h" COEFFS 0 1 0 0 0 0.01 /end COMPU_METHOD
/begin COMPU_METHOD CM_u8_speed_1_10kph "u8_speed_1/10kph" RAT_FUNC "%9.1" "km/h" COEFFS 0 1 0 0 0 0.1 /end COMPU_METHOD
/begin COMPU_METHOD CM_u8_speed_kph "u8_speed_kph" RAT_FUNC "%8.0" "km/h" COEFFS 0 1 0 0 0 1 /end COMPU_METHOD
/begin COMPU_METHOD CM_u8_temp_1_10C "u8_temp_1/10C" RAT_FUNC "%9.1" "°C" COEFFS 0 1 0 0 0 0.1 /end COMPU_METHOD
/begin COMPU_METHOD CM_u8_temp_5_8_40c "u8_temp_5/8-40c" RAT_FUNC "%11.3" "°C" COEFFS 0 1 40 0 0 0.625 /end COMPU_METHOD
/begin COMPU_METHOD CM_u8_temp__40c "u8_temp_-40c" RAT_FUNC "%8.0" "°C" COEFFS 0 1 40 0 0 1 /end COMPU_METHOD
/begin COMPU_METHOD CM_u8_time_100ms "u8_time_100ms" RAT_FUNC "%8.0" "ms" COEFFS 0 1 0 0 0 100 /end COMPU_METHOD
/begin COMPU_METHOD CM_u8_time_10ms "u8_time_10ms" RAT_FUNC "%8.0" "ms" COEFFS 0 1 0 0 0 10 /end COMPU_METHOD
/begin COMPU_METHOD CM_u8_time_20ms "u8_time_20ms" RAT_FUNC "%8.0" "ms" COEFFS 0 1 0 0 0 20 /end COMPU_METHOD
/begin COMPU_METHOD CM_u8_time_50ms "u8_time_50ms" RAT_FUNC "%8.0" "ms" COEFFS 0 1 0 0 0 50 /end COMPU_METHOD
/begin COMPU_METHOD CM_u8_time_5ms "u8_time_5ms" RAT_FUNC "%8.0" "ms" COEFFS 0 1 0 0 0 5 /end COMPU_METHOD
/begin COMPU_METHOD CM_u8_time_ms "u8_time_ms" RAT_FUNC "%8.0" "ms" COEFFS 0 1 0 0 0 1 /end COMPU_METHOD
/begin COMPU_METHOD CM_u8_time_s "u8_time_s" RAT_FUNC "%8.0" "s" COEFFS 0 1 0 0 0 1 /end COMPU_METHOD
/begin COMPU_METHOD CM_u8_torque_nm "u8_torque_nm" RAT_FUNC "%8.0" "Nm" COEFFS 0 1 0 0 0 1 /end COMPU_METHOD
/begin COMPU_METHOD CM_u8_voltage_5_255v "u8_voltage_5/255v" RAT_FUNC "%12.4" "V" COEFFS 0 1 0 0 0 0.0196078431372549 /end COMPU_METHOD
/begin COMPU_METHOD CM_u8_volume_1_10gallon "u8_volume_1/10gallon" RAT_FUNC "%9.1" "gallon" COEFFS 0 1 0 0 0 0.1 /end COMPU_METHOD
/begin CHARACTERISTIC CAL_base "T6-EVORA--F430-V000E#ROW#Lotus#Evora GT430#2019#MT#64kb#MPC5534#CRP#0x59D4#LOTUS EVORA GT430 MAN MY19 ROW" ASCII 0x40008654 RL_VALUE_UBYTE 0 NO_COMPU_METHOD 0 255 NUMBER 32 /end CHARACTERISTIC
/begin CHARACTERISTIC CAL_ecu_data_base "Calibration: ECU data base (val/1023)." VALUE 0x40008674 RL_VALUE_UWORD 0 CM_u16_factor_1_1023 0 6406.15835777126 /end CHARACTERISTIC
/begin CHARACTERISTIC CAL_ecu_ips_calibration_version "Calibration: ECU IPS calibration version." VALUE 0x4000867B RL_VALUE_UBYTE 0 NO_COMPU_METHOD 0 255 /end CHARACTERISTIC
/begin CHARACTERISTIC CAL_ecu_unknown_tire_circumference "Calibration: ECU tire circumference." VALUE 0x4000869C RL_VALUE_UWORD 0 NO_COMPU_METHOD 0 65535 /end CHARACTERISTIC
/begin CHARACTERISTIC CAL_ecu_abs_ring_teeth_count "Calibration: ECU ABS ring teeth count." VALUE 0x4000869E RL_VALUE_UBYTE 0 NO_COMPU_METHOD 0 255 /end CHARACTERISTIC
/begin CHARACTERISTIC CAL_ac_compressor_max_coolant_temp_max "Calibration: A/C compressor maximum coolant temperature maximum (val/255)." VALUE 0x400086B4 RL_VALUE_UBYTE 0 CM_u8_factor_1_255 0 100 /end CHARACTERISTIC
/begin CHARACTERISTIC CAL_ac_compressor_max_coolant_temp_min "Calibration: A/C compressor maximum coolant temperature minimum (val/255)." VALUE 0x400086B5 RL_VALUE_UBYTE 0 CM_u8_factor_1_255 0 100 /end CHARACTERISTIC
/begin CHARACTERISTIC CAL_ac_compressor_max_throttle "Calibration: A/C compressor maximum throttle (val/255)." VALUE 0x400086B6 RL_VALUE_UBYTE 0 CM_u8_factor_1_255 0 100 /end CHARACTERISTIC
/begin CHARACTERISTIC CAL_ac_ign_comp_delay "undefined1" VALUE 0x400086B8 RL_VALUE_UBYTE 0 NO_COMPU_METHOD 0 255 /end CHARACTERISTIC
/begin CHARACTERISTIC CAL_ac_compressor_engine_speed_max "Calibration: A/C compressor engine speed maximum (RPM = val*125/4+500)." VALUE 0x400086C8 RL_VALUE_UBYTE 0 CM_u8_rspeed_125_4_500rpm 500 8468.75 /end CHARACTERISTIC
/begin CHARACTERISTIC CAL_ac_compressor_engine_speed_min "Calibration: A/C compressor engine speed minimum (RPM = val*125/4+500)." VALUE 0x400086C9 RL_VALUE_UBYTE 0 CM_u8_rspeed_125_4_500rpm 500 8468.75 /end CHARACTERISTIC
/begin CHARACTERISTIC CAL_ac_shutdown_delay "undefined1" VALUE 0x400086CC RL_VALUE_UBYTE 0 NO_COMPU_METHOD 0 255 /end CHARACTERISTIC
/begin CHARACTERISTIC CAL_ecu_learning_x_axis_stability_threshold "Calibration: ECU learning x axis stability threshold." VALUE 0x400086D1 RL_VALUE_UBYTE 0 NO_COMPU_METHOD 0 255 /end CHARACTERISTIC
/begin CHARACTERISTIC CAL_ecu_learning_y_axis_stability_threshold "Calibration: ECU learning y axis stability threshold." VALUE 0x400086D2 RL_VALUE_UBYTE 0 NO_COMPU_METHOD 0 255 /end CHARACTERISTIC
/begin CHARACTERISTIC CAL_ac_compressor_deactivate_car_speed "Calibration: A/C compressor deactivate car speed (km/h; 2-element array)." VAL_BLK 0x400086DC RL_VALUE_UBYTE 0 CM_u8_speed_kph 0 255 NUMBER 2 /end CHARACTERISTIC
/begin CHARACTERISTIC CAL_ecu_ign_threshold "Calibration: ECU ignition threshold (V = val*5/255)." VALUE 0x400086DF RL_VALUE_UBYTE 0 CM_u8_voltage_5_255v 0 5 /end CHARACTERISTIC
/begin CHARACTERISTIC CAL_ac_inhibit_evap_temp "undefined1" VALUE 0x40008707 RL_VALUE_UBYTE 0 NO_COMPU_METHOD 0 255 /end CHARACTERISTIC
/begin CHARACTERISTIC CAL_ac_evap_timer_ticks_5ms "Calibration: A/C evaporative timer ticks 5ms." VALUE 0x40008709 RL_VALUE_UBYTE 0 NO_COMPU_METHOD 0 255 /end CHARACTERISTIC
/begin CHARACTERISTIC CAL_ac_evap_pid_derivative_filter_alpha "undefined1" VALUE 0x4000870B RL_VALUE_UBYTE 0 NO_COMPU_METHOD 0 255 /end CHARACTERISTIC
/begin CHARACTERISTIC CAL_cruise_unknown2 "undefined1" VALUE 0x40008716 RL_VALUE_UBYTE 0 NO_COMPU_METHOD 0 255 /end CHARACTERISTIC
/begin CHARACTERISTIC CAL_ac_evap_freeze_inhibit_delay "undefined1" VALUE 0x40008718 RL_VALUE_UBYTE 0 NO_COMPU_METHOD 0 255 /end CHARACTERISTIC
/begin CHARACTERISTIC CAL_ac_load_ramp_steps "undefined1" VALUE 0x4000871E RL_VALUE_UBYTE 0 NO_COMPU_METHOD 0 255 /end CHARACTERISTIC
/begin CHARACTERISTIC CAL_ac_evap_target_temp "Calibration: A/C evaporative target temperature (°C = val/10)." VALUE 0x4000871F RL_VALUE_UBYTE 0 CM_u8_temp_1_10C 0 25.5 /end CHARACTERISTIC
/begin CHARACTERISTIC CAL_ac_evap_pid_kd "undefined1" VALUE 0x40008720 RL_VALUE_UBYTE 0 NO_COMPU_METHOD 0 255 /end CHARACTERISTIC
/begin CHARACTERISTIC CAL_ac_evap_pid_ki_warm "undefined1" VALUE 0x40008721 RL_VALUE_UBYTE 0 NO_COMPU_METHOD 0 255 /end CHARACTERISTIC
/begin CHARACTERISTIC CAL_ac_evap_pid_integrator_limit "undefined1" VALUE 0x40008722 RL_VALUE_UBYTE 0 NO_COMPU_METHOD 0 255 /end CHARACTERISTIC
/begin CHARACTERISTIC CAL_ac_output_pwm_freq "Calibration: A/C output PWM freq." VALUE 0x40008724 RL_VALUE_UWORD 0 NO_COMPU_METHOD 0 65535 /end CHARACTERISTIC
/begin CHARACTERISTIC CAL_ac_compressor_soft_engage_time "undefined1" VALUE 0x40008727 RL_VALUE_UBYTE 0 NO_COMPU_METHOD 0 255 /end CHARACTERISTIC
/begin CHARACTERISTIC CAL_ac_unknown3 "undefined1" VALUE 0x40008729 RL_VALUE_UBYTE 0 NO_COMPU_METHOD 0 255 /end CHARACTERISTIC
/begin CHARACTERISTIC CAL_ac_compressor_power_offset "undefined1" VALUE 0x40008736 RL_VALUE_UBYTE 0 NO_COMPU_METHOD 0 255 /end CHARACTERISTIC
/begin CHARACTERISTIC CAL_ac_load_slew_up_period_ "undefined1" VALUE 0x4000873C RL_VALUE_UBYTE 0 NO_COMPU_METHOD 0 255 /end CHARACTERISTIC
/begin CHARACTERISTIC CAL_ac_load_slew_down_period "undefined1" VALUE 0x4000873D RL_VALUE_UBYTE 0 NO_COMPU_METHOD 0 255 /end CHARACTERISTIC
/begin CHARACTERISTIC CAL_ac_load_slew_up_step "undefined1" VALUE 0x40008740 RL_VALUE_UBYTE 0 NO_COMPU_METHOD 0 255 /end CHARACTERISTIC
/begin CHARACTERISTIC CAL_ac_load_slew_down_step "undefined1" VALUE 0x40008741 RL_VALUE_UBYTE 0 NO_COMPU_METHOD 0 255 /end CHARACTERISTIC
/begin CHARACTERISTIC CAL_ac_evap_pid_ki_cold "undefined1" VALUE 0x40008747 RL_VALUE_UBYTE 0 NO_COMPU_METHOD 0 255 /end CHARACTERISTIC
/begin CHARACTERISTIC CAL_ecu_engine_running_threshold_unknown "Calibration: ECU engine running threshold (2-element array)." VAL_BLK 0x4000877E RL_VALUE_UBYTE 0 NO_COMPU_METHOD 0 255 NUMBER 2 /end CHARACTERISTIC
/begin CHARACTERISTIC CAL_misc_engine_detection_off "undefined2" VALUE 0x40008780 RL_VALUE_UWORD 0 NO_COMPU_METHOD 0 65535 /end CHARACTERISTIC
/begin CHARACTERISTIC CAL_ecu_vehicle_mode_button_time "Calibration: ECU vehicle mode button time (ms = val*10)." VALUE 0x40008782 RL_VALUE_UWORD 0 CM_u8_time_10ms 0 655350 /end CHARACTERISTIC
/begin CHARACTERISTIC CAL_ac_compressor_engine_speed2 "Calibration: A/C compressor engine speed2 (RPM = val*125/4+500; 2-element array)." VAL_BLK 0x400087AE RL_VALUE_UBYTE 0 CM_u8_rspeed_125_4_500rpm 500 8468.75 NUMBER 2 /end CHARACTERISTIC
/begin CHARACTERISTIC CAL_ac_compressor_runtime_min "Calibration: A/C compressor runtime minimum (ms = val*5)." VALUE 0x400087B0 RL_VALUE_UWORD 0 CM_u8_time_5ms 0 327675 /end CHARACTERISTIC
/begin CHARACTERISTIC CAL_cruise_accel_pedal_override_threshold_exit "Calibration: cruise accelerator pedal override threshold exit (val/1023)." VALUE 0x400087BC RL_VALUE_UBYTE 0 CM_u16_factor_1_1023 0 24.9266862170088 /end CHARACTERISTIC
/begin CHARACTERISTIC CAL_cruise_accel_pedal_override_threshold_enter "Calibration: cruise accelerator pedal override threshold enter (val/1023)." VALUE 0x400087BD RL_VALUE_UBYTE 0 CM_u16_factor_1_1023 0 24.9266862170088 /end CHARACTERISTIC
/begin CHARACTERISTIC CAL_ecu_2gr_cylinder_air_mass_mg "Calibration: ECU 2gr cylinder air mass mg (mg)." VALUE 0x400087BE RL_VALUE_UWORD 0 CM_u16_mass_mg 0 65535 /end CHARACTERISTIC
/begin CHARACTERISTIC CAL_ecu_2gr_cylinder_air_mass_mg_obd_ii "Calibration: ECU 2gr cylinder air mass mg OBD-II (mg)." VALUE 0x400087C0 RL_VALUE_UWORD 0 CM_u16_mass_mg 0 65535 /end CHARACTERISTIC
/begin CHARACTERISTIC CAL_vehicle_moving_speed_min "Calibration: vehicle moving speed minimum (km/h)." VALUE 0x400087C5 RL_VALUE_UBYTE 0 CM_u8_speed_kph 0 255 /end CHARACTERISTIC
/begin CHARACTERISTIC CAL_cruise_resume_timer "Calibration: cruise resume timer (ms = val*10)." VALUE 0x400087CD RL_VALUE_UBYTE 0 CM_u8_time_10ms 0 2550 /end CHARACTERISTIC
/begin CHARACTERISTIC CAL_cluster_shift_light_deadband_rpm "Calibration: cluster shift light deadband RPM (RPM)." VALUE 0x400087DE RL_VALUE_UWORD 0 CM_u16_rspeed_rpm 0 65535 /end CHARACTERISTIC
/begin CHARACTERISTIC CAL_cluster_fuel_level_zero_clip_threshold "Calibration: cluster fuel level zero clip threshold (gal = val/10)." VALUE 0x400087E8 RL_VALUE_UWORD 0 CM_u8_volume_1_10gallon 0 6553.5 /end CHARACTERISTIC
/begin CHARACTERISTIC CAL_cruise_integrator_clamp "undefined1" VALUE 0x400087EA RL_VALUE_UBYTE 0 NO_COMPU_METHOD 0 255 /end CHARACTERISTIC
/begin CHARACTERISTIC CAL_cruise_derivative_clamp "undefined1" VALUE 0x400087EB RL_VALUE_UBYTE 0 NO_COMPU_METHOD 0 255 /end CHARACTERISTIC
/begin CHARACTERISTIC CAL_cruise_speed_error_limit "Calibration: cruise speed error limit (km/h)." VALUE 0x4000880E RL_VALUE_UBYTE 0 CM_u8_speed_kph 0 255 /end CHARACTERISTIC
/begin CHARACTERISTIC CAL_cruise_integral_term_limit "Calibration: cruise integral term limit (val/100)." VALUE 0x4000880F RL_VALUE_UBYTE 0 CM_u8_factor_1_100 0 255 /end CHARACTERISTIC
/begin CHARACTERISTIC CAL_cruise_derivative_term_limit "Calibration: cruise derivative term limit (val/100)." VALUE 0x40008810 RL_VALUE_UBYTE 0 CM_u8_factor_1_100 0 255 /end CHARACTERISTIC
/begin CHARACTERISTIC CAL_cruise_speed_limit "Calibration: cruise speed limit (km/h; 2-element array)." VAL_BLK 0x40008860 RL_VALUE_UBYTE 0 CM_u8_speed_kph 0 255 NUMBER 2 /end CHARACTERISTIC
/begin CHARACTERISTIC CAL_cruise_speed_deadband "Calibration: cruise speed deadband (km/h)." VALUE 0x40008864 RL_VALUE_UBYTE 0 CM_u8_speed_kph 0 255 /end CHARACTERISTIC
/begin CHARACTERISTIC CAL_cruise_speed_increment "Calibration: cruise speed increment (km/h = val/100)." VALUE 0x40008865 RL_VALUE_UBYTE 0 CM_u8_speed_1_100kph 0 2.55 /end CHARACTERISTIC
/begin CHARACTERISTIC CAL_cruise_speed_decrement "Calibration: cruise speed decrement (km/h = val/100)." VALUE 0x40008866 RL_VALUE_UBYTE 0 CM_u8_speed_1_100kph 0 2.55 /end CHARACTERISTIC
/begin CHARACTERISTIC CAL_cruise_speed_increment2 "Calibration: cruise speed increment2 (km/h = val/10)." VALUE 0x4000886C RL_VALUE_UBYTE 0 CM_u8_speed_1_10kph 0 25.5 /end CHARACTERISTIC
/begin CHARACTERISTIC CAL_cruise_airflow_slew_step "undefined1" VALUE 0x4000886D RL_VALUE_UBYTE 0 NO_COMPU_METHOD 0 255 /end CHARACTERISTIC
/begin CHARACTERISTIC CAL_ecu_brake_or_clutch_inactive_timer "Calibration: ECU brake or clutch inactive timer (ms = val*5)." VALUE 0x40008875 RL_VALUE_UBYTE 0 CM_u8_time_5ms 0 1275 /end CHARACTERISTIC
/begin CHARACTERISTIC CAL_ac_compressor_speed_filter_coeff "undefined1" VALUE 0x4000887B RL_VALUE_UBYTE 0 NO_COMPU_METHOD 0 255 /end CHARACTERISTIC
/begin CHARACTERISTIC CAL_ecu_wheelspeed_update_timer "Calibration: ECU wheelspeed update timer (ms = val*5)." VALUE 0x400088AE RL_VALUE_UBYTE 0 CM_u8_time_5ms 0 1275 /end CHARACTERISTIC
/begin CHARACTERISTIC CAL_cruise_integral_gearchange_retain "u8_factor_1/255" VALUE 0x400088AF RL_VALUE_UBYTE 0 CM_u8_factor_1_255 0 100 /end CHARACTERISTIC
/begin CHARACTERISTIC CAL_cruise_integral_freeze_accel "uint8_t" VALUE 0x400088B0 RL_VALUE_UBYTE 0 NO_COMPU_METHOD 0 255 /end CHARACTERISTIC
/begin CHARACTERISTIC CAL_vehicle_speed_limit "Calibration: vehicle speed limit (km/h)." VALUE 0x400088B6 RL_VALUE_UBYTE 0 CM_u8_speed_kph 0 255 /end CHARACTERISTIC
/begin CHARACTERISTIC CAL_vehicle_speed_limit_enforce "Calibration: vehicle speed limit enforce (boolean flag)." VALUE 0x400088B8 RL_VALUE_UBYTE 0 NO_COMPU_METHOD 0 255 /end CHARACTERISTIC
/begin CHARACTERISTIC CAL_vehicle_speed_limit_enforce_margin "Calibration: vehicle speed limit enforce margin." VALUE 0x400088B9 RL_VALUE_UBYTE 0 NO_COMPU_METHOD 0 255 /end CHARACTERISTIC
/begin CHARACTERISTIC CAL_vehicle_standing_start_throttle_threshold "Calibration: vehicle standing start throttle threshold (val/1023)." VALUE 0x400088BA RL_VALUE_UWORD 0 CM_u16_factor_1_1023 0 6406.15835777126 /end CHARACTERISTIC
/begin CHARACTERISTIC CAL_ecu_engine_breakin_distance "Calibration: ECU engine breakin distance (km)." VALUE 0x400088BC RL_VALUE_UWORD 0 CM_u16_distance_km 0 65535 /end CHARACTERISTIC
/begin CHARACTERISTIC CAL_cruise_tps_accelerating_threshold "Calibration: cruise throttle position accelerating threshold (val/1023)." VALUE 0x400088BF RL_VALUE_UBYTE 0 CM_u16_factor_1_1023 0 24.9266862170088 /end CHARACTERISTIC
/begin CHARACTERISTIC CAL_cluster_brake_switch_max_speed_ips_unknown "Calibration: cluster brake switch maximum speed IPS (km/h)." VALUE 0x400088C0 RL_VALUE_UBYTE 0 CM_u8_speed_kph 0 255 /end CHARACTERISTIC
/begin CHARACTERISTIC CAL_cruise_brake_cancel_time "Calibration: cruise brake cancel time (ms = val*10)." VALUE 0x400088DE RL_VALUE_UWORD 0 CM_u8_time_10ms 0 655350 /end CHARACTERISTIC
/begin CHARACTERISTIC CAL_dca_enable_untested "Drive Cycle Assist is a disabled throttle control mechanism in the T6E firmware. It has not been tested in the aftermarket and requires a special VIN in addition to this flag for activation. As of now, there is no reason to change it. The current the" VALUE 0x400088E3 RL_VALUE_UBYTE 0 NO_COMPU_METHOD 0 255 /end CHARACTERISTIC
/begin CHARACTERISTIC CAL_ecu_engine_speed_reference_enable "Calibration: ECU engine speed reference enable (boolean flag)." VALUE 0x400088E4 RL_VALUE_UBYTE 0 NO_COMPU_METHOD 0 255 /end CHARACTERISTIC
/begin CHARACTERISTIC CAL_logger_high_speed_logger_enable "To enable the built-in highspeed data logger, set this configuration option." VALUE 0x400088EC RL_VALUE_UBYTE 0 NO_COMPU_METHOD 0 255 /end CHARACTERISTIC
/begin CHARACTERISTIC CAL_dca_enable_steering_max "Calibration: drive-cycle-assist enable steering maximum." VALUE 0x40008915 RL_VALUE_UBYTE 0 NO_COMPU_METHOD 0 255 /end CHARACTERISTIC
/begin CHARACTERISTIC CAL_dca_enable_carspeed "Calibration: drive-cycle-assist enable carspeed (km/h; 2-element array)." VAL_BLK 0x40008916 RL_VALUE_UBYTE 0 CM_u8_speed_kph 0 255 NUMBER 2 /end CHARACTERISTIC
/begin CHARACTERISTIC CAL_dca_stationary_wait_time "Calibration: drive-cycle-assist stationary wait time (ms = val*100)." VALUE 0x40008918 RL_VALUE_UBYTE 0 CM_u8_time_100ms 0 25500 /end CHARACTERISTIC
/begin CHARACTERISTIC CAL_dca_enable_tps_margin "Calibration: drive-cycle-assist enable throttle position margin (val/1023)." VALUE 0x4000891A RL_VALUE_UBYTE 0 CM_u16_factor_1_1023 0 24.9266862170088 /end CHARACTERISTIC
/begin CHARACTERISTIC CAL_dca_activate_timer "Calibration: drive-cycle-assist activate timer (ms = val*5)." VALUE 0x4000891B RL_VALUE_UBYTE 0 CM_u8_time_5ms 0 1275 /end CHARACTERISTIC
/begin CHARACTERISTIC CAL_dca_activate_tps_threshold "Calibration: drive-cycle-assist activate throttle position threshold (val/1023)." VALUE 0x4000891C RL_VALUE_UWORD 0 CM_u16_factor_1_1023 0 6406.15835777126 /end CHARACTERISTIC
/begin CHARACTERISTIC CAL_dca_ramp_timer_unknown "Calibration: drive-cycle-assist ramp timer (ms = val*20)." VALUE 0x40008920 RL_VALUE_UBYTE 0 CM_u8_time_20ms 0 5100 /end CHARACTERISTIC
/begin CHARACTERISTIC CAL_ecu_rpm_600 "Calibration: ECU RPM 600 (RPM = val*4)." VALUE 0x40008921 RL_VALUE_UBYTE 0 CM_u8_rspeed_4rpm 0 1020 /end CHARACTERISTIC
/begin CHARACTERISTIC CAL_ecu_engine_speed_decel_hysteresis_rpm "Calibration: ECU engine speed decel hysteresis RPM (RPM = val/4)." VALUE 0x40008924 RL_VALUE_UWORD 0 CM_u16_rspeed_1_4rpm 0 16383.75 /end CHARACTERISTIC
/begin CHARACTERISTIC CAL_ecu_rpm_5250 "Calibration: ECU RPM 5250 (RPM)." VALUE 0x40008928 RL_VALUE_UWORD 0 CM_u16_rspeed_rpm 0 65535 /end CHARACTERISTIC
/begin CHARACTERISTIC CAL_cruise_feedforward_blend_threshold "undefined1" VALUE 0x4000893E RL_VALUE_UBYTE 0 NO_COMPU_METHOD 0 255 /end CHARACTERISTIC
/begin CHARACTERISTIC CAL_ac_compressor_engine_speed3 "Calibration: A/C compressor engine speed3 (RPM = val*4; 2-element array)." VAL_BLK 0x40008950 RL_VALUE_UBYTE 0 CM_u8_rspeed_4rpm 0 1020 NUMBER 2 /end CHARACTERISTIC
/begin CHARACTERISTIC CAL_cluster_fuel_economy_factory_stepsize "Calibration: cluster fuel economy factory stepsize." VALUE 0x40008979 RL_VALUE_UBYTE 0 NO_COMPU_METHOD 0 255 /end CHARACTERISTIC
/begin CHARACTERISTIC CAL_cluster_dte_min_distance_threshold "Calibration: cluster dte minimum distance threshold (km)." VALUE 0x4000898E RL_VALUE_UBYTE 0 CM_u16_distance_km 0 255 /end CHARACTERISTIC
/begin CHARACTERISTIC CAL_cluster_fuel_range_remaining_smoothing_factor "Calibration: cluster fuel range remaining smoothing factor." VALUE 0x4000898F RL_VALUE_UBYTE 0 NO_COMPU_METHOD 0 255 /end CHARACTERISTIC
/begin CHARACTERISTIC CAL_cluster_fuel_mileage_update_timer "Calibration: cluster fuel mileage update timer (ms = val*100)." VALUE 0x40008991 RL_VALUE_UBYTE 0 CM_u8_time_100ms 0 25500 /end CHARACTERISTIC
/begin CHARACTERISTIC CAL_cluster_fuel_economy_factor_limit "This is a fuel economy limit for calculating avaiable range." VAL_BLK 0x400089C6 RL_VALUE_UBYTE 0 NO_COMPU_METHOD 0 255 NUMBER 2 /end CHARACTERISTIC
/begin CHARACTERISTIC CAL_cluster_fuel_range_smoothing_interval "Calibration: cluster fuel range smoothing interval (ms = val*100)." VALUE 0x400089C8 RL_VALUE_UBYTE 0 CM_u8_time_100ms 0 25500 /end CHARACTERISTIC
/begin CHARACTERISTIC CAL_cluster_fuel_usage_reset_request_timer "Calibration: cluster fuel usage reset request timer (ms = val*100)." VALUE 0x400089C9 RL_VALUE_UBYTE 0 CM_u8_time_100ms 0 25500 /end CHARACTERISTIC
/begin AXIS_PTS CAL_cruise_proportional_gain_ips_X_gear "Calibration: X-axis (gear) for the cruise proportional gain IPS table (4-element array)." 0x40008BD6 car_current_gear RL_AXIS_UBYTE 0 NO_COMPU_METHOD 4 0 255 /end AXIS_PTS
/begin CHARACTERISTIC CAL_cruise_proportional_gain_ips "Calibration: cruise proportional gain IPS (4-element array)." CURVE 0x40008BDA RL_VALUE_UBYTE 0 NO_COMPU_METHOD 0 255
 /begin AXIS_DESCR COM_AXIS car_current_gear NO_COMPU_METHOD 4 0 255 AXIS_PTS_REF CAL_cruise_proportional_gain_ips_X_gear /end AXIS_DESCR
/end CHARACTERISTIC
/begin AXIS_PTS CAL_cruise_integral_gain_ips_X_gear "Calibration: X-axis (gear) for the cruise integral gain IPS table (4-element array)." 0x40008BDE NO_INPUT_QUANTITY RL_AXIS_UBYTE 0 NO_COMPU_METHOD 4 0 255 /end AXIS_PTS
/begin CHARACTERISTIC CAL_cruise_integral_gain_ips "Calibration: cruise integral gain IPS (val/100; 4-element array)." CURVE 0x40008BE2 RL_VALUE_UBYTE 0 CM_u8_factor_1_100 0 255
 /begin AXIS_DESCR COM_AXIS NO_INPUT_QUANTITY NO_COMPU_METHOD 4 0 255 AXIS_PTS_REF CAL_cruise_integral_gain_ips_X_gear /end AXIS_DESCR
/end CHARACTERISTIC
/begin AXIS_PTS CAL_cruise_derivative_gain_ips_X_gear "Calibration: X-axis (gear) for the cruise derivative gain IPS table (4-element array)." 0x40008BE6 car_current_gear RL_AXIS_UBYTE 0 NO_COMPU_METHOD 4 0 255 /end AXIS_PTS
/begin CHARACTERISTIC CAL_cruise_derivative_gain_ips "Calibration: cruise derivative gain IPS (4-element array)." CURVE 0x40008BEA RL_VALUE_UBYTE 0 NO_COMPU_METHOD 0 255
 /begin AXIS_DESCR COM_AXIS car_current_gear NO_COMPU_METHOD 4 0 255 AXIS_PTS_REF CAL_cruise_derivative_gain_ips_X_gear /end AXIS_DESCR
/end CHARACTERISTIC
/begin AXIS_PTS CAL_ac_load_limit_X_rpm "Calibration: X-axis (rpm) for the A/C load limit table (RPM = val*125/4+500; 4-element array)." 0x40008D48 engine_speed_8bit RL_AXIS_UBYTE 0 CM_u8_rspeed_125_4_500rpm 4 500 8468.75 /end AXIS_PTS
/begin CHARACTERISTIC CAL_ac_load_limit "Calibration: A/C load limit (4-element array)." CURVE 0x40008D4C RL_VALUE_UBYTE 0 NO_COMPU_METHOD 0 255
 /begin AXIS_DESCR COM_AXIS engine_speed_8bit CM_u8_rspeed_125_4_500rpm 4 500 8468.75 AXIS_PTS_REF CAL_ac_load_limit_X_rpm /end AXIS_DESCR
/end CHARACTERISTIC
/begin AXIS_PTS CAL_cruise_proportional_gain_manual_longbox_X_gear "Calibration: X-axis (gear) for the cruise proportional gain manual longbox table (4-element array)." 0x40008D66 car_current_gear RL_AXIS_UBYTE 0 NO_COMPU_METHOD 4 0 255 /end AXIS_PTS
/begin CHARACTERISTIC CAL_cruise_proportional_gain_manual_longbox "Calibration: cruise proportional gain manual longbox (4-element array)." CURVE 0x40008D6A RL_VALUE_UBYTE 0 NO_COMPU_METHOD 0 255
 /begin AXIS_DESCR COM_AXIS car_current_gear NO_COMPU_METHOD 4 0 255 AXIS_PTS_REF CAL_cruise_proportional_gain_manual_longbox_X_gear /end AXIS_DESCR
/end CHARACTERISTIC
/begin AXIS_PTS CAL_cruise_integral_gain_manual_longbox_X_gear "Calibration: X-axis (gear) for the cruise integral gain manual longbox table (4-element array)." 0x40008D6E car_current_gear RL_AXIS_UBYTE 0 NO_COMPU_METHOD 4 0 255 /end AXIS_PTS
/begin CHARACTERISTIC CAL_cruise_integral_gain_manual_longbox "Calibration: cruise integral gain manual longbox (val/100; 4-element array)." CURVE 0x40008D72 RL_VALUE_UBYTE 0 CM_u8_factor_1_100 0 255
 /begin AXIS_DESCR COM_AXIS car_current_gear NO_COMPU_METHOD 4 0 255 AXIS_PTS_REF CAL_cruise_integral_gain_manual_longbox_X_gear /end AXIS_DESCR
/end CHARACTERISTIC
/begin AXIS_PTS CAL_cruise_derivative_gain_manual_longbox_X_gear "Calibration: X-axis (gear) for the cruise derivative gain manual longbox table (4-element array)." 0x40008D76 car_current_gear RL_AXIS_UBYTE 0 NO_COMPU_METHOD 4 0 255 /end AXIS_PTS
/begin CHARACTERISTIC CAL_cruise_derivative_gain_manual_longbox "Calibration: cruise derivative gain manual longbox (4-element array)." CURVE 0x40008D7A RL_VALUE_UBYTE 0 NO_COMPU_METHOD 0 255
 /begin AXIS_DESCR COM_AXIS car_current_gear NO_COMPU_METHOD 4 0 255 AXIS_PTS_REF CAL_cruise_derivative_gain_manual_longbox_X_gear /end AXIS_DESCR
/end CHARACTERISTIC
/begin AXIS_PTS CAL_ecu_engine_speed_target_dec_gain_X_coolant_temp "Calibration: X-axis (coolant temp) for the ECU engine speed target dec gain table (°C = val*5/8−40; 4-element array)." 0x40008E58 coolant_temp RL_AXIS_UBYTE 0 CM_u8_temp_5_8_40c 4 -40 119.375 /end AXIS_PTS
/begin CHARACTERISTIC CAL_ecu_engine_speed_target_dec_gain "Calibration: ECU engine speed target dec gain (val/255; 4-element array)." CURVE 0x40008E5C RL_VALUE_UBYTE 0 CM_u8_factor_1_255 0 100
 /begin AXIS_DESCR COM_AXIS coolant_temp CM_u8_temp_5_8_40c 4 -40 119.375 AXIS_PTS_REF CAL_ecu_engine_speed_target_dec_gain_X_coolant_temp /end AXIS_DESCR
/end CHARACTERISTIC
/begin AXIS_PTS CAL_cruise_proportional_gain_manual_cr_X_gear "Calibration: X-axis (gear) for the cruise proportional gain manual cr table (4-element array)." 0x4000946A car_current_gear RL_AXIS_UBYTE 0 NO_COMPU_METHOD 4 0 255 /end AXIS_PTS
/begin CHARACTERISTIC CAL_cruise_proportional_gain_manual_cr "Calibration: cruise proportional gain manual cr (4-element array)." CURVE 0x4000946E RL_VALUE_UBYTE 0 NO_COMPU_METHOD 0 255
 /begin AXIS_DESCR COM_AXIS car_current_gear NO_COMPU_METHOD 4 0 255 AXIS_PTS_REF CAL_cruise_proportional_gain_manual_cr_X_gear /end AXIS_DESCR
/end CHARACTERISTIC
/begin AXIS_PTS CAL_cruise_integral_gain_manual_cr_X_gear "Calibration: X-axis (gear) for the cruise integral gain manual cr table (4-element array)." 0x40009472 car_current_gear RL_AXIS_UBYTE 0 NO_COMPU_METHOD 4 0 255 /end AXIS_PTS
/begin CHARACTERISTIC CAL_cruise_integral_gain_manual_cr "Calibration: cruise integral gain manual cr (val/100; 4-element array)." CURVE 0x40009476 RL_VALUE_UBYTE 0 CM_u8_factor_1_100 0 255
 /begin AXIS_DESCR COM_AXIS car_current_gear NO_COMPU_METHOD 4 0 255 AXIS_PTS_REF CAL_cruise_integral_gain_manual_cr_X_gear /end AXIS_DESCR
/end CHARACTERISTIC
/begin AXIS_PTS CAL_cruise_derivative_gain_manual_cr_X_gear "Calibration: X-axis (gear) for the cruise derivative gain manual cr table (4-element array)." 0x4000947A car_current_gear RL_AXIS_UBYTE 0 NO_COMPU_METHOD 4 0 255 /end AXIS_PTS
/begin CHARACTERISTIC CAL_cruise_derivative_gain_manual_cr "Calibration: cruise derivative gain manual cr (4-element array)." CURVE 0x4000947E RL_VALUE_UBYTE 0 NO_COMPU_METHOD 0 255
 /begin AXIS_DESCR COM_AXIS car_current_gear NO_COMPU_METHOD 4 0 255 AXIS_PTS_REF CAL_cruise_derivative_gain_manual_cr_X_gear /end AXIS_DESCR
/end CHARACTERISTIC
/begin CHARACTERISTIC CAL_cluster_shiftlight_rpm_offset_manual "Calibration: cluster shiftlight RPM offset manual (8-element array)." VAL_BLK 0x40009B9A RL_VALUE_UBYTE 0 NO_COMPU_METHOD 0 255 NUMBER 8 /end CHARACTERISTIC
/begin CHARACTERISTIC CAL_cluster_shiftlight_rpm_offset_manual_40009BA2 "Calibration: cluster shiftlight RPM offset manual (RPM = val*8; 8-element array)." VAL_BLK 0x40009BA2 RL_VALUE_UBYTE 0 CM_u8_rspeed_8rpm 0 2040 NUMBER 8 /end CHARACTERISTIC
/begin AXIS_PTS CAL_ecu_engine_speed_target_sport_X_pps "Calibration: X-axis (pps) for the ECU engine speed target sport table (val/1023; 10-element array)." 0x40009CE6 NO_INPUT_QUANTITY RL_AXIS_UWORD 0 CM_u16_factor_1_1023 10 0 6406.15835777126 /end AXIS_PTS
/begin CHARACTERISTIC CAL_ecu_engine_speed_target_sport "Calibration: ECU engine speed target sport (RPM = val/4; 10-element array)." CURVE 0x40009CFA RL_VALUE_UWORD 0 CM_u16_rspeed_1_4rpm 0 16383.75
 /begin AXIS_DESCR COM_AXIS NO_INPUT_QUANTITY CM_u16_factor_1_1023 10 0 6406.15835777126 AXIS_PTS_REF CAL_ecu_engine_speed_target_sport_X_pps /end AXIS_DESCR
/end CHARACTERISTIC
/begin CHARACTERISTIC CAL_cluster_shiftlight_rpm_offset_ips "Calibration: cluster shiftlight RPM offset IPS (8-element array)." VAL_BLK 0x4000C67A RL_VALUE_UBYTE 0 NO_COMPU_METHOD 0 255 NUMBER 8 /end CHARACTERISTIC
/begin CHARACTERISTIC CAL_cluster_shiftlight_rpm_offset_ips_4000C682 "Calibration: cluster shiftlight RPM offset IPS (RPM = val*8; 8-element array)." VAL_BLK 0x4000C682 RL_VALUE_UBYTE 0 CM_u8_rspeed_8rpm 0 2040 NUMBER 8 /end CHARACTERISTIC
/begin AXIS_PTS CAL_ecu_engine_speed_target_tour_X_pps "Calibration: X-axis (pps) for the ECU engine speed target tour table (val/1023; 10-element array)." 0x4000C86A NO_INPUT_QUANTITY RL_AXIS_UWORD 0 CM_u16_factor_1_1023 10 0 6406.15835777126 /end AXIS_PTS
/begin CHARACTERISTIC CAL_ecu_engine_speed_target_tour "Calibration: ECU engine speed target tour (RPM = val/4; 10-element array)." CURVE 0x4000C87E RL_VALUE_UWORD 0 CM_u16_rspeed_1_4rpm 0 16383.75
 /begin AXIS_DESCR COM_AXIS NO_INPUT_QUANTITY CM_u16_factor_1_1023 10 0 6406.15835777126 AXIS_PTS_REF CAL_ecu_engine_speed_target_tour_X_pps /end AXIS_DESCR
/end CHARACTERISTIC
/begin AXIS_PTS CAL_dca_tps_limit_manual_X_time "Calibration: X-axis (time) for the drive-cycle-assist throttle position limit manual table (ms = val*50; 8-element array)." 0x4000C8D2 NO_INPUT_QUANTITY RL_AXIS_UBYTE 0 CM_u8_time_50ms 8 0 12750 /end AXIS_PTS
/begin CHARACTERISTIC CAL_dca_tps_limit_manual "Calibration: drive-cycle-assist throttle position limit manual (val/255; 8-element array)." CURVE 0x4000C8DA RL_VALUE_UBYTE 0 CM_u8_factor_1_255 0 100
 /begin AXIS_DESCR COM_AXIS NO_INPUT_QUANTITY CM_u8_time_50ms 8 0 12750 AXIS_PTS_REF CAL_dca_tps_limit_manual_X_time /end AXIS_DESCR
/end CHARACTERISTIC
/begin AXIS_PTS CAL_dca_unknown_ips_nolc_X_time "Calibration: X-axis (time) for the drive-cycle-assist IPS nolc table (ms = val*50; 8-element array)." 0x4000C8E2 NO_INPUT_QUANTITY RL_AXIS_UBYTE 0 CM_u8_time_50ms 8 0 12750 /end AXIS_PTS
/begin CHARACTERISTIC CAL_dca_unknown_ips_nolc "Calibration: drive-cycle-assist IPS nolc (val/255; 8-element array)." CURVE 0x4000C8EA RL_VALUE_UBYTE 0 CM_u8_factor_1_255 0 100
 /begin AXIS_DESCR COM_AXIS NO_INPUT_QUANTITY CM_u8_time_50ms 8 0 12750 AXIS_PTS_REF CAL_dca_unknown_ips_nolc_X_time /end AXIS_DESCR
/end CHARACTERISTIC
/begin CHARACTERISTIC CAL_dca_tps_limit_ips_x_time "Calibration: drive-cycle-assist throttle position limit IPS x time (ms = val*50; 8-element array)." VAL_BLK 0x4000C902 RL_VALUE_UBYTE 0 CM_u8_time_50ms 0 12750 NUMBER 8 /end CHARACTERISTIC
/begin CHARACTERISTIC CAL_dca_tps_limit_ips "Calibration: drive-cycle-assist throttle position limit IPS (val/255; 8-element array)." VAL_BLK 0x4000C90A RL_VALUE_UBYTE 0 CM_u8_factor_1_255 0 100 NUMBER 8 /end CHARACTERISTIC
/begin CHARACTERISTIC CAL_cluster_test_enable_ "Calibration: cluster test enable (boolean flag)." VALUE 0x4000C9D8 RL_VALUE_UBYTE 0 NO_COMPU_METHOD 0 255 /end CHARACTERISTIC
/begin CHARACTERISTIC CAL_ecu_system_voltage_threshold "Calibration: ECU system voltage threshold (2-element array)." VAL_BLK 0x4000CA0C RL_VALUE_UWORD 0 CM_u16_voltage_18_1023v 0 1153.10850439883 NUMBER 2 /end CHARACTERISTIC
/begin CHARACTERISTIC CAL_cluster_coolant_warning "Calibration: cluster coolant warning (°C = val*5/8−40; 2-element array)." VAL_BLK 0x4000CA32 RL_VALUE_UBYTE 0 CM_u8_temp_5_8_40c -40 119.375 NUMBER 2 /end CHARACTERISTIC
/begin CHARACTERISTIC CAL_lea_misfire_baseline_set "undefined1" VALUE 0x4000CA66 RL_VALUE_UBYTE 0 NO_COMPU_METHOD 0 255 /end CHARACTERISTIC
/begin CHARACTERISTIC CAL_ecu_obd_mode2F_timer "Calibration: ECU OBD mode2F timer (ms = val*5)." VALUE 0x4000CA90 RL_VALUE_UWORD 0 CM_u8_time_5ms 0 327675 /end CHARACTERISTIC
/begin CHARACTERISTIC CAL_cluster_fuel_level_warning_threshold "Calibration: cluster fuel level warning threshold (gal = val/10; 2-element array)." VAL_BLK 0x4000CAA0 RL_VALUE_UWORD 0 CM_u8_volume_1_10gallon 0 6553.5 NUMBER 2 /end CHARACTERISTIC
/begin CHARACTERISTIC CAL_unknown15 "undefined1" VALUE 0x4000D3B6 RL_VALUE_UBYTE 0 NO_COMPU_METHOD 0 255 /end CHARACTERISTIC
/begin AXIS_PTS CAL_ecu_engine_speed_target_ramp_gain_tour_X_rpm "Calibration: X-axis (rpm) for the ECU engine speed target ramp gain tour table (RPM = val*125/4+500; 4-element array)." 0x4000D614 engine_speed_8bit RL_AXIS_UBYTE 0 CM_u8_rspeed_125_4_500rpm 4 500 8468.75 /end AXIS_PTS
/begin AXIS_PTS CAL_ecu_engine_speed_target_ramp_gain_tour_Y_coolant_temp "Calibration: Y-axis (coolant temp) for the ECU engine speed target ramp gain tour table (°C = val*5/8−40; 4-element array)." 0x4000D618 coolant_temp RL_AXIS_UBYTE 0 CM_u8_temp_5_8_40c 4 -40 119.375 /end AXIS_PTS
/begin CHARACTERISTIC CAL_ecu_engine_speed_target_ramp_gain_tour "Calibration: ECU engine speed target ramp gain tour (val/2560; 16-element array)." MAP 0x4000D61C RL_VALUE_UBYTE 0 CM_u8_factor_1_2560 0 9.9609375
 /begin AXIS_DESCR COM_AXIS engine_speed_8bit CM_u8_rspeed_125_4_500rpm 4 500 8468.75 AXIS_PTS_REF CAL_ecu_engine_speed_target_ramp_gain_tour_X_rpm /end AXIS_DESCR
 /begin AXIS_DESCR COM_AXIS coolant_temp CM_u8_temp_5_8_40c 4 -40 119.375 AXIS_PTS_REF CAL_ecu_engine_speed_target_ramp_gain_tour_Y_coolant_temp /end AXIS_DESCR
/end CHARACTERISTIC
/begin AXIS_PTS CAL_ecu_engine_speed_target_ramp_gain_sport_X_rpm "Calibration: X-axis (rpm) for the ECU engine speed target ramp gain sport table (RPM = val*125/4+500; 4-element array)." 0x4000D62C engine_speed_8bit RL_AXIS_UBYTE 0 CM_u8_rspeed_125_4_500rpm 4 500 8468.75 /end AXIS_PTS
/begin AXIS_PTS CAL_ecu_engine_speed_target_ramp_gain_sport_Y_coolant_temp "Calibration: Y-axis (coolant temp) for the ECU engine speed target ramp gain sport table (°C = val*5/8−40; 4-element array)." 0x4000D630 coolant_temp RL_AXIS_UBYTE 0 CM_u8_temp_5_8_40c 4 -40 119.375 /end AXIS_PTS
/begin CHARACTERISTIC CAL_ecu_engine_speed_target_ramp_gain_sport "Calibration: ECU engine speed target ramp gain sport (val/2560; 16-element array)." MAP 0x4000D634 RL_VALUE_UBYTE 0 CM_u8_factor_1_2560 0 9.9609375
 /begin AXIS_DESCR COM_AXIS engine_speed_8bit CM_u8_rspeed_125_4_500rpm 4 500 8468.75 AXIS_PTS_REF CAL_ecu_engine_speed_target_ramp_gain_sport_X_rpm /end AXIS_DESCR
 /begin AXIS_DESCR COM_AXIS coolant_temp CM_u8_temp_5_8_40c 4 -40 119.375 AXIS_PTS_REF CAL_ecu_engine_speed_target_ramp_gain_sport_Y_coolant_temp /end AXIS_DESCR
/end CHARACTERISTIC
/begin CHARACTERISTIC CAL_misc_calid "Calibration: misc calid (16-element array)." ASCII 0x4000D9F0 RL_VALUE_UBYTE 0 NO_COMPU_METHOD 0 255 NUMBER 16 /end CHARACTERISTIC
/begin CHARACTERISTIC CAL_ecu_thermostat_diag_maf_threshold_manual "uint8_t[18]" VAL_BLK 0x4000DFE8 RL_VALUE_UBYTE 0 NO_COMPU_METHOD 0 255 NUMBER 18 /end CHARACTERISTIC
/begin CHARACTERISTIC CAL_ecu_thermostat_diag_maf_threshold_ips "uint8_t[18]" VAL_BLK 0x4000E016 RL_VALUE_UBYTE 0 NO_COMPU_METHOD 0 255 NUMBER 18 /end CHARACTERISTIC
/begin CHARACTERISTIC CAL_prog_version "Calibration: prog version (32-element array)." ASCII 0x4000E028 RL_VALUE_UBYTE 0 NO_COMPU_METHOD 0 255 NUMBER 32 /end CHARACTERISTIC
/begin AXIS_PTS CAL_cluster_oil_pressure_warn_threshold_X_engine_speed "Calibration: X-axis (engine speed) for the cluster oil pressure warn threshold table (RPM = val*125/4+500; 8-element array)." 0x4000E6E4 engine_speed_8bit RL_AXIS_UBYTE 0 CM_u8_rspeed_125_4_500rpm 8 500 8468.75 /end AXIS_PTS
/begin CHARACTERISTIC CAL_cluster_oil_pressure_warn_threshold "Calibration: cluster oil pressure warn threshold (RPM = val*125/4+500; 8-element array)." CURVE 0x4000E6EC RL_VALUE_UBYTE 0 CM_u8_rspeed_125_4_500rpm 500 8468.75
 /begin AXIS_DESCR COM_AXIS engine_speed_8bit CM_u8_rspeed_125_4_500rpm 8 500 8468.75 AXIS_PTS_REF CAL_cluster_oil_pressure_warn_threshold_X_engine_speed /end AXIS_DESCR
/end CHARACTERISTIC
/begin CHARACTERISTIC CAL_ecu_unlock_magic "Calibration: ECU unlock magic (4-element array)." ASCII 0x4000EFFA RL_VALUE_UBYTE 0 NO_COMPU_METHOD 0 255 NUMBER 4 /end CHARACTERISTIC
/begin CHARACTERISTIC CAL_ecu_cvn "Calibration: ECU cvn." VALUE 0x4000EFFE RL_VALUE_UWORD 0 NO_COMPU_METHOD 0 65535 /end CHARACTERISTIC
/begin MEASUREMENT ecu_shutdown_timer "ECU shutdown timer (ms = val*5)." ULONG CM_u8_time_5ms 0 0 0 21474836475 ECU_ADDRESS 0x40001438 /end MEASUREMENT
/begin MEASUREMENT event_timer_10hz "undefined2" UWORD NO_COMPU_METHOD 0 0 0 65535 ECU_ADDRESS 0x4000143E /end MEASUREMENT
/begin MEASUREMENT event_timer_100hz "undefined1" UBYTE NO_COMPU_METHOD 0 0 0 255 ECU_ADDRESS 0x40001440 /end MEASUREMENT
/begin MEASUREMENT event_timer_50hz "undefined1" UBYTE NO_COMPU_METHOD 0 0 0 255 ECU_ADDRESS 0x40001441 /end MEASUREMENT
/begin MEASUREMENT event_timer_20hz "undefined1" UBYTE NO_COMPU_METHOD 0 0 0 255 ECU_ADDRESS 0x40001442 /end MEASUREMENT
/begin MEASUREMENT event_timer_5hz "undefined1" UBYTE NO_COMPU_METHOD 0 0 0 255 ECU_ADDRESS 0x40001443 /end MEASUREMENT
/begin MEASUREMENT tick_counter_333ms "undefined1" UBYTE NO_COMPU_METHOD 0 0 0 255 ECU_ADDRESS 0x40001444 /end MEASUREMENT
/begin MEASUREMENT event_timer_2hz "undefined1" UBYTE NO_COMPU_METHOD 0 0 0 255 ECU_ADDRESS 0x40001445 /end MEASUREMENT
/begin MEASUREMENT event_timer_1s "undefined1" UBYTE NO_COMPU_METHOD 0 0 0 255 ECU_ADDRESS 0x40001446 /end MEASUREMENT
/begin MEASUREMENT event_timer_1000hz "undefined1" UBYTE NO_COMPU_METHOD 0 0 0 255 ECU_ADDRESS 0x40001447 /end MEASUREMENT
/begin MEASUREMENT event_timer_200hz "undefined1" UBYTE NO_COMPU_METHOD 0 0 0 255 ECU_ADDRESS 0x40001448 /end MEASUREMENT
/begin MEASUREMENT etpu_stats_warmup_counter "undefined1" UBYTE NO_COMPU_METHOD 0 0 0 255 ECU_ADDRESS 0x40001449 /end MEASUREMENT
/begin MEASUREMENT tmap_expected_raw "TMAP lookup (°C = val*5/8−40)." UBYTE CM_u8_temp_5_8_40c 0 0 -40 119.375 ECU_ADDRESS 0x40001456 /end MEASUREMENT
/begin MEASUREMENT tmap_expected_K "TMAP expected K." UWORD NO_COMPU_METHOD 0 0 0 65535 ECU_ADDRESS 0x40001458 /end MEASUREMENT
/begin MEASUREMENT manifold_temp_correction_factor_1_20000 "Manifold temperature correction factor 1/20000." UWORD NO_COMPU_METHOD 0 0 0 65535 ECU_ADDRESS 0x4000145A /end MEASUREMENT
/begin MEASUREMENT ambient_temp_correction_factor_1_20000 "Ambient temperature correction factor 1/20000." UWORD NO_COMPU_METHOD 0 0 0 65535 ECU_ADDRESS 0x4000145C /end MEASUREMENT
/begin MEASUREMENT air_density_manifold_ratio_1_20000 "Air density manifold ratio 1/20000." UWORD NO_COMPU_METHOD 0 0 0 65535 ECU_ADDRESS 0x4000145E /end MEASUREMENT
/begin MEASUREMENT air_density_ambient_ratio_1_20000 "Air density ambient ratio 1/20000." UWORD NO_COMPU_METHOD 0 0 0 65535 ECU_ADDRESS 0x40001460 /end MEASUREMENT
/begin MEASUREMENT engine_running_confirm_timer "undefined2" UWORD NO_COMPU_METHOD 0 0 0 65535 ECU_ADDRESS 0x40001462 /end MEASUREMENT
/begin MEASUREMENT knock_sensor1_voltage "Knock sensor1 voltage (V = val*5/1023)." UWORD CM_u16_voltage_5_1023v 0 0 0 320.307917888563 ECU_ADDRESS 0x40001478 /end MEASUREMENT
/begin MEASUREMENT knock_sensor2_voltage "Knock sensor2 voltage (V = val*5/1023)." UWORD CM_u16_voltage_5_1023v 0 0 0 320.307917888563 ECU_ADDRESS 0x4000147A /end MEASUREMENT
/begin MEASUREMENT brake_or_clutch_inactive_timer "undefined1" UBYTE NO_COMPU_METHOD 0 0 0 255 ECU_ADDRESS 0x4000147C /end MEASUREMENT
/begin MEASUREMENT fuel_level_stable_counter "u8_count" UBYTE NO_COMPU_METHOD 0 0 0 255 ECU_ADDRESS 0x4000147D /end MEASUREMENT
/begin MEASUREMENT brake_clutch_debounce_timer_ "undefined1" UBYTE NO_COMPU_METHOD 0 0 0 255 ECU_ADDRESS 0x4000147E /end MEASUREMENT
/begin MEASUREMENT ign_comp_coolant "i16_angle_1/4deg" SWORD CM_u8_angle_1_4deg 0 0 -8192 8191.75 ECU_ADDRESS 0x40001480 /end MEASUREMENT
/begin MEASUREMENT ign_temp_engine_air_comp "Ignition temperature engine air compensation (° = val/4)." SWORD CM_u8_angle_1_4deg 0 0 -8192 8191.75 ECU_ADDRESS 0x40001482 /end MEASUREMENT
/begin MEASUREMENT ign_comp_rpm "Ignition compensation RPM (° = val/4)." SWORD CM_u8_angle_1_4deg 0 0 -8192 8191.75 ECU_ADDRESS 0x40001484 /end MEASUREMENT
/begin MEASUREMENT ign_adv_adj_coolant_factor "u8_factor_1/128" UBYTE CM_u8_factor_1_128 0 0 0 199.21875 ECU_ADDRESS 0x40001486 /end MEASUREMENT
/begin MEASUREMENT ign_comp_manifold_temp_raw "Ignition compensation manifold temperature (° = val/4)." SWORD CM_u8_angle_1_4deg 0 0 -8192 8191.75 ECU_ADDRESS 0x40001488 /end MEASUREMENT
/begin MEASUREMENT ign_comp_manifold_temp_load_multiplier "u8_factor_1/128" UBYTE CM_u8_factor_1_128 0 0 0 199.21875 ECU_ADDRESS 0x4000148A /end MEASUREMENT
/begin MEASUREMENT ign_adv_limit "undefined2" UWORD NO_COMPU_METHOD 0 0 0 65535 ECU_ADDRESS 0x4000148C /end MEASUREMENT
/begin MEASUREMENT ign_retard_recovery_step "Ignition retard recovery step (° = val/4−32)." UBYTE CM_u8_angle_1_4_32deg 0 0 -32 31.75 ECU_ADDRESS 0x4000148E /end MEASUREMENT
/begin MEASUREMENT inj_warmup_factor "Injector enrichment factor load n coolant (val/64)." UBYTE CM_u8_factor_1_64 0 0 0 398.4375 ECU_ADDRESS 0x40001490 /end MEASUREMENT
/begin MEASUREMENT cranking_enrichment_coolant "Cranking enrichment coolant (val/32)." UBYTE CM_u16_factor_1_32 0 0 0 796.875 ECU_ADDRESS 0x40001491 /end MEASUREMENT
/begin MEASUREMENT inj_cranking_comp_air_temp "undefined1" UBYTE NO_COMPU_METHOD 0 0 0 255 ECU_ADDRESS 0x40001492 /end MEASUREMENT
/begin MEASUREMENT inj_pulse_time_b1 "Injector pulse time bank 1 (µs)." UWORD CM_u16_time_us 0 0 0 65535 ECU_ADDRESS 0x40001494 /end MEASUREMENT
/begin MEASUREMENT inj_pulse_time_b2 "Injector pulse time bank 2 (µs)." UWORD CM_u16_time_us 0 0 0 65535 ECU_ADDRESS 0x40001496 /end MEASUREMENT
/begin MEASUREMENT inj_enrichment_charge_air_temp "Injector compensation air temperature raw2." UBYTE NO_COMPU_METHOD 0 0 0 255 ECU_ADDRESS 0x40001498 /end MEASUREMENT
/begin MEASUREMENT engine_off_time_100ms "Engine off time 100ms (ms = val*100)." UWORD CM_u8_time_100ms 0 0 0 6553500 ECU_ADDRESS 0x4000149A /end MEASUREMENT
/begin MEASUREMENT load_limit_from_inj "Load limit from injector (mg/stroke)." ULONG CM_u16_load_mg_stroke 0 0 0 4294967295 ECU_ADDRESS 0x400014A0 /end MEASUREMENT
/begin MEASUREMENT soak_timer_tick_10hz_ "undefined1" UBYTE NO_COMPU_METHOD 0 0 0 255 ECU_ADDRESS 0x400014A4 /end MEASUREMENT
/begin MEASUREMENT fuel_usage_reset_request_timer "undefined1" UBYTE NO_COMPU_METHOD 0 0 0 255 ECU_ADDRESS 0x400014A8 /end MEASUREMENT
/begin MEASUREMENT cluster_500ms_divider "Transmission cooler timer (ms = val*100)." UBYTE CM_u8_time_100ms 0 0 0 25500 ECU_ADDRESS 0x400014A9 /end MEASUREMENT
/begin MEASUREMENT cluster_lamp_test_timer "undefined1" UBYTE NO_COMPU_METHOD 0 0 0 255 ECU_ADDRESS 0x400014AB /end MEASUREMENT
/begin MEASUREMENT cac_pump_dutcycle_debug_override "Charge-air-cooler pump dutcycle debug override (val/255)." UWORD CM_u8_factor_1_255 0 0 0 25700 ECU_ADDRESS 0x400014AE /end MEASUREMENT
/begin MEASUREMENT cluster_test_timer "undefined1" UBYTE NO_COMPU_METHOD 0 0 0 255 ECU_ADDRESS 0x400014B0 /end MEASUREMENT
/begin MEASUREMENT exhaust_flap_dc "Exhaust flap duty cycle (val/10000)." UWORD CM_u16_factor_1_10000 0 0 0 655.35 ECU_ADDRESS 0x400014B2 /end MEASUREMENT
/begin MEASUREMENT flexcan_a_tx_102_timer "Flexcan a tx 102 timer." SBYTE NO_COMPU_METHOD 0 0 -128 127 ECU_ADDRESS 0x400014B4 /end MEASUREMENT
/begin MEASUREMENT inj_tip_apply_adj "Injector tip apply adj (boolean flag)." UBYTE NO_COMPU_METHOD 0 0 0 255 ECU_ADDRESS 0x400014B8 /end MEASUREMENT
/begin MEASUREMENT obd_monitor_task_scheduler_token "undefined2" UWORD NO_COMPU_METHOD 0 0 0 65535 ECU_ADDRESS 0x400014C8 /end MEASUREMENT
/begin MEASUREMENT obd_ii_stft_bank1 "OBD-II: short-term fuel trim bank1 (% = val*100/128−100)." UBYTE CM_u8_percent_100_128_100 0 0 -100 99.21875 ECU_ADDRESS 0x400014CA /end MEASUREMENT
/begin MEASUREMENT obd_ii_stft_bank2 "OBD-II: short-term fuel trim bank2 (% = val*100/128−100)." UBYTE CM_u8_percent_100_128_100 0 0 -100 99.21875 ECU_ADDRESS 0x400014CB /end MEASUREMENT
/begin MEASUREMENT obd_ii_ltft_bank1 "OBD-II: long-term fuel trim bank1 (% = val*100/128−100)." UBYTE CM_u8_percent_100_128_100 0 0 -100 99.21875 ECU_ADDRESS 0x400014CC /end MEASUREMENT
/begin MEASUREMENT obd_ii_ltft_bank2 "OBD-II: long-term fuel trim bank2 (% = val*100/128−100)." UBYTE CM_u8_percent_100_128_100 0 0 -100 99.21875 ECU_ADDRESS 0x400014CD /end MEASUREMENT
/begin MEASUREMENT obd_ii_DTC_current "string" ULONG NO_COMPU_METHOD 0 0 0 4294967295 ECU_ADDRESS 0x400014D0 /end MEASUREMENT
/begin MEASUREMENT obd_ii_perm_dtc "string" ULONG NO_COMPU_METHOD 0 0 0 4294967295 ECU_ADDRESS 0x400014D8 /end MEASUREMENT
/begin MEASUREMENT obd_ii_DTC_confirmed "string" ULONG NO_COMPU_METHOD 0 0 0 4294967295 ECU_ADDRESS 0x400014E0 /end MEASUREMENT
/begin MEASUREMENT obd_ii_DTC_pending "string" ULONG NO_COMPU_METHOD 0 0 0 4294967295 ECU_ADDRESS 0x400014E8 /end MEASUREMENT
/begin MEASUREMENT tps_obd_ii_model_pos "u16_factor_1/20000" UWORD CM_u16_factor_1_20000 0 0 0 327.675 ECU_ADDRESS 0x400014F0 /end MEASUREMENT
/begin MEASUREMENT closedloop_o2_timer_unknown "undefined1" UBYTE NO_COMPU_METHOD 0 0 0 255 ECU_ADDRESS 0x400014F8 /end MEASUREMENT
/begin MEASUREMENT idle_control_timer_10hz "undefined1" UBYTE NO_COMPU_METHOD 0 0 0 255 ECU_ADDRESS 0x40001502 /end MEASUREMENT
/begin MEASUREMENT knock_buffer_size "Knock buffer size." UBYTE NO_COMPU_METHOD 0 0 0 255 ECU_ADDRESS 0x40001508 /end MEASUREMENT
/begin MEASUREMENT knock_sensitivity "Knock sensitivity (val/255)." UBYTE CM_u8_factor_1_255 0 0 0 100 ECU_ADDRESS 0x40001509 /end MEASUREMENT
/begin MEASUREMENT knock_peak_threshold "Knock peak threshold." UBYTE NO_COMPU_METHOD 0 0 0 255 ECU_ADDRESS 0x4000150A /end MEASUREMENT
/begin MEASUREMENT knock_ign_retard_delay_timer "undefined1" UBYTE NO_COMPU_METHOD 0 0 0 255 ECU_ADDRESS 0x4000150B /end MEASUREMENT
/begin MEASUREMENT knock_ign_retard_timer_unknown2 "undefined1" UBYTE NO_COMPU_METHOD 0 0 0 255 ECU_ADDRESS 0x4000150C /end MEASUREMENT
/begin MEASUREMENT accel_pedal_mode "Accelerator pedal mode (enumerated state)." UBYTE NO_COMPU_METHOD 0 0 0 255 ECU_ADDRESS 0x40001520 /end MEASUREMENT
/begin MEASUREMENT accel_pedal_d_zero_voltage "u16_factor_1/1023" UWORD CM_u16_factor_1_1023 0 0 0 6406.15835777126 ECU_ADDRESS 0x40001522 /end MEASUREMENT
/begin MEASUREMENT accel_pedal_e_zero_voltage "undefined2" UWORD NO_COMPU_METHOD 0 0 0 65535 ECU_ADDRESS 0x40001524 /end MEASUREMENT
/begin MEASUREMENT cruise_accel_override_holdoff_timer "undefined1" UBYTE NO_COMPU_METHOD 0 0 0 255 ECU_ADDRESS 0x40001526 /end MEASUREMENT
/begin MEASUREMENT cruise_timer_unknown "undefined2" UWORD NO_COMPU_METHOD 0 0 0 65535 ECU_ADDRESS 0x40001528 /end MEASUREMENT
/begin MEASUREMENT accel_pedal_zero_trim_timer "Accelerator pedal zero trim timer (ms = val*5)." UWORD CM_u8_time_5ms 0 0 0 327675 ECU_ADDRESS 0x4000152A /end MEASUREMENT
/begin MEASUREMENT evap_purge_ramp_up_step "undefined2" UWORD NO_COMPU_METHOD 0 0 0 65535 ECU_ADDRESS 0x40001530 /end MEASUREMENT
/begin MEASUREMENT evap_purge_ramp_down_step "undefined2" UWORD NO_COMPU_METHOD 0 0 0 65535 ECU_ADDRESS 0x40001532 /end MEASUREMENT
/begin MEASUREMENT clutch_sensor_confidence_min "undefined2" UWORD NO_COMPU_METHOD 0 0 0 65535 ECU_ADDRESS 0x4000154E /end MEASUREMENT
/begin MEASUREMENT cam_park_position_max_inlet_b1 "u16_angle_1/4deg" UWORD CM_u8_angle_1_4deg 0 0 0 16383.75 ECU_ADDRESS 0x40001550 /end MEASUREMENT
/begin MEASUREMENT cam_park_position_max_inlet_b2 "u16_angle_1/4deg" UWORD CM_u8_angle_1_4deg 0 0 0 16383.75 ECU_ADDRESS 0x40001552 /end MEASUREMENT
/begin MEASUREMENT cam_park_position_max_exhaust_b1 "undefined2" UWORD NO_COMPU_METHOD 0 0 0 65535 ECU_ADDRESS 0x40001554 /end MEASUREMENT
/begin MEASUREMENT cam_park_position_max_exhaust_b2 "undefined2" UWORD NO_COMPU_METHOD 0 0 0 65535 ECU_ADDRESS 0x40001556 /end MEASUREMENT
/begin MEASUREMENT vvt_duty_inlet_b1 "undefined2" UWORD NO_COMPU_METHOD 0 0 0 65535 ECU_ADDRESS 0x40001560 /end MEASUREMENT
/begin MEASUREMENT vvt_duty_inlet_b2 "undefined2" UWORD NO_COMPU_METHOD 0 0 0 65535 ECU_ADDRESS 0x40001562 /end MEASUREMENT
/begin MEASUREMENT vvt_duty_exh_b1 "undefined2" UWORD NO_COMPU_METHOD 0 0 0 65535 ECU_ADDRESS 0x40001564 /end MEASUREMENT
/begin MEASUREMENT vvt_duty_exh_b2 "undefined2" UWORD NO_COMPU_METHOD 0 0 0 65535 ECU_ADDRESS 0x40001566 /end MEASUREMENT
/begin MEASUREMENT tps_warmup_limit_timer "undefined1" UBYTE NO_COMPU_METHOD 0 0 0 255 ECU_ADDRESS 0x40001568 /end MEASUREMENT
/begin MEASUREMENT throttle_actuator_activity "Throttle actuator activity (boolean flag)." UBYTE NO_COMPU_METHOD 0 0 0 255 ECU_ADDRESS 0x40001569 /end MEASUREMENT
/begin MEASUREMENT lfb_tps_max "undefined2" UWORD NO_COMPU_METHOD 0 0 0 65535 ECU_ADDRESS 0x4000156A /end MEASUREMENT
/begin MEASUREMENT tps_target_from_torque_limit "Throttle position target from torque limit (val/1023)." UWORD CM_u16_factor_1_1023 0 0 0 6406.15835777126 ECU_ADDRESS 0x4000156C /end MEASUREMENT
/begin MEASUREMENT etb_high_duty_timer "undefined2" UWORD NO_COMPU_METHOD 0 0 0 65535 ECU_ADDRESS 0x4000156E /end MEASUREMENT
/begin MEASUREMENT etb_low_voltage_debounce_counter "undefined1" UBYTE NO_COMPU_METHOD 0 0 0 255 ECU_ADDRESS 0x40001572 /end MEASUREMENT
/begin MEASUREMENT lfb_requires_init "undefined1" UBYTE NO_COMPU_METHOD 0 0 0 255 ECU_ADDRESS 0x40001573 /end MEASUREMENT
/begin MEASUREMENT knock_sampling_active "Knock sampling active (boolean flag)." UBYTE NO_COMPU_METHOD 0 0 0 255 ECU_ADDRESS 0x40001578 /end MEASUREMENT
/begin MEASUREMENT knock_agc_stage_override_value "undefined1" UBYTE NO_COMPU_METHOD 0 0 0 255 ECU_ADDRESS 0x40001579 /end MEASUREMENT
/begin MEASUREMENT knock_agc_gain_normalization_divisor "undefined1" UBYTE NO_COMPU_METHOD 0 0 0 255 ECU_ADDRESS 0x4000157A /end MEASUREMENT
/begin MEASUREMENT knock_window_irq_phase "undefined1" UBYTE NO_COMPU_METHOD 0 0 0 255 ECU_ADDRESS 0x4000157B /end MEASUREMENT
/begin MEASUREMENT air_temp_ambient "Air temperature intake (°C = val*5/8−40)." UBYTE CM_u8_temp_5_8_40c 0 0 -40 119.375 ECU_ADDRESS 0x40001590 /end MEASUREMENT
/begin MEASUREMENT air_temp_ambient_unscaled "undefined1" UBYTE NO_COMPU_METHOD 0 0 0 255 ECU_ADDRESS 0x40001591 /end MEASUREMENT
/begin MEASUREMENT torque_request1 "undefined2" UWORD NO_COMPU_METHOD 0 0 0 65535 ECU_ADDRESS 0x40001592 /end MEASUREMENT
/begin MEASUREMENT torque_request2 "undefined2" UWORD NO_COMPU_METHOD 0 0 0 65535 ECU_ADDRESS 0x40001594 /end MEASUREMENT
/begin MEASUREMENT torque_request3 "undefined2" UWORD NO_COMPU_METHOD 0 0 0 65535 ECU_ADDRESS 0x40001596 /end MEASUREMENT
/begin MEASUREMENT cruise_min_engage_gear "enum_t6e_gear" UBYTE NO_COMPU_METHOD 0 0 0 255 ECU_ADDRESS 0x400015AA /end MEASUREMENT
/begin MEASUREMENT torque_limit_tps_current "Torque limit throttle position current (val/4095)." UWORD CM_u16_factor_1_4095 0 0 0 1600.3663003663 ECU_ADDRESS 0x400015B8 /end MEASUREMENT
/begin MEASUREMENT torque_limit_external_request "Torque limit external request (Nm)." UWORD CM_u8_torque_nm 0 0 0 65535 ECU_ADDRESS 0x400015BA /end MEASUREMENT
/begin MEASUREMENT torque_external_request_tps_based "Torque external request throttle position based (Nm)." UWORD CM_u8_torque_nm 0 0 0 65535 ECU_ADDRESS 0x400015BC /end MEASUREMENT
/begin MEASUREMENT torque_limit_external_tc_fast "Torque limit external traction control fast (Nm)." UWORD CM_u8_torque_nm 0 0 0 65535 ECU_ADDRESS 0x400015BE /end MEASUREMENT
/begin MEASUREMENT torque_limit_external_esp_fast "Torque limit external ESP fast (Nm)." UWORD CM_u8_torque_nm 0 0 0 65535 ECU_ADDRESS 0x400015C0 /end MEASUREMENT
/begin MEASUREMENT torque_limit_external_tc_slow "Torque limit external traction control slow (Nm)." UWORD CM_u8_torque_nm 0 0 0 65535 ECU_ADDRESS 0x400015C2 /end MEASUREMENT
/begin MEASUREMENT torque_limit_tcu_0xc7_raw "u16_torque_nm" UWORD CM_u8_torque_nm 0 0 0 65535 ECU_ADDRESS 0x400015C4 /end MEASUREMENT
/begin MEASUREMENT torque_requested_during_shift_raw "u16_torque_nm" UWORD CM_u8_torque_nm 0 0 0 65535 ECU_ADDRESS 0x400015C8 /end MEASUREMENT
/begin MEASUREMENT torque_requested_during_shift_scaled "u16_torque_nm" UWORD CM_u8_torque_nm 0 0 0 65535 ECU_ADDRESS 0x400015CA /end MEASUREMENT
/begin MEASUREMENT torque_target_tps_compensated "Torque target throttle position compensated (Nm)." UWORD CM_u8_torque_nm 0 0 0 65535 ECU_ADDRESS 0x400015CC /end MEASUREMENT
/begin MEASUREMENT tps_feedforward_from_load_limit "Throttle position feedforward from load limit (val/4095)." UWORD CM_u16_factor_1_4095 0 0 0 1600.3663003663 ECU_ADDRESS 0x400015D0 /end MEASUREMENT
/begin MEASUREMENT torque_cut_demand_threshold "Torque cut demand threshold (val/255)." UWORD CM_u8_factor_1_255 0 0 0 25700 ECU_ADDRESS 0x400015D2 /end MEASUREMENT
/begin MEASUREMENT torque_reduction_factor_ign "Torque reduction factor ignition (val/255)." UBYTE CM_u8_factor_1_255 0 0 0 100 ECU_ADDRESS 0x400015D4 /end MEASUREMENT
/begin MEASUREMENT torque_spark_efficiency_slope "undefined2" UWORD NO_COMPU_METHOD 0 0 0 65535 ECU_ADDRESS 0x400015D6 /end MEASUREMENT
/begin MEASUREMENT torque_spark_efficiency_current "Torque spark efficiency current (val/255)." UBYTE CM_u8_factor_1_255 0 0 0 100 ECU_ADDRESS 0x400015D8 /end MEASUREMENT
/begin MEASUREMENT torque_factor_from_ign_retard "Torque factor from ignition retard (val/255)." UBYTE CM_u8_factor_1_255 0 0 0 100 ECU_ADDRESS 0x400015D9 /end MEASUREMENT
/begin MEASUREMENT torque_factor_ign_retard_net "undefined1" UBYTE NO_COMPU_METHOD 0 0 0 255 ECU_ADDRESS 0x400015DA /end MEASUREMENT
/begin MEASUREMENT torque_to_tps_cal "Torque to throttle position cal (val/4095)." UWORD CM_u16_factor_1_4095 0 0 0 1600.3663003663 ECU_ADDRESS 0x400015DC /end MEASUREMENT
/begin MEASUREMENT _torque_to_tps_lea "Torque to throttle position lea (val/100)." UBYTE CM_u8_factor_1_100 0 0 0 255 ECU_ADDRESS 0x400015DE /end MEASUREMENT
/begin MEASUREMENT torque_cruise_request "Torque cruise request (Nm)." UWORD CM_u8_torque_nm 0 0 0 65535 ECU_ADDRESS 0x400015E0 /end MEASUREMENT
/begin MEASUREMENT torque_limit_arbitrated_fast "u16_torque_nm" UWORD CM_u8_torque_nm 0 0 0 65535 ECU_ADDRESS 0x400015E2 /end MEASUREMENT
/begin MEASUREMENT torque_limit_arbitrated_slow "u16_torque_nm" UWORD CM_u8_torque_nm 0 0 0 65535 ECU_ADDRESS 0x400015E4 /end MEASUREMENT
/begin MEASUREMENT torque_limit_0xb7_fast_validated "u16_torque_nm" UWORD CM_u8_torque_nm 0 0 0 65535 ECU_ADDRESS 0x400015E6 /end MEASUREMENT
/begin MEASUREMENT torque_limit_0xb7_slow_validated "u16_torque_nm" UWORD CM_u8_torque_nm 0 0 0 65535 ECU_ADDRESS 0x400015E8 /end MEASUREMENT
/begin MEASUREMENT torque_limit_arbitrary_end_of_pass_unused "u16_torque_nm" UWORD CM_u8_torque_nm 0 0 0 65535 ECU_ADDRESS 0x400015EA /end MEASUREMENT
/begin MEASUREMENT torque_limit_tcu_0xc7_validated "u16_torque_nm" UWORD CM_u8_torque_nm 0 0 0 65535 ECU_ADDRESS 0x400015EC /end MEASUREMENT
/begin MEASUREMENT torque_limit_ips_shift_fast "u16_torque_nm" UWORD CM_u8_torque_nm 0 0 0 65535 ECU_ADDRESS 0x400015EE /end MEASUREMENT
/begin MEASUREMENT torque_limit_ips_shift_slow "u16_torque_nm" UWORD CM_u8_torque_nm 0 0 0 65535 ECU_ADDRESS 0x400015F0 /end MEASUREMENT
/begin MEASUREMENT torque_limit_dpm_spark "u16_torque_nm" UWORD CM_u8_torque_nm 0 0 0 65535 ECU_ADDRESS 0x400015F2 /end MEASUREMENT
/begin MEASUREMENT torque_limit_dpm_throttle "u16_torque_nm" UWORD CM_u8_torque_nm 0 0 0 65535 ECU_ADDRESS 0x400015F4 /end MEASUREMENT
/begin MEASUREMENT torque_timer_primary_unknown "undefined1" UBYTE NO_COMPU_METHOD 0 0 0 255 ECU_ADDRESS 0x400015F6 /end MEASUREMENT
/begin MEASUREMENT ac_10hz_timer "A/C 10hz timer (ms = val*5)." UBYTE CM_u8_time_5ms 0 0 0 1275 ECU_ADDRESS 0x400015F8 /end MEASUREMENT
/begin MEASUREMENT ac_compressor_soft_engage_timer "undefined1" UBYTE NO_COMPU_METHOD 0 0 0 255 ECU_ADDRESS 0x400015FB /end MEASUREMENT
/begin MEASUREMENT coding_validated "Coding validated (boolean flag)." UBYTE NO_COMPU_METHOD 0 0 0 255 ECU_ADDRESS 0x40001600 /end MEASUREMENT
/begin MEASUREMENT speed_limit_target_ramped "Speed limit target ramped (km/h = val/100)." UWORD CM_u8_speed_1_100kph 0 0 0 655.35 ECU_ADDRESS 0x4000160C /end MEASUREMENT
/begin MEASUREMENT revlimit_car_speed_limit "Rev-limit car speed limit (km/h = val/100)." UWORD CM_u8_speed_1_100kph 0 0 0 655.35 ECU_ADDRESS 0x4000160E /end MEASUREMENT
/begin MEASUREMENT sas_timer_unknown "undefined1" UBYTE NO_COMPU_METHOD 0 0 0 255 ECU_ADDRESS 0x4000161A /end MEASUREMENT
/begin MEASUREMENT p0316_eval_tc_request_state "P0316 eval traction control request state (enumerated state)." UBYTE NO_COMPU_METHOD 0 0 0 255 ECU_ADDRESS 0x4000161C /end MEASUREMENT
/begin MEASUREMENT dpm_control_flags "undefined2" UWORD NO_COMPU_METHOD 0 0 0 65535 ECU_ADDRESS 0x40001638 /end MEASUREMENT
/begin MEASUREMENT dpm_mode_index "Driver performance mode mode index." UBYTE NO_COMPU_METHOD 0 0 0 255 ECU_ADDRESS 0x4000163A /end MEASUREMENT
/begin MEASUREMENT torque_limit_dpm_spark_4000163C "Driver performance mode target torque reduced (Nm)." UWORD CM_u8_torque_nm 0 0 0 65535 ECU_ADDRESS 0x4000163C /end MEASUREMENT
/begin MEASUREMENT torque_limit_dpm_throttle_4000163E "Driver performance mode target torque upper limit (Nm)." UWORD CM_u8_torque_nm 0 0 0 65535 ECU_ADDRESS 0x4000163E /end MEASUREMENT
/begin MEASUREMENT dpm_torque_when_tc_activated "Driver performance mode torque when traction control activated (Nm)." UWORD CM_u8_torque_nm 0 0 0 65535 ECU_ADDRESS 0x40001640 /end MEASUREMENT
/begin MEASUREMENT flash_driver_init_status "pointer" ULONG NO_COMPU_METHOD 0 0 0 4294967295 ECU_ADDRESS 0x40001648 /end MEASUREMENT
/begin MEASUREMENT flash_erase_pending_flags "undefined1" UBYTE NO_COMPU_METHOD 0 0 0 255 ECU_ADDRESS 0x40001670 /end MEASUREMENT
/begin MEASUREMENT crank_cycle_position "undefined2" UWORD NO_COMPU_METHOD 0 0 0 65535 ECU_ADDRESS 0x40001674 /end MEASUREMENT
/begin MEASUREMENT ecu_unlocked "ECU unlocked (boolean flag)." UBYTE NO_COMPU_METHOD 0 0 0 255 ECU_ADDRESS 0x40001678 /end MEASUREMENT
/begin MEASUREMENT free_ram_overrun_flag "Free ram overrun flag (boolean flag)." UBYTE NO_COMPU_METHOD 0 0 0 255 ECU_ADDRESS 0x40001680 /end MEASUREMENT
/begin MEASUREMENT free_ram_count "undefined4" ULONG NO_COMPU_METHOD 0 0 0 4294967295 ECU_ADDRESS 0x40001684 /end MEASUREMENT
/begin MEASUREMENT free_ram_scan_ptr "undefined4" ULONG NO_COMPU_METHOD 0 0 0 4294967295 ECU_ADDRESS 0x40001688 /end MEASUREMENT
/begin MEASUREMENT inj_bank_balance_trim_unused "undefined1" UBYTE NO_COMPU_METHOD 0 0 0 255 ECU_ADDRESS 0x4000168D /end MEASUREMENT
/begin MEASUREMENT vvt_exhaust_fallback_angle_zero "undefined1" UBYTE NO_COMPU_METHOD 0 0 0 255 ECU_ADDRESS 0x4000168E /end MEASUREMENT
/begin MEASUREMENT afr_target_trim_0p02_steps "undefined1" UBYTE NO_COMPU_METHOD 0 0 0 255 ECU_ADDRESS 0x4000168F /end MEASUREMENT
/begin MEASUREMENT vvt_intake_fallback_angle_zero "undefined1" UBYTE NO_COMPU_METHOD 0 0 0 255 ECU_ADDRESS 0x40001690 /end MEASUREMENT
/begin MEASUREMENT fuel_pump_duty_trim "undefined1" UBYTE NO_COMPU_METHOD 0 0 0 255 ECU_ADDRESS 0x40001691 /end MEASUREMENT
/begin MEASUREMENT inj_angle_test_trim "undefined1" UBYTE NO_COMPU_METHOD 0 0 0 255 ECU_ADDRESS 0x40001692 /end MEASUREMENT
/begin MEASUREMENT ign_advance_test_trim "undefined1" UBYTE NO_COMPU_METHOD 0 0 0 255 ECU_ADDRESS 0x40001693 /end MEASUREMENT
/begin MEASUREMENT inj_efficiency_test_trim "undefined1" UBYTE NO_COMPU_METHOD 0 0 0 255 ECU_ADDRESS 0x40001694 /end MEASUREMENT
/begin MEASUREMENT timer_main "undefined4" ULONG NO_COMPU_METHOD 0 0 0 4294967295 ECU_ADDRESS 0x40001698 /end MEASUREMENT
/begin MEASUREMENT tps_transient_magnitude_decay "Throttle position transient magnitude decay (val/1023)." UWORD CM_u16_factor_1_1023 0 0 0 6406.15835777126 ECU_ADDRESS 0x400016A0 /end MEASUREMENT
/begin MEASUREMENT ecu_run_timer "ECU run timer (ms = val*100)." UWORD CM_u8_time_100ms 0 0 0 6553500 ECU_ADDRESS 0x400016A2 /end MEASUREMENT
/begin MEASUREMENT dfco_pedal_ramp_target2 "undefined2" UWORD NO_COMPU_METHOD 0 0 0 65535 ECU_ADDRESS 0x400016A4 /end MEASUREMENT
/begin MEASUREMENT fuel_cut_inhibit_timer "Fuel cut inhibit timer (ms = val*5)." UWORD CM_u8_time_5ms 0 0 0 327675 ECU_ADDRESS 0x400016AA /end MEASUREMENT
/begin MEASUREMENT fan_engine_bay_enable_delay "undefined2" UWORD NO_COMPU_METHOD 0 0 0 65535 ECU_ADDRESS 0x400016AC /end MEASUREMENT
/begin MEASUREMENT tps_delta_rate "i16_factor_1/1023" SWORD CM_u16_factor_1_1023 0 0 -3203.12805474096 3203.0303030303 ECU_ADDRESS 0x400016AE /end MEASUREMENT
/begin MEASUREMENT tps_rate_steadystate "Throttle position rate current (val/255)." SWORD CM_u16_factor_1_1023 0 0 -3203.12805474096 3203.0303030303 ECU_ADDRESS 0x400016B0 /end MEASUREMENT
/begin MEASUREMENT fan_engine_bay_run_timer "undefined1" UBYTE NO_COMPU_METHOD 0 0 0 255 ECU_ADDRESS 0x400016B2 /end MEASUREMENT
/begin MEASUREMENT maf_accumulated_since_start_raw "MAF accumulated since start (mg)." UWORD CM_u16_mass_mg 0 0 0 65535 ECU_ADDRESS 0x400016B4 /end MEASUREMENT
/begin MEASUREMENT maf_accum_since_start_scaled "undefined2" UWORD NO_COMPU_METHOD 0 0 0 65535 ECU_ADDRESS 0x400016B6 /end MEASUREMENT
/begin MEASUREMENT fuel_level "Fuel level (gal = val/10)." UWORD CM_u8_volume_1_10gallon 0 0 0 6553.5 ECU_ADDRESS 0x400016B8 /end MEASUREMENT
/begin MEASUREMENT load_learning_stabilization_timer "undefined2" UWORD NO_COMPU_METHOD 0 0 0 65535 ECU_ADDRESS 0x400016BA /end MEASUREMENT
/begin MEASUREMENT obd_ii_accumulated_mass_air "OBD-II: accumulated mass air (µg)." ULONG CM_u32_mass_ug 0 0 0 4294967295 ECU_ADDRESS 0x400016C0 /end MEASUREMENT
/begin MEASUREMENT maf_accum_integral "undefined4" ULONG NO_COMPU_METHOD 0 0 0 4294967295 ECU_ADDRESS 0x400016C4 /end MEASUREMENT
/begin MEASUREMENT cooling_timer_recirc_pump "Cooling timer recirc pump (ms = val*5)." ULONG CM_u8_time_5ms 0 0 0 21474836475 ECU_ADDRESS 0x400016D0 /end MEASUREMENT
/begin MEASUREMENT injtip_overrun_hysteresis_timer "undefined2" UWORD NO_COMPU_METHOD 0 0 0 65535 ECU_ADDRESS 0x400016D4 /end MEASUREMENT
/begin MEASUREMENT fan_engine_bay_engine_off_timer "undefined2" UWORD NO_COMPU_METHOD 0 0 0 65535 ECU_ADDRESS 0x400016D6 /end MEASUREMENT
/begin MEASUREMENT fan_engine_bay_stationary_timer "undefined2" UWORD NO_COMPU_METHOD 0 0 0 65535 ECU_ADDRESS 0x400016D8 /end MEASUREMENT
/begin MEASUREMENT current_gear_time "Current gear time (ms = val*100)." UWORD CM_u8_time_100ms 0 0 0 6553500 ECU_ADDRESS 0x400016DA /end MEASUREMENT
/begin MEASUREMENT engine_speed_delta100ms "Engine speed delta100ms (RPM)." UWORD CM_u16_rspeed_rpm 0 0 0 65535 ECU_ADDRESS 0x400016DC /end MEASUREMENT
/begin MEASUREMENT ign_on_engine_stopped_time "undefined4" ULONG NO_COMPU_METHOD 0 0 0 4294967295 ECU_ADDRESS 0x400016E4 /end MEASUREMENT
/begin MEASUREMENT injtip_decay_cycle_counter "undefined2" UWORD NO_COMPU_METHOD 0 0 0 65535 ECU_ADDRESS 0x400016E8 /end MEASUREMENT
/begin MEASUREMENT injtip_transient_throttle_response_time "u16_time_5ms" UWORD CM_u8_time_5ms 0 0 0 327675 ECU_ADDRESS 0x400016EA /end MEASUREMENT
/begin MEASUREMENT load_learning_holdoff_timer "undefined2" UWORD NO_COMPU_METHOD 0 0 0 65535 ECU_ADDRESS 0x400016EC /end MEASUREMENT
/begin MEASUREMENT ips_cruise_status_flags "undefined1" UBYTE NO_COMPU_METHOD 0 0 0 255 ECU_ADDRESS 0x400016EF /end MEASUREMENT
/begin MEASUREMENT dfco_pedal_ramp_step_interval "undefined1" UBYTE NO_COMPU_METHOD 0 0 0 255 ECU_ADDRESS 0x400016F2 /end MEASUREMENT
/begin MEASUREMENT task_timing_stats_reset_request "undefined1" UBYTE NO_COMPU_METHOD 0 0 0 255 ECU_ADDRESS 0x400016F3 /end MEASUREMENT
/begin MEASUREMENT inj_fuel_fillm_xtau_coeff_combined "Injector fuel fillm X-tau film coeff combined (val/255)." UBYTE CM_u8_factor_1_255 0 0 0 100 ECU_ADDRESS 0x400016F4 /end MEASUREMENT
/begin MEASUREMENT fuel_film_X_factor "X-axis (factor) for the fuel film table (val/255)." UBYTE CM_u8_factor_1_255 0 0 0 100 ECU_ADDRESS 0x400016F5 /end MEASUREMENT
/begin MEASUREMENT load_filter_alpha_xtau "Load filter alpha X-tau film (val/255)." UBYTE CM_u8_factor_1_255 0 0 0 100 ECU_ADDRESS 0x400016F6 /end MEASUREMENT
/begin MEASUREMENT load_filtered_slow "u16_load_mg/stroke" UWORD CM_u16_load_mg_stroke 0 0 0 65535 ECU_ADDRESS 0x40001702 /end MEASUREMENT
/begin MEASUREMENT load_filtered_from_maf "u32_load_mg/stroke" ULONG CM_u16_load_mg_stroke 0 0 0 4294967295 ECU_ADDRESS 0x40001704 /end MEASUREMENT
/begin MEASUREMENT load_measured_maf_filter_accum_q8 "undefined4" ULONG NO_COMPU_METHOD 0 0 0 4294967295 ECU_ADDRESS 0x40001708 /end MEASUREMENT
/begin MEASUREMENT etpu_elapsed_min_ticks "undefined4" ULONG NO_COMPU_METHOD 0 0 0 4294967295 ECU_ADDRESS 0x40001710 /end MEASUREMENT
/begin MEASUREMENT etpu_elapsed_max_captured_ticks "undefined4" ULONG NO_COMPU_METHOD 0 0 0 4294967295 ECU_ADDRESS 0x40001714 /end MEASUREMENT
/begin MEASUREMENT dspi_c_interval_timer "DSPI c interval timer (ms = val*5)." UBYTE CM_u8_time_5ms 0 0 0 1275 ECU_ADDRESS 0x40001718 /end MEASUREMENT
/begin MEASUREMENT runtime_since_start "Runtime since start (ms = val*5)." ULONG CM_u8_time_5ms 0 0 0 21474836475 ECU_ADDRESS 0x4000171C /end MEASUREMENT
/begin MEASUREMENT obd_ii_vvt_inlet_angle_bank2 "OBD-II: VVT inlet angle bank2 (° = val/4)." UWORD CM_u8_angle_1_4deg 0 0 0 16383.75 ECU_ADDRESS 0x40001722 /end MEASUREMENT
/begin MEASUREMENT obd_ii_vvt_exhaust_position_bank2 "OBD-II: VVT exhaust position bank2 (° = val/4)." UWORD CM_u8_angle_1_4deg 0 0 0 16383.75 ECU_ADDRESS 0x40001724 /end MEASUREMENT
/begin MEASUREMENT obd_ii_vvt_inlet_position_bank1 "OBD-II: VVT inlet position bank1 (° = val/4)." UWORD CM_u8_angle_1_4deg 0 0 0 16383.75 ECU_ADDRESS 0x40001726 /end MEASUREMENT
/begin MEASUREMENT obd_ii_vvt_exhaust_position_bank1 "OBD-II: VVT exhaust position bank1 (° = val/4)." UWORD CM_u8_angle_1_4deg 0 0 0 16383.75 ECU_ADDRESS 0x40001728 /end MEASUREMENT
/begin MEASUREMENT ign_startup_delay_counter "undefined2" UWORD NO_COMPU_METHOD 0 0 0 65535 ECU_ADDRESS 0x40001730 /end MEASUREMENT
/begin MEASUREMENT maf_voltage_buffer_index "undefined2" UWORD NO_COMPU_METHOD 0 0 0 65535 ECU_ADDRESS 0x40001732 /end MEASUREMENT
/begin MEASUREMENT map_voltage_buffer_index "undefined2" UWORD NO_COMPU_METHOD 0 0 0 65535 ECU_ADDRESS 0x40001734 /end MEASUREMENT
/begin MEASUREMENT cal_verification_lockout "undefined1" UBYTE NO_COMPU_METHOD 0 0 0 255 ECU_ADDRESS 0x40001736 /end MEASUREMENT
/begin MEASUREMENT slow_period_update_divider "undefined1" UBYTE NO_COMPU_METHOD 0 0 0 255 ECU_ADDRESS 0x40001737 /end MEASUREMENT
/begin MEASUREMENT engine_sync_reset_count "undefined1" UBYTE NO_COMPU_METHOD 0 0 0 255 ECU_ADDRESS 0x4000173A /end MEASUREMENT
/begin MEASUREMENT torque_cut_level_prev "Torque cut level prev." UBYTE NO_COMPU_METHOD 0 0 0 255 ECU_ADDRESS 0x40001746 /end MEASUREMENT
/begin MEASUREMENT torque_cut_remaining_cyl_count "undefined1" UBYTE NO_COMPU_METHOD 0 0 0 255 ECU_ADDRESS 0x40001747 /end MEASUREMENT
/begin MEASUREMENT torque_cut_coilpack_failure_mask "undefined1" UBYTE NO_COMPU_METHOD 0 0 0 255 ECU_ADDRESS 0x40001748 /end MEASUREMENT
/begin MEASUREMENT failed_ignition_cyl_count_prev "undefined1" UBYTE NO_COMPU_METHOD 0 0 0 255 ECU_ADDRESS 0x40001749 /end MEASUREMENT
/begin MEASUREMENT torque_cut_cyl_anchor "undefined1" UBYTE NO_COMPU_METHOD 0 0 0 255 ECU_ADDRESS 0x4000174A /end MEASUREMENT
/begin MEASUREMENT crank_sync_prev_cylinder_idx "undefined1" UBYTE NO_COMPU_METHOD 0 0 0 255 ECU_ADDRESS 0x4000174C /end MEASUREMENT
/begin MEASUREMENT ign_cyl_active_count_bank2 "undefined1" UBYTE NO_COMPU_METHOD 0 0 0 255 ECU_ADDRESS 0x40001755 /end MEASUREMENT
/begin MEASUREMENT ign_cyl_active_count_bank1 "undefined1" UBYTE NO_COMPU_METHOD 0 0 0 255 ECU_ADDRESS 0x40001756 /end MEASUREMENT
/begin MEASUREMENT ign_cyl_cut_flags "undefined1" UBYTE NO_COMPU_METHOD 0 0 0 255 ECU_ADDRESS 0x40001757 /end MEASUREMENT
/begin MEASUREMENT next_firing_cyl_index "undefined1" UBYTE NO_COMPU_METHOD 0 0 0 255 ECU_ADDRESS 0x40001758 /end MEASUREMENT
/begin MEASUREMENT rpm_or_roughness_measure_unknown "undefined4" ULONG NO_COMPU_METHOD 0 0 0 4294967295 ECU_ADDRESS 0x4000175C /end MEASUREMENT
/begin MEASUREMENT engine_is_running "Engine is running (boolean flag)." UBYTE NO_COMPU_METHOD 0 0 0 255 ECU_ADDRESS 0x40001760 /end MEASUREMENT
/begin MEASUREMENT engine_speed_16bit "Engine speed 2 (RPM)." UWORD CM_u16_rspeed_rpm 0 0 0 65535 ECU_ADDRESS 0x40001762 /end MEASUREMENT
/begin MEASUREMENT obd_ii_engine_speed "OBD-II: engine speed (RPM = val/4)." UWORD CM_u16_rspeed_1_4rpm 0 0 0 16383.75 ECU_ADDRESS 0x40001764 /end MEASUREMENT
/begin MEASUREMENT temp_engine_air_derived1 "u8_temp_5/8-40c" UBYTE CM_u8_temp_5_8_40c 0 0 -40 119.375 ECU_ADDRESS 0x40001766 /end MEASUREMENT
/begin MEASUREMENT iat_engine_stopped "u8_temp_5/8-40c" UBYTE CM_u8_temp_5_8_40c 0 0 -40 119.375 ECU_ADDRESS 0x40001767 /end MEASUREMENT
/begin MEASUREMENT coolant_temp_engine_stopped "Coolant temperature engine stopped (°C = val*5/8−40)." UBYTE CM_u8_temp_5_8_40c 0 0 -40 119.375 ECU_ADDRESS 0x40001768 /end MEASUREMENT
/begin MEASUREMENT engine_speed_8bit "Engine speed 3 (RPM = val*125/4+500)." UBYTE CM_u8_rspeed_125_4_500rpm 0 0 500 8468.75 ECU_ADDRESS 0x40001769 /end MEASUREMENT
/begin MEASUREMENT engine_speed_period_1 "undefined4" ULONG NO_COMPU_METHOD 0 0 0 4294967295 ECU_ADDRESS 0x4000176C /end MEASUREMENT
/begin MEASUREMENT engine_speed_period_2 "undefined4" ULONG NO_COMPU_METHOD 0 0 0 4294967295 ECU_ADDRESS 0x40001770 /end MEASUREMENT
/begin MEASUREMENT engine_speeed_period_avg "undefined2" UWORD NO_COMPU_METHOD 0 0 0 65535 ECU_ADDRESS 0x40001774 /end MEASUREMENT
/begin MEASUREMENT engine_rpm_rate "undefined4" ULONG NO_COMPU_METHOD 0 0 0 4294967295 ECU_ADDRESS 0x40001778 /end MEASUREMENT
/begin MEASUREMENT injection_flags "undefined2" UWORD NO_COMPU_METHOD 0 0 0 65535 ECU_ADDRESS 0x4000177C /end MEASUREMENT
/begin MEASUREMENT dfco_cut_duration "undefined2" UWORD NO_COMPU_METHOD 0 0 0 65535 ECU_ADDRESS 0x4000177E /end MEASUREMENT
/begin MEASUREMENT cam_exh_b2_edge_status "undefined1" UBYTE NO_COMPU_METHOD 0 0 0 255 ECU_ADDRESS 0x40001793 /end MEASUREMENT
/begin MEASUREMENT cam_exh_b2_edge_polarity "undefined1" UBYTE NO_COMPU_METHOD 0 0 0 255 ECU_ADDRESS 0x4000179B /end MEASUREMENT
/begin MEASUREMENT cam_exh_b2_delta_angle "undefined2" UWORD NO_COMPU_METHOD 0 0 0 65535 ECU_ADDRESS 0x400017A0 /end MEASUREMENT
/begin MEASUREMENT cam_exh_b2_last_angle "undefined2" UWORD NO_COMPU_METHOD 0 0 0 65535 ECU_ADDRESS 0x400017B0 /end MEASUREMENT
/begin MEASUREMENT engine_running_state "undefined1" UBYTE NO_COMPU_METHOD 0 0 0 255 ECU_ADDRESS 0x400017D8 /end MEASUREMENT
/begin MEASUREMENT crank_tooth_counter "undefined2" UWORD NO_COMPU_METHOD 0 0 0 65535 ECU_ADDRESS 0x400017DC /end MEASUREMENT
/begin MEASUREMENT eTPU_crank_angle_speed_scaling "undefined4" ULONG NO_COMPU_METHOD 0 0 0 4294967295 ECU_ADDRESS 0x400017E8 /end MEASUREMENT
/begin MEASUREMENT knock_window_irq_count "undefined1" UBYTE NO_COMPU_METHOD 0 0 0 255 ECU_ADDRESS 0x400017EC /end MEASUREMENT
/begin MEASUREMENT cyl_fire_counter_unknown "undefined1" UBYTE NO_COMPU_METHOD 0 0 0 255 ECU_ADDRESS 0x400017EE /end MEASUREMENT
/begin MEASUREMENT cam_sync_pulse_count "undefined1" UBYTE NO_COMPU_METHOD 0 0 0 255 ECU_ADDRESS 0x400017F4 /end MEASUREMENT
/begin MEASUREMENT ac_compressor_speed_pulse_seen "undefined1" UBYTE NO_COMPU_METHOD 0 0 0 255 ECU_ADDRESS 0x40001819 /end MEASUREMENT
/begin MEASUREMENT ac_compressor_speed_period_us "undefined4" ULONG NO_COMPU_METHOD 0 0 0 4294967295 ECU_ADDRESS 0x4000181C /end MEASUREMENT
/begin MEASUREMENT nonabs_wheel_speed_period_ticks "undefined4" ULONG NO_COMPU_METHOD 0 0 0 4294967295 ECU_ADDRESS 0x40001820 /end MEASUREMENT
/begin MEASUREMENT obd_ii_relay_status "undefined1" UBYTE NO_COMPU_METHOD 0 0 0 255 ECU_ADDRESS 0x40001824 /end MEASUREMENT
/begin MEASUREMENT fuel_level_filtered_x40000 "undefined4" ULONG NO_COMPU_METHOD 0 0 0 4294967295 ECU_ADDRESS 0x4000182C /end MEASUREMENT
/begin MEASUREMENT coolant_temp_sensor_voltage "Coolant temperature sensor voltage (V = val*5/1023)." UWORD CM_u16_voltage_5_1023v 0 0 0 320.307917888563 ECU_ADDRESS 0x40001830 /end MEASUREMENT
/begin MEASUREMENT ac_evap_temp_voltage "A/C evaporative temperature voltage (V = val*5/1023)." UWORD CM_u16_voltage_5_1023v 0 0 0 320.307917888563 ECU_ADDRESS 0x40001832 /end MEASUREMENT
/begin MEASUREMENT sensor_adc_engine_air_voltage "Sensor ADC engine air voltage (V = val*5/1023)." UWORD CM_u16_voltage_5_1023v 0 0 0 320.307917888563 ECU_ADDRESS 0x40001834 /end MEASUREMENT
/begin MEASUREMENT coolant_temp "Coolant temperature (°C = val*5/8−40)." UBYTE CM_u8_temp_5_8_40c 0 0 -40 119.375 ECU_ADDRESS 0x40001836 /end MEASUREMENT
/begin MEASUREMENT obd_ii_ac_evap_temp "OBD-II: A/C evaporative temperature (°C = val/10)." UWORD CM_u8_temp_1_10C 0 0 0 6553.5 ECU_ADDRESS 0x40001838 /end MEASUREMENT
/begin MEASUREMENT temp_engine_air "Temperature engine air (°C = val*5/8−40)." UBYTE CM_u8_temp_5_8_40c 0 0 -40 119.375 ECU_ADDRESS 0x4000183A /end MEASUREMENT
/begin MEASUREMENT iat "Intake air temp (°C = val*5/8−40)." UWORD CM_u8_temp_5_8_40c 0 0 -40 40919.375 ECU_ADDRESS 0x4000183C /end MEASUREMENT
/begin MEASUREMENT coolant_temp_raw "Coolant temperature (°C = val*5/8−40)." UWORD CM_u8_temp_5_8_40c 0 0 -40 40919.375 ECU_ADDRESS 0x4000183E /end MEASUREMENT
/begin MEASUREMENT ac_evap_temp "undefined2" UWORD NO_COMPU_METHOD 0 0 0 65535 ECU_ADDRESS 0x40001840 /end MEASUREMENT
/begin MEASUREMENT atmo_baro_sensor_voltage "undefined2" UWORD NO_COMPU_METHOD 0 0 0 65535 ECU_ADDRESS 0x40001842 /end MEASUREMENT
/begin MEASUREMENT obd_ii_atmospheric_baro "OBD-II: atmospheric baro (mbar)." UWORD CM_u16_pressure_mbar 0 0 0 65535 ECU_ADDRESS 0x40001844 /end MEASUREMENT
/begin MEASUREMENT tps_8bit "Tps2 (val/255)." UBYTE CM_u8_factor_1_255 0 0 0 100 ECU_ADDRESS 0x40001846 /end MEASUREMENT
/begin MEASUREMENT fuel_level_raw "Fuel level." UBYTE NO_COMPU_METHOD 0 0 0 255 ECU_ADDRESS 0x40001847 /end MEASUREMENT
/begin MEASUREMENT obd_ii_evap_purge_pressure "undefined2" UWORD NO_COMPU_METHOD 0 0 0 65535 ECU_ADDRESS 0x40001848 /end MEASUREMENT
/begin MEASUREMENT obd_ii_o2_sensor1_voltage "OBD-II: O2 sensor1 voltage (V = val*5/1023)." UWORD CM_u16_voltage_5_1023v 0 0 0 320.307917888563 ECU_ADDRESS 0x4000184A /end MEASUREMENT
/begin MEASUREMENT obd_ii_o2_sensor5_voltage "OBD-II: O2 sensor5 voltage (V = val*5/1023)." UWORD CM_u16_voltage_5_1023v 0 0 0 320.307917888563 ECU_ADDRESS 0x4000184C /end MEASUREMENT
/begin MEASUREMENT obd_ii_o2_sensor2_voltage "OBD-II: O2 sensor2 voltage (V = val*5/1023)." UWORD CM_u16_voltage_5_1023v 0 0 0 320.307917888563 ECU_ADDRESS 0x4000184E /end MEASUREMENT
/begin MEASUREMENT obd_ii_o2_sensor6_voltage "OBD-II: O2 sensor6 voltage (V = val*5/1023)." UWORD CM_u16_voltage_5_1023v 0 0 0 320.307917888563 ECU_ADDRESS 0x40001850 /end MEASUREMENT
/begin MEASUREMENT ignition_on_flags "undefined2" UWORD NO_COMPU_METHOD 0 0 0 65535 ECU_ADDRESS 0x40001852 /end MEASUREMENT
/begin MEASUREMENT sensor_adc_ecu_voltage "Sensor ADC ECU voltage (V = val*18/1023)." UWORD CM_u16_voltage_18_1023v 0 0 0 1153.10850439883 ECU_ADDRESS 0x40001854 /end MEASUREMENT
/begin MEASUREMENT evap_purge_pressure_voltage "undefined2" UWORD NO_COMPU_METHOD 0 0 0 65535 ECU_ADDRESS 0x40001856 /end MEASUREMENT
/begin MEASUREMENT clutch_pos_voltage "Clutch position voltage (V = val*5/1023)." UWORD CM_u16_voltage_5_1023v 0 0 0 320.307917888563 ECU_ADDRESS 0x40001858 /end MEASUREMENT
/begin MEASUREMENT fuel_level_voltage "Fuel level voltage (V = val*5/1023)." UWORD CM_u16_voltage_5_1023v 0 0 0 320.307917888563 ECU_ADDRESS 0x4000185C /end MEASUREMENT
/begin MEASUREMENT o2_sensor1_heater_current_scaled "O2 sensor1 heater current scaled (mA)." UWORD CM_u16_current_mA 0 0 0 65535 ECU_ADDRESS 0x4000185E /end MEASUREMENT
/begin MEASUREMENT o2_sensor2_heater_current_scaled "O2 sensor2 heater current scaled (mA)." UWORD CM_u16_current_mA 0 0 0 65535 ECU_ADDRESS 0x40001860 /end MEASUREMENT
/begin MEASUREMENT o2_sensor5_heater_current_scaled "O2 sensor5 heater current scaled (mA)." UWORD CM_u16_current_mA 0 0 0 65535 ECU_ADDRESS 0x40001862 /end MEASUREMENT
/begin MEASUREMENT o2_sensor6_heater_current_scaled "O2 sensor6 heater current scaled (mA)." UWORD CM_u16_current_mA 0 0 0 65535 ECU_ADDRESS 0x40001864 /end MEASUREMENT
/begin MEASUREMENT intake_air_sensor_voltage "Intake air sensor voltage (V = val*5/1023)." UWORD CM_u16_voltage_5_1023v 0 0 0 320.307917888563 ECU_ADDRESS 0x40001866 /end MEASUREMENT
/begin MEASUREMENT obd_ii_manifold_temp "OBD-II: manifold temperature (°C = val*5/8−40)." UBYTE CM_u8_temp_5_8_40c 0 0 -40 119.375 ECU_ADDRESS 0x40001868 /end MEASUREMENT
/begin MEASUREMENT chargecooler_temp_div_160 "Chargecooler temperature div 160." UWORD NO_COMPU_METHOD 0 0 0 65535 ECU_ADDRESS 0x4000186A /end MEASUREMENT
/begin MEASUREMENT sensor_temp_unk1_diag "undefined1" UBYTE NO_COMPU_METHOD 0 0 0 255 ECU_ADDRESS 0x4000186C /end MEASUREMENT
/begin MEASUREMENT sensor_temp_unk2_diag "undefined1" UBYTE NO_COMPU_METHOD 0 0 0 255 ECU_ADDRESS 0x4000186D /end MEASUREMENT
/begin MEASUREMENT load_filtered1 "undefined4" ULONG NO_COMPU_METHOD 0 0 0 4294967295 ECU_ADDRESS 0x40001870 /end MEASUREMENT
/begin MEASUREMENT load_filtered_slow_accum "undefined4" ULONG NO_COMPU_METHOD 0 0 0 4294967295 ECU_ADDRESS 0x40001874 /end MEASUREMENT
/begin MEASUREMENT load_maf_diag "u16_load_mg/stroke" UWORD CM_u16_load_mg_stroke 0 0 0 65535 ECU_ADDRESS 0x40001878 /end MEASUREMENT
/begin MEASUREMENT load_measured_maf_filtered "Load smoothed MAF (mg/stroke)." UWORD CM_u16_load_mg_stroke 0 0 0 65535 ECU_ADDRESS 0x4000187A /end MEASUREMENT
/begin MEASUREMENT map_voltage "MAP voltage (V = val*5/1023)." UWORD CM_u16_voltage_5_1023v 0 0 0 320.307917888563 ECU_ADDRESS 0x4000187C /end MEASUREMENT
/begin MEASUREMENT map "MAP (mbar)." UWORD CM_u16_pressure_mbar 0 0 0 65535 ECU_ADDRESS 0x4000187E /end MEASUREMENT
/begin MEASUREMENT obd_ii_manifold_pressure "OBD-II: manifold pressure (mbar)." UWORD CM_u16_pressure_mbar 0 0 0 65535 ECU_ADDRESS 0x40001880 /end MEASUREMENT
/begin MEASUREMENT sport_button_pressed "Sport button pressed (boolean flag)." UBYTE NO_COMPU_METHOD 0 0 0 255 ECU_ADDRESS 0x4000188A /end MEASUREMENT
/begin MEASUREMENT race_button_state "Race button state (boolean flag)." UBYTE NO_COMPU_METHOD 0 0 0 255 ECU_ADDRESS 0x4000188B /end MEASUREMENT
/begin MEASUREMENT lat_accel "Lateral accelerator (g = val/10)." SWORD CM_i16_accel_1_10g 0 0 -3276.8 3276.7 ECU_ADDRESS 0x4000188E /end MEASUREMENT
/begin MEASUREMENT vehicle_mode "Vehicle mode (enumerated state)." UBYTE NO_COMPU_METHOD 0 0 0 255 ECU_ADDRESS 0x40001890 /end MEASUREMENT
/begin MEASUREMENT vehicle_mode_flags "Vehicle mode flags." UWORD NO_COMPU_METHOD 0 0 0 65535 ECU_ADDRESS 0x40001892 /end MEASUREMENT
/begin MEASUREMENT oil_pressure_switch_raw "undefined2" UWORD NO_COMPU_METHOD 0 0 0 65535 ECU_ADDRESS 0x40001894 /end MEASUREMENT
/begin MEASUREMENT lookup_bounds__ "undefined1" UBYTE NO_COMPU_METHOD 0 0 0 255 ECU_ADDRESS 0x40001896 /end MEASUREMENT
/begin MEASUREMENT iat2 "undefined4" ULONG NO_COMPU_METHOD 0 0 0 4294967295 ECU_ADDRESS 0x40001898 /end MEASUREMENT
/begin MEASUREMENT trans_fluid_temp_u32 "undefined4" ULONG NO_COMPU_METHOD 0 0 0 4294967295 ECU_ADDRESS 0x4000189C /end MEASUREMENT
/begin MEASUREMENT coolant_temp_derived1 "undefined4" ULONG NO_COMPU_METHOD 0 0 0 4294967295 ECU_ADDRESS 0x400018A0 /end MEASUREMENT
/begin MEASUREMENT coolant_temp_derived2 "undefined4" ULONG NO_COMPU_METHOD 0 0 0 4294967295 ECU_ADDRESS 0x400018A4 /end MEASUREMENT
/begin MEASUREMENT ac_evap_temp_raw "undefined4" ULONG NO_COMPU_METHOD 0 0 0 4294967295 ECU_ADDRESS 0x400018A8 /end MEASUREMENT
/begin MEASUREMENT chargecooler_temp2 "undefined4" ULONG NO_COMPU_METHOD 0 0 0 4294967295 ECU_ADDRESS 0x400018AC /end MEASUREMENT
/begin MEASUREMENT fuel_pressure_abs_scaled "undefined4" ULONG NO_COMPU_METHOD 0 0 0 4294967295 ECU_ADDRESS 0x400018B0 /end MEASUREMENT
/begin MEASUREMENT intake_manifold_pressure2 "undefined4" ULONG NO_COMPU_METHOD 0 0 0 4294967295 ECU_ADDRESS 0x400018B4 /end MEASUREMENT
/begin MEASUREMENT clutch_position_raw2 "undefined4" ULONG NO_COMPU_METHOD 0 0 0 4294967295 ECU_ADDRESS 0x400018B8 /end MEASUREMENT
/begin MEASUREMENT o2_sensor1_heater_current "O2 sensor1 heater current (V = val*5/1023)." UWORD CM_u16_voltage_5_1023v 0 0 0 320.307917888563 ECU_ADDRESS 0x400018BC /end MEASUREMENT
/begin MEASUREMENT o2_sensor2_heater_current "O2 sensor2 heater current (V = val*5/1023)." UWORD CM_u16_voltage_5_1023v 0 0 0 320.307917888563 ECU_ADDRESS 0x400018BE /end MEASUREMENT
/begin MEASUREMENT o2_sensor5_heater_current "O2 sensor5 heater current (V = val*5/1023)." UWORD CM_u16_voltage_5_1023v 0 0 0 320.307917888563 ECU_ADDRESS 0x400018C0 /end MEASUREMENT
/begin MEASUREMENT o2_sensor6_heater_current "O2 sensor6 heater current (V = val*5/1023)." UWORD CM_u16_voltage_5_1023v 0 0 0 320.307917888563 ECU_ADDRESS 0x400018C2 /end MEASUREMENT
/begin MEASUREMENT fuel_level_update_holdoff_counter "uint16_t" UWORD NO_COMPU_METHOD 0 0 0 65535 ECU_ADDRESS 0x400018C4 /end MEASUREMENT
/begin MEASUREMENT lat_accel_last "Lateral accelerator last (g = val/255)." SLONG CM_u8_accel_1_255g 0 0 -8421504.50196078 8421504.49803922 ECU_ADDRESS 0x400018C8 /end MEASUREMENT
/begin MEASUREMENT driver_input_hold_timer "undefined1" UBYTE NO_COMPU_METHOD 0 0 0 255 ECU_ADDRESS 0x400018CC /end MEASUREMENT
/begin MEASUREMENT abs_a8_flag2_previous_state "undefined1" UBYTE NO_COMPU_METHOD 0 0 0 255 ECU_ADDRESS 0x400018CD /end MEASUREMENT
/begin MEASUREMENT driver_input_debounce_timer "Driver input debounce timer (ms = val*10)." UWORD CM_u8_time_10ms 0 0 0 655350 ECU_ADDRESS 0x400018CE /end MEASUREMENT
/begin MEASUREMENT driver_input_mode_timer "undefined1" UBYTE NO_COMPU_METHOD 0 0 0 255 ECU_ADDRESS 0x400018D0 /end MEASUREMENT
/begin MEASUREMENT sport_button_press_timer_unknown1 "undefined1" UBYTE NO_COMPU_METHOD 0 0 0 255 ECU_ADDRESS 0x400018D1 /end MEASUREMENT
/begin MEASUREMENT race_button_press_timer_unknown1 "undefined1" UBYTE NO_COMPU_METHOD 0 0 0 255 ECU_ADDRESS 0x400018D4 /end MEASUREMENT
/begin MEASUREMENT vehicle_mode_button_register "undefined1" UBYTE NO_COMPU_METHOD 0 0 0 255 ECU_ADDRESS 0x400018D8 /end MEASUREMENT
/begin MEASUREMENT vehicle_mode_timer_unknown3 "Vehicle mode timer unknown3 (ms = val*10)." UBYTE CM_u8_time_10ms 0 0 0 2550 ECU_ADDRESS 0x400018DA /end MEASUREMENT
/begin MEASUREMENT _tmp_val1 "undefined2" UWORD NO_COMPU_METHOD 0 0 0 65535 ECU_ADDRESS 0x400018DE /end MEASUREMENT
/begin MEASUREMENT _tmp_val2 "undefined4" ULONG NO_COMPU_METHOD 0 0 0 4294967295 ECU_ADDRESS 0x400018E0 /end MEASUREMENT
/begin MEASUREMENT fuel_pressure_atmo_relative "Fuel pressure atmo relative (mbar)." UWORD CM_u16_pressure_mbar 0 0 0 65535 ECU_ADDRESS 0x400018E6 /end MEASUREMENT
/begin MEASUREMENT fuel_pressure_abs2 "Fuel pressure abs2 (mbar)." UWORD CM_u16_pressure_mbar 0 0 0 65535 ECU_ADDRESS 0x400018E8 /end MEASUREMENT
/begin MEASUREMENT fuel_pressure_voltage "Fuel pressure voltage (V = val*5/1023)." UWORD CM_u16_voltage_5_1023v 0 0 0 320.307917888563 ECU_ADDRESS 0x400018EA /end MEASUREMENT
/begin MEASUREMENT fuel_pressure_abs "Fuel pressure ABS (mbar)." UWORD CM_u16_pressure_mbar 0 0 0 65535 ECU_ADDRESS 0x400018EC /end MEASUREMENT
/begin MEASUREMENT oil_pressure_sensor_voltage_raw "Oil pressure sensor voltage (V = val*5/1023)." UWORD CM_u16_voltage_5_1023v 0 0 0 320.307917888563 ECU_ADDRESS 0x400018EE /end MEASUREMENT
/begin MEASUREMENT sensor_adc_ign_voltage "Sensor ADC ignition voltage (V = val*5/1023)." UWORD CM_u16_voltage_5_1023v 0 0 0 320.307917888563 ECU_ADDRESS 0x400018F2 /end MEASUREMENT
/begin MEASUREMENT sensor_temp_unk2_raw "undefined2" UWORD NO_COMPU_METHOD 0 0 0 65535 ECU_ADDRESS 0x400018F4 /end MEASUREMENT
/begin MEASUREMENT sensor_temp_unk1_raw "undefined2" UWORD NO_COMPU_METHOD 0 0 0 65535 ECU_ADDRESS 0x400018F6 /end MEASUREMENT
/begin MEASUREMENT trans_fluid_temp_u8 "Transmission fluid temperature (°C = val*5/8−40)." UBYTE CM_u8_temp_5_8_40c 0 0 -40 119.375 ECU_ADDRESS 0x400018F8 /end MEASUREMENT
/begin MEASUREMENT trans_fluid_temp_raw "Transmission fluid temperature (°C = val*5/8−40)." UBYTE CM_u8_temp_5_8_40c 0 0 -40 119.375 ECU_ADDRESS 0x400018F9 /end MEASUREMENT
/begin MEASUREMENT trans_temp_voltage "Transmission temperature voltage (V = val*5/1023)." UWORD CM_u16_voltage_5_1023v 0 0 0 320.307917888563 ECU_ADDRESS 0x400018FA /end MEASUREMENT
/begin MEASUREMENT ign_adv_target1 "Ignition adv target1 (° = val/4)." SWORD CM_u8_angle_1_4deg 0 0 -8192 8191.75 ECU_ADDRESS 0x40001900 /end MEASUREMENT
/begin MEASUREMENT ign_base "Ignition base (° = val/4)." SWORD CM_u8_angle_1_4deg 0 0 -8192 8191.75 ECU_ADDRESS 0x40001902 /end MEASUREMENT
/begin MEASUREMENT ign_knock_safe "Ignition knock safe (° = val/4)." SWORD CM_u8_angle_1_4deg 0 0 -8192 8191.75 ECU_ADDRESS 0x40001904 /end MEASUREMENT
/begin MEASUREMENT ign_target_rate_limited "i16_angle_1/4deg" SWORD CM_u8_angle_1_4deg 0 0 -8192 8191.75 ECU_ADDRESS 0x40001906 /end MEASUREMENT
/begin MEASUREMENT ign_adv_target "Ignition adv target (° = val/4)." SWORD CM_u8_angle_1_4deg 0 0 -8192 8191.75 ECU_ADDRESS 0x40001908 /end MEASUREMENT
/begin MEASUREMENT ign_dwell_time "Ignition dwell time (µs)." UWORD CM_u16_time_us 0 0 0 65535 ECU_ADDRESS 0x4000190A /end MEASUREMENT
/begin MEASUREMENT ign_comp_rpm_accel "Ignition compensation RPM accelerator (° = val/4)." SWORD CM_u8_angle_1_4deg 0 0 -8192 8191.75 ECU_ADDRESS 0x4000190C /end MEASUREMENT
/begin MEASUREMENT ign_mbt_modeled "Ignition MBT modeled (° = val/4)." SWORD CM_u8_angle_1_4deg 0 0 -8192 8191.75 ECU_ADDRESS 0x4000190E /end MEASUREMENT
/begin MEASUREMENT ign_adv_min "Ignition adv minimum (° = val/4)." SWORD CM_u8_angle_1_4deg 0 0 -8192 8191.75 ECU_ADDRESS 0x40001910 /end MEASUREMENT
/begin MEASUREMENT __ign_comp_roughness_detection "undefined2" UWORD NO_COMPU_METHOD 0 0 0 65535 ECU_ADDRESS 0x40001912 /end MEASUREMENT
/begin MEASUREMENT ign_comp_idle_error "Ignition compensation idle speed1 (° = val/4)." SWORD CM_u8_angle_1_4deg 0 0 -8192 8191.75 ECU_ADDRESS 0x40001914 /end MEASUREMENT
/begin MEASUREMENT ign_comp_idle_error_driveaway "Ignition compensation idle error3 (° = val/4)." SWORD CM_u8_angle_1_4deg 0 0 -8192 8191.75 ECU_ADDRESS 0x40001916 /end MEASUREMENT
/begin MEASUREMENT ign_adv_coolant_comp "Ignition adv coolant compensation (° = val/4)." SWORD CM_u8_angle_1_4deg 0 0 -8192 8191.75 ECU_ADDRESS 0x40001918 /end MEASUREMENT
/begin MEASUREMENT ign_comp_startup_tps "Ignition MAF accum trim startup (° = val/4)." SWORD CM_u8_angle_1_4deg 0 0 -8192 8191.75 ECU_ADDRESS 0x4000191A /end MEASUREMENT
/begin MEASUREMENT ign_comp_startup "Ignition compensation startup (° = val/4)." SBYTE CM_u8_angle_1_4deg 0 0 -32 31.75 ECU_ADDRESS 0x4000191C /end MEASUREMENT
/begin MEASUREMENT ign_operating_state_flags "undefined2" UWORD NO_COMPU_METHOD 0 0 0 65535 ECU_ADDRESS 0x4000191E /end MEASUREMENT
/begin MEASUREMENT ign_comp_tps_rate "Ignition compensation throttle position rate (° = val/4)." SBYTE CM_u8_angle_1_4deg 0 0 -32 31.75 ECU_ADDRESS 0x40001920 /end MEASUREMENT
/begin MEASUREMENT ign_comp_iat "Ignition compensation intake air temp (° = val/4)." SWORD CM_u8_angle_1_4deg 0 0 -8192 8191.75 ECU_ADDRESS 0x40001922 /end MEASUREMENT
/begin MEASUREMENT ign_idle_mode_holdover_timer_5ms "u16_time_5ms" UWORD CM_u8_time_5ms 0 0 0 327675 ECU_ADDRESS 0x40001930 /end MEASUREMENT
/begin MEASUREMENT ign_coldstart_comp "u8_angle_1/4-10deg" UBYTE CM_u8_angle_1_4_10deg 0 0 -10 53.75 ECU_ADDRESS 0x40001932 /end MEASUREMENT
/begin MEASUREMENT ign_target_step_advance "u8_angle_1/4deg" UBYTE CM_u8_angle_1_4deg 0 0 0 63.75 ECU_ADDRESS 0x40001933 /end MEASUREMENT
/begin MEASUREMENT ign_target_step_retard "u8_angle_1/4deg" UBYTE CM_u8_angle_1_4deg 0 0 0 63.75 ECU_ADDRESS 0x40001934 /end MEASUREMENT
/begin MEASUREMENT ign_comp_transient_total "Ignition compensation transient total (° = val/4)." SWORD CM_u8_angle_1_4deg 0 0 -8192 8191.75 ECU_ADDRESS 0x40001936 /end MEASUREMENT
/begin MEASUREMENT ign_comp_idle_error_moving "undefined2" UWORD NO_COMPU_METHOD 0 0 0 65535 ECU_ADDRESS 0x40001938 /end MEASUREMENT
/begin MEASUREMENT ign_target_step_prescaler "u8_time_5ms" UBYTE CM_u8_time_5ms 0 0 0 1275 ECU_ADDRESS 0x4000193A /end MEASUREMENT
/begin MEASUREMENT ign_target_update_inhibit_timer_5ms "undefined2" UWORD NO_COMPU_METHOD 0 0 0 65535 ECU_ADDRESS 0x4000193C /end MEASUREMENT
/begin MEASUREMENT ign_idle_comp_recovery_timer_5ms "undefined1" UBYTE NO_COMPU_METHOD 0 0 0 255 ECU_ADDRESS 0x4000193E /end MEASUREMENT
/begin MEASUREMENT ign_mode "Ignition mode (enumerated state)." UBYTE NO_COMPU_METHOD 0 0 0 255 ECU_ADDRESS 0x4000193F /end MEASUREMENT
/begin MEASUREMENT tps_rate_filtered_for_ign_comp "i16_factor_1/1023" SWORD CM_u16_factor_1_1023 0 0 -3203.12805474096 3203.0303030303 ECU_ADDRESS 0x40001940 /end MEASUREMENT
/begin MEASUREMENT tps_rate_ign_decay_tick_counter "u16_time_5ms" UWORD CM_u8_time_5ms 0 0 0 327675 ECU_ADDRESS 0x4000194A /end MEASUREMENT
/begin MEASUREMENT inj_deadtime_us "Injector pulse time scaled (µs)." UWORD CM_u16_time_us 0 0 0 65535 ECU_ADDRESS 0x40001950 /end MEASUREMENT
/begin MEASUREMENT mass_to_time_scaler_b1 "undefined4" ULONG NO_COMPU_METHOD 0 0 0 4294967295 ECU_ADDRESS 0x40001954 /end MEASUREMENT
/begin MEASUREMENT mass_to_time_scaler_b2 "undefined4" ULONG NO_COMPU_METHOD 0 0 0 4294967295 ECU_ADDRESS 0x40001958 /end MEASUREMENT
/begin MEASUREMENT enrichment_cranking_blend "undefined1" UBYTE NO_COMPU_METHOD 0 0 0 255 ECU_ADDRESS 0x4000195C /end MEASUREMENT
/begin MEASUREMENT obd_ii_injector_pulse_time_bank1_us "OBD-II: injector pulse time bank1 us (µs)." ULONG CM_u16_time_us 0 0 0 4294967295 ECU_ADDRESS 0x40001960 /end MEASUREMENT
/begin MEASUREMENT obd_ii_injector_pulse_time_bank2_us "OBD-II: injector pulse time bank2 us (µs)." ULONG CM_u16_time_us 0 0 0 4294967295 ECU_ADDRESS 0x40001964 /end MEASUREMENT
/begin MEASUREMENT inj_startup_pulse_time "Injector pulse width total (µs)." ULONG CM_u16_time_us 0 0 0 4294967295 ECU_ADDRESS 0x40001968 /end MEASUREMENT
/begin MEASUREMENT inj_start_angle_target "u32_angle_1/10defg" ULONG CM_u32_angle_1_10defg 0 0 0 429496729.5 ECU_ADDRESS 0x4000196C /end MEASUREMENT
/begin MEASUREMENT inj_start_angle_offset_deg "undefined4" ULONG NO_COMPU_METHOD 0 0 0 4294967295 ECU_ADDRESS 0x40001970 /end MEASUREMENT
/begin MEASUREMENT afr_target2 "AFR target2 (val/100)." UWORD CM_u16_afr_1_100 0 0 0 655.35 ECU_ADDRESS 0x40001974 /end MEASUREMENT
/begin MEASUREMENT afr_commanded "AFR commanded (val/100)." UWORD CM_u16_afr_1_100 0 0 0 655.35 ECU_ADDRESS 0x40001976 /end MEASUREMENT
/begin MEASUREMENT inj_flow_rate_scaled "Injector flow rate scaled (mg/s)." UWORD CM_u16_flow_mg_s 0 0 0 65535 ECU_ADDRESS 0x40001978 /end MEASUREMENT
/begin MEASUREMENT inj_fuel_mass_required "Injector fuel mass required (µg = val*100)." UWORD CM_u16_mass_100ug 0 0 0 6553500 ECU_ADDRESS 0x4000197A /end MEASUREMENT
/begin MEASUREMENT fuel_control_mode_flags "uint8_t" UBYTE NO_COMPU_METHOD 0 0 0 255 ECU_ADDRESS 0x4000197C /end MEASUREMENT
/begin MEASUREMENT inj_pw_b1_with_trims "Injector pw bank 1 with trims (µs)." ULONG CM_u16_time_us 0 0 0 4294967295 ECU_ADDRESS 0x40001980 /end MEASUREMENT
/begin MEASUREMENT inj_pw_b2_with_trims "undefined4" ULONG NO_COMPU_METHOD 0 0 0 4294967295 ECU_ADDRESS 0x40001984 /end MEASUREMENT
/begin MEASUREMENT inj_startup_enrichment_offset "Injector startup enrichment offset (µs)." ULONG CM_u16_time_us 0 0 0 4294967295 ECU_ADDRESS 0x40001988 /end MEASUREMENT
/begin MEASUREMENT inj_pw_b1_pretrim "undefined4" ULONG NO_COMPU_METHOD 0 0 0 4294967295 ECU_ADDRESS 0x4000198C /end MEASUREMENT
/begin MEASUREMENT inj_pw_b2_pretrim "undefined4" ULONG NO_COMPU_METHOD 0 0 0 4294967295 ECU_ADDRESS 0x40001990 /end MEASUREMENT
/begin MEASUREMENT inj_fuel_mass_bank1 "Injector fuel mass bank1 (µg = val*100)." UWORD CM_u16_mass_100ug 0 0 0 6553500 ECU_ADDRESS 0x40001994 /end MEASUREMENT
/begin MEASUREMENT inj_fuel_mass_bank2 "undefined2" UWORD NO_COMPU_METHOD 0 0 0 65535 ECU_ADDRESS 0x40001996 /end MEASUREMENT
/begin MEASUREMENT inj_angle_raw "Injector angle." UBYTE CM_u8_angle_720_256deg 0 0 0 717.1875 ECU_ADDRESS 0x40001998 /end MEASUREMENT
/begin MEASUREMENT afr_enrichment_from_ign_retard "u8_afr_1/100" UBYTE CM_u16_afr_1_100 0 0 0 2.55 ECU_ADDRESS 0x40001999 /end MEASUREMENT
/begin MEASUREMENT inj_efficiency "Injector efficiency (val/100)." UBYTE CM_u8_factor_1_100 0 0 0 255 ECU_ADDRESS 0x4000199A /end MEASUREMENT
/begin MEASUREMENT inj_duty_cycle_bank1 "Injector duty cycle bank1 (val/100)." UBYTE CM_u8_factor_1_100 0 0 0 255 ECU_ADDRESS 0x4000199B /end MEASUREMENT
/begin MEASUREMENT inj_duty_cycle_bank2 "Injector duty cycle bank2 (val/100)." UBYTE CM_u8_factor_1_100 0 0 0 255 ECU_ADDRESS 0x4000199C /end MEASUREMENT
/begin MEASUREMENT fuel_usage_instantaneous "u16_economy_1/10ml_per_km" UWORD CM_u16_economy_1_10ml_per_km 0 0 0 6553.5 ECU_ADDRESS 0x4000199E /end MEASUREMENT
/begin MEASUREMENT fuel_mileage_instantaneous "undefined2" UWORD NO_COMPU_METHOD 0 0 0 65535 ECU_ADDRESS 0x400019A0 /end MEASUREMENT
/begin MEASUREMENT coilpack_failure_flags "undefined2" UWORD NO_COMPU_METHOD 0 0 0 65535 ECU_ADDRESS 0x400019A2 /end MEASUREMENT
/begin MEASUREMENT inj_bank_balance_ratio "undefined1" UBYTE NO_COMPU_METHOD 0 0 0 255 ECU_ADDRESS 0x400019A4 /end MEASUREMENT
/begin MEASUREMENT revlimit_fuelcut_count "undefined1" UBYTE NO_COMPU_METHOD 0 0 0 255 ECU_ADDRESS 0x400019A8 /end MEASUREMENT
/begin MEASUREMENT mass_ratio_b1_prev "undefined1" UBYTE NO_COMPU_METHOD 0 0 0 255 ECU_ADDRESS 0x400019A9 /end MEASUREMENT
/begin MEASUREMENT mass_ratio_b2_prev "undefined1" UBYTE NO_COMPU_METHOD 0 0 0 255 ECU_ADDRESS 0x400019AA /end MEASUREMENT
/begin MEASUREMENT cranking_enrichment_load "undefined1" UBYTE NO_COMPU_METHOD 0 0 0 255 ECU_ADDRESS 0x400019AB /end MEASUREMENT
/begin MEASUREMENT inj_flow_rate "Injector flow rate (mg/s)." UWORD CM_u16_flow_mg_s 0 0 0 65535 ECU_ADDRESS 0x400019AC /end MEASUREMENT
/begin MEASUREMENT fuel_pressure_manifold_relative "Fuel pressure manifold relative (mbar)." UWORD CM_u16_pressure_mbar 0 0 0 65535 ECU_ADDRESS 0x400019AE /end MEASUREMENT
/begin MEASUREMENT rev_limit_active_time_divider "Rev limit active time divider (ms = val*5)." UBYTE CM_u8_time_5ms 0 0 0 1275 ECU_ADDRESS 0x400019B0 /end MEASUREMENT
/begin MEASUREMENT closedloop_entry_delay_timer "Closedloop entry delay timer (ms = val*5)." UWORD CM_u8_time_5ms 0 0 0 327675 ECU_ADDRESS 0x400019B2 /end MEASUREMENT
/begin MEASUREMENT inj_flow_rate_b1 "Injector flow rate bank 1 (mg/s)." UWORD CM_u16_flow_mg_s 0 0 0 65535 ECU_ADDRESS 0x400019B4 /end MEASUREMENT
/begin MEASUREMENT inj_flow_rate_b2 "Injector flow rate bank 2 (mg/s)." UWORD CM_u16_flow_mg_s 0 0 0 65535 ECU_ADDRESS 0x400019B6 /end MEASUREMENT
/begin MEASUREMENT inj_cranking_enrichment_soak_time_X_engine_off_time "undefined1" UBYTE NO_COMPU_METHOD 0 0 0 255 ECU_ADDRESS 0x400019B8 /end MEASUREMENT
/begin MEASUREMENT cranking_enrichment_air_temp "undefined1" UBYTE NO_COMPU_METHOD 0 0 0 255 ECU_ADDRESS 0x400019B9 /end MEASUREMENT
/begin MEASUREMENT cranking_enrichment_mass_accum "undefined1" UBYTE NO_COMPU_METHOD 0 0 0 255 ECU_ADDRESS 0x400019BA /end MEASUREMENT
/begin MEASUREMENT inj_pw_max_allowed "Injector pw maximum allowed (µs)." ULONG CM_u16_time_us 0 0 0 4294967295 ECU_ADDRESS 0x400019BC /end MEASUREMENT
/begin MEASUREMENT inj_deadtime_comp_iat "Injector compensation air temperature (val/100)." UBYTE CM_u8_factor_1_100 0 0 0 255 ECU_ADDRESS 0x400019C0 /end MEASUREMENT
/begin MEASUREMENT inj_coldstart_enrichment_factor "undefined1" UBYTE NO_COMPU_METHOD 0 0 0 255 ECU_ADDRESS 0x400019C1 /end MEASUREMENT
/begin MEASUREMENT inj_pw_coldstart_limit_b1 "Injector pw coldstart limit bank 1 (µs)." ULONG CM_u16_time_us 0 0 0 4294967295 ECU_ADDRESS 0x400019C4 /end MEASUREMENT
/begin MEASUREMENT inj_pw_coldstart_limit_b2 "Injector pw coldstart limit bank 2 (µs)." ULONG CM_u16_time_us 0 0 0 4294967295 ECU_ADDRESS 0x400019C8 /end MEASUREMENT
/begin MEASUREMENT inj_pw_b1_pretrims "Injector pw bank 1 pretrims (µs)." ULONG CM_u16_time_us 0 0 0 4294967295 ECU_ADDRESS 0x400019CC /end MEASUREMENT
/begin MEASUREMENT inj_pw_b2_pretrims "Injector pw bank 2 pretrims (µs)." ULONG CM_u16_time_us 0 0 0 4294967295 ECU_ADDRESS 0x400019D0 /end MEASUREMENT
/begin MEASUREMENT closedloop_entry_delay_steps "undefined1" UBYTE NO_COMPU_METHOD 0 0 0 255 ECU_ADDRESS 0x400019D4 /end MEASUREMENT
/begin MEASUREMENT afr_target "undefined2" UWORD NO_COMPU_METHOD 0 0 0 65535 ECU_ADDRESS 0x400019D6 /end MEASUREMENT
/begin MEASUREMENT inj_power_enrich_load_threshold "undefined1" UBYTE NO_COMPU_METHOD 0 0 0 255 ECU_ADDRESS 0x400019D8 /end MEASUREMENT
/begin MEASUREMENT inj_pulse_time_max_window "Injector pulse time maximum window (µs)." ULONG CM_u16_time_us 0 0 0 4294967295 ECU_ADDRESS 0x400019DC /end MEASUREMENT
/begin MEASUREMENT fuel_pressure_rel_50mbar "Fuel pressure lookup for time base (mbar = val*50)." UBYTE CM_u8_pressure_50mbar 0 0 0 12750 ECU_ADDRESS 0x400019E0 /end MEASUREMENT
/begin MEASUREMENT eTPU_base_unknown "undefined4" ULONG NO_COMPU_METHOD 0 0 0 4294967295 ECU_ADDRESS 0x400019F0 /end MEASUREMENT
/begin MEASUREMENT etpu_mcr_addr "Etpu MCR addr (pointer)." ULONG NO_COMPU_METHOD 0 0 0 4294967295 ECU_ADDRESS 0x40001A00 /end MEASUREMENT
/begin MEASUREMENT timer_main_start2 "undefined4" ULONG NO_COMPU_METHOD 0 0 0 4294967295 ECU_ADDRESS 0x40001A2C /end MEASUREMENT
/begin MEASUREMENT lea_init_stamp_lo "undefined2" UWORD NO_COMPU_METHOD 0 0 0 65535 ECU_ADDRESS 0x40001A30 /end MEASUREMENT
/begin MEASUREMENT lea_init_stamp_hi "undefined2" UWORD NO_COMPU_METHOD 0 0 0 65535 ECU_ADDRESS 0x40001A32 /end MEASUREMENT
/begin MEASUREMENT lea_init_status_flags "undefined4" ULONG NO_COMPU_METHOD 0 0 0 4294967295 ECU_ADDRESS 0x40001A34 /end MEASUREMENT
/begin MEASUREMENT diag_lea_reset_trigger "undefined2" UWORD NO_COMPU_METHOD 0 0 0 65535 ECU_ADDRESS 0x40001A38 /end MEASUREMENT
/begin MEASUREMENT flash_saved_sll_slms_mask "undefined4" ULONG NO_COMPU_METHOD 0 0 0 4294967295 ECU_ADDRESS 0x40001A68 /end MEASUREMENT
/begin MEASUREMENT flash_saved_lml_hbl_hi_mask "undefined4" ULONG NO_COMPU_METHOD 0 0 0 4294967295 ECU_ADDRESS 0x40001A6C /end MEASUREMENT
/begin MEASUREMENT flash_saved_lml_hbl_lo_mask "undefined4" ULONG NO_COMPU_METHOD 0 0 0 4294967295 ECU_ADDRESS 0x40001A70 /end MEASUREMENT
/begin MEASUREMENT cooling_system_flags "undefined4" ULONG NO_COMPU_METHOD 0 0 0 4294967295 ECU_ADDRESS 0x40001A78 /end MEASUREMENT
/begin MEASUREMENT new_gear_detected_flags "undefined2" UWORD NO_COMPU_METHOD 0 0 0 65535 ECU_ADDRESS 0x40001A7C /end MEASUREMENT
/begin MEASUREMENT car_current_gear "Car current gear (enumerated state)." UBYTE NO_COMPU_METHOD 0 0 0 255 ECU_ADDRESS 0x40001A7E /end MEASUREMENT
/begin MEASUREMENT fuel_level_pct "undefined1" UBYTE NO_COMPU_METHOD 0 0 0 255 ECU_ADDRESS 0x40001A7F /end MEASUREMENT
/begin MEASUREMENT recirculation_pump_state___or_acis "undefined1" UBYTE NO_COMPU_METHOD 0 0 0 255 ECU_ADDRESS 0x40001A83 /end MEASUREMENT
/begin MEASUREMENT ign_voltage_above_threshold "Ignition voltage above threshold (boolean flag)." UBYTE NO_COMPU_METHOD 0 0 0 255 ECU_ADDRESS 0x40001A85 /end MEASUREMENT
/begin MEASUREMENT rev_per_km "undefined4" ULONG NO_COMPU_METHOD 0 0 0 4294967295 ECU_ADDRESS 0x40001A88 /end MEASUREMENT
/begin MEASUREMENT o2_sensor1_heater_enable_state "O2 sensor1 heater enable state (boolean flag)." UBYTE NO_COMPU_METHOD 0 0 0 255 ECU_ADDRESS 0x40001A8C /end MEASUREMENT
/begin MEASUREMENT o2_sensor2_heater_enable_state "O2 sensor2 heater enable state (boolean flag)." UBYTE NO_COMPU_METHOD 0 0 0 255 ECU_ADDRESS 0x40001A8D /end MEASUREMENT
/begin MEASUREMENT o2_sensor5_heater_enable_state "O2 sensor5 heater enable state (boolean flag)." UBYTE NO_COMPU_METHOD 0 0 0 255 ECU_ADDRESS 0x40001A8E /end MEASUREMENT
/begin MEASUREMENT o2_sensor6_heater_enable_state "O2 sensor6 heater enable state (boolean flag)." UBYTE NO_COMPU_METHOD 0 0 0 255 ECU_ADDRESS 0x40001A8F /end MEASUREMENT
/begin MEASUREMENT exhaust_flap_state "Exhaust flap state (boolean flag)." UBYTE NO_COMPU_METHOD 0 0 0 255 ECU_ADDRESS 0x40001A90 /end MEASUREMENT
/begin MEASUREMENT car_speed_u8 "Car speed (km/h)." UBYTE CM_u8_speed_kph 0 0 0 255 ECU_ADDRESS 0x40001A91 /end MEASUREMENT
/begin MEASUREMENT car_speed_x100 "Car speed x100 (km/h = val/100)." UWORD CM_u8_speed_1_100kph 0 0 0 655.35 ECU_ADDRESS 0x40001A92 /end MEASUREMENT
/begin MEASUREMENT wheel_speeds "Wheel speeds (structure)." ULONG NO_COMPU_METHOD 0 0 0 4294967295 ECU_ADDRESS 0x40001A94 /end MEASUREMENT
/begin MEASUREMENT brake_switch "undefined1" UBYTE NO_COMPU_METHOD 0 0 0 255 ECU_ADDRESS 0x40001A9C /end MEASUREMENT
/begin MEASUREMENT clutch_pos_sensor "undefined1" UBYTE NO_COMPU_METHOD 0 0 0 255 ECU_ADDRESS 0x40001A9D /end MEASUREMENT
/begin MEASUREMENT cluster_lamp_test_state "undefined1" UBYTE NO_COMPU_METHOD 0 0 0 255 ECU_ADDRESS 0x40001AB6 /end MEASUREMENT
/begin MEASUREMENT roughness_flags "undefined2" UWORD NO_COMPU_METHOD 0 0 0 65535 ECU_ADDRESS 0x40001AB8 /end MEASUREMENT
/begin MEASUREMENT ign_adv_from_roughness_detection "undefined2" UWORD NO_COMPU_METHOD 0 0 0 65535 ECU_ADDRESS 0x40001ABA /end MEASUREMENT
/begin MEASUREMENT accel_front_wheels "undefined2" UWORD NO_COMPU_METHOD 0 0 0 65535 ECU_ADDRESS 0x40001AC0 /end MEASUREMENT
/begin MEASUREMENT radiator_fan_duty_cycle_target "Radiator fan duty cycle target (% = val*100/255)." UBYTE CM_u8_factor_1_255 0 0 0 100 ECU_ADDRESS 0x40001AC2 /end MEASUREMENT
/begin MEASUREMENT cac_pump_dutycycle "Charge-air-cooler pump dutycycle (val/255)." UBYTE CM_u8_factor_1_255 0 0 0 100 ECU_ADDRESS 0x40001AC3 /end MEASUREMENT
/begin MEASUREMENT cac_pwm_output "undefined1" UBYTE NO_COMPU_METHOD 0 0 0 255 ECU_ADDRESS 0x40001AC4 /end MEASUREMENT
/begin MEASUREMENT fuel_usage_reset "Fuel usage reset (boolean flag)." UBYTE NO_COMPU_METHOD 0 0 0 255 ECU_ADDRESS 0x40001AC5 /end MEASUREMENT
/begin MEASUREMENT cluster_fuel_mileage_update_timer "undefined1" UBYTE NO_COMPU_METHOD 0 0 0 255 ECU_ADDRESS 0x40001AC6 /end MEASUREMENT
/begin MEASUREMENT fuel_usage_timer1 "undefined1" UBYTE NO_COMPU_METHOD 0 0 0 255 ECU_ADDRESS 0x40001AC7 /end MEASUREMENT
/begin MEASUREMENT cluster_shiftlight_rpm_offset "undefined2" UWORD NO_COMPU_METHOD 0 0 0 65535 ECU_ADDRESS 0x40001AC8 /end MEASUREMENT
/begin MEASUREMENT coolant_fan_afterrun_time "Coolant fant afterrun time (s)." UWORD CM_u8_time_s 0 0 0 65535 ECU_ADDRESS 0x40001ACA /end MEASUREMENT
/begin MEASUREMENT cluster_shift_light_state "Cluster shift light state." UBYTE NO_COMPU_METHOD 0 0 0 255 ECU_ADDRESS 0x40001ACC /end MEASUREMENT
/begin MEASUREMENT oil_pressure_warning_light_timer "undefined1" UBYTE NO_COMPU_METHOD 0 0 0 255 ECU_ADDRESS 0x40001ACD /end MEASUREMENT
/begin MEASUREMENT dash_data_CAN400 "Dash data CAN400 (structure)." ULONG NO_COMPU_METHOD 0 0 0 4294967295 ECU_ADDRESS 0x40001AD0 /end MEASUREMENT
/begin MEASUREMENT cluster_indicator_flags "undefined1" UBYTE NO_COMPU_METHOD 0 0 0 255 ECU_ADDRESS 0x40001AD8 /end MEASUREMENT
/begin MEASUREMENT cluster_flags "undefined1" UBYTE NO_COMPU_METHOD 0 0 0 255 ECU_ADDRESS 0x40001AD9 /end MEASUREMENT
/begin MEASUREMENT shutdown_eeprom_saved "Shutdown eeprom saved (boolean flag)." UBYTE NO_COMPU_METHOD 0 0 0 255 ECU_ADDRESS 0x40001ADA /end MEASUREMENT
/begin MEASUREMENT exhaust_flap_output_initialized "Exhaust flap output initialized (boolean flag)." UBYTE NO_COMPU_METHOD 0 0 0 255 ECU_ADDRESS 0x40001ADB /end MEASUREMENT
/begin MEASUREMENT exhaust_flap_flags "undefined1" UBYTE NO_COMPU_METHOD 0 0 0 255 ECU_ADDRESS 0x40001ADC /end MEASUREMENT
/begin MEASUREMENT nonabs_wheelspeed "undefined4" ULONG NO_COMPU_METHOD 0 0 0 4294967295 ECU_ADDRESS 0x40001AE0 /end MEASUREMENT
/begin MEASUREMENT recirc_pump_afterrun_started "Recirc pump afterrun started (boolean flag)." UBYTE NO_COMPU_METHOD 0 0 0 255 ECU_ADDRESS 0x40001AE7 /end MEASUREMENT
/begin MEASUREMENT fan_coolant_fall_delta "Coolant temperature fan sample drop amount (°C = val*5/8−40)." UBYTE CM_u8_temp_5_8_40c 0 0 -40 119.375 ECU_ADDRESS 0x40001AE8 /end MEASUREMENT
/begin MEASUREMENT fan_coolant_fall_check_timer "undefined1" UBYTE NO_COMPU_METHOD 0 0 0 255 ECU_ADDRESS 0x40001AE9 /end MEASUREMENT
/begin MEASUREMENT fan_inhibit_coolant_falling "Fan engine bay inhibit (boolean flag)." UBYTE NO_COMPU_METHOD 0 0 0 255 ECU_ADDRESS 0x40001AEA /end MEASUREMENT
/begin MEASUREMENT fan_coolant_fall_check_prev_temp "Coolant temperature sample for fan control (°C = val*5/8−40)." UBYTE CM_u8_temp_5_8_40c 0 0 -40 119.375 ECU_ADDRESS 0x40001AEB /end MEASUREMENT
/begin MEASUREMENT ips_cooling "IPS cooling (boolean flag)." UBYTE NO_COMPU_METHOD 0 0 0 255 ECU_ADDRESS 0x40001AEC /end MEASUREMENT
/begin MEASUREMENT temp_engine_air_cooling_control "Temperature engine air cooling control (°C = val*5/8−40)." UBYTE CM_u8_temp_5_8_40c 0 0 -40 119.375 ECU_ADDRESS 0x40001AED /end MEASUREMENT
/begin MEASUREMENT engine_speed_tach "Engine speed tach (RPM = val/4)." UWORD CM_u16_rspeed_1_4rpm 0 0 0 16383.75 ECU_ADDRESS 0x40001B00 /end MEASUREMENT
/begin MEASUREMENT recirc_pump_override_state "undefined1" UBYTE NO_COMPU_METHOD 0 0 0 255 ECU_ADDRESS 0x40001B02 /end MEASUREMENT
/begin MEASUREMENT trans_pump_override_state "undefined1" UBYTE NO_COMPU_METHOD 0 0 0 255 ECU_ADDRESS 0x40001B03 /end MEASUREMENT
/begin MEASUREMENT trans_pump_enable_request "Transmission pump enable request (boolean flag)." UBYTE NO_COMPU_METHOD 0 0 0 255 ECU_ADDRESS 0x40001B04 /end MEASUREMENT
/begin MEASUREMENT radiator_fan_pwm_initialized "Radiator fan PWM initialized (boolean flag)." UBYTE NO_COMPU_METHOD 0 0 0 255 ECU_ADDRESS 0x40001B05 /end MEASUREMENT
/begin MEASUREMENT radiator_fan_dc_coolant_based "Radiator fan duty cycle coolant based (% = val*100/255)." UBYTE CM_u8_factor_1_255 0 0 0 100 ECU_ADDRESS 0x40001B06 /end MEASUREMENT
/begin MEASUREMENT radiator_fan_dc_airtemp_based "Radiator fan duty cycle airtemp based (% = val*100/255)." UBYTE CM_u8_factor_1_255 0 0 0 100 ECU_ADDRESS 0x40001B07 /end MEASUREMENT
/begin MEASUREMENT radiator_fan_dc_hotstart "Radiator fan duty cycle hotstart (% = val*100/255)." UBYTE CM_u8_factor_1_255 0 0 0 100 ECU_ADDRESS 0x40001B08 /end MEASUREMENT
/begin MEASUREMENT radiator_fan_pwm_output "undefined1" UBYTE NO_COMPU_METHOD 0 0 0 255 ECU_ADDRESS 0x40001B09 /end MEASUREMENT
/begin MEASUREMENT cac_pwm_output_last "undefined1" UBYTE NO_COMPU_METHOD 0 0 0 255 ECU_ADDRESS 0x40001B0B /end MEASUREMENT
/begin MEASUREMENT cac_pump_pwm_initialized "Charge-air-cooler pump PWM initialized (boolean flag)." UBYTE NO_COMPU_METHOD 0 0 0 255 ECU_ADDRESS 0x40001B0C /end MEASUREMENT
/begin MEASUREMENT cac_warmup_timer "undefined1" UBYTE NO_COMPU_METHOD 0 0 0 255 ECU_ADDRESS 0x40001B0D /end MEASUREMENT
/begin MEASUREMENT exhaust_flap_state_40001B11 "undefined1" UBYTE NO_COMPU_METHOD 0 0 0 255 ECU_ADDRESS 0x40001B11 /end MEASUREMENT
/begin MEASUREMENT wheelspeed_front_delta_accum "undefined2" UWORD NO_COMPU_METHOD 0 0 0 65535 ECU_ADDRESS 0x40001B14 /end MEASUREMENT
/begin MEASUREMENT wheel_speed_front_delta "undefined2" UWORD NO_COMPU_METHOD 0 0 0 65535 ECU_ADDRESS 0x40001B16 /end MEASUREMENT
/begin MEASUREMENT wheelspeed_update_timer "Wheelspeed update timer (ms = val*5)." UBYTE CM_u8_time_5ms 0 0 0 1275 ECU_ADDRESS 0x40001B18 /end MEASUREMENT
/begin MEASUREMENT wheelspeed_front_average "undefined2" UWORD NO_COMPU_METHOD 0 0 0 65535 ECU_ADDRESS 0x40001B1A /end MEASUREMENT
/begin MEASUREMENT wheelspeed_front_avg_prev "undefined2" UWORD NO_COMPU_METHOD 0 0 0 65535 ECU_ADDRESS 0x40001B1C /end MEASUREMENT
/begin MEASUREMENT engine_speed_pps_target "undefined2" UWORD NO_COMPU_METHOD 0 0 0 65535 ECU_ADDRESS 0x40001B1E /end MEASUREMENT
/begin MEASUREMENT engine_speed_reference_x256 "Engine speed reference x256 (RPM = val*1024)." ULONG CM_u32_rspeed_1024rpm 0 0 0 4398046510080 ECU_ADDRESS 0x40001B20 /end MEASUREMENT
/begin MEASUREMENT engine_speed_decel_limiter_active "Engine speed decel limiter active (boolean flag)." UBYTE NO_COMPU_METHOD 0 0 0 255 ECU_ADDRESS 0x40001B24 /end MEASUREMENT
/begin MEASUREMENT idle_underspeed_latch "Idle underspeed latch (boolean flag)." UBYTE NO_COMPU_METHOD 0 0 0 255 ECU_ADDRESS 0x40001B25 /end MEASUREMENT
/begin MEASUREMENT engine_speed_reference_prev_x256 "undefined4" ULONG NO_COMPU_METHOD 0 0 0 4294967295 ECU_ADDRESS 0x40001B28 /end MEASUREMENT
/begin MEASUREMENT engine_speed_target_ramp_up_gain "undefined1" UBYTE NO_COMPU_METHOD 0 0 0 255 ECU_ADDRESS 0x40001B2C /end MEASUREMENT
/begin MEASUREMENT fuel_economy_factor "undefined2" UWORD NO_COMPU_METHOD 0 0 0 65535 ECU_ADDRESS 0x40001B2E /end MEASUREMENT
/begin MEASUREMENT cluster_range_to_empty_calculated "Cluster range to empty calculated (km)." UWORD CM_u16_distance_km 0 0 0 65535 ECU_ADDRESS 0x40001B30 /end MEASUREMENT
/begin MEASUREMENT fuel_level_prev "Fuel level prev (gal = val/10)." UWORD CM_u8_volume_1_10gallon 0 0 0 6553.5 ECU_ADDRESS 0x40001B32 /end MEASUREMENT
/begin MEASUREMENT fuel_range_remaining "Fuel range remaining." UWORD NO_COMPU_METHOD 0 0 0 65535 ECU_ADDRESS 0x40001B34 /end MEASUREMENT
/begin MEASUREMENT fuel_economy_avg "Fuel economy avg." UWORD NO_COMPU_METHOD 0 0 0 65535 ECU_ADDRESS 0x40001B36 /end MEASUREMENT
/begin MEASUREMENT fuel_economy_instantaneous "Fuel economy instantaneous." UWORD NO_COMPU_METHOD 0 0 0 65535 ECU_ADDRESS 0x40001B38 /end MEASUREMENT
/begin MEASUREMENT ips_shift_light_flags "undefined1" UBYTE NO_COMPU_METHOD 0 0 0 255 ECU_ADDRESS 0x40001B3A /end MEASUREMENT
/begin MEASUREMENT paddle_shift_sensor_raw "undefined2" UWORD NO_COMPU_METHOD 0 0 0 65535 ECU_ADDRESS 0x40001B3C /end MEASUREMENT
/begin MEASUREMENT paddle_shift_flags "undefined1" UBYTE NO_COMPU_METHOD 0 0 0 255 ECU_ADDRESS 0x40001B3E /end MEASUREMENT
/begin MEASUREMENT inj_dfco_recovery_enrichment "Injector decel fuel cut-off recovery enrichment (µs)." ULONG CM_u16_time_us 0 0 0 4294967295 ECU_ADDRESS 0x40001B40 /end MEASUREMENT
/begin MEASUREMENT inj_tip_adj_enrichment "Injector tip adj enrichment (µs)." ULONG CM_u16_time_us 0 0 0 4294967295 ECU_ADDRESS 0x40001B44 /end MEASUREMENT
/begin MEASUREMENT inj_tip_adj_enleanment "Injector tip adj enleanment (µs)." ULONG CM_u16_time_us 0 0 0 4294967295 ECU_ADDRESS 0x40001B48 /end MEASUREMENT
/begin MEASUREMENT inj_flags "undefined2" UWORD NO_COMPU_METHOD 0 0 0 65535 ECU_ADDRESS 0x40001B4C /end MEASUREMENT
/begin MEASUREMENT injtip_in_rpm_decay "undefined1" UBYTE NO_COMPU_METHOD 0 0 0 255 ECU_ADDRESS 0x40001B4E /end MEASUREMENT
/begin MEASUREMENT injtip_out_rpm_decay "undefined1" UBYTE NO_COMPU_METHOD 0 0 0 255 ECU_ADDRESS 0x40001B4F /end MEASUREMENT
/begin MEASUREMENT dfco_pedal_ramp_target "undefined1" UBYTE NO_COMPU_METHOD 0 0 0 255 ECU_ADDRESS 0x40001B50 /end MEASUREMENT
/begin MEASUREMENT injtip_in_enrichment_raw "undefined4" ULONG NO_COMPU_METHOD 0 0 0 4294967295 ECU_ADDRESS 0x40001B54 /end MEASUREMENT
/begin MEASUREMENT injtip_out_enleanment_raw "undefined4" ULONG NO_COMPU_METHOD 0 0 0 4294967295 ECU_ADDRESS 0x40001B58 /end MEASUREMENT
/begin MEASUREMENT injtip_transient_magnitude "undefined2" UWORD NO_COMPU_METHOD 0 0 0 65535 ECU_ADDRESS 0x40001B5C /end MEASUREMENT
/begin MEASUREMENT dfco_recovery_enrich_cooldown_timer "undefined2" UWORD NO_COMPU_METHOD 0 0 0 65535 ECU_ADDRESS 0x40001B5E /end MEASUREMENT
/begin MEASUREMENT inj_trim_post_start "undefined2" UWORD NO_COMPU_METHOD 0 0 0 65535 ECU_ADDRESS 0x40001B60 /end MEASUREMENT
/begin MEASUREMENT injtip_in_rpm_scale "undefined1" UBYTE NO_COMPU_METHOD 0 0 0 255 ECU_ADDRESS 0x40001B62 /end MEASUREMENT
/begin MEASUREMENT injtip_in_coolant_scale "undefined1" UBYTE NO_COMPU_METHOD 0 0 0 255 ECU_ADDRESS 0x40001B63 /end MEASUREMENT
/begin MEASUREMENT injtip_out_rpm_scale "undefined1" UBYTE NO_COMPU_METHOD 0 0 0 255 ECU_ADDRESS 0x40001B64 /end MEASUREMENT
/begin MEASUREMENT injtip_out_coolant_scale "undefined1" UBYTE NO_COMPU_METHOD 0 0 0 255 ECU_ADDRESS 0x40001B65 /end MEASUREMENT
/begin MEASUREMENT inj_tip_in_adj_gear_current "Injector tip in adj gear current." SBYTE NO_COMPU_METHOD 0 0 -128 127 ECU_ADDRESS 0x40001B66 /end MEASUREMENT
/begin MEASUREMENT dfco_enable_engine_speed "Decel fuel cut-off enable engine speed (RPM)." UWORD CM_u16_rspeed_rpm 0 0 0 65535 ECU_ADDRESS 0x40001B68 /end MEASUREMENT
/begin MEASUREMENT dfco_disable_rpm_ingear "undefined2" UWORD NO_COMPU_METHOD 0 0 0 65535 ECU_ADDRESS 0x40001B6A /end MEASUREMENT
/begin MEASUREMENT dfco_disable_rpm_neutral "undefined2" UWORD NO_COMPU_METHOD 0 0 0 65535 ECU_ADDRESS 0x40001B6C /end MEASUREMENT
/begin MEASUREMENT injtip_out_load_scale "undefined1" UBYTE NO_COMPU_METHOD 0 0 0 255 ECU_ADDRESS 0x40001B6E /end MEASUREMENT
/begin MEASUREMENT cyl_fuelcut_sparking_mask "undefined1" UBYTE NO_COMPU_METHOD 0 0 0 255 ECU_ADDRESS 0x40001B79 /end MEASUREMENT
/begin MEASUREMENT ign_per_cyl_fire_enable "undefined1" UBYTE NO_COMPU_METHOD 0 0 0 255 ECU_ADDRESS 0x40001B7A /end MEASUREMENT
/begin MEASUREMENT sensor_adc_maf1 "Sensor ADC maf1 (V = val*5/1023)." UWORD CM_u16_voltage_5_1023v 0 0 0 320.307917888563 ECU_ADDRESS 0x40001B88 /end MEASUREMENT
/begin MEASUREMENT obd_ii_maf_flow "OBD-II: MAF flow (mg/s = val*10)." UWORD CM_u16_flow_10mg_s 0 0 0 655350 ECU_ADDRESS 0x40001B8A /end MEASUREMENT
/begin MEASUREMENT maf_flow "MAF flow (mg/s = val*10)." UWORD CM_u16_flow_10mg_s 0 0 0 655350 ECU_ADDRESS 0x40001B8C /end MEASUREMENT
/begin MEASUREMENT engine_mass_flow_rate_from_map "Engine mass flow rate from MAP (mg/s = val*100)." UWORD CM_u16_flow_100mg_s 0 0 0 6553500 ECU_ADDRESS 0x40001B8E /end MEASUREMENT
/begin MEASUREMENT load_mass_per_time "undefined2" UWORD NO_COMPU_METHOD 0 0 0 65535 ECU_ADDRESS 0x40001B90 /end MEASUREMENT
/begin MEASUREMENT airflow_rate_expected_alphaN "undefined2" UWORD NO_COMPU_METHOD 0 0 0 65535 ECU_ADDRESS 0x40001B92 /end MEASUREMENT
/begin MEASUREMENT manifold_pressure_calculated "Manifold pressure calculated (mbar)." UWORD CM_u16_pressure_mbar 0 0 0 65535 ECU_ADDRESS 0x40001B94 /end MEASUREMENT
/begin MEASUREMENT load_mass_per_stroke_raw "Load mass per stroke (mg/stroke)." ULONG CM_u16_load_mg_stroke 0 0 0 4294967295 ECU_ADDRESS 0x40001B98 /end MEASUREMENT
/begin MEASUREMENT load_selected_raw "Load selected (mg/stroke)." ULONG CM_u16_load_mg_stroke 0 0 0 4294967295 ECU_ADDRESS 0x40001B9C /end MEASUREMENT
/begin MEASUREMENT sensor_adc_maf2 "Sensor ADC maf2 (V = val*5/1023)." UWORD CM_u16_voltage_5_1023v 0 0 0 320.307917888563 ECU_ADDRESS 0x40001BA0 /end MEASUREMENT
/begin MEASUREMENT load_alphaN_learn_cell "Lea load alphaN index." UWORD NO_COMPU_METHOD 0 0 0 65535 ECU_ADDRESS 0x40001BA2 /end MEASUREMENT
/begin MEASUREMENT load_alphaN_maf_error_correction_cell "undefined2" UWORD NO_COMPU_METHOD 0 0 0 65535 ECU_ADDRESS 0x40001BA4 /end MEASUREMENT
/begin MEASUREMENT load_baro_gain "undefined2" UWORD NO_COMPU_METHOD 0 0 0 65535 ECU_ADDRESS 0x40001BA8 /end MEASUREMENT
/begin MEASUREMENT _ve_for_map_synthesis "u16_factor_1/100" UWORD CM_u8_factor_1_100 0 0 0 65535 ECU_ADDRESS 0x40001BAA /end MEASUREMENT
/begin MEASUREMENT load_maf_vs_alphaN_difference "Load MAF vs alphaN difference (mg/stroke)." UWORD CM_u16_load_mg_stroke 0 0 0 65535 ECU_ADDRESS 0x40001BAC /end MEASUREMENT
/begin MEASUREMENT tps_delta_from_idle "u16_factor_1/1023" UWORD CM_u16_factor_1_1023 0 0 0 6406.15835777126 ECU_ADDRESS 0x40001BAE /end MEASUREMENT
/begin MEASUREMENT load_measured_maf "Load measured MAF (mg/stroke)." ULONG CM_u16_load_mg_stroke 0 0 0 4294967295 ECU_ADDRESS 0x40001BB0 /end MEASUREMENT
/begin MEASUREMENT load_from_speed_density "Load from speed density (mg/stroke)." ULONG CM_u16_load_mg_stroke 0 0 0 4294967295 ECU_ADDRESS 0x40001BB4 /end MEASUREMENT
/begin MEASUREMENT maf_flow_difference "MAF flow difference (mg/s = val*10)." UWORD CM_u16_flow_10mg_s 0 0 0 655350 ECU_ADDRESS 0x40001BB8 /end MEASUREMENT
/begin MEASUREMENT load_computed_alphaN "Load computed alphaN (mg/stroke)." ULONG CM_u16_load_mg_stroke 0 0 0 4294967295 ECU_ADDRESS 0x40001BBC /end MEASUREMENT
/begin MEASUREMENT load_alphaN_expected "u32_load_mg/stroke" ULONG CM_u16_load_mg_stroke 0 0 0 4294967295 ECU_ADDRESS 0x40001BC0 /end MEASUREMENT
/begin MEASUREMENT tps_idle_baseline_learned "u32_factor_1/1023" ULONG CM_u16_factor_1_1023 0 0 0 419840400.293255 ECU_ADDRESS 0x40001BC4 /end MEASUREMENT
/begin MEASUREMENT load_alphaN_calc "Load alphaN calculated (mg/stroke = val*1173)." UWORD CM_u16_load_mg_stroke 0 0 0 65535 ECU_ADDRESS 0x40001BC8 /end MEASUREMENT
/begin MEASUREMENT load_to_tps_mapping "Load to throttle position mapping (val/1023)." UWORD CM_u16_factor_1_1023 0 0 0 6406.15835777126 ECU_ADDRESS 0x40001BCA /end MEASUREMENT
/begin MEASUREMENT maf_vs_alphaN_flow_error "i16_flow_400mg/s" SWORD CM_i16_flow_400mg_s 0 0 -13107200 13106800 ECU_ADDRESS 0x40001BCC /end MEASUREMENT
/begin MEASUREMENT load_alphaN_trim_factor "u16_factor_1/100" UWORD CM_u8_factor_1_100 0 0 0 65535 ECU_ADDRESS 0x40001BCE /end MEASUREMENT
/begin MEASUREMENT load_alphaN_maf_error_correction "u16_factor_1/100" UWORD CM_u8_factor_1_100 0 0 0 65535 ECU_ADDRESS 0x40001BD0 /end MEASUREMENT
/begin MEASUREMENT transient_load_timer "Transient load timer (ms = val*5)." UBYTE CM_u8_time_5ms 0 0 0 1275 ECU_ADDRESS 0x40001BD2 /end MEASUREMENT
/begin MEASUREMENT load_mass_per_stroke "Load mass per stroke (mg/stroke = val*4)." UBYTE CM_u8_load_4mg_stroke 0 0 0 1020 ECU_ADDRESS 0x40001BD3 /end MEASUREMENT
/begin MEASUREMENT load_8bit "Load 1 (mg/stroke = val*1173)." UBYTE CM_u8_load_1173mg_255stroke 0 0 0 1173 ECU_ADDRESS 0x40001BD4 /end MEASUREMENT
/begin MEASUREMENT load_unused1 "undefined1" UBYTE NO_COMPU_METHOD 0 0 0 255 ECU_ADDRESS 0x40001BD5 /end MEASUREMENT
/begin MEASUREMENT tps_scaling_factor "Throttle position scaling factor (val/255)." UBYTE CM_u8_factor_1_255 0 0 0 100 ECU_ADDRESS 0x40001BD6 /end MEASUREMENT
/begin MEASUREMENT load_selection_tps_threshold "u8_factor_1/255" UBYTE CM_u8_factor_1_255 0 0 0 100 ECU_ADDRESS 0x40001BD7 /end MEASUREMENT
/begin MEASUREMENT knock_inhibit_tps_max "Knock inhibit throttle position maximum (val/255)." UBYTE CM_u8_factor_1_255 0 0 0 100 ECU_ADDRESS 0x40001BD8 /end MEASUREMENT
/begin MEASUREMENT load_computed_to_measured_ratio "Load computed to measured ratio (val/100)." UBYTE CM_u8_factor_1_100 0 0 0 255 ECU_ADDRESS 0x40001BD9 /end MEASUREMENT
/begin MEASUREMENT tps_idle_to_current_ratio "Throttle position idle to current ratio (val/100)." UBYTE CM_u8_factor_1_100 0 0 0 255 ECU_ADDRESS 0x40001BDA /end MEASUREMENT
/begin MEASUREMENT obd_ii_calc_engine_load "OBD-II: calculated engine load (val/255)." UBYTE CM_u8_factor_1_255 0 0 0 100 ECU_ADDRESS 0x40001BDB /end MEASUREMENT
/begin MEASUREMENT obd_ii_load_abs "OBD-II: load ABS (val/255)." UWORD CM_u8_factor_1_255 0 0 0 25700 ECU_ADDRESS 0x40001BDC /end MEASUREMENT
/begin MEASUREMENT load_pct "Load pct (val/100)." UBYTE CM_u8_factor_1_100 0 0 0 255 ECU_ADDRESS 0x40001BDE /end MEASUREMENT
/begin MEASUREMENT load_source_is_alphaN "Load source is alphaN (boolean flag)." UBYTE NO_COMPU_METHOD 0 0 0 255 ECU_ADDRESS 0x40001BDF /end MEASUREMENT
/begin MEASUREMENT engine_speed_period_adj "Engine speed period adj (µs)." UWORD CM_u16_time_us 0 0 0 65535 ECU_ADDRESS 0x40001BE0 /end MEASUREMENT
/begin MEASUREMENT maf_flow_2 "MAF flow 2 (mg/s = val*10)." UWORD CM_u16_flow_10mg_s 0 0 0 655350 ECU_ADDRESS 0x40001BE2 /end MEASUREMENT
/begin MEASUREMENT load_ref_charge "u8_load_4mg/stroke" UBYTE CM_u8_load_4mg_stroke 0 0 0 1020 ECU_ADDRESS 0x40001BE4 /end MEASUREMENT
/begin MEASUREMENT load_u8_tmp "undefined1" UBYTE NO_COMPU_METHOD 0 0 0 255 ECU_ADDRESS 0x40001BE5 /end MEASUREMENT
/begin MEASUREMENT load_unknown "Load." ULONG NO_COMPU_METHOD 0 0 0 4294967295 ECU_ADDRESS 0x40001BE8 /end MEASUREMENT
/begin MEASUREMENT ve_for_speed_density "VE for speed density (val/10000)." UWORD CM_u16_factor_1_10000 0 0 0 655.35 ECU_ADDRESS 0x40001BEC /end MEASUREMENT
/begin MEASUREMENT manifold_pressure_ratio_mbar "Manifold pressure ratio mbar (mbar)." UWORD CM_u16_pressure_mbar 0 0 0 65535 ECU_ADDRESS 0x40001BEE /end MEASUREMENT
/begin MEASUREMENT vacuum_mbar "Vacuum mbar (mbar)." UWORD CM_u16_pressure_mbar 0 0 0 65535 ECU_ADDRESS 0x40001BF0 /end MEASUREMENT
/begin MEASUREMENT cat_monitor_min_maf_accum_thresh_ "undefined1" UBYTE NO_COMPU_METHOD 0 0 0 255 ECU_ADDRESS 0x40001C12 /end MEASUREMENT
/begin MEASUREMENT obd_ii_postcat_o2_mean_b2 "float" ULONG NO_COMPU_METHOD 0 0 0 4294967295 ECU_ADDRESS 0x40001C34 /end MEASUREMENT
/begin MEASUREMENT obd_ii_postcat_o2_mean_b1 "undefined4" ULONG NO_COMPU_METHOD 0 0 0 4294967295 ECU_ADDRESS 0x40001C38 /end MEASUREMENT
/begin MEASUREMENT obd_ii_o2_precat_sw_bank2 "undefined2" UWORD NO_COMPU_METHOD 0 0 0 65535 ECU_ADDRESS 0x40001C44 /end MEASUREMENT
/begin MEASUREMENT obd_cat_monitor_count_b1 "undefined2" UWORD NO_COMPU_METHOD 0 0 0 65535 ECU_ADDRESS 0x40001C46 /end MEASUREMENT
/begin MEASUREMENT obd_cat_monitor_threshold_current "undefined2" UWORD NO_COMPU_METHOD 0 0 0 65535 ECU_ADDRESS 0x40001C48 /end MEASUREMENT
/begin MEASUREMENT obd_similar_cond_met_mask "undefined1" UBYTE NO_COMPU_METHOD 0 0 0 255 ECU_ADDRESS 0x40001C68 /end MEASUREMENT
/begin MEASUREMENT obd_ii_montior_passes_bitfield "undefined2" UWORD NO_COMPU_METHOD 0 0 0 65535 ECU_ADDRESS 0x40001C6A /end MEASUREMENT
/begin MEASUREMENT obd_ii_engine_coolant_temp "OBD-II: engine coolant temperature (°C = val−40)." UBYTE CM_u8_temp__40c 0 0 -40 215 ECU_ADDRESS 0x40001C6D /end MEASUREMENT
/begin MEASUREMENT obd_ii_dtc_state "undefined1" UBYTE NO_COMPU_METHOD 0 0 0 255 ECU_ADDRESS 0x40001C6E /end MEASUREMENT
/begin MEASUREMENT obd_ii_clear_dtc_request "OBD-II: clear DTC request (boolean flag)." UBYTE NO_COMPU_METHOD 0 0 0 255 ECU_ADDRESS 0x40001C6F /end MEASUREMENT
/begin MEASUREMENT engine_has_run "undefined1" UBYTE NO_COMPU_METHOD 0 0 0 255 ECU_ADDRESS 0x40001C74 /end MEASUREMENT
/begin MEASUREMENT obd_warmup_ready "undefined1" UBYTE NO_COMPU_METHOD 0 0 0 255 ECU_ADDRESS 0x40001C75 /end MEASUREMENT
/begin MEASUREMENT obd_ii_monitors_completed_this_drive_cycle "OBD-II: monitors completed this drive cycle." UBYTE NO_COMPU_METHOD 0 0 0 255 ECU_ADDRESS 0x40001C7A /end MEASUREMENT
/begin MEASUREMENT freeze_frame_dtc "undefined4" ULONG NO_COMPU_METHOD 0 0 0 4294967295 ECU_ADDRESS 0x40001CA4 /end MEASUREMENT
/begin MEASUREMENT freeze_frame_dtc_config "undefined1" UBYTE NO_COMPU_METHOD 0 0 0 255 ECU_ADDRESS 0x40001CA8 /end MEASUREMENT
/begin MEASUREMENT latch_counter_p0122 "undefined1" UBYTE NO_COMPU_METHOD 0 0 0 255 ECU_ADDRESS 0x40001CB8 /end MEASUREMENT
/begin MEASUREMENT latch_counter_p0123 "undefined1" UBYTE NO_COMPU_METHOD 0 0 0 255 ECU_ADDRESS 0x40001CB9 /end MEASUREMENT
/begin MEASUREMENT latch_counter_p0222 "undefined1" UBYTE NO_COMPU_METHOD 0 0 0 255 ECU_ADDRESS 0x40001CBA /end MEASUREMENT
/begin MEASUREMENT latch_counter_p0223 "undefined1" UBYTE NO_COMPU_METHOD 0 0 0 255 ECU_ADDRESS 0x40001CBB /end MEASUREMENT
/begin MEASUREMENT obd_ii_throttle_monitor_pass_counter "undefined1" UBYTE NO_COMPU_METHOD 0 0 0 255 ECU_ADDRESS 0x40001CBC /end MEASUREMENT
/begin MEASUREMENT obd_P2119_not_failed "undefined1" UBYTE NO_COMPU_METHOD 0 0 0 255 ECU_ADDRESS 0x40001CBD /end MEASUREMENT
/begin MEASUREMENT obd_P2173_fail_countdown_ "undefined1" UBYTE NO_COMPU_METHOD 0 0 0 255 ECU_ADDRESS 0x40001CBE /end MEASUREMENT
/begin MEASUREMENT obd_P2135_not_failed "undefined1" UBYTE NO_COMPU_METHOD 0 0 0 255 ECU_ADDRESS 0x40001CBF /end MEASUREMENT
/begin MEASUREMENT etb_module_fault_latched "undefined1" UBYTE NO_COMPU_METHOD 0 0 0 255 ECU_ADDRESS 0x40001CC9 /end MEASUREMENT
/begin MEASUREMENT obd_ii_throttle_monitor_fail_debounce "undefined2" UWORD NO_COMPU_METHOD 0 0 0 65535 ECU_ADDRESS 0x40001CCA /end MEASUREMENT
/begin MEASUREMENT hc08_sf_mode_duration "undefined2" UWORD NO_COMPU_METHOD 0 0 0 65535 ECU_ADDRESS 0x40001CD2 /end MEASUREMENT
/begin MEASUREMENT obd_ii_throttle_model_velocity "undefined2" UWORD NO_COMPU_METHOD 0 0 0 65535 ECU_ADDRESS 0x40001CE0 /end MEASUREMENT
/begin MEASUREMENT obd_ii_throttle_model_error "undefined2" UWORD NO_COMPU_METHOD 0 0 0 65535 ECU_ADDRESS 0x40001CE2 /end MEASUREMENT
/begin MEASUREMENT obd_ii_throttle_monitor_blank_timer "undefined1" UBYTE NO_COMPU_METHOD 0 0 0 255 ECU_ADDRESS 0x40001CE4 /end MEASUREMENT
/begin MEASUREMENT evap_vent_valve_closed "undefined1" UBYTE NO_COMPU_METHOD 0 0 0 255 ECU_ADDRESS 0x40001CE8 /end MEASUREMENT
/begin MEASUREMENT evap_canister_purge_solenoid_timer "undefined1" UBYTE NO_COMPU_METHOD 0 0 0 255 ECU_ADDRESS 0x40001CEB /end MEASUREMENT
/begin MEASUREMENT evap_purge_flow_state_timer "undefined1" UBYTE NO_COMPU_METHOD 0 0 0 255 ECU_ADDRESS 0x40001CED /end MEASUREMENT
/begin MEASUREMENT evap_vent_control_timer "undefined1" UBYTE NO_COMPU_METHOD 0 0 0 255 ECU_ADDRESS 0x40001CF0 /end MEASUREMENT
/begin MEASUREMENT car_speed_flags_unknown "undefined1" UBYTE NO_COMPU_METHOD 0 0 0 255 ECU_ADDRESS 0x40001CFE /end MEASUREMENT
/begin MEASUREMENT cl_state_flags_bank1 "undefined2" UWORD NO_COMPU_METHOD 0 0 0 65535 ECU_ADDRESS 0x40001D08 /end MEASUREMENT
/begin MEASUREMENT cl_state_flags_bank2 "undefined2" UWORD NO_COMPU_METHOD 0 0 0 65535 ECU_ADDRESS 0x40001D0A /end MEASUREMENT
/begin MEASUREMENT stft_bank1 "Short-term fuel trim bank1 (val/20)." SWORD CM_i16_factor_1_20 0 0 -163840 163835 ECU_ADDRESS 0x40001D0C /end MEASUREMENT
/begin MEASUREMENT stft_bank2 "Short-term fuel trim bank2 (val/20)." SWORD CM_i16_factor_1_20 0 0 -163840 163835 ECU_ADDRESS 0x40001D0E /end MEASUREMENT
/begin MEASUREMENT cl_status_bank1 "Closed-loop status bank1." UWORD NO_COMPU_METHOD 0 0 0 65535 ECU_ADDRESS 0x40001D10 /end MEASUREMENT
/begin MEASUREMENT cl_status_bank2 "Closed-loop status bank2." UWORD NO_COMPU_METHOD 0 0 0 65535 ECU_ADDRESS 0x40001D12 /end MEASUREMENT
/begin MEASUREMENT stft_filtered_bank1 "undefined2" UWORD NO_COMPU_METHOD 0 0 0 65535 ECU_ADDRESS 0x40001D14 /end MEASUREMENT
/begin MEASUREMENT stft_filtered_bank2 "undefined2" UWORD NO_COMPU_METHOD 0 0 0 65535 ECU_ADDRESS 0x40001D16 /end MEASUREMENT
/begin MEASUREMENT ltft_bank1 "Long-term fuel trim bank1 (% = val/10)." SWORD CM_i16_factor_1_10pct 0 0 -3276.8 3276.7 ECU_ADDRESS 0x40001D18 /end MEASUREMENT
/begin MEASUREMENT ltft_bank2 "Long-term fuel trim bank2 (% = val/10)." SWORD CM_i16_factor_1_10pct 0 0 -3276.8 3276.7 ECU_ADDRESS 0x40001D1A /end MEASUREMENT
/begin MEASUREMENT fuel_learn_timer "Fuel learn timer (ms = val*100)." UWORD CM_u8_time_100ms 0 0 0 6553500 ECU_ADDRESS 0x40001D1C /end MEASUREMENT
/begin MEASUREMENT obd_ii_fuel_trim_offidle_time_bank1 "undefined2" UWORD NO_COMPU_METHOD 0 0 0 65535 ECU_ADDRESS 0x40001D1E /end MEASUREMENT
/begin MEASUREMENT obd_ii_fuel_trim_offidle_time_bank2 "undefined2" UWORD NO_COMPU_METHOD 0 0 0 65535 ECU_ADDRESS 0x40001D20 /end MEASUREMENT
/begin MEASUREMENT obd_ii_fuel_trim_idle_time_bank1 "undefined2" UWORD NO_COMPU_METHOD 0 0 0 65535 ECU_ADDRESS 0x40001D22 /end MEASUREMENT
/begin MEASUREMENT obd_ii_fuel_trim_idle_time_bank2 "undefined2" UWORD NO_COMPU_METHOD 0 0 0 65535 ECU_ADDRESS 0x40001D24 /end MEASUREMENT
/begin MEASUREMENT obd_ii_fuel_trim_zone3_time_bank1 "undefined2" UWORD NO_COMPU_METHOD 0 0 0 65535 ECU_ADDRESS 0x40001D26 /end MEASUREMENT
/begin MEASUREMENT obd_ii_fuel_trim_zone3_time_bank2 "undefined2" UWORD NO_COMPU_METHOD 0 0 0 65535 ECU_ADDRESS 0x40001D28 /end MEASUREMENT
/begin MEASUREMENT cl_proportional_gain_lean "undefined2" UWORD NO_COMPU_METHOD 0 0 0 65535 ECU_ADDRESS 0x40001D2A /end MEASUREMENT
/begin MEASUREMENT cl_proportional_gain_rich "undefined2" UWORD NO_COMPU_METHOD 0 0 0 65535 ECU_ADDRESS 0x40001D2C /end MEASUREMENT
/begin MEASUREMENT cl_jump_lean "Closed-loop integral gain (val/20)." SWORD CM_i16_factor_1_20 0 0 -163840 163835 ECU_ADDRESS 0x40001D2E /end MEASUREMENT
/begin MEASUREMENT cl_jump_rich "Closed-loop derivative gain (val/20)." SWORD CM_i16_factor_1_20 0 0 -163840 163835 ECU_ADDRESS 0x40001D30 /end MEASUREMENT
/begin MEASUREMENT closedloop_activate_time "Closedloop activate time (ms = val*5)." UWORD CM_u8_time_5ms 0 0 0 327675 ECU_ADDRESS 0x40001D32 /end MEASUREMENT
/begin MEASUREMENT stft_ramp_rate_bank1 "undefined2" UWORD NO_COMPU_METHOD 0 0 0 65535 ECU_ADDRESS 0x40001D34 /end MEASUREMENT
/begin MEASUREMENT stft_ramp_rate_bank2 "undefined2" UWORD NO_COMPU_METHOD 0 0 0 65535 ECU_ADDRESS 0x40001D36 /end MEASUREMENT
/begin MEASUREMENT closed_loop_active_bank1 "undefined1" UBYTE NO_COMPU_METHOD 0 0 0 255 ECU_ADDRESS 0x40001D38 /end MEASUREMENT
/begin MEASUREMENT closed_loop_active_bank2 "undefined1" UBYTE NO_COMPU_METHOD 0 0 0 255 ECU_ADDRESS 0x40001D39 /end MEASUREMENT
/begin MEASUREMENT stft_ramp_timer_bank1 "undefined2" UWORD NO_COMPU_METHOD 0 0 0 65535 ECU_ADDRESS 0x40001D3A /end MEASUREMENT
/begin MEASUREMENT o2_switch_counter_bank1 "O2 switch counter bank1." UWORD NO_COMPU_METHOD 0 0 0 65535 ECU_ADDRESS 0x40001D3C /end MEASUREMENT
/begin MEASUREMENT stft_ramp_timer_bank2 "undefined2" UWORD NO_COMPU_METHOD 0 0 0 65535 ECU_ADDRESS 0x40001D3E /end MEASUREMENT
/begin MEASUREMENT o2_switch_counter_bank2 "O2 switch counter bank2." UWORD NO_COMPU_METHOD 0 0 0 65535 ECU_ADDRESS 0x40001D40 /end MEASUREMENT
/begin MEASUREMENT stft_filter_accum_bank1 "undefined4" ULONG NO_COMPU_METHOD 0 0 0 4294967295 ECU_ADDRESS 0x40001D44 /end MEASUREMENT
/begin MEASUREMENT stft_filter_accum_bank2 "undefined4" ULONG NO_COMPU_METHOD 0 0 0 4294967295 ECU_ADDRESS 0x40001D48 /end MEASUREMENT
/begin MEASUREMENT o2_threshold_lean "undefined2" UWORD NO_COMPU_METHOD 0 0 0 65535 ECU_ADDRESS 0x40001D4C /end MEASUREMENT
/begin MEASUREMENT o2_threshold_rich "undefined2" UWORD NO_COMPU_METHOD 0 0 0 65535 ECU_ADDRESS 0x40001D4E /end MEASUREMENT
/begin MEASUREMENT fuel_learning_zone "uint8_t" UBYTE NO_COMPU_METHOD 0 0 0 255 ECU_ADDRESS 0x40001D52 /end MEASUREMENT
/begin MEASUREMENT cl_cross_bank_check_enabled "undefined1" UBYTE NO_COMPU_METHOD 0 0 0 255 ECU_ADDRESS 0x40001D53 /end MEASUREMENT
/begin MEASUREMENT cl_cross_bank_fault "undefined2" UWORD NO_COMPU_METHOD 0 0 0 65535 ECU_ADDRESS 0x40001D54 /end MEASUREMENT
/begin MEASUREMENT o2_switch_count_threshold "undefined2" UWORD NO_COMPU_METHOD 0 0 0 65535 ECU_ADDRESS 0x40001D56 /end MEASUREMENT
/begin MEASUREMENT stft_at_o2_rich_switch_bank1 "undefined2" UWORD NO_COMPU_METHOD 0 0 0 65535 ECU_ADDRESS 0x40001D58 /end MEASUREMENT
/begin MEASUREMENT stft_at_o2_rich_switch_bank2 "undefined2" UWORD NO_COMPU_METHOD 0 0 0 65535 ECU_ADDRESS 0x40001D5A /end MEASUREMENT
/begin MEASUREMENT stft_bank_sync_hold_timer_bank1 "undefined2" UWORD NO_COMPU_METHOD 0 0 0 65535 ECU_ADDRESS 0x40001D5C /end MEASUREMENT
/begin MEASUREMENT stft_bank_sync_hold_timer_bank2 "undefined2" UWORD NO_COMPU_METHOD 0 0 0 65535 ECU_ADDRESS 0x40001D5E /end MEASUREMENT
/begin MEASUREMENT stft_increment_timer_bank1 "Short-term fuel trim increment timer bank1 (ms = val*5)." UBYTE CM_u8_time_5ms 0 0 0 1275 ECU_ADDRESS 0x40001D66 /end MEASUREMENT
/begin MEASUREMENT stft_increment_timer_bank2 "Short-term fuel trim increment timer bank2 (ms = val*5)." UBYTE CM_u8_time_5ms 0 0 0 1275 ECU_ADDRESS 0x40001D67 /end MEASUREMENT
/begin MEASUREMENT obd_ii_P0171_debounce_counter "undefined1" UBYTE NO_COMPU_METHOD 0 0 0 255 ECU_ADDRESS 0x40001D68 /end MEASUREMENT
/begin MEASUREMENT obd_ii_P0172_debounce_counter "undefined1" UBYTE NO_COMPU_METHOD 0 0 0 255 ECU_ADDRESS 0x40001D69 /end MEASUREMENT
/begin MEASUREMENT obd_ii_P0174_debounce_counter "undefined1" UBYTE NO_COMPU_METHOD 0 0 0 255 ECU_ADDRESS 0x40001D6A /end MEASUREMENT
/begin MEASUREMENT obd_ii_P0175_debounce_counter "undefined1" UBYTE NO_COMPU_METHOD 0 0 0 255 ECU_ADDRESS 0x40001D6B /end MEASUREMENT
/begin MEASUREMENT obd_ii_P2191_debounce_counter "undefined1" UBYTE NO_COMPU_METHOD 0 0 0 255 ECU_ADDRESS 0x40001D6C /end MEASUREMENT
/begin MEASUREMENT obd_ii_P2193_debounce_counter "undefined1" UBYTE NO_COMPU_METHOD 0 0 0 255 ECU_ADDRESS 0x40001D6D /end MEASUREMENT
/begin MEASUREMENT hc08_remote_comm_fault_count "undefined2" UWORD NO_COMPU_METHOD 0 0 0 65535 ECU_ADDRESS 0x40001D9A /end MEASUREMENT
/begin MEASUREMENT throttle_monitor5_max_ticks "undefined2" UWORD NO_COMPU_METHOD 0 0 0 65535 ECU_ADDRESS 0x40001D9E /end MEASUREMENT
/begin MEASUREMENT throttle_uptime_max_ticks "undefined2" UWORD NO_COMPU_METHOD 0 0 0 65535 ECU_ADDRESS 0x40001DA0 /end MEASUREMENT
/begin MEASUREMENT hc08_send_timer "Hc08 send timer (ms = val*5)." UWORD CM_u8_time_5ms 0 0 0 327675 ECU_ADDRESS 0x40001DA4 /end MEASUREMENT
/begin MEASUREMENT throttle_control_mode "Throttle control mode (enumerated state)." UBYTE NO_COMPU_METHOD 0 0 0 255 ECU_ADDRESS 0x40001DA8 /end MEASUREMENT
/begin MEASUREMENT throttle_control_flags "undefined1" UBYTE NO_COMPU_METHOD 0 0 0 255 ECU_ADDRESS 0x40001DA9 /end MEASUREMENT
/begin MEASUREMENT tps_commanded_hc08 "u8_factor_1/255" UBYTE CM_u8_factor_1_255 0 0 0 100 ECU_ADDRESS 0x40001DAA /end MEASUREMENT
/begin MEASUREMENT engine_operating_state_flags "uint16_t" UWORD NO_COMPU_METHOD 0 0 0 65535 ECU_ADDRESS 0x40001DB0 /end MEASUREMENT
/begin MEASUREMENT obd_ii_idle_speed_target_total "OBD-II: idle speed target total (RPM)." UWORD CM_u16_rspeed_rpm 0 0 0 65535 ECU_ADDRESS 0x40001DB2 /end MEASUREMENT
/begin MEASUREMENT idle_speed_error_tps_compensated "undefined2" UWORD NO_COMPU_METHOD 0 0 0 65535 ECU_ADDRESS 0x40001DB8 /end MEASUREMENT
/begin MEASUREMENT obd_ii_idle_speed_error "undefined2" UWORD NO_COMPU_METHOD 0 0 0 65535 ECU_ADDRESS 0x40001DBA /end MEASUREMENT
/begin MEASUREMENT obd_ii_idle_air_output "OBD-II: idle air output (mg/s = val*100)." UWORD CM_u16_flow_100mg_s 0 0 0 6553500 ECU_ADDRESS 0x40001DBC /end MEASUREMENT
/begin MEASUREMENT idle_air_control_proportional_term "undefined2" UWORD NO_COMPU_METHOD 0 0 0 65535 ECU_ADDRESS 0x40001DBE /end MEASUREMENT
/begin MEASUREMENT idle_air_control_integral_term "undefined4" ULONG NO_COMPU_METHOD 0 0 0 4294967295 ECU_ADDRESS 0x40001DC0 /end MEASUREMENT
/begin MEASUREMENT obd_ii_idle_status "undefined1" UBYTE NO_COMPU_METHOD 0 0 0 255 ECU_ADDRESS 0x40001DC4 /end MEASUREMENT
/begin MEASUREMENT idle_stabilization_timer "undefined1" UBYTE NO_COMPU_METHOD 0 0 0 255 ECU_ADDRESS 0x40001DCC /end MEASUREMENT
/begin MEASUREMENT timer_above_min_carspeed "undefined1" UBYTE NO_COMPU_METHOD 0 0 0 255 ECU_ADDRESS 0x40001DCD /end MEASUREMENT
/begin MEASUREMENT idle_comp_moving_blend_rpm_high "u16_rspeed_rpm" UWORD CM_u16_rspeed_rpm 0 0 0 65535 ECU_ADDRESS 0x40001DD4 /end MEASUREMENT
/begin MEASUREMENT idle_control_entry_rpm "u16_rspeed_rpm" UWORD CM_u16_rspeed_rpm 0 0 0 65535 ECU_ADDRESS 0x40001DD6 /end MEASUREMENT
/begin MEASUREMENT idle_comp_carspeed_decaying "Idle compensation carspeed decaying (RPM)." UWORD CM_u16_rspeed_rpm 0 0 0 65535 ECU_ADDRESS 0x40001DE4 /end MEASUREMENT
/begin MEASUREMENT idle_comp_ac "undefined2" UWORD NO_COMPU_METHOD 0 0 0 65535 ECU_ADDRESS 0x40001DE8 /end MEASUREMENT
/begin MEASUREMENT idle_comp_fan "undefined2" UWORD NO_COMPU_METHOD 0 0 0 65535 ECU_ADDRESS 0x40001DEA /end MEASUREMENT
/begin MEASUREMENT idle_airflow_expected "undefined2" UWORD NO_COMPU_METHOD 0 0 0 65535 ECU_ADDRESS 0x40001DF0 /end MEASUREMENT
/begin MEASUREMENT idle_air_warmup_factor "undefined1" UBYTE NO_COMPU_METHOD 0 0 0 255 ECU_ADDRESS 0x40001DF2 /end MEASUREMENT
/begin MEASUREMENT idle_air_comp_while_moving "u16_flow_100mg/s" UWORD CM_u16_flow_100mg_s 0 0 0 6553500 ECU_ADDRESS 0x40001DF4 /end MEASUREMENT
/begin MEASUREMENT idle_comp_high_rpm_transient "Idle compensation high RPM transient (RPM)." UWORD CM_u16_rspeed_rpm 0 0 0 65535 ECU_ADDRESS 0x40001DF8 /end MEASUREMENT
/begin MEASUREMENT idle_comp_failed_cylinder_misfire "Idle compensation failed cylinder misfire (mg/s = val*10)." UWORD CM_u16_flow_10mg_s 0 0 0 655350 ECU_ADDRESS 0x40001DFE /end MEASUREMENT
/begin MEASUREMENT idle_corrected_airflow "undefined2" UWORD NO_COMPU_METHOD 0 0 0 65535 ECU_ADDRESS 0x40001E00 /end MEASUREMENT
/begin MEASUREMENT idle_air_low_load_cam_active "undefined1" UBYTE NO_COMPU_METHOD 0 0 0 255 ECU_ADDRESS 0x40001E02 /end MEASUREMENT
/begin MEASUREMENT idle_air_fast_decay_flag "undefined1" UBYTE NO_COMPU_METHOD 0 0 0 255 ECU_ADDRESS 0x40001E03 /end MEASUREMENT
/begin MEASUREMENT idle_strategy "Idle strategy (enumerated state)." UBYTE NO_COMPU_METHOD 0 0 0 255 ECU_ADDRESS 0x40001E04 /end MEASUREMENT
/begin MEASUREMENT idle_rolling_target_delta "u16_rspeed_rpm" UWORD CM_u16_rspeed_rpm 0 0 0 65535 ECU_ADDRESS 0x40001E06 /end MEASUREMENT
/begin MEASUREMENT idle_comp_decay_step_timer "u8_time_ms" UBYTE CM_u8_time_ms 0 0 0 255 ECU_ADDRESS 0x40001E0A /end MEASUREMENT
/begin MEASUREMENT idle_air_decay_step_timer "undefined1" UBYTE NO_COMPU_METHOD 0 0 0 255 ECU_ADDRESS 0x40001E0B /end MEASUREMENT
/begin MEASUREMENT idle_comp_decay_step "undefined1" UBYTE NO_COMPU_METHOD 0 0 0 255 ECU_ADDRESS 0x40001E0C /end MEASUREMENT
/begin MEASUREMENT idle_comp_accel_pedal_pos "Idle compensation accelerator pedal position (RPM = val*4)." UBYTE CM_u8_rspeed_4rpm 0 0 0 1020 ECU_ADDRESS 0x40001E0D /end MEASUREMENT
/begin MEASUREMENT idle_comp_timer_carspeed "Idle compensation timer carspeed (RPM)." UWORD CM_u16_rspeed_rpm 0 0 0 65535 ECU_ADDRESS 0x40001E0E /end MEASUREMENT
/begin MEASUREMENT idle_comp_iat "Idle compensation intake air temp (RPM)." UBYTE CM_u16_rspeed_rpm 0 0 0 255 ECU_ADDRESS 0x40001E10 /end MEASUREMENT
/begin MEASUREMENT idle_rolling_target_delta_slewed "u16_rspeed_rpm" UWORD CM_u16_rspeed_rpm 0 0 0 65535 ECU_ADDRESS 0x40001E12 /end MEASUREMENT
/begin MEASUREMENT idle_comp_car_speed "Idle compensation car speed (RPM)." UWORD CM_u16_rspeed_rpm 0 0 0 65535 ECU_ADDRESS 0x40001E14 /end MEASUREMENT
/begin MEASUREMENT idle_air_target_flow "u16_flow_100mg/s" UWORD CM_u16_flow_100mg_s 0 0 0 6553500 ECU_ADDRESS 0x40001E16 /end MEASUREMENT
/begin MEASUREMENT idle_comp_high_rpm_transient_max "undefined2" UWORD NO_COMPU_METHOD 0 0 0 65535 ECU_ADDRESS 0x40001E18 /end MEASUREMENT
/begin MEASUREMENT idle_tps_requested "Idle throttle position requested (val/1023)." UWORD CM_u16_factor_1_1023 0 0 0 6406.15835777126 ECU_ADDRESS 0x40001E1C /end MEASUREMENT
/begin MEASUREMENT knock_ign_retard_hold_counter_per_cyl "undefined1" UBYTE NO_COMPU_METHOD 0 0 0 255 ECU_ADDRESS 0x40001E28 /end MEASUREMENT
/begin MEASUREMENT knock_ign_retard_sum "Knock ignition retard cyl0 (° = val/4)." UWORD CM_u8_angle_1_4deg 0 0 0 16383.75 ECU_ADDRESS 0x40001E3E /end MEASUREMENT
/begin MEASUREMENT knock_flags "undefined1" UBYTE NO_COMPU_METHOD 0 0 0 255 ECU_ADDRESS 0x40001E40 /end MEASUREMENT
/begin MEASUREMENT knock_sampling_window_offset "undefined1" UBYTE NO_COMPU_METHOD 0 0 0 255 ECU_ADDRESS 0x40001E41 /end MEASUREMENT
/begin MEASUREMENT ign_adv_delta_to_knock_safe "Ignition adv delta to knock safe (° = val/4)." SWORD CM_u8_angle_1_4deg 0 0 -8192 8191.75 ECU_ADDRESS 0x40001E50 /end MEASUREMENT
/begin MEASUREMENT knock_inhibit_timer_tps_rate "Knock inhibit timer throttle position rate (ms = val*5)." UBYTE CM_u8_time_5ms 0 0 0 1275 ECU_ADDRESS 0x40001E52 /end MEASUREMENT
/begin MEASUREMENT octane_scaler_current_min "Octane scaler current minimum." UWORD NO_COMPU_METHOD 0 0 0 65535 ECU_ADDRESS 0x40001E54 /end MEASUREMENT
/begin MEASUREMENT knock_agc_gain_select_bit1 "bool" UBYTE NO_COMPU_METHOD 0 0 0 255 ECU_ADDRESS 0x40001E5A /end MEASUREMENT
/begin MEASUREMENT knock_agc_gain_select_bit0 "bool" UBYTE NO_COMPU_METHOD 0 0 0 255 ECU_ADDRESS 0x40001E5B /end MEASUREMENT
/begin MEASUREMENT evap_system_state_flags "undefined4" ULONG NO_COMPU_METHOD 0 0 0 4294967295 ECU_ADDRESS 0x40001E6C /end MEASUREMENT
/begin MEASUREMENT obd_ii_system_leak_status "undefined1" UBYTE NO_COMPU_METHOD 0 0 0 255 ECU_ADDRESS 0x40001E72 /end MEASUREMENT
/begin MEASUREMENT obd_ii_eval_leak_check_result "undefined2" UWORD NO_COMPU_METHOD 0 0 0 65535 ECU_ADDRESS 0x40001E76 /end MEASUREMENT
/begin MEASUREMENT main_diagnostic_flags "undefined2" UWORD NO_COMPU_METHOD 0 0 0 65535 ECU_ADDRESS 0x40001EA0 /end MEASUREMENT
/begin MEASUREMENT p050b_fail_cycle_counter "undefined2" UWORD NO_COMPU_METHOD 0 0 0 65535 ECU_ADDRESS 0x40001EA2 /end MEASUREMENT
/begin MEASUREMENT obd_ii_knock_monitor_counters "undefined1" UBYTE NO_COMPU_METHOD 0 0 0 255 ECU_ADDRESS 0x40001EB2 /end MEASUREMENT
/begin MEASUREMENT misfire_threshold_current_window "undefined2" UWORD NO_COMPU_METHOD 0 0 0 65535 ECU_ADDRESS 0x40001ECA /end MEASUREMENT
/begin MEASUREMENT misfire_min_torque_threshold "undefined1" UBYTE NO_COMPU_METHOD 0 0 0 255 ECU_ADDRESS 0x40001ECD /end MEASUREMENT
/begin MEASUREMENT misfire_p1302_pass_holdoff_timer "undefined2" UWORD NO_COMPU_METHOD 0 0 0 65535 ECU_ADDRESS 0x40001ED0 /end MEASUREMENT
/begin MEASUREMENT misfire_wheel_speed_deviation "undefined4" ULONG NO_COMPU_METHOD 0 0 0 4294967295 ECU_ADDRESS 0x40001EE8 /end MEASUREMENT
/begin MEASUREMENT misfire_wheel_speed_filt_x256 "undefined4" ULONG NO_COMPU_METHOD 0 0 0 4294967295 ECU_ADDRESS 0x40001EF8 /end MEASUREMENT
/begin MEASUREMENT misfire_wheel_speed_filt "undefined4" ULONG NO_COMPU_METHOD 0 0 0 4294967295 ECU_ADDRESS 0x40001F08 /end MEASUREMENT
/begin MEASUREMENT misfire_last_sampled_cyl "undefined1" UBYTE NO_COMPU_METHOD 0 0 0 255 ECU_ADDRESS 0x40001F1E /end MEASUREMENT
/begin MEASUREMENT failed_ignition_cyl_count "uint8_t" UBYTE NO_COMPU_METHOD 0 0 0 255 ECU_ADDRESS 0x40001F24 /end MEASUREMENT
/begin MEASUREMENT misfire_enable_hold_timer "undefined2" UWORD NO_COMPU_METHOD 0 0 0 65535 ECU_ADDRESS 0x40001F26 /end MEASUREMENT
/begin MEASUREMENT misfire_sensitivity "undefined2" UWORD NO_COMPU_METHOD 0 0 0 65535 ECU_ADDRESS 0x40001F2C /end MEASUREMENT
/begin MEASUREMENT misfire_rpm_load_threshold_scaled "undefined2" UWORD NO_COMPU_METHOD 0 0 0 65535 ECU_ADDRESS 0x40001F2E /end MEASUREMENT
/begin MEASUREMENT obd_ii_max_misfire_results_emissions "undefined2" UWORD NO_COMPU_METHOD 0 0 0 65535 ECU_ADDRESS 0x40001F34 /end MEASUREMENT
/begin MEASUREMENT misfire_emissions_limit "undefined1" UBYTE NO_COMPU_METHOD 0 0 0 255 ECU_ADDRESS 0x40001F36 /end MEASUREMENT
/begin MEASUREMENT misfire_condition_flags "undefined4" ULONG NO_COMPU_METHOD 0 0 0 4294967295 ECU_ADDRESS 0x40001F38 /end MEASUREMENT
/begin MEASUREMENT obd_ii_mode22_supported_pids_120_40 "undefined1" UBYTE NO_COMPU_METHOD 0 0 0 255 ECU_ADDRESS 0x40001F60 /end MEASUREMENT
/begin MEASUREMENT obd_DTC_pending_count "undefined1" UBYTE NO_COMPU_METHOD 0 0 0 255 ECU_ADDRESS 0x40001F88 /end MEASUREMENT
/begin MEASUREMENT obd_ii_mode08_active_test_mask "undefined1" UBYTE NO_COMPU_METHOD 0 0 0 255 ECU_ADDRESS 0x40001F90 /end MEASUREMENT
/begin MEASUREMENT obd_DTC_confirmed_count "undefined1" UBYTE NO_COMPU_METHOD 0 0 0 255 ECU_ADDRESS 0x40001F98 /end MEASUREMENT
/begin MEASUREMENT obd_ii_mode13_requested "OBD-II: mode13 requested (boolean flag)." UBYTE NO_COMPU_METHOD 0 0 0 255 ECU_ADDRESS 0x40001F99 /end MEASUREMENT
/begin MEASUREMENT calibration_verification_number "undefined2" UWORD NO_COMPU_METHOD 0 0 0 65535 ECU_ADDRESS 0x40001FA0 /end MEASUREMENT
/begin MEASUREMENT o2_sensor_1_leanrich "undefined" ULONG NO_COMPU_METHOD 0 0 0 4294967295 ECU_ADDRESS 0x40001FCC /end MEASUREMENT
/begin MEASUREMENT obd_ii_o2_precat_diag_timer_bank2 "OBD-II: O2 precat diag timer bank2 (ms = val*5)." UWORD CM_u8_time_5ms 0 0 0 327675 ECU_ADDRESS 0x4000200E /end MEASUREMENT
/begin MEASUREMENT obd_ii_o2_precat_diag_timer_bank1 "undefined2" UWORD NO_COMPU_METHOD 0 0 0 65535 ECU_ADDRESS 0x40002010 /end MEASUREMENT
/begin MEASUREMENT obd_ii_o2_response_test_flags_bank2 "undefined2" UWORD NO_COMPU_METHOD 0 0 0 65535 ECU_ADDRESS 0x4000202E /end MEASUREMENT
/begin MEASUREMENT obd_ii_o2_response_test_flags_bank1 "undefined2" UWORD NO_COMPU_METHOD 0 0 0 65535 ECU_ADDRESS 0x40002030 /end MEASUREMENT
/begin MEASUREMENT cylinder_seq_sync_flags "undefined1" UBYTE NO_COMPU_METHOD 0 0 0 255 ECU_ADDRESS 0x40002052 /end MEASUREMENT
/begin MEASUREMENT aux_coolant_pump_state_and_diag_ "undefined2" UWORD NO_COMPU_METHOD 0 0 0 65535 ECU_ADDRESS 0x40002080 /end MEASUREMENT
/begin MEASUREMENT cac_diag_P023B_pass_counter "undefined1" UBYTE NO_COMPU_METHOD 0 0 0 255 ECU_ADDRESS 0x4000210C /end MEASUREMENT
/begin MEASUREMENT cac_diag_P023C_pass_counter "undefined1" UBYTE NO_COMPU_METHOD 0 0 0 255 ECU_ADDRESS 0x40002110 /end MEASUREMENT
/begin MEASUREMENT cac_fault_code_latched "undefined2" UWORD NO_COMPU_METHOD 0 0 0 65535 ECU_ADDRESS 0x40002114 /end MEASUREMENT
/begin MEASUREMENT cac_response_timestamp "undefined2" UWORD NO_COMPU_METHOD 0 0 0 65535 ECU_ADDRESS 0x40002116 /end MEASUREMENT
/begin MEASUREMENT cac_response_time "undefined2" UWORD NO_COMPU_METHOD 0 0 0 65535 ECU_ADDRESS 0x40002118 /end MEASUREMENT
/begin MEASUREMENT cac_diag_timer "undefined2" UWORD NO_COMPU_METHOD 0 0 0 65535 ECU_ADDRESS 0x4000211A /end MEASUREMENT
/begin MEASUREMENT cac_pwm_active_timer "undefined2" UWORD NO_COMPU_METHOD 0 0 0 65535 ECU_ADDRESS 0x4000211C /end MEASUREMENT
/begin MEASUREMENT cac_fault_debounce_counter "undefined1" UBYTE NO_COMPU_METHOD 0 0 0 255 ECU_ADDRESS 0x4000211E /end MEASUREMENT
/begin MEASUREMENT cac_pwm_mismatch_counter "undefined1" UBYTE NO_COMPU_METHOD 0 0 0 255 ECU_ADDRESS 0x4000211F /end MEASUREMENT
/begin MEASUREMENT cac_diag_state_timeout_counter "undefined1" UBYTE NO_COMPU_METHOD 0 0 0 255 ECU_ADDRESS 0x40002120 /end MEASUREMENT
/begin MEASUREMENT cac_measured_dutycycle "Charge-air-cooler measured dutycycle (val/255)." UBYTE CM_u8_factor_1_255 0 0 0 100 ECU_ADDRESS 0x40002121 /end MEASUREMENT
/begin MEASUREMENT accelerator_pedal_pos_d "Accelerator pedal position d (val/1023)." UWORD CM_u16_factor_1_1023 0 0 0 6406.15835777126 ECU_ADDRESS 0x40002128 /end MEASUREMENT
/begin MEASUREMENT accelerator_pedal_pos_e "Accelerator pedal position e (val/1023)." UWORD CM_u16_factor_1_1023 0 0 0 6406.15835777126 ECU_ADDRESS 0x4000212A /end MEASUREMENT
/begin MEASUREMENT tps_requested_scaled_by_limit "Throttle position requested scaled by limit (val/1023)." UWORD CM_u16_factor_1_1023 0 0 0 6406.15835777126 ECU_ADDRESS 0x4000212C /end MEASUREMENT
/begin MEASUREMENT tps_requested_scaled_by_limit2 "Throttle position requested scaled by limit2 (val/255)." UWORD CM_u8_factor_1_255 0 0 0 25700 ECU_ADDRESS 0x4000212E /end MEASUREMENT
/begin MEASUREMENT accel_pedal_latched "Accelerator pedal latched (val/1023)." UWORD CM_u16_factor_1_1023 0 0 0 6406.15835777126 ECU_ADDRESS 0x40002130 /end MEASUREMENT
/begin MEASUREMENT tps_driver_requested "Throttle position target (val/1023)." UWORD CM_u16_factor_1_1023 0 0 0 6406.15835777126 ECU_ADDRESS 0x40002134 /end MEASUREMENT
/begin MEASUREMENT dca_stationary_wait_timer "undefined2" UWORD NO_COMPU_METHOD 0 0 0 65535 ECU_ADDRESS 0x40002136 /end MEASUREMENT
/begin MEASUREMENT dca_active_timer "Drive-cycle-assist active timer (ms = val*5)." UWORD CM_u8_time_5ms 0 0 0 327675 ECU_ADDRESS 0x40002138 /end MEASUREMENT
/begin MEASUREMENT dca_activate_timer "undefined1" UBYTE NO_COMPU_METHOD 0 0 0 255 ECU_ADDRESS 0x4000213A /end MEASUREMENT
/begin MEASUREMENT dca_tps_idle_delta "u16_factor_1/1023" UWORD CM_u16_factor_1_1023 0 0 0 6406.15835777126 ECU_ADDRESS 0x4000213C /end MEASUREMENT
/begin MEASUREMENT dca_tps_target_limit "u16_factor_1/1023" UWORD CM_u16_factor_1_1023 0 0 0 6406.15835777126 ECU_ADDRESS 0x4000213E /end MEASUREMENT
/begin MEASUREMENT dca_accel_pedal_raw "u16_factor_1/1023" UWORD CM_u16_factor_1_1023 0 0 0 6406.15835777126 ECU_ADDRESS 0x40002140 /end MEASUREMENT
/begin MEASUREMENT dca_accel_pedal "u16_factor_1/1023" UWORD CM_u16_factor_1_1023 0 0 0 6406.15835777126 ECU_ADDRESS 0x40002142 /end MEASUREMENT
/begin MEASUREMENT dca_tps_ramp_step "undefined2" UWORD NO_COMPU_METHOD 0 0 0 65535 ECU_ADDRESS 0x40002144 /end MEASUREMENT
/begin MEASUREMENT dca_tps_ramp_target "undefined2" UWORD NO_COMPU_METHOD 0 0 0 65535 ECU_ADDRESS 0x40002146 /end MEASUREMENT
/begin MEASUREMENT dca_tps_ramp_index "undefined2" UWORD NO_COMPU_METHOD 0 0 0 65535 ECU_ADDRESS 0x40002148 /end MEASUREMENT
/begin MEASUREMENT dca_config_enabled "Drive-cycle-assist config enabled (boolean flag)." UBYTE NO_COMPU_METHOD 0 0 0 255 ECU_ADDRESS 0x4000214A /end MEASUREMENT
/begin MEASUREMENT accel_pedal_shift_qualify_timer "u8_time_5ms" UBYTE CM_u8_time_5ms 0 0 0 1275 ECU_ADDRESS 0x4000215E /end MEASUREMENT
/begin MEASUREMENT accel_pedal_shift_qualify_armed "Accelerator pedal shift qualify armed (boolean flag)." UBYTE NO_COMPU_METHOD 0 0 0 255 ECU_ADDRESS 0x4000215F /end MEASUREMENT
/begin MEASUREMENT dca_mode "Drive-cycle-assist mode (enumerated state)." UBYTE NO_COMPU_METHOD 0 0 0 255 ECU_ADDRESS 0x40002160 /end MEASUREMENT
/begin MEASUREMENT _obd_ii_commanded_evap_purge "undefined2" UWORD NO_COMPU_METHOD 0 0 0 65535 ECU_ADDRESS 0x40002168 /end MEASUREMENT
/begin MEASUREMENT evap_purge_flags "undefined2" UWORD NO_COMPU_METHOD 0 0 0 65535 ECU_ADDRESS 0x4000216A /end MEASUREMENT
/begin MEASUREMENT idle_bypass_airflow "undefined2" UWORD NO_COMPU_METHOD 0 0 0 65535 ECU_ADDRESS 0x4000216E /end MEASUREMENT
/begin MEASUREMENT load_comp_idle "Load compensation idle (mg/stroke)." UWORD CM_u16_load_mg_stroke 0 0 0 65535 ECU_ADDRESS 0x40002170 /end MEASUREMENT
/begin MEASUREMENT evap_purge_fuel_mass_b1 "Evaporative purge fuel mass bank 1 (µg = val*100)." UWORD CM_u16_mass_100ug 0 0 0 6553500 ECU_ADDRESS 0x40002174 /end MEASUREMENT
/begin MEASUREMENT evap_purge_fuel_mass_b2 "Evaporative purge fuel mass bank 2 (µg = val*100)." UWORD CM_u16_mass_100ug 0 0 0 6553500 ECU_ADDRESS 0x40002176 /end MEASUREMENT
/begin MEASUREMENT obd_ii_vapor_concentration "undefined2" UWORD NO_COMPU_METHOD 0 0 0 65535 ECU_ADDRESS 0x40002178 /end MEASUREMENT
/begin MEASUREMENT evap_purge_vacuum_filtered "undefined2" UWORD NO_COMPU_METHOD 0 0 0 65535 ECU_ADDRESS 0x40002182 /end MEASUREMENT
/begin MEASUREMENT evap_purge_solenoid_duty_table "undefined2" UWORD NO_COMPU_METHOD 0 0 0 65535 ECU_ADDRESS 0x40002188 /end MEASUREMENT
/begin MEASUREMENT evap_stft_settle_timer "undefined1" UBYTE NO_COMPU_METHOD 0 0 0 255 ECU_ADDRESS 0x40002190 /end MEASUREMENT
/begin MEASUREMENT evap_purge_duty_ramped "undefined2" UWORD NO_COMPU_METHOD 0 0 0 65535 ECU_ADDRESS 0x400021AC /end MEASUREMENT
/begin MEASUREMENT evap_purge_duty_max "undefined1" UBYTE NO_COMPU_METHOD 0 0 0 255 ECU_ADDRESS 0x400021AE /end MEASUREMENT
/begin MEASUREMENT evap_purge_duty_max_flow "undefined1" UBYTE NO_COMPU_METHOD 0 0 0 255 ECU_ADDRESS 0x400021AF /end MEASUREMENT
/begin MEASUREMENT evap_purge_duty_max_fuel "undefined1" UBYTE NO_COMPU_METHOD 0 0 0 255 ECU_ADDRESS 0x400021B0 /end MEASUREMENT
/begin MEASUREMENT evap_purge_inj_fuel_mass_min "undefined2" UWORD NO_COMPU_METHOD 0 0 0 65535 ECU_ADDRESS 0x400021C8 /end MEASUREMENT
/begin MEASUREMENT evap_purge_open_kick_timer "undefined1" UBYTE NO_COMPU_METHOD 0 0 0 255 ECU_ADDRESS 0x400021D6 /end MEASUREMENT
/begin MEASUREMENT obd_ii_mode2f_flags_enabled "undefined4" ULONG NO_COMPU_METHOD 0 0 0 4294967295 ECU_ADDRESS 0x400021D8 /end MEASUREMENT
/begin MEASUREMENT obd_ii_mode2f_flags_state "undefined4" ULONG NO_COMPU_METHOD 0 0 0 4294967295 ECU_ADDRESS 0x400021DC /end MEASUREMENT
/begin MEASUREMENT obd_ii_2f_trans_pump_requested "undefined4" ULONG NO_COMPU_METHOD 0 0 0 4294967295 ECU_ADDRESS 0x400021E0 /end MEASUREMENT
/begin MEASUREMENT obd_ii_2f_trans_pump_state "undefined4" ULONG NO_COMPU_METHOD 0 0 0 4294967295 ECU_ADDRESS 0x400021E4 /end MEASUREMENT
/begin MEASUREMENT timer_engine_off_unknown1 "Timer engine off unknown1 (ms = val*5)." UWORD CM_u8_time_5ms 0 0 0 327675 ECU_ADDRESS 0x400021EC /end MEASUREMENT
/begin MEASUREMENT obd_ii_mode2f_vvti_output_val "OBD-II: mode2f vvti output." UBYTE NO_COMPU_METHOD 0 0 0 255 ECU_ADDRESS 0x400021EE /end MEASUREMENT
/begin MEASUREMENT obd_ii_mode2f_tach_commanded "OBD-II: mode2f tach commanded (RPM = val*4)." UWORD CM_u8_rspeed_4rpm 0 0 0 262140 ECU_ADDRESS 0x400021F0 /end MEASUREMENT
/begin MEASUREMENT obd_ii_mode2f_evap_purge_val "undefined1" UBYTE NO_COMPU_METHOD 0 0 0 255 ECU_ADDRESS 0x400021F2 /end MEASUREMENT
/begin MEASUREMENT obd_dyno_mode_active "OBD-II: diag override (boolean flag)." UBYTE NO_COMPU_METHOD 0 0 0 255 ECU_ADDRESS 0x400021F3 /end MEASUREMENT
/begin MEASUREMENT obd_ii_mode2f_cooling_fan_dutycycle "undefined1" UBYTE NO_COMPU_METHOD 0 0 0 255 ECU_ADDRESS 0x400021F4 /end MEASUREMENT
/begin MEASUREMENT cac_pump_test_2F_dutycycle "Charge-air-cooler pump test 2F dutycycle (val/255)." UBYTE CM_u8_factor_1_255 0 0 0 100 ECU_ADDRESS 0x400021F5 /end MEASUREMENT
/begin MEASUREMENT obd_ii_mode2f_coil_pulse_timer "u8_time_5ms" UBYTE CM_u8_time_5ms 0 0 0 1275 ECU_ADDRESS 0x40002217 /end MEASUREMENT
/begin MEASUREMENT obd_ii_mode2f_184_timer_unknown "OBD-II: mode2f 184 timer (ms = val*5)." UBYTE CM_u8_time_5ms 0 0 0 1275 ECU_ADDRESS 0x40002218 /end MEASUREMENT
/begin MEASUREMENT obd_ii_mode2f_timeout "undefined2" UWORD NO_COMPU_METHOD 0 0 0 65535 ECU_ADDRESS 0x4000221A /end MEASUREMENT
/begin MEASUREMENT obd_ii_monitor_status_this_drive_cycle "OBD-II: monitor status this drive cycle." UWORD NO_COMPU_METHOD 0 0 0 65535 ECU_ADDRESS 0x40002222 /end MEASUREMENT
/begin MEASUREMENT obd_p101_config "OBD-II: P101 config (OBD-II monitor enable level)." UBYTE NO_COMPU_METHOD 0 0 0 255 ECU_ADDRESS 0x40002230 /end MEASUREMENT
/begin MEASUREMENT engine_state_failure_flags "undefined4" ULONG NO_COMPU_METHOD 0 0 0 4294967295 ECU_ADDRESS 0x40002248 /end MEASUREMENT
/begin MEASUREMENT oil_pressure_low_event "Oil pressure low event (boolean flag)." UBYTE NO_COMPU_METHOD 0 0 0 255 ECU_ADDRESS 0x4000224C /end MEASUREMENT
/begin MEASUREMENT load_residual_maf_vs_speed_density "i16_load_mg/stroke" SWORD CM_u16_load_mg_stroke 0 0 -32768 32767 ECU_ADDRESS 0x40002254 /end MEASUREMENT
/begin MEASUREMENT load_residual_maf_vs_alphaN_expected "i16_load_mg/stroke" SWORD CM_u16_load_mg_stroke 0 0 -32768 32767 ECU_ADDRESS 0x40002256 /end MEASUREMENT
/begin MEASUREMENT oil_pressure_low_timer "undefined2" UWORD NO_COMPU_METHOD 0 0 0 65535 ECU_ADDRESS 0x400022CA /end MEASUREMENT
/begin MEASUREMENT oil_pressure_low_detected "Oil pressure low detected (boolean flag)." UBYTE NO_COMPU_METHOD 0 0 0 255 ECU_ADDRESS 0x400022CC /end MEASUREMENT
/begin MEASUREMENT obd_ii_P0111_stage "undefined1" UBYTE NO_COMPU_METHOD 0 0 0 255 ECU_ADDRESS 0x400022E4 /end MEASUREMENT
/begin MEASUREMENT oil_pressure_expected "undefined2" UWORD NO_COMPU_METHOD 0 0 0 65535 ECU_ADDRESS 0x40002312 /end MEASUREMENT
/begin MEASUREMENT clutch_sensor_confidence "undefined2" UWORD NO_COMPU_METHOD 0 0 0 65535 ECU_ADDRESS 0x40002334 /end MEASUREMENT
/begin MEASUREMENT cp_upper "Cp upper (V = val*5/1023)." UWORD CM_u16_voltage_5_1023v 0 0 0 320.307917888563 ECU_ADDRESS 0x40002370 /end MEASUREMENT
/begin MEASUREMENT cp_lower "Cp lower (V = val*5/1023)." UWORD CM_u16_voltage_5_1023v 0 0 0 320.307917888563 ECU_ADDRESS 0x40002372 /end MEASUREMENT
/begin MEASUREMENT clutch_sample_below_count "undefined1" UBYTE NO_COMPU_METHOD 0 0 0 255 ECU_ADDRESS 0x40002374 /end MEASUREMENT
/begin MEASUREMENT clutch_sample_above_count "undefined1" UBYTE NO_COMPU_METHOD 0 0 0 255 ECU_ADDRESS 0x40002375 /end MEASUREMENT
/begin MEASUREMENT cp_sample_count "Cp sample count." UBYTE NO_COMPU_METHOD 0 0 0 255 ECU_ADDRESS 0x40002376 /end MEASUREMENT
/begin MEASUREMENT clutch_confidence_min_init_flag "Clutch confidence minimum init flag (boolean flag)." UBYTE NO_COMPU_METHOD 0 0 0 255 ECU_ADDRESS 0x40002377 /end MEASUREMENT
/begin MEASUREMENT obd_p0106_throttle_vacuum_model "undefined1" UBYTE NO_COMPU_METHOD 0 0 0 255 ECU_ADDRESS 0x4000237C /end MEASUREMENT
/begin MEASUREMENT obd_p0106_throttle_vacuum_rpm_hi "undefined1" UBYTE NO_COMPU_METHOD 0 0 0 255 ECU_ADDRESS 0x4000237D /end MEASUREMENT
/begin MEASUREMENT obd_p0106_throttle_vacuum_rpm_lo "undefined1" UBYTE NO_COMPU_METHOD 0 0 0 255 ECU_ADDRESS 0x4000237E /end MEASUREMENT
/begin MEASUREMENT coolant_temp_derived3 "Coolant temperature derived3 (°C = val*5/8−40)." UBYTE CM_u8_temp_5_8_40c 0 0 -40 119.375 ECU_ADDRESS 0x40002384 /end MEASUREMENT
/begin MEASUREMENT thermostat_diag_maf_threshold_ips "undefined1" UBYTE NO_COMPU_METHOD 0 0 0 255 ECU_ADDRESS 0x40002388 /end MEASUREMENT
/begin MEASUREMENT obd_ii_P0128_fail_countdown "undefined1" UBYTE NO_COMPU_METHOD 0 0 0 255 ECU_ADDRESS 0x40002391 /end MEASUREMENT
/begin MEASUREMENT obd_ii_P0128_lowspeed_seconds "undefined4" ULONG NO_COMPU_METHOD 0 0 0 4294967295 ECU_ADDRESS 0x40002394 /end MEASUREMENT
/begin MEASUREMENT obd_ii_P0128_iat_too_cold_latch "undefined1" UBYTE NO_COMPU_METHOD 0 0 0 255 ECU_ADDRESS 0x40002398 /end MEASUREMENT
/begin MEASUREMENT vvt_task_rate_divider "undefined1" UBYTE NO_COMPU_METHOD 0 0 0 255 ECU_ADDRESS 0x400023C0 /end MEASUREMENT
/begin MEASUREMENT vvt_inlet_taget_calc_bank1 "undefined2" UWORD NO_COMPU_METHOD 0 0 0 65535 ECU_ADDRESS 0x400023C2 /end MEASUREMENT
/begin MEASUREMENT vvt_exhaust_taget_calc_bank1 "VVT exhaust taget calculated bank1 (° = val/4)." UWORD CM_u8_angle_1_4deg 0 0 0 16383.75 ECU_ADDRESS 0x400023C4 /end MEASUREMENT
/begin MEASUREMENT vvt_pi_p_term_inlet_b1 "undefined2" UWORD NO_COMPU_METHOD 0 0 0 65535 ECU_ADDRESS 0x400023C6 /end MEASUREMENT
/begin MEASUREMENT vvt_pi_p_term_inlet_b2 "undefined2" UWORD NO_COMPU_METHOD 0 0 0 65535 ECU_ADDRESS 0x400023D0 /end MEASUREMENT
/begin MEASUREMENT vvt_pi_p_term_exhaust_b1 "undefined2" UWORD NO_COMPU_METHOD 0 0 0 65535 ECU_ADDRESS 0x400023DC /end MEASUREMENT
/begin MEASUREMENT vvt_pi_p_term_exhaust_b2 "undefined2" UWORD NO_COMPU_METHOD 0 0 0 65535 ECU_ADDRESS 0x400023E8 /end MEASUREMENT
/begin MEASUREMENT vvt_intake_transition_complete "VVT intake transition complete (boolean flag)." UBYTE NO_COMPU_METHOD 0 0 0 255 ECU_ADDRESS 0x400023F4 /end MEASUREMENT
/begin MEASUREMENT vvt_exhaust_transition_complete "VVT exhaust transition complete (boolean flag)." UBYTE NO_COMPU_METHOD 0 0 0 255 ECU_ADDRESS 0x400023F5 /end MEASUREMENT
/begin MEASUREMENT cam_park_position_sum_inlet_b1 "u16_angle_1/4deg" UWORD CM_u8_angle_1_4deg 0 0 0 16383.75 ECU_ADDRESS 0x400023F8 /end MEASUREMENT
/begin MEASUREMENT cam_park_position_sum_inlet_b2 "uint32_t" ULONG NO_COMPU_METHOD 0 0 0 4294967295 ECU_ADDRESS 0x400023FC /end MEASUREMENT
/begin MEASUREMENT cam_park_position_sum_exhaust_b1 "undefined4" ULONG NO_COMPU_METHOD 0 0 0 4294967295 ECU_ADDRESS 0x40002400 /end MEASUREMENT
/begin MEASUREMENT cam_park_position_sum_exhaust_b2 "undefined4" ULONG NO_COMPU_METHOD 0 0 0 4294967295 ECU_ADDRESS 0x40002404 /end MEASUREMENT
/begin MEASUREMENT cam_park_sample_count_inlet_b1 "undefined4" ULONG NO_COMPU_METHOD 0 0 0 4294967295 ECU_ADDRESS 0x40002408 /end MEASUREMENT
/begin MEASUREMENT cam_park_sample_count_inlet_b2 "undefined4" ULONG NO_COMPU_METHOD 0 0 0 4294967295 ECU_ADDRESS 0x4000240C /end MEASUREMENT
/begin MEASUREMENT cam_park_sample_count_exhaust_b1 "undefined4" ULONG NO_COMPU_METHOD 0 0 0 4294967295 ECU_ADDRESS 0x40002410 /end MEASUREMENT
/begin MEASUREMENT cam_park_sample_count_exhaust_b2 "undefined4" ULONG NO_COMPU_METHOD 0 0 0 4294967295 ECU_ADDRESS 0x40002414 /end MEASUREMENT
/begin MEASUREMENT vvt_park_integral_reset_flags "undefined1" UBYTE NO_COMPU_METHOD 0 0 0 255 ECU_ADDRESS 0x40002418 /end MEASUREMENT
/begin MEASUREMENT vvt_intake_target_zero_timer "undefined1" UBYTE NO_COMPU_METHOD 0 0 0 255 ECU_ADDRESS 0x40002419 /end MEASUREMENT
/begin MEASUREMENT vvt_exhaust_target_zero_timer "undefined1" UBYTE NO_COMPU_METHOD 0 0 0 255 ECU_ADDRESS 0x4000241A /end MEASUREMENT
/begin MEASUREMENT vvt_low_load_active "VVT low load active (boolean flag)." UBYTE NO_COMPU_METHOD 0 0 0 255 ECU_ADDRESS 0x4000241B /end MEASUREMENT
/begin MEASUREMENT vvt_error_scale "undefined1" UBYTE NO_COMPU_METHOD 0 0 0 255 ECU_ADDRESS 0x4000241C /end MEASUREMENT
/begin MEASUREMENT vvt_exhaust_mode_flags "undefined1" UBYTE NO_COMPU_METHOD 0 0 0 255 ECU_ADDRESS 0x4000241D /end MEASUREMENT
/begin MEASUREMENT vvt_intake_mode_flags "undefined1" UBYTE NO_COMPU_METHOD 0 0 0 255 ECU_ADDRESS 0x4000241E /end MEASUREMENT
/begin MEASUREMENT cam_edge_watchdog_exhaust_b2 "undefined1" UBYTE NO_COMPU_METHOD 0 0 0 255 ECU_ADDRESS 0x4000241F /end MEASUREMENT
/begin MEASUREMENT cam_edge_watchdog_exhaust_b1 "undefined1" UBYTE NO_COMPU_METHOD 0 0 0 255 ECU_ADDRESS 0x40002420 /end MEASUREMENT
/begin MEASUREMENT cam_edge_watchdog_inlet_b2 "undefined1" UBYTE NO_COMPU_METHOD 0 0 0 255 ECU_ADDRESS 0x40002421 /end MEASUREMENT
/begin MEASUREMENT cam_edge_watchdog "undefined1" UBYTE NO_COMPU_METHOD 0 0 0 255 ECU_ADDRESS 0x40002422 /end MEASUREMENT
/begin MEASUREMENT cam_park_position_mean_exhaust_b2 "undefined4" ULONG NO_COMPU_METHOD 0 0 0 4294967295 ECU_ADDRESS 0x40002424 /end MEASUREMENT
/begin MEASUREMENT cam_park_position_mean_exhaust_b1 "undefined4" ULONG NO_COMPU_METHOD 0 0 0 4294967295 ECU_ADDRESS 0x40002428 /end MEASUREMENT
/begin MEASUREMENT cam_park_position_mean_inlet_b2 "undefined4" ULONG NO_COMPU_METHOD 0 0 0 4294967295 ECU_ADDRESS 0x4000242C /end MEASUREMENT
/begin MEASUREMENT cam_park_position_mean_inlet_b1 "undefined4" ULONG NO_COMPU_METHOD 0 0 0 4294967295 ECU_ADDRESS 0x40002430 /end MEASUREMENT
/begin MEASUREMENT cam_park_offset_fault_exhaust_b2 "undefined1" UBYTE NO_COMPU_METHOD 0 0 0 255 ECU_ADDRESS 0x40002434 /end MEASUREMENT
/begin MEASUREMENT cam_park_offset_fault_exhaust_b1 "undefined1" UBYTE NO_COMPU_METHOD 0 0 0 255 ECU_ADDRESS 0x40002435 /end MEASUREMENT
/begin MEASUREMENT cam_park_offset_fault_inlet_b1 "undefined1" UBYTE NO_COMPU_METHOD 0 0 0 255 ECU_ADDRESS 0x40002437 /end MEASUREMENT
/begin MEASUREMENT cam_park_check_done_exhaust_b2 "undefined1" UBYTE NO_COMPU_METHOD 0 0 0 255 ECU_ADDRESS 0x40002438 /end MEASUREMENT
/begin MEASUREMENT cam_park_check_done_exhaust_b1 "undefined1" UBYTE NO_COMPU_METHOD 0 0 0 255 ECU_ADDRESS 0x40002439 /end MEASUREMENT
/begin MEASUREMENT cam_park_check_done_inlet_b1 "undefined1" UBYTE NO_COMPU_METHOD 0 0 0 255 ECU_ADDRESS 0x4000243B /end MEASUREMENT
/begin MEASUREMENT vvt_start_time "undefined2" UWORD NO_COMPU_METHOD 0 0 0 65535 ECU_ADDRESS 0x4000243C /end MEASUREMENT
/begin MEASUREMENT obd_ii_vvt_exhaust_error_bank2 "OBD-II: VVT exhaust error bank2 (° = val/4)." UWORD CM_u8_angle_1_4deg 0 0 0 16383.75 ECU_ADDRESS 0x4000243E /end MEASUREMENT
/begin MEASUREMENT obd_ii_vvt_exhaust_error_bank1 "OBD-II: VVT exhaust error bank1 (° = val/4)." UWORD CM_u8_angle_1_4deg 0 0 0 16383.75 ECU_ADDRESS 0x40002440 /end MEASUREMENT
/begin MEASUREMENT obd_ii_vvt_inlet_angle_error_bank2 "OBD-II: VVT inlet angle error bank2 (° = val/4)." UWORD CM_u8_angle_1_4deg 0 0 0 16383.75 ECU_ADDRESS 0x40002442 /end MEASUREMENT
/begin MEASUREMENT obd_ii_vvt_inlet_angle_error_bank1 "OBD-II: VVT inlet angle error bank1 (° = val/4)." UWORD CM_u8_angle_1_4deg 0 0 0 16383.75 ECU_ADDRESS 0x40002444 /end MEASUREMENT
/begin MEASUREMENT obd_ii_vvt_exhaust_target_bank1 "OBD-II: VVT exhaust target bank1 (° = val/4)." UWORD CM_u8_angle_1_4deg 0 0 0 16383.75 ECU_ADDRESS 0x40002446 /end MEASUREMENT
/begin MEASUREMENT vvt_inlet_target_bank1 "VVT inlet target bank1 (° = val/4)." UWORD CM_u8_angle_1_4deg 0 0 0 16383.75 ECU_ADDRESS 0x40002448 /end MEASUREMENT
/begin MEASUREMENT obd_ii_throttle_body_range_perf "undefined1" UBYTE NO_COMPU_METHOD 0 0 0 255 ECU_ADDRESS 0x40002450 /end MEASUREMENT
/begin MEASUREMENT tps_absolute_ "undefined2" UWORD NO_COMPU_METHOD 0 0 0 65535 ECU_ADDRESS 0x40002452 /end MEASUREMENT
/begin MEASUREMENT tps_absolute_b "u16_voltage_5/1023v" UWORD CM_u16_voltage_5_1023v 0 0 0 320.307917888563 ECU_ADDRESS 0x40002454 /end MEASUREMENT
/begin MEASUREMENT tps_absolute_a "u16_voltage_5/1023v" UWORD CM_u16_voltage_5_1023v 0 0 0 320.307917888563 ECU_ADDRESS 0x40002456 /end MEASUREMENT
/begin MEASUREMENT tps_absolte_b_u8 "u16_voltage_5/1023v" UWORD CM_u16_voltage_5_1023v 0 0 0 320.307917888563 ECU_ADDRESS 0x40002458 /end MEASUREMENT
/begin MEASUREMENT etb_pwm_duty_percent "undefined1" UBYTE NO_COMPU_METHOD 0 0 0 255 ECU_ADDRESS 0x4000245A /end MEASUREMENT
/begin MEASUREMENT obd_ii_commanded_throttle_actuator "Final, commanded throttle position" UWORD CM_u16_factor_1_4095 0 0 0 1600.3663003663 ECU_ADDRESS 0x4000245C /end MEASUREMENT
/begin MEASUREMENT tps_limited_clamped "TPS target after warmup/min clamps" UWORD CM_u16_factor_1_1023 0 0 0 6406.15835777126 ECU_ADDRESS 0x4000245E /end MEASUREMENT
/begin MEASUREMENT etb_dbg_error "undefined2" UWORD NO_COMPU_METHOD 0 0 0 65535 ECU_ADDRESS 0x40002460 /end MEASUREMENT
/begin MEASUREMENT etb_dbg_derivative_filtered "undefined2" UWORD NO_COMPU_METHOD 0 0 0 65535 ECU_ADDRESS 0x40002462 /end MEASUREMENT
/begin MEASUREMENT etb_dbg_p_term "undefined4" ULONG NO_COMPU_METHOD 0 0 0 4294967295 ECU_ADDRESS 0x40002464 /end MEASUREMENT
/begin MEASUREMENT etb_dbg_integral "undefined4" ULONG NO_COMPU_METHOD 0 0 0 4294967295 ECU_ADDRESS 0x40002468 /end MEASUREMENT
/begin MEASUREMENT etb_dbg_i_term "undefined4" ULONG NO_COMPU_METHOD 0 0 0 4294967295 ECU_ADDRESS 0x4000246C /end MEASUREMENT
/begin MEASUREMENT etb_dbg_pid_sum "undefined4" ULONG NO_COMPU_METHOD 0 0 0 4294967295 ECU_ADDRESS 0x40002470 /end MEASUREMENT
/begin MEASUREMENT etb_dbg_d_term "undefined4" ULONG NO_COMPU_METHOD 0 0 0 4294967295 ECU_ADDRESS 0x40002474 /end MEASUREMENT
/begin MEASUREMENT etb_dbg_feedforward_term "undefined4" ULONG NO_COMPU_METHOD 0 0 0 4294967295 ECU_ADDRESS 0x40002478 /end MEASUREMENT
/begin MEASUREMENT tps_target_post_limits_s32 "uint32_t" ULONG NO_COMPU_METHOD 0 0 0 4294967295 ECU_ADDRESS 0x4000247C /end MEASUREMENT
/begin MEASUREMENT tps_target_post_limits_u16 "u16_factor_1/1023" UWORD CM_u16_factor_1_1023 0 0 0 6406.15835777126 ECU_ADDRESS 0x40002480 /end MEASUREMENT
/begin MEASUREMENT cruise_cancel_request_flags "undefined2" UWORD NO_COMPU_METHOD 0 0 0 65535 ECU_ADDRESS 0x40002492 /end MEASUREMENT
/begin MEASUREMENT tps_smoothing_step_flags "Throttle position smoothing step flags (enumerated state)." UBYTE NO_COMPU_METHOD 0 0 0 255 ECU_ADDRESS 0x40002494 /end MEASUREMENT
/begin MEASUREMENT throttle_error_flags "Throttle error flags." UBYTE NO_COMPU_METHOD 0 0 0 255 ECU_ADDRESS 0x40002496 /end MEASUREMENT
/begin MEASUREMENT etb_hc08_state_mismatch "bool" UBYTE NO_COMPU_METHOD 0 0 0 255 ECU_ADDRESS 0x40002497 /end MEASUREMENT
/begin MEASUREMENT throttle_calibrate_fail "Throttle calibrate fail (boolean flag)." UBYTE NO_COMPU_METHOD 0 0 0 255 ECU_ADDRESS 0x40002498 /end MEASUREMENT
/begin MEASUREMENT lfb_pulse_toggle_timer "Lfb pulse toggle timer (ms = val*100)." UWORD CM_u8_time_100ms 0 0 0 6553500 ECU_ADDRESS 0x4000249A /end MEASUREMENT
/begin MEASUREMENT lfb_state_flags "undefined1" UBYTE NO_COMPU_METHOD 0 0 0 255 ECU_ADDRESS 0x4000249C /end MEASUREMENT
/begin MEASUREMENT torque_limit "Torque limit (Nm)." UWORD CM_u8_torque_nm 0 0 0 65535 ECU_ADDRESS 0x4000249E /end MEASUREMENT
/begin MEASUREMENT etb_initialization_state "Throttle body initialization state (enumerated state)." UBYTE NO_COMPU_METHOD 0 0 0 255 ECU_ADDRESS 0x400024A0 /end MEASUREMENT
/begin MEASUREMENT tps_max_during_warmup "Throttle position maximum during warmup (val/1023)." UWORD CM_u16_factor_1_1023 0 0 0 6406.15835777126 ECU_ADDRESS 0x400024A4 /end MEASUREMENT
/begin MEASUREMENT tps_smooth_step_timer "u16_time_10ms" UWORD CM_u8_time_10ms 0 0 0 655350 ECU_ADDRESS 0x400024BC /end MEASUREMENT
/begin MEASUREMENT tps_request_before_limits "Throttle position request before limits (val/1023)." UWORD CM_u16_factor_1_1023 0 0 0 6406.15835777126 ECU_ADDRESS 0x400024BE /end MEASUREMENT
/begin MEASUREMENT tps_smooth_error "u16_factor_1/255" UWORD CM_u8_factor_1_255 0 0 0 25700 ECU_ADDRESS 0x400024C0 /end MEASUREMENT
/begin MEASUREMENT tpssmooth_decrement "u16_factor_1/4095" UWORD CM_u16_factor_1_4095 0 0 0 1600.3663003663 ECU_ADDRESS 0x400024C2 /end MEASUREMENT
/begin MEASUREMENT tps_smooth_incr_step "u16_factor_1/4095" UWORD CM_u16_factor_1_4095 0 0 0 1600.3663003663 ECU_ADDRESS 0x400024C4 /end MEASUREMENT
/begin MEASUREMENT tpssmooth_parking_mode_active "bool" UBYTE NO_COMPU_METHOD 0 0 0 255 ECU_ADDRESS 0x400024C6 /end MEASUREMENT
/begin MEASUREMENT revlimit_throttle_clamp_active "Rev-limit throttle clamp active (boolean flag)." UBYTE NO_COMPU_METHOD 0 0 0 255 ECU_ADDRESS 0x400024C7 /end MEASUREMENT
/begin MEASUREMENT tps_smooth_decr_by_rpm "Throttle position smooth decrement2 (val/255)." UBYTE CM_u8_factor_1_255 0 0 0 100 ECU_ADDRESS 0x400024C8 /end MEASUREMENT
/begin MEASUREMENT tps_smooth_incr_by_rpm "u8_factor_1/255" UBYTE CM_u8_factor_1_255 0 0 0 100 ECU_ADDRESS 0x400024C9 /end MEASUREMENT
/begin MEASUREMENT tps_smooth_incr_by_delta "Tpssmooth increment2 (val/255)." UBYTE CM_u8_factor_1_255 0 0 0 100 ECU_ADDRESS 0x400024CA /end MEASUREMENT
/begin MEASUREMENT tpssmooth_decrement_a "undefined1" UBYTE NO_COMPU_METHOD 0 0 0 255 ECU_ADDRESS 0x400024CB /end MEASUREMENT
/begin MEASUREMENT tps_torque_limit_applied "Throttle position torque limit applied (boolean flag)." UBYTE NO_COMPU_METHOD 0 0 0 255 ECU_ADDRESS 0x400024CC /end MEASUREMENT
/begin MEASUREMENT torque_limit_cooldown_timer "undefined2" UWORD NO_COMPU_METHOD 0 0 0 65535 ECU_ADDRESS 0x400024CE /end MEASUREMENT
/begin MEASUREMENT tps_commanded_filtered "Throttle position smooth (val/4095)." UWORD CM_u16_factor_1_4095 0 0 0 1600.3663003663 ECU_ADDRESS 0x400024D0 /end MEASUREMENT
/begin MEASUREMENT torque_limit_by_rpm "Torque limit by RPM (Nm)." UWORD CM_u8_torque_nm 0 0 0 65535 ECU_ADDRESS 0x400024D2 /end MEASUREMENT
/begin MEASUREMENT torque_limit_engine_speed "Torque limit engine speed (Nm)." UWORD CM_u8_torque_nm 0 0 0 65535 ECU_ADDRESS 0x400024D4 /end MEASUREMENT
/begin MEASUREMENT etb_pos_history_z0 "undefined2" UWORD NO_COMPU_METHOD 0 0 0 65535 ECU_ADDRESS 0x400024D8 /end MEASUREMENT
/begin MEASUREMENT etb_pos_history_z1 "undefined2" UWORD NO_COMPU_METHOD 0 0 0 65535 ECU_ADDRESS 0x400024DA /end MEASUREMENT
/begin MEASUREMENT etb_pos_history_z2 "undefined2" UWORD NO_COMPU_METHOD 0 0 0 65535 ECU_ADDRESS 0x400024DC /end MEASUREMENT
/begin MEASUREMENT etb_pos_history_z3 "undefined2" UWORD NO_COMPU_METHOD 0 0 0 65535 ECU_ADDRESS 0x400024DE /end MEASUREMENT
/begin MEASUREMENT etb_pid_integral "undefined4" ULONG NO_COMPU_METHOD 0 0 0 4294967295 ECU_ADDRESS 0x400024E0 /end MEASUREMENT
/begin MEASUREMENT etb_init_delay_timer "undefined2" UWORD NO_COMPU_METHOD 0 0 0 65535 ECU_ADDRESS 0x400024E4 /end MEASUREMENT
/begin MEASUREMENT tps_init_and_stability_state "undefined1" UBYTE NO_COMPU_METHOD 0 0 0 255 ECU_ADDRESS 0x400024E6 /end MEASUREMENT
/begin MEASUREMENT hc08_cruise_mode_ack_timer "undefined2" UWORD NO_COMPU_METHOD 0 0 0 65535 ECU_ADDRESS 0x400024E8 /end MEASUREMENT
/begin MEASUREMENT throttle_uptime_ticks "undefined2" UWORD NO_COMPU_METHOD 0 0 0 65535 ECU_ADDRESS 0x400024EA /end MEASUREMENT
/begin MEASUREMENT throttle_monitor5_ticks "undefined2" UWORD NO_COMPU_METHOD 0 0 0 65535 ECU_ADDRESS 0x400024EC /end MEASUREMENT
/begin MEASUREMENT lbf_entry_countdown_timer "undefined2" UWORD NO_COMPU_METHOD 0 0 0 65535 ECU_ADDRESS 0x400024F4 /end MEASUREMENT
/begin MEASUREMENT lfb_brake_off_hold_ticks "undefined2" UWORD NO_COMPU_METHOD 0 0 0 65535 ECU_ADDRESS 0x400024F6 /end MEASUREMENT
/begin MEASUREMENT tps_track_b_closed_value "undefined2" UWORD NO_COMPU_METHOD 0 0 0 65535 ECU_ADDRESS 0x400024FC /end MEASUREMENT
/begin MEASUREMENT tps_track_a_closed_value "undefined2" UWORD NO_COMPU_METHOD 0 0 0 65535 ECU_ADDRESS 0x400024FE /end MEASUREMENT
/begin MEASUREMENT ips_state_flags "undefined1" UBYTE NO_COMPU_METHOD 0 0 0 255 ECU_ADDRESS 0x40002500 /end MEASUREMENT
/begin MEASUREMENT tcu_0xc7_engine_speed_request "u16_rspeed_rpm" UWORD CM_u16_rspeed_rpm 0 0 0 65535 ECU_ADDRESS 0x40002502 /end MEASUREMENT
/begin MEASUREMENT tps_state_degraded "Throttle position state degraded (boolean flag)." UBYTE NO_COMPU_METHOD 0 0 0 255 ECU_ADDRESS 0x40002508 /end MEASUREMENT
/begin MEASUREMENT tps_16bit "Throttle position (val/1023)." UWORD CM_u16_factor_1_4095 0 0 0 1600.3663003663 ECU_ADDRESS 0x4000250A /end MEASUREMENT
/begin MEASUREMENT accel_pedal_state_degraded "Accelerator pedal state degraded (boolean flag)." UBYTE NO_COMPU_METHOD 0 0 0 255 ECU_ADDRESS 0x4000250C /end MEASUREMENT
/begin MEASUREMENT accel_pedal_pos_16bit "Accelerator pedal position (val/1023)." UWORD CM_u16_factor_1_1023 0 0 0 6406.15835777126 ECU_ADDRESS 0x40002510 /end MEASUREMENT
/begin MEASUREMENT tps_fault_active "Throttle position fault active (boolean flag)." UBYTE NO_COMPU_METHOD 0 0 0 255 ECU_ADDRESS 0x40002512 /end MEASUREMENT
/begin MEASUREMENT accel_pedal_fault_active "Accelerator pedal fault active (boolean flag)." UBYTE NO_COMPU_METHOD 0 0 0 255 ECU_ADDRESS 0x40002513 /end MEASUREMENT
/begin MEASUREMENT tps_fault_flags "undefined1" UBYTE NO_COMPU_METHOD 0 0 0 255 ECU_ADDRESS 0x40002515 /end MEASUREMENT
/begin MEASUREMENT knock_buffer_last_index "undefined1" UBYTE NO_COMPU_METHOD 0 0 0 255 ECU_ADDRESS 0x40002518 /end MEASUREMENT
/begin MEASUREMENT knock_sensor_new_data_available "Knock sensor new data available (boolean flag)." UBYTE NO_COMPU_METHOD 0 0 0 255 ECU_ADDRESS 0x4000251A /end MEASUREMENT
/begin MEASUREMENT knock_curr_cylinder "undefined1" UBYTE NO_COMPU_METHOD 0 0 0 255 ECU_ADDRESS 0x4000251B /end MEASUREMENT
/begin MEASUREMENT knock_agc_stage_current "undefined1" UBYTE NO_COMPU_METHOD 0 0 0 255 ECU_ADDRESS 0x4000251C /end MEASUREMENT
/begin MEASUREMENT knock_buffer_index "Knock buffer index." UBYTE NO_COMPU_METHOD 0 0 0 255 ECU_ADDRESS 0x4000251D /end MEASUREMENT
/begin MEASUREMENT knock_agc_stage_override_enable "bool" UBYTE NO_COMPU_METHOD 0 0 0 255 ECU_ADDRESS 0x40002529 /end MEASUREMENT
/begin MEASUREMENT knock_freq_bin_count "undefined1" UBYTE NO_COMPU_METHOD 0 0 0 255 ECU_ADDRESS 0x4000252A /end MEASUREMENT
/begin MEASUREMENT obd_ii_defer_send "OBD-II: defer send (boolean flag)." UBYTE NO_COMPU_METHOD 0 0 0 255 ECU_ADDRESS 0x40002540 /end MEASUREMENT
/begin MEASUREMENT obd_ii_tx_messages_pending "OBD-II: tx messages pending (boolean flag)." UBYTE NO_COMPU_METHOD 0 0 0 255 ECU_ADDRESS 0x40002541 /end MEASUREMENT
/begin MEASUREMENT isotp_flow_status "undefined1" UBYTE NO_COMPU_METHOD 0 0 0 255 ECU_ADDRESS 0x40002542 /end MEASUREMENT
/begin MEASUREMENT isotp_fc_received "ISO-TP flow-control received (boolean flag)." UBYTE NO_COMPU_METHOD 0 0 0 255 ECU_ADDRESS 0x40002543 /end MEASUREMENT
/begin MEASUREMENT isotp_block_size "undefined1" UBYTE NO_COMPU_METHOD 0 0 0 255 ECU_ADDRESS 0x40002544 /end MEASUREMENT
/begin MEASUREMENT isotp_stmin "ISO-TP STmin." UBYTE NO_COMPU_METHOD 0 0 0 255 ECU_ADDRESS 0x40002545 /end MEASUREMENT
/begin MEASUREMENT obd_ii_response_length "undefined2" UWORD NO_COMPU_METHOD 0 0 0 65535 ECU_ADDRESS 0x40002546 /end MEASUREMENT
/begin MEASUREMENT isotp_block_counter "undefined1" UBYTE NO_COMPU_METHOD 0 0 0 255 ECU_ADDRESS 0x40002548 /end MEASUREMENT
/begin MEASUREMENT isotp_stmin_counter "undefined1" UBYTE NO_COMPU_METHOD 0 0 0 255 ECU_ADDRESS 0x40002549 /end MEASUREMENT
/begin MEASUREMENT gear_index_auto "Gear index auto (enumerated state)." UBYTE NO_COMPU_METHOD 0 0 0 255 ECU_ADDRESS 0x40002550 /end MEASUREMENT
/begin MEASUREMENT ips_shift_active "bool" UBYTE NO_COMPU_METHOD 0 0 0 255 ECU_ADDRESS 0x40002551 /end MEASUREMENT
/begin MEASUREMENT ips_flags_faults_ "undefined1" UBYTE NO_COMPU_METHOD 0 0 0 255 ECU_ADDRESS 0x40002552 /end MEASUREMENT
/begin MEASUREMENT abs_a8_flag2 "undefined1" UBYTE NO_COMPU_METHOD 0 0 0 255 ECU_ADDRESS 0x40002553 /end MEASUREMENT
/begin MEASUREMENT obd_ii_oil_temp_ips "undefined1" UBYTE NO_COMPU_METHOD 0 0 0 255 ECU_ADDRESS 0x40002554 /end MEASUREMENT
/begin MEASUREMENT dm_data_buffer "undefined4" ULONG NO_COMPU_METHOD 0 0 0 4294967295 ECU_ADDRESS 0x40002558 /end MEASUREMENT
/begin MEASUREMENT can_rx_msg_timestamp "undefined2" UWORD NO_COMPU_METHOD 0 0 0 65535 ECU_ADDRESS 0x40002564 /end MEASUREMENT
/begin MEASUREMENT can_b7_rolling_counter "undefined1" UBYTE NO_COMPU_METHOD 0 0 0 255 ECU_ADDRESS 0x4000256D /end MEASUREMENT
/begin MEASUREMENT imu_gyro "undefined2" UWORD NO_COMPU_METHOD 0 0 0 65535 ECU_ADDRESS 0x4000258A /end MEASUREMENT
/begin MEASUREMENT imu_accel_lat "IMU accelerator lateral (g = val/255)." SWORD CM_u8_accel_1_255g 0 0 -128.501960784314 128.498039215686 ECU_ADDRESS 0x4000258E /end MEASUREMENT
/begin MEASUREMENT steering_angle_sensor_status "undefined1" UBYTE NO_COMPU_METHOD 0 0 0 255 ECU_ADDRESS 0x40002591 /end MEASUREMENT
/begin MEASUREMENT steering_angle_rate_ "undefined1" UBYTE NO_COMPU_METHOD 0 0 0 255 ECU_ADDRESS 0x40002592 /end MEASUREMENT
/begin MEASUREMENT steering_angle "Steering angle (° = val/10)." UWORD CM_u16_angle_1_10deg 0 0 0 6553.5 ECU_ADDRESS 0x40002594 /end MEASUREMENT
/begin MEASUREMENT obd_MIL_and_DTC "undefined1" UBYTE NO_COMPU_METHOD 0 0 0 255 ECU_ADDRESS 0x400025E8 /end MEASUREMENT
/begin MEASUREMENT obd_DTC_count "undefined1" UBYTE NO_COMPU_METHOD 0 0 0 255 ECU_ADDRESS 0x400025E9 /end MEASUREMENT
/begin MEASUREMENT esci_seq_number "undefined1" UBYTE NO_COMPU_METHOD 0 0 0 255 ECU_ADDRESS 0x400025F2 /end MEASUREMENT
/begin MEASUREMENT throttle_tx_counter "Throttle tx counter." ULONG NO_COMPU_METHOD 0 0 0 4294967295 ECU_ADDRESS 0x40002600 /end MEASUREMENT
/begin MEASUREMENT cruise_switch_unknown_voltage "undefined2" UWORD NO_COMPU_METHOD 0 0 0 65535 ECU_ADDRESS 0x40002608 /end MEASUREMENT
/begin MEASUREMENT obd_ii_cruise_status "undefined4" ULONG NO_COMPU_METHOD 0 0 0 4294967295 ECU_ADDRESS 0x4000260C /end MEASUREMENT
/begin MEASUREMENT cruise_speed_target "Cruise speed target (km/h = val/100)." UWORD CM_u8_speed_1_100kph 0 0 0 655.35 ECU_ADDRESS 0x40002610 /end MEASUREMENT
/begin MEASUREMENT cruise_proportional_term "Cruise proportional term (km/h = val/100)." UWORD CM_u8_speed_1_100kph 0 0 0 655.35 ECU_ADDRESS 0x40002612 /end MEASUREMENT
/begin MEASUREMENT cruise_integral_term "undefined2" UWORD NO_COMPU_METHOD 0 0 0 65535 ECU_ADDRESS 0x40002614 /end MEASUREMENT
/begin MEASUREMENT cruise_deriv_term "undefined2" UWORD NO_COMPU_METHOD 0 0 0 65535 ECU_ADDRESS 0x40002616 /end MEASUREMENT
/begin MEASUREMENT cruise_virtual_pps_request "Cruise virtual pps request (val/1023)." UWORD CM_u16_factor_1_1023 0 0 0 6406.15835777126 ECU_ADDRESS 0x4000261C /end MEASUREMENT
/begin MEASUREMENT tps_commanded_cruise "undefined2" UWORD NO_COMPU_METHOD 0 0 0 65535 ECU_ADDRESS 0x4000261E /end MEASUREMENT
/begin MEASUREMENT cruise_speed_error "Cruise speed error (km/h = val/100)." UWORD CM_u8_speed_1_100kph 0 0 0 655.35 ECU_ADDRESS 0x40002620 /end MEASUREMENT
/begin MEASUREMENT cruise_flags_unknown "undefined2" UWORD NO_COMPU_METHOD 0 0 0 65535 ECU_ADDRESS 0x40002622 /end MEASUREMENT
/begin MEASUREMENT cruise_cancel_button_hold_count "undefined1" UBYTE NO_COMPU_METHOD 0 0 0 255 ECU_ADDRESS 0x40002628 /end MEASUREMENT
/begin MEASUREMENT cruise_resume_button_hold_count "undefined1" UBYTE NO_COMPU_METHOD 0 0 0 255 ECU_ADDRESS 0x40002629 /end MEASUREMENT
/begin MEASUREMENT cruise_set_button_hold_count "undefined1" UBYTE NO_COMPU_METHOD 0 0 0 255 ECU_ADDRESS 0x4000262A /end MEASUREMENT
/begin MEASUREMENT cruise_integral_accum "int16_t" SWORD NO_COMPU_METHOD 0 0 -32768 32767 ECU_ADDRESS 0x4000262E /end MEASUREMENT
/begin MEASUREMENT cruise_coast_switch_override_timer "undefined1" UBYTE NO_COMPU_METHOD 0 0 0 255 ECU_ADDRESS 0x40002634 /end MEASUREMENT
/begin MEASUREMENT cruise_speed_smoothed "Cruise speed smoothed (km/h = val/100)." UWORD CM_u8_speed_1_100kph 0 0 0 655.35 ECU_ADDRESS 0x40002636 /end MEASUREMENT
/begin MEASUREMENT cruise_switch_unknown_voltage2 "undefined2" UWORD NO_COMPU_METHOD 0 0 0 65535 ECU_ADDRESS 0x40002638 /end MEASUREMENT
/begin MEASUREMENT cruise_transition_lockout_timer "undefined2" UWORD NO_COMPU_METHOD 0 0 0 65535 ECU_ADDRESS 0x40002640 /end MEASUREMENT
/begin MEASUREMENT cruise_integral_gain "undefined1" UBYTE NO_COMPU_METHOD 0 0 0 255 ECU_ADDRESS 0x4000264A /end MEASUREMENT
/begin MEASUREMENT cruise_stalk_idle_debounce_timer "undefined1" UBYTE NO_COMPU_METHOD 0 0 0 255 ECU_ADDRESS 0x4000264B /end MEASUREMENT
/begin MEASUREMENT cruise_switch_pos "Cruise switch position (enumerated state)." UBYTE NO_COMPU_METHOD 0 0 0 255 ECU_ADDRESS 0x4000264C /end MEASUREMENT
/begin MEASUREMENT cruise_speed_error_normalized "undefined1" UBYTE NO_COMPU_METHOD 0 0 0 255 ECU_ADDRESS 0x4000264D /end MEASUREMENT
/begin MEASUREMENT obd_ii_engine_torque "OBD-II: engine torque (Nm)." UWORD CM_u8_torque_nm 0 0 0 65535 ECU_ADDRESS 0x40002650 /end MEASUREMENT
/begin MEASUREMENT torque_estimated_actual_load "undefined2" UWORD NO_COMPU_METHOD 0 0 0 65535 ECU_ADDRESS 0x40002652 /end MEASUREMENT
/begin MEASUREMENT engine_friction_torque "Engine friction torque (Nm)." UWORD CM_u8_torque_nm 0 0 0 65535 ECU_ADDRESS 0x40002654 /end MEASUREMENT
/begin MEASUREMENT torque_estimated_alphaN "Torque estimated alphaN (Nm)." UWORD CM_u8_torque_nm 0 0 0 65535 ECU_ADDRESS 0x40002656 /end MEASUREMENT
/begin MEASUREMENT torque_engine_friction_base "Torque engine friction base (Nm)." UWORD CM_u8_torque_nm 0 0 0 65535 ECU_ADDRESS 0x40002658 /end MEASUREMENT
/begin MEASUREMENT load_estimated_alphaN "Load estimated alphaN (mg/stroke)." UWORD CM_u16_load_mg_stroke 0 0 0 65535 ECU_ADDRESS 0x4000265A /end MEASUREMENT
/begin MEASUREMENT load_learned_alphaN "Load learned alphaN (mg/stroke)." UWORD CM_u16_load_mg_stroke 0 0 0 65535 ECU_ADDRESS 0x4000265C /end MEASUREMENT
/begin MEASUREMENT load_target_with_torque_limit "Load target with torque limit (mg/stroke = val*1173)." UWORD CM_u8_load_1173mg_255stroke 0 0 0 301461 ECU_ADDRESS 0x4000265E /end MEASUREMENT
/begin MEASUREMENT torque_limit_tps_target "Torque limit throttle position target (val/4095)." UWORD CM_u16_factor_1_4095 0 0 0 1600.3663003663 ECU_ADDRESS 0x40002660 /end MEASUREMENT
/begin MEASUREMENT ign_comp_torque_reduction "undefined2" UWORD NO_COMPU_METHOD 0 0 0 65535 ECU_ADDRESS 0x40002662 /end MEASUREMENT
/begin MEASUREMENT torque_allowed_factor "Torque allowed factor (val/255)." UBYTE CM_u8_factor_1_255 0 0 0 100 ECU_ADDRESS 0x40002664 /end MEASUREMENT
/begin MEASUREMENT torque_limit_external_net "Torque limit external net (Nm)." UWORD CM_u8_torque_nm 0 0 0 65535 ECU_ADDRESS 0x40002666 /end MEASUREMENT
/begin MEASUREMENT torque_limit_external_factor "Torque limit external factor (val/255)." UBYTE CM_u8_factor_1_255 0 0 0 100 ECU_ADDRESS 0x40002668 /end MEASUREMENT
/begin MEASUREMENT torque_margin_above_limit "Torque margin above limit (Nm)." UWORD CM_u8_torque_nm 0 0 0 65535 ECU_ADDRESS 0x4000266A /end MEASUREMENT
/begin MEASUREMENT torque_net_engine_combustion "Torque net engine combustion (Nm)." UWORD CM_u8_torque_nm 0 0 0 65535 ECU_ADDRESS 0x4000266C /end MEASUREMENT
/begin MEASUREMENT torque_alphaN_net "Torque alphaN net (Nm)." UWORD CM_u8_torque_nm 0 0 0 65535 ECU_ADDRESS 0x4000266E /end MEASUREMENT
/begin MEASUREMENT torque_limit_base_factor "Torque limit base factor (val/255)." UBYTE CM_u8_factor_1_255 0 0 0 100 ECU_ADDRESS 0x40002670 /end MEASUREMENT
/begin MEASUREMENT torque_efficiency_factor "undefined1" UBYTE NO_COMPU_METHOD 0 0 0 255 ECU_ADDRESS 0x40002671 /end MEASUREMENT
/begin MEASUREMENT torque_engine_friction_temp_component "Torque engine friction temperature component (Nm)." UWORD CM_u8_torque_nm 0 0 0 65535 ECU_ADDRESS 0x40002672 /end MEASUREMENT
/begin MEASUREMENT torque_engine_friction_ac_load "Torque engine friction A/C load (Nm)." UWORD CM_u8_torque_nm 0 0 0 65535 ECU_ADDRESS 0x40002674 /end MEASUREMENT
/begin MEASUREMENT torque_cut_demand_factor "Torque cut demand factor (val/255)." UWORD CM_u8_factor_1_255 0 0 0 25700 ECU_ADDRESS 0x40002676 /end MEASUREMENT
/begin MEASUREMENT torque_factor_per_cyl_step "undefined1" UBYTE NO_COMPU_METHOD 0 0 0 255 ECU_ADDRESS 0x40002678 /end MEASUREMENT
/begin MEASUREMENT torque_cut_level "Torque cut level." UBYTE NO_COMPU_METHOD 0 0 0 255 ECU_ADDRESS 0x40002679 /end MEASUREMENT
/begin MEASUREMENT spark_retard_from_mbt "undefined2" UWORD NO_COMPU_METHOD 0 0 0 65535 ECU_ADDRESS 0x4000267A /end MEASUREMENT
/begin MEASUREMENT message_102_complete "Message 102 complete (boolean flag)." UBYTE NO_COMPU_METHOD 0 0 0 255 ECU_ADDRESS 0x4000267C /end MEASUREMENT
/begin MEASUREMENT torque_limit_source_flags "uint8_t" UBYTE NO_COMPU_METHOD 0 0 0 255 ECU_ADDRESS 0x4000267D /end MEASUREMENT
/begin MEASUREMENT torque_req_0xb7_abs_esp_active "Torque req 0xb7 ABS ESP active (boolean flag)." UBYTE NO_COMPU_METHOD 0 0 0 255 ECU_ADDRESS 0x4000267E /end MEASUREMENT
/begin MEASUREMENT torque_req_0xb7_cruise_control_active "Torque req 0xb7 cruise control active (boolean flag)." UBYTE NO_COMPU_METHOD 0 0 0 255 ECU_ADDRESS 0x4000267F /end MEASUREMENT
/begin GROUP G_Climate "Air conditioning" ROOT
 /begin REF_CHARACTERISTIC CAL_ac_compressor_deactivate_car_speed CAL_ac_compressor_engine_speed2 CAL_ac_compressor_engine_speed3 CAL_ac_compressor_engine_speed_max CAL_ac_compressor_engine_speed_min CAL_ac_compressor_max_coolant_temp_max CAL_ac_compressor_max_coolant_temp_min CAL_ac_compressor_max_throttle CAL_ac_compressor_power_offset CAL_ac_compressor_runtime_min CAL_ac_compressor_soft_engage_time CAL_ac_compressor_speed_filter_coeff CAL_ac_evap_freeze_inhibit_delay CAL_ac_evap_pid_derivative_filter_alpha CAL_ac_evap_pid_integrator_limit CAL_ac_evap_pid_kd CAL_ac_evap_pid_ki_cold CAL_ac_evap_pid_ki_warm CAL_ac_evap_target_temp CAL_ac_evap_timer_ticks_5ms CAL_ac_ign_comp_delay CAL_ac_inhibit_evap_temp CAL_ac_load_limit CAL_ac_load_limit_X_rpm CAL_ac_load_ramp_steps CAL_ac_load_slew_down_period CAL_ac_load_slew_down_step CAL_ac_load_slew_up_period_ CAL_ac_load_slew_up_step CAL_ac_output_pwm_freq CAL_ac_shutdown_delay CAL_ac_unknown3 /end REF_CHARACTERISTIC
/end GROUP
/begin GROUP G_Cruise "Cruise control" ROOT
 /begin REF_CHARACTERISTIC CAL_cruise_accel_pedal_override_threshold_enter CAL_cruise_accel_pedal_override_threshold_exit CAL_cruise_airflow_slew_step CAL_cruise_brake_cancel_time CAL_cruise_derivative_clamp CAL_cruise_derivative_gain_ips CAL_cruise_derivative_gain_ips_X_gear CAL_cruise_derivative_gain_manual_cr CAL_cruise_derivative_gain_manual_cr_X_gear CAL_cruise_derivative_gain_manual_longbox CAL_cruise_derivative_gain_manual_longbox_X_gear CAL_cruise_derivative_term_limit CAL_cruise_feedforward_blend_threshold CAL_cruise_integral_freeze_accel CAL_cruise_integral_gain_ips CAL_cruise_integral_gain_ips_X_gear CAL_cruise_integral_gain_manual_cr CAL_cruise_integral_gain_manual_cr_X_gear CAL_cruise_integral_gain_manual_longbox CAL_cruise_integral_gain_manual_longbox_X_gear CAL_cruise_integral_gearchange_retain CAL_cruise_integral_term_limit CAL_cruise_integrator_clamp CAL_cruise_proportional_gain_ips CAL_cruise_proportional_gain_ips_X_gear CAL_cruise_proportional_gain_manual_cr CAL_cruise_proportional_gain_manual_cr_X_gear CAL_cruise_proportional_gain_manual_longbox CAL_cruise_proportional_gain_manual_longbox_X_gear CAL_cruise_resume_timer CAL_cruise_speed_deadband CAL_cruise_speed_decrement CAL_cruise_speed_error_limit CAL_cruise_speed_increment CAL_cruise_speed_increment2 CAL_cruise_speed_limit CAL_cruise_tps_accelerating_threshold CAL_cruise_unknown2 /end REF_CHARACTERISTIC
/end GROUP
/begin GROUP G_Vehicle "Vehicle and body" ROOT /begin SUB_GROUP G_Vehicle_cluster G_Vehicle_dca G_Vehicle_vehicle /end SUB_GROUP /end GROUP
/begin GROUP G_Vehicle_cluster "cluster"
 /begin REF_CHARACTERISTIC CAL_cluster_brake_switch_max_speed_ips_unknown CAL_cluster_coolant_warning CAL_cluster_dte_min_distance_threshold CAL_cluster_fuel_economy_factor_limit CAL_cluster_fuel_economy_factory_stepsize CAL_cluster_fuel_level_warning_threshold CAL_cluster_fuel_level_zero_clip_threshold CAL_cluster_fuel_mileage_update_timer CAL_cluster_fuel_range_remaining_smoothing_factor CAL_cluster_fuel_range_smoothing_interval CAL_cluster_fuel_usage_reset_request_timer CAL_cluster_oil_pressure_warn_threshold CAL_cluster_oil_pressure_warn_threshold_X_engine_speed CAL_cluster_shift_light_deadband_rpm CAL_cluster_shiftlight_rpm_offset_ips CAL_cluster_shiftlight_rpm_offset_ips_4000C682 CAL_cluster_shiftlight_rpm_offset_manual CAL_cluster_shiftlight_rpm_offset_manual_40009BA2 CAL_cluster_test_enable_ /end REF_CHARACTERISTIC
/end GROUP
/begin GROUP G_Vehicle_dca "dca"
 /begin REF_CHARACTERISTIC CAL_dca_activate_timer CAL_dca_activate_tps_threshold CAL_dca_enable_carspeed CAL_dca_enable_steering_max CAL_dca_enable_tps_margin CAL_dca_enable_untested CAL_dca_ramp_timer_unknown CAL_dca_stationary_wait_time CAL_dca_tps_limit_ips CAL_dca_tps_limit_ips_x_time CAL_dca_tps_limit_manual CAL_dca_tps_limit_manual_X_time CAL_dca_unknown_ips_nolc CAL_dca_unknown_ips_nolc_X_time /end REF_CHARACTERISTIC
/end GROUP
/begin GROUP G_Vehicle_vehicle "vehicle"
 /begin REF_CHARACTERISTIC CAL_vehicle_moving_speed_min CAL_vehicle_speed_limit CAL_vehicle_speed_limit_enforce CAL_vehicle_speed_limit_enforce_margin CAL_vehicle_standing_start_throttle_threshold /end REF_CHARACTERISTIC
/end GROUP
/begin GROUP G_Other "Other" ROOT
 /begin SUB_GROUP G_Other_base G_Other_ecu G_Other_lea G_Other_logger G_Other_misc G_Other_prog G_Other_unknown15 /end SUB_GROUP
/end GROUP
/begin GROUP G_Other_base "base" /begin REF_CHARACTERISTIC CAL_base /end REF_CHARACTERISTIC /end GROUP
/begin GROUP G_Other_ecu "ecu"
 /begin REF_CHARACTERISTIC CAL_ecu_2gr_cylinder_air_mass_mg CAL_ecu_2gr_cylinder_air_mass_mg_obd_ii CAL_ecu_abs_ring_teeth_count CAL_ecu_brake_or_clutch_inactive_timer CAL_ecu_cvn CAL_ecu_data_base CAL_ecu_engine_breakin_distance CAL_ecu_engine_running_threshold_unknown CAL_ecu_engine_speed_decel_hysteresis_rpm CAL_ecu_engine_speed_reference_enable CAL_ecu_engine_speed_target_dec_gain CAL_ecu_engine_speed_target_dec_gain_X_coolant_temp CAL_ecu_engine_speed_target_ramp_gain_sport CAL_ecu_engine_speed_target_ramp_gain_sport_X_rpm CAL_ecu_engine_speed_target_ramp_gain_sport_Y_coolant_temp CAL_ecu_engine_speed_target_ramp_gain_tour CAL_ecu_engine_speed_target_ramp_gain_tour_X_rpm CAL_ecu_engine_speed_target_ramp_gain_tour_Y_coolant_temp CAL_ecu_engine_speed_target_sport CAL_ecu_engine_speed_target_sport_X_pps CAL_ecu_engine_speed_target_tour CAL_ecu_engine_speed_target_tour_X_pps CAL_ecu_ign_threshold CAL_ecu_ips_calibration_version CAL_ecu_learning_x_axis_stability_threshold CAL_ecu_learning_y_axis_stability_threshold CAL_ecu_obd_mode2F_timer CAL_ecu_rpm_5250 CAL_ecu_rpm_600 CAL_ecu_system_voltage_threshold CAL_ecu_thermostat_diag_maf_threshold_ips CAL_ecu_thermostat_diag_maf_threshold_manual CAL_ecu_unknown_tire_circumference CAL_ecu_unlock_magic CAL_ecu_vehicle_mode_button_time CAL_ecu_wheelspeed_update_timer /end REF_CHARACTERISTIC
/end GROUP
/begin GROUP G_Other_lea "lea" /begin REF_CHARACTERISTIC CAL_lea_misfire_baseline_set /end REF_CHARACTERISTIC /end GROUP
/begin GROUP G_Other_logger "logger" /begin REF_CHARACTERISTIC CAL_logger_high_speed_logger_enable /end REF_CHARACTERISTIC /end GROUP
/begin GROUP G_Other_misc "misc" /begin REF_CHARACTERISTIC CAL_misc_calid CAL_misc_engine_detection_off /end REF_CHARACTERISTIC /end GROUP
/begin GROUP G_Other_prog "prog" /begin REF_CHARACTERISTIC CAL_prog_version /end REF_CHARACTERISTIC /end GROUP
/begin GROUP G_Other_unknown15 "unknown15" /begin REF_CHARACTERISTIC CAL_unknown15 /end REF_CHARACTERISTIC /end GROUP
/end MODULE
/end PROJECT
