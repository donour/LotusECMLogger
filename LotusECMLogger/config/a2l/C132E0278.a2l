ASAP2_VERSION 1 61
/begin PROJECT C132E0278 "Lotus T6 C132E0278"
/begin HEADER "" VERSION "generated v1" /end HEADER
/begin MODULE C132E0278 ""
/begin MOD_COMMON "" BYTE_ORDER MSB_FIRST ALIGNMENT_BYTE 1 ALIGNMENT_WORD 2 ALIGNMENT_LONG 4 /end MOD_COMMON
/begin RECORD_LAYOUT RL_VALUE_UBYTE FNC_VALUES 1 UBYTE ROW_DIR DIRECT /end RECORD_LAYOUT
/begin RECORD_LAYOUT RL_AXIS_UBYTE AXIS_PTS_X 1 UBYTE INDEX_INCR DIRECT /end RECORD_LAYOUT
/begin RECORD_LAYOUT RL_VALUE_SBYTE FNC_VALUES 1 SBYTE ROW_DIR DIRECT /end RECORD_LAYOUT
/begin RECORD_LAYOUT RL_AXIS_SBYTE AXIS_PTS_X 1 SBYTE INDEX_INCR DIRECT /end RECORD_LAYOUT
/begin RECORD_LAYOUT RL_VALUE_UWORD FNC_VALUES 1 UWORD ROW_DIR DIRECT /end RECORD_LAYOUT
/begin RECORD_LAYOUT RL_AXIS_UWORD AXIS_PTS_X 1 UWORD INDEX_INCR DIRECT /end RECORD_LAYOUT
/begin RECORD_LAYOUT RL_VALUE_SWORD FNC_VALUES 1 SWORD ROW_DIR DIRECT /end RECORD_LAYOUT
/begin RECORD_LAYOUT RL_VALUE_ULONG FNC_VALUES 1 ULONG ROW_DIR DIRECT /end RECORD_LAYOUT
/begin COMPU_METHOD CM_u16_afr_1_100 "u16_afr_1/100" RAT_FUNC "%10.2" "AFR" COEFFS 0 1 0 0 0 0.01 /end COMPU_METHOD
/begin COMPU_METHOD CM_u16_angle_1_10deg "u16_angle_1/10deg" RAT_FUNC "%9.1" "deg" COEFFS 0 1 0 0 0 0.1 /end COMPU_METHOD
/begin COMPU_METHOD CM_u16_current_mA "u16_current_mA" RAT_FUNC "%8.0" "mA" COEFFS 0 1 0 0 0 1 /end COMPU_METHOD
/begin COMPU_METHOD CM_u16_distance_mm_div2 "u16_distance_mm_div2" RAT_FUNC "%9.1" "mm" COEFFS 0 1 0 0 0 0.5 /end COMPU_METHOD
/begin COMPU_METHOD CM_u16_factor_1_10000 "u16_factor_1/10000" RAT_FUNC "%10.2" "%" COEFFS 0 1 0 0 0 0.01 /end COMPU_METHOD
/begin COMPU_METHOD CM_u16_factor_1_1023 "u16_factor_1/1023" RAT_FUNC "%12.4" "%" COEFFS 0 1 0 0 0 0.0977517106549365 /end COMPU_METHOD
/begin COMPU_METHOD CM_u16_factor_1_32 "u16_factor_1/32" RAT_FUNC "%11.3" "%" COEFFS 0 1 0 0 0 3.125 /end COMPU_METHOD
/begin COMPU_METHOD CM_u16_flow_100mg_s "u16_flow_100mg/s" RAT_FUNC "%8.0" "mg/s" COEFFS 0 1 0 0 0 100 /end COMPU_METHOD
/begin COMPU_METHOD CM_u16_flow_mg_s "u16_flow_mg/s" RAT_FUNC "%8.0" "mg/s" COEFFS 0 1 0 0 0 1 /end COMPU_METHOD
/begin COMPU_METHOD CM_u16_load_mg_stroke "u16_load_mg/stroke" RAT_FUNC "%8.0" "mg/stroke" COEFFS 0 1 0 0 0 1 /end COMPU_METHOD
/begin COMPU_METHOD CM_u16_mass_mg "u16_mass_mg" RAT_FUNC "%8.0" "mg" COEFFS 0 1 0 0 0 1 /end COMPU_METHOD
/begin COMPU_METHOD CM_u16_power_1_100kw "u16_power_1/100kw" RAT_FUNC "%10.2" "kW" COEFFS 0 1 0 0 0 0.01 /end COMPU_METHOD
/begin COMPU_METHOD CM_u16_pressure_mbar "u16_pressure_mbar" RAT_FUNC "%8.0" "mbar" COEFFS 0 1 0 0 0 1 /end COMPU_METHOD
/begin COMPU_METHOD CM_u16_rspeed_1_4rpm "u16_rspeed_1/4rpm" RAT_FUNC "%10.2" "rpm" COEFFS 0 1 0 0 0 0.25 /end COMPU_METHOD
/begin COMPU_METHOD CM_u16_rspeed_rpm "u16_rspeed_rpm" RAT_FUNC "%8.0" "rpm" COEFFS 0 1 0 0 0 1 /end COMPU_METHOD
/begin COMPU_METHOD CM_u16_slip_1_8pct "u16_slip_1/8pct" RAT_FUNC "%11.3" "%" COEFFS 0 1 0 0 0 0.125 /end COMPU_METHOD
/begin COMPU_METHOD CM_u16_voltage_18_1023v "u16_voltage_18/1023v" RAT_FUNC "%12.4" "V" COEFFS 0 1 0 0 0 0.0175953079178886 /end COMPU_METHOD
/begin COMPU_METHOD CM_u16_voltage_5_1023v "u16_voltage_5/1023v" RAT_FUNC "%12.4" "V" COEFFS 0 1 0 0 0 0.00488758553274682 /end COMPU_METHOD
/begin COMPU_METHOD CM_u8_accel_1_255g "u8_accel_1/255g" RAT_FUNC "%12.4" "g" COEFFS 0 1 0 0 0 0.00392156862745098 /end COMPU_METHOD
/begin COMPU_METHOD CM_u8_angle_1_4_10deg "u8_angle_1/4-10deg" RAT_FUNC "%10.2" "deg" COEFFS 0 1 10 0 0 0.25 /end COMPU_METHOD
/begin COMPU_METHOD CM_u8_angle_1_4_20deg "u8_angle_1/4-20deg" RAT_FUNC "%10.2" "deg" COEFFS 0 1 20 0 0 0.25 /end COMPU_METHOD
/begin COMPU_METHOD CM_u8_angle_1_4_64deg "u8_angle_1/4-64deg" RAT_FUNC "%10.2" "deg" COEFFS 0 1 64 0 0 0.25 /end COMPU_METHOD
/begin COMPU_METHOD CM_u8_angle_1_4deg "u8_angle_1/4deg" RAT_FUNC "%10.2" "deg" COEFFS 0 1 0 0 0 0.25 /end COMPU_METHOD
/begin COMPU_METHOD CM_u8_angle_720_256deg "u8_angle_720/256deg" RAT_FUNC "%12.4" "deg" COEFFS 0 1 0 0 0 2.8125 /end COMPU_METHOD
/begin COMPU_METHOD CM_u8_factor_1_100 "u8_factor_1/100" RAT_FUNC "%8.0" "%" COEFFS 0 1 0 0 0 1 /end COMPU_METHOD
/begin COMPU_METHOD CM_u8_factor_1_200 "u8_factor_1/200" RAT_FUNC "%9.1" "%" COEFFS 0 1 0 0 0 0.5 /end COMPU_METHOD
/begin COMPU_METHOD CM_u8_factor_1_255 "u8_factor_1/255" RAT_FUNC "%12.4" "%" COEFFS 0 1 0 0 0 0.392156862745098 /end COMPU_METHOD
/begin COMPU_METHOD CM_u8_factor_1_2560 "u8_factor_1/2560" RAT_FUNC "%12.4" "%" COEFFS 0 1 0 0 0 0.0390625 /end COMPU_METHOD
/begin COMPU_METHOD CM_u8_flow_2g_s "u8_flow_2g/s" RAT_FUNC "%8.0" "g/s" COEFFS 0 1 0 0 0 2 /end COMPU_METHOD
/begin COMPU_METHOD CM_u8_flow_g_s "u8_flow_g/s" RAT_FUNC "%8.0" "g/s" COEFFS 0 1 0 0 0 1 /end COMPU_METHOD
/begin COMPU_METHOD CM_u8_load_1173mg_255stroke "u8_load_1173mg/255stroke" RAT_FUNC "%9.1" "mg/stroke" COEFFS 0 1 0 0 0 4.6 /end COMPU_METHOD
/begin COMPU_METHOD CM_u8_load_2mg_stroke "u8_load_2mg/stroke" RAT_FUNC "%8.0" "mg/stroke" COEFFS 0 1 0 0 0 2 /end COMPU_METHOD
/begin COMPU_METHOD CM_u8_load_4mg_stroke "u8_load_4mg/stroke" RAT_FUNC "%8.0" "mg/stroke" COEFFS 0 1 0 0 0 4 /end COMPU_METHOD
/begin COMPU_METHOD CM_u8_mass_32mg "u8_mass_32mg" RAT_FUNC "%8.0" "mg" COEFFS 0 1 0 0 0 32 /end COMPU_METHOD
/begin COMPU_METHOD CM_u8_mass_g "u8_mass_g" RAT_FUNC "%8.0" "g" COEFFS 0 1 0 0 0 1 /end COMPU_METHOD
/begin COMPU_METHOD CM_u8_pressure_4mbar "u8_pressure_4mbar" RAT_FUNC "%8.0" "mbar" COEFFS 0 1 0 0 0 4 /end COMPU_METHOD
/begin COMPU_METHOD CM_u8_rspeed_125_4_500rpm "u8_rspeed_125/4+500rpm" RAT_FUNC "%10.2" "rpm" COEFFS 0 1 -500 0 0 31.25 /end COMPU_METHOD
/begin COMPU_METHOD CM_u8_rspeed_2rpm "u8_rspeed_2rpm" RAT_FUNC "%8.0" "rpm" COEFFS 0 1 0 0 0 2 /end COMPU_METHOD
/begin COMPU_METHOD CM_u8_rspeed_4_500rpm "u8_rspeed_4+500rpm" RAT_FUNC "%8.0" "rpm" COEFFS 0 1 -500 0 0 4 /end COMPU_METHOD
/begin COMPU_METHOD CM_u8_rspeed_4rpm "u8_rspeed_4rpm" RAT_FUNC "%8.0" "rpm" COEFFS 0 1 0 0 0 4 /end COMPU_METHOD
/begin COMPU_METHOD CM_u8_rspeed_50rpm "u8_rspeed_50rpm" RAT_FUNC "%8.0" "rpm" COEFFS 0 1 0 0 0 50 /end COMPU_METHOD
/begin COMPU_METHOD CM_u8_rspeed_8rpm "u8_rspeed_8rpm" RAT_FUNC "%8.0" "rpm" COEFFS 0 1 0 0 0 8 /end COMPU_METHOD
/begin COMPU_METHOD CM_u8_speed_1_100kph "u8_speed_1/100kph" RAT_FUNC "%10.2" "km/h" COEFFS 0 1 0 0 0 0.01 /end COMPU_METHOD
/begin COMPU_METHOD CM_u8_speed_kph "u8_speed_kph" RAT_FUNC "%8.0" "km/h" COEFFS 0 1 0 0 0 1 /end COMPU_METHOD
/begin COMPU_METHOD CM_u8_temp_5_8_40c "u8_temp_5/8-40c" RAT_FUNC "%11.3" "°C" COEFFS 0 1 40 0 0 0.625 /end COMPU_METHOD
/begin COMPU_METHOD CM_u8_time_100ms "u8_time_100ms" RAT_FUNC "%8.0" "ms" COEFFS 0 1 0 0 0 100 /end COMPU_METHOD
/begin COMPU_METHOD CM_u8_time_10us "u8_time_10us" RAT_FUNC "%8.0" "us" COEFFS 0 1 0 0 0 10 /end COMPU_METHOD
/begin COMPU_METHOD CM_u8_time_50ms "u8_time_50ms" RAT_FUNC "%8.0" "ms" COEFFS 0 1 0 0 0 50 /end COMPU_METHOD
/begin COMPU_METHOD CM_u8_time_5ms "u8_time_5ms" RAT_FUNC "%8.0" "ms" COEFFS 0 1 0 0 0 5 /end COMPU_METHOD
/begin COMPU_METHOD CM_u8_time_s "u8_time_s" RAT_FUNC "%8.0" "s" COEFFS 0 1 0 0 0 1 /end COMPU_METHOD
/begin COMPU_METHOD CM_u8_torque_4nm "u8_torque_4nm" RAT_FUNC "%8.0" "Nm" COEFFS 0 1 0 0 0 4 /end COMPU_METHOD
/begin COMPU_METHOD CM_u8_torque_nm "u8_torque_nm" RAT_FUNC "%8.0" "Nm" COEFFS 0 1 0 0 0 1 /end COMPU_METHOD
/begin COMPU_METHOD CM_u8_volume_1_10gallon "u8_volume_1/10gallon" RAT_FUNC "%9.1" "gallon" COEFFS 0 1 0 0 0 0.1 /end COMPU_METHOD
/begin AXIS_PTS CAL_load_alphaN_base_X_engine_speed "Calibration: X-axis (engine speed) for the load alphaN base table (RPM = val*125/4+500; 20-element array)." 0x4000ADF2 NO_INPUT_QUANTITY RL_AXIS_UBYTE 0 CM_u8_rspeed_125_4_500rpm 20 500 8468.75 /end AXIS_PTS
/begin AXIS_PTS CAL_load_alphaN_base_Y_tps "Calibration: Y-axis (tps) for the load alphaN base table (val/255; 20-element array)." 0x4000AE06 NO_INPUT_QUANTITY RL_AXIS_UBYTE 0 CM_u8_factor_1_255 20 0 100 /end AXIS_PTS
/begin CHARACTERISTIC CAL_load_alphaN_base "Calibration: load alphaN base (mg/stroke = val*1173; 400-element array)." MAP 0x4000AE1A RL_VALUE_UBYTE 0 CM_u8_load_1173mg_255stroke 0 1173
 /begin AXIS_DESCR COM_AXIS NO_INPUT_QUANTITY CM_u8_rspeed_125_4_500rpm 20 500 8468.75 AXIS_PTS_REF CAL_load_alphaN_base_X_engine_speed /end AXIS_DESCR
 /begin AXIS_DESCR COM_AXIS NO_INPUT_QUANTITY CM_u8_factor_1_255 20 0 100 AXIS_PTS_REF CAL_load_alphaN_base_Y_tps /end AXIS_DESCR
/end CHARACTERISTIC
/begin AXIS_PTS CAL_torque_limit_by_rpm_X_gear "Calibration: X-axis (gear) for the torque limit by RPM table (8-element array)." 0x4000AFAA NO_INPUT_QUANTITY RL_AXIS_UBYTE 0 NO_COMPU_METHOD 8 0 255 /end AXIS_PTS
/begin AXIS_PTS CAL_torque_limit_by_rpm_Y_rpm "Calibration: Y-axis (rpm) for the torque limit by RPM table (RPM = val*125/4+500; 8-element array)." 0x4000AFB2 NO_INPUT_QUANTITY RL_AXIS_UBYTE 0 CM_u8_rspeed_125_4_500rpm 8 500 8468.75 /end AXIS_PTS
/begin CHARACTERISTIC CAL_torque_limit_by_rpm "*WARNING* This table has been patched to double the torque values. Each 8bit value represents 4nm of torque." MAP 0x4000AFBA RL_VALUE_UBYTE 0 CM_u8_torque_4nm 0 1020
 /begin AXIS_DESCR COM_AXIS NO_INPUT_QUANTITY NO_COMPU_METHOD 8 0 255 AXIS_PTS_REF CAL_torque_limit_by_rpm_X_gear /end AXIS_DESCR
 /begin AXIS_DESCR COM_AXIS NO_INPUT_QUANTITY CM_u8_rspeed_125_4_500rpm 8 500 8468.75 AXIS_PTS_REF CAL_torque_limit_by_rpm_Y_rpm /end AXIS_DESCR
/end CHARACTERISTIC
/begin AXIS_PTS CAL_tpstarget_tour_ips_X_pps "Calibration: X-axis (pps) for the tpstarget tour IPS table (val/1023; 16-element array)." 0x4000B032 NO_INPUT_QUANTITY RL_AXIS_UWORD 0 CM_u16_factor_1_1023 16 0 6406.15835777126 /end AXIS_PTS
/begin CHARACTERISTIC CAL_tpstarget_tour_ips "Calibration: tpstarget tour IPS (val/1023; 16-element array)." CURVE 0x4000B052 RL_VALUE_UWORD 0 CM_u16_factor_1_1023 0 6406.15835777126
 /begin AXIS_DESCR COM_AXIS NO_INPUT_QUANTITY CM_u16_factor_1_1023 16 0 6406.15835777126 AXIS_PTS_REF CAL_tpstarget_tour_ips_X_pps /end AXIS_DESCR
/end CHARACTERISTIC
/begin AXIS_PTS CAL_tpstarget_sport_ips_X_pps "Calibration: X-axis (pps) for the tpstarget sport IPS table (val/1023; 16-element array)." 0x4000B072 NO_INPUT_QUANTITY RL_AXIS_UWORD 0 CM_u16_factor_1_1023 16 0 6406.15835777126 /end AXIS_PTS
/begin CHARACTERISTIC CAL_tpstarget_sport_ips "Calibration: tpstarget sport IPS (val/1023; 16-element array)." CURVE 0x4000B092 RL_VALUE_UWORD 0 CM_u16_factor_1_1023 0 6406.15835777126
 /begin AXIS_DESCR COM_AXIS NO_INPUT_QUANTITY CM_u16_factor_1_1023 16 0 6406.15835777126 AXIS_PTS_REF CAL_tpstarget_sport_ips_X_pps /end AXIS_DESCR
/end CHARACTERISTIC
/begin AXIS_PTS CAL_knock_sensitivity_X_engine_speed "Calibration: X-axis (engine speed) for the knock sensitivity table (RPM = val*125/4+500; 8-element array)." 0x4000B0B2 NO_INPUT_QUANTITY RL_AXIS_UBYTE 0 CM_u8_rspeed_125_4_500rpm 8 500 8468.75 /end AXIS_PTS
/begin AXIS_PTS CAL_knock_sensitivity_Y_load "Calibration: Y-axis (load) for the knock sensitivity table (mg/stroke = val*4; 8-element array)." 0x4000B0BA NO_INPUT_QUANTITY RL_AXIS_UBYTE 0 CM_u8_load_4mg_stroke 8 0 1020 /end AXIS_PTS
/begin CHARACTERISTIC CAL_knock_sensitivity "Calibration: knock sensitivity (val/255; 64-element array)." MAP 0x4000B0C2 RL_VALUE_UBYTE 0 CM_u8_factor_1_255 0 100
 /begin AXIS_DESCR COM_AXIS NO_INPUT_QUANTITY CM_u8_rspeed_125_4_500rpm 8 500 8468.75 AXIS_PTS_REF CAL_knock_sensitivity_X_engine_speed /end AXIS_DESCR
 /begin AXIS_DESCR COM_AXIS NO_INPUT_QUANTITY CM_u8_load_4mg_stroke 8 0 1020 AXIS_PTS_REF CAL_knock_sensitivity_Y_load /end AXIS_DESCR
/end CHARACTERISTIC
/begin AXIS_PTS CAL_knock_peak_threshold_X_engine_speed "Calibration: X-axis (engine speed) for the knock peak threshold table (RPM = val*125/4+500; 8-element array)." 0x4000B102 NO_INPUT_QUANTITY RL_AXIS_UBYTE 0 CM_u8_rspeed_125_4_500rpm 8 500 8468.75 /end AXIS_PTS
/begin AXIS_PTS CAL_knock_peak_threshold_Y_load "Calibration: Y-axis (load) for the knock peak threshold table (mg/stroke = val*4; 8-element array)." 0x4000B10A NO_INPUT_QUANTITY RL_AXIS_UBYTE 0 CM_u8_load_4mg_stroke 8 0 1020 /end AXIS_PTS
/begin CHARACTERISTIC CAL_knock_peak_threshold "Calibration: knock peak threshold (64-element array)." MAP 0x4000B112 RL_VALUE_UBYTE 0 NO_COMPU_METHOD 0 255
 /begin AXIS_DESCR COM_AXIS NO_INPUT_QUANTITY CM_u8_rspeed_125_4_500rpm 8 500 8468.75 AXIS_PTS_REF CAL_knock_peak_threshold_X_engine_speed /end AXIS_DESCR
 /begin AXIS_DESCR COM_AXIS NO_INPUT_QUANTITY CM_u8_load_4mg_stroke 8 0 1020 AXIS_PTS_REF CAL_knock_peak_threshold_Y_load /end AXIS_DESCR
/end CHARACTERISTIC
/begin AXIS_PTS CAL_knock_count_to_retard_X_knock_count "Calibration: X-axis (knock count) for the knock count to retard table (8-element array)." 0x4000B152 NO_INPUT_QUANTITY RL_AXIS_UBYTE 0 NO_COMPU_METHOD 8 0 255 /end AXIS_PTS
/begin CHARACTERISTIC CAL_knock_count_to_retard "Calibration: knock count to retard (° = val/4; 8-element array)." CURVE 0x4000B15A RL_VALUE_UBYTE 0 CM_u8_angle_1_4deg 0 63.75
 /begin AXIS_DESCR COM_AXIS NO_INPUT_QUANTITY NO_COMPU_METHOD 8 0 255 AXIS_PTS_REF CAL_knock_count_to_retard_X_knock_count /end AXIS_DESCR
/end CHARACTERISTIC
/begin AXIS_PTS CAL_knock_detection_load_threshold_X_rpm "Calibration: X-axis (rpm) for the knock detection load threshold table (RPM = val*125/4+500; 8-element array)." 0x4000B162 NO_INPUT_QUANTITY RL_AXIS_UBYTE 0 CM_u8_rspeed_125_4_500rpm 8 500 8468.75 /end AXIS_PTS
/begin CHARACTERISTIC CAL_knock_detection_load_threshold "Calibration: knock detection load threshold (mg/stroke = val*4; 8-element array)." CURVE 0x4000B16A RL_VALUE_UBYTE 0 CM_u8_load_4mg_stroke 0 1020
 /begin AXIS_DESCR COM_AXIS NO_INPUT_QUANTITY CM_u8_rspeed_125_4_500rpm 8 500 8468.75 AXIS_PTS_REF CAL_knock_detection_load_threshold_X_rpm /end AXIS_DESCR
/end CHARACTERISTIC
/begin AXIS_PTS CAL_knock_learning_load_threshold_X_rpm "Calibration: X-axis (rpm) for the knock learning load threshold table (RPM = val*125/4+500; 8-element array)." 0x4000B172 NO_INPUT_QUANTITY RL_AXIS_UBYTE 0 CM_u8_rspeed_125_4_500rpm 8 500 8468.75 /end AXIS_PTS
/begin CHARACTERISTIC CAL_knock_learning_load_threshold "Calibration: knock learning load threshold (mg/stroke = val*4; 8-element array)." CURVE 0x4000B17A RL_VALUE_UBYTE 0 CM_u8_load_4mg_stroke 0 1020
 /begin AXIS_DESCR COM_AXIS NO_INPUT_QUANTITY CM_u8_rspeed_125_4_500rpm 8 500 8468.75 AXIS_PTS_REF CAL_knock_learning_load_threshold_X_rpm /end AXIS_DESCR
/end CHARACTERISTIC
/begin AXIS_PTS CAL_evap_purge_flow_coefficient_X_dutycycle "Calibration: X-axis (dutycycle) for the evaporative purge flow coefficient table (val/255; 16-element array)." 0x4000B182 NO_INPUT_QUANTITY RL_AXIS_UBYTE 0 CM_u8_factor_1_255 16 0 100 /end AXIS_PTS
/begin AXIS_PTS CAL_evap_purge_flow_coefficient_Y_vacuum "Calibration: Y-axis (vacuum) for the evaporative purge flow coefficient table (mbar = val*4; 16-element array)." 0x4000B192 NO_INPUT_QUANTITY RL_AXIS_UBYTE 0 CM_u8_pressure_4mbar 16 0 1020 /end AXIS_PTS
/begin CHARACTERISTIC CAL_evap_purge_flow_coefficient "Calibration: evaporative purge flow coefficient (256-element array)." MAP 0x4000B1A2 RL_VALUE_UBYTE 0 NO_COMPU_METHOD 0 255
 /begin AXIS_DESCR COM_AXIS NO_INPUT_QUANTITY CM_u8_factor_1_255 16 0 100 AXIS_PTS_REF CAL_evap_purge_flow_coefficient_X_dutycycle /end AXIS_DESCR
 /begin AXIS_DESCR COM_AXIS NO_INPUT_QUANTITY CM_u8_pressure_4mbar 16 0 1020 AXIS_PTS_REF CAL_evap_purge_flow_coefficient_Y_vacuum /end AXIS_DESCR
/end CHARACTERISTIC
/begin AXIS_PTS CAL_tpstarget_tour_manual_X_pps "Calibration: X-axis (pps) for the tpstarget tour manual table (val/1023; 16-element array)." 0x4000B2B2 NO_INPUT_QUANTITY RL_AXIS_UWORD 0 CM_u16_factor_1_1023 16 0 6406.15835777126 /end AXIS_PTS
/begin CHARACTERISTIC CAL_tpstarget_tour_manual "Calibration: tpstarget tour manual (val/1023; 16-element array)." CURVE 0x4000B2D2 RL_VALUE_UWORD 0 CM_u16_factor_1_1023 0 6406.15835777126
 /begin AXIS_DESCR COM_AXIS NO_INPUT_QUANTITY CM_u16_factor_1_1023 16 0 6406.15835777126 AXIS_PTS_REF CAL_tpstarget_tour_manual_X_pps /end AXIS_DESCR
/end CHARACTERISTIC
/begin AXIS_PTS CAL_tpstarget_sport_manual_X_pps "Calibration: X-axis (pps) for the tpstarget sport manual table (val/1023; 16-element array)." 0x4000B332 NO_INPUT_QUANTITY RL_AXIS_UWORD 0 CM_u16_factor_1_1023 16 0 6406.15835777126 /end AXIS_PTS
/begin CHARACTERISTIC CAL_tpstarget_sport_manual "Calibration: tpstarget sport manual (val/1023; 16-element array)." CURVE 0x4000B352 RL_VALUE_UWORD 0 CM_u16_factor_1_1023 0 6406.15835777126
 /begin AXIS_DESCR COM_AXIS NO_INPUT_QUANTITY CM_u16_factor_1_1023 16 0 6406.15835777126 AXIS_PTS_REF CAL_tpstarget_sport_manual_X_pps /end AXIS_DESCR
/end CHARACTERISTIC
/begin AXIS_PTS CAL_ign_target_step_retard_accel_pedal_X_rpm "Calibration: X-axis (engine speed) for the ignition compensation tps2 table (RPM = val*125/4+500; 8-element array)." 0x4000B372 NO_INPUT_QUANTITY RL_AXIS_UBYTE 0 CM_u8_rspeed_125_4_500rpm 8 500 8468.75 /end AXIS_PTS
/begin AXIS_PTS CAL_ign_target_step_retard_accel_pedal_Y_pps "Calibration: Y-axis (accel pedal) for the ignition compensation tps2 table (val/255; 16-element array)." 0x4000B37A NO_INPUT_QUANTITY RL_AXIS_UBYTE 0 CM_u8_factor_1_255 16 0 100 /end AXIS_PTS
/begin CHARACTERISTIC CAL_ign_target_step_retard_accel_pedal "ign_target_step_retard — how fast timing gets pulled. Same rate limit in the opposite direction: when the timing target drops, this is the largest amount of timing the ECU may remove per step, again one step every 50 ms, again in quarter-degrees, so " MAP 0x4000B38A RL_VALUE_UBYTE 0 CM_u8_angle_1_4deg 0 63.75
 /begin AXIS_DESCR COM_AXIS NO_INPUT_QUANTITY CM_u8_rspeed_125_4_500rpm 8 500 8468.75 AXIS_PTS_REF CAL_ign_target_step_retard_accel_pedal_X_rpm /end AXIS_DESCR
 /begin AXIS_DESCR COM_AXIS NO_INPUT_QUANTITY CM_u8_factor_1_255 16 0 100 AXIS_PTS_REF CAL_ign_target_step_retard_accel_pedal_Y_pps /end AXIS_DESCR
/end CHARACTERISTIC
/begin AXIS_PTS CAL_inj_cranking_enrichment_coolant_ips_X_coolant_engine_stopped "Calibration: X-axis (coolant engine stopped) for the injector cranking enrichment coolant IPS table (°C = val*5/8−40; 12-element array)." 0x4000B40A NO_INPUT_QUANTITY RL_AXIS_UWORD 0 CM_u8_temp_5_8_40c 12 -40 40919.375 /end AXIS_PTS
/begin AXIS_PTS CAL_inj_cranking_enrichment_coolant_ips_Y_maf_accumulated "Calibration: Y-axis (maf accumulated) for the injector cranking enrichment coolant IPS table (mg; 14-element array)." 0x4000B422 NO_INPUT_QUANTITY RL_AXIS_UWORD 0 CM_u16_mass_mg 14 0 65535 /end AXIS_PTS
/begin CHARACTERISTIC CAL_inj_cranking_enrichment_coolant_ips "Calibration: injector cranking enrichment coolant IPS (val/32; 168-element array)." MAP 0x4000B43E RL_VALUE_UWORD 0 CM_u16_factor_1_32 0 204796.875
 /begin AXIS_DESCR COM_AXIS NO_INPUT_QUANTITY CM_u8_temp_5_8_40c 12 -40 40919.375 AXIS_PTS_REF CAL_inj_cranking_enrichment_coolant_ips_X_coolant_engine_stopped /end AXIS_DESCR
 /begin AXIS_DESCR COM_AXIS NO_INPUT_QUANTITY CM_u16_mass_mg 14 0 65535 AXIS_PTS_REF CAL_inj_cranking_enrichment_coolant_ips_Y_maf_accumulated /end AXIS_DESCR
/end CHARACTERISTIC
/begin AXIS_PTS CAL_torque_torque_to_load_X_engine_speed "Calibration: X-axis (engine speed) for the torque torque to load table (RPM; 16-element array)." 0x4000B64A NO_INPUT_QUANTITY RL_AXIS_UWORD 0 CM_u16_rspeed_rpm 16 0 65535 /end AXIS_PTS
/begin AXIS_PTS CAL_torque_torque_to_load_Y_torque "Calibration: Y-axis (torque) for the torque torque to load table (Nm; 16-element array)." 0x4000B66A NO_INPUT_QUANTITY RL_AXIS_UWORD 0 CM_u8_torque_nm 16 0 65535 /end AXIS_PTS
/begin CHARACTERISTIC CAL_torque_torque_to_load "Calibration: torque torque to load (mg/stroke; 256-element array)." MAP 0x4000B68A RL_VALUE_UWORD 0 CM_u16_load_mg_stroke 0 65535
 /begin AXIS_DESCR COM_AXIS NO_INPUT_QUANTITY CM_u16_rspeed_rpm 16 0 65535 AXIS_PTS_REF CAL_torque_torque_to_load_X_engine_speed /end AXIS_DESCR
 /begin AXIS_DESCR COM_AXIS NO_INPUT_QUANTITY CM_u8_torque_nm 16 0 65535 AXIS_PTS_REF CAL_torque_torque_to_load_Y_torque /end AXIS_DESCR
/end CHARACTERISTIC
/begin AXIS_PTS CAL_torque_ign_retard_base_X_engine_speed "Calibration: X-axis (engine speed) for the torque ignition retard base table (RPM = val*125/4+500; 16-element array)." 0x4000B88A NO_INPUT_QUANTITY RL_AXIS_UBYTE 0 CM_u8_rspeed_125_4_500rpm 16 500 8468.75 /end AXIS_PTS
/begin AXIS_PTS CAL_torque_ign_retard_base_Y_torque_reduction_factor "Calibration: Y-axis (torque reduction factor) for the torque ignition retard base table (val/255; 16-element array)." 0x4000B89A NO_INPUT_QUANTITY RL_AXIS_UBYTE 0 CM_u8_factor_1_255 16 0 100 /end AXIS_PTS
/begin CHARACTERISTIC CAL_torque_ign_retard_base "Calibration: torque ignition retard base (° = val/4−64; 256-element array)." MAP 0x4000B8AA RL_VALUE_UBYTE 0 CM_u8_angle_1_4_64deg -64 -0.25
 /begin AXIS_DESCR COM_AXIS NO_INPUT_QUANTITY CM_u8_rspeed_125_4_500rpm 16 500 8468.75 AXIS_PTS_REF CAL_torque_ign_retard_base_X_engine_speed /end AXIS_DESCR
 /begin AXIS_DESCR COM_AXIS NO_INPUT_QUANTITY CM_u8_factor_1_255 16 0 100 AXIS_PTS_REF CAL_torque_ign_retard_base_Y_torque_reduction_factor /end AXIS_DESCR
/end CHARACTERISTIC
/begin AXIS_PTS CAL_ign_min_X_engine_speed "Calibration: X-axis (engine speed) for the ignition minimum table (RPM = val*125/4+500; 16-element array)." 0x4000B9AA NO_INPUT_QUANTITY RL_AXIS_UBYTE 0 CM_u8_rspeed_125_4_500rpm 16 500 8468.75 /end AXIS_PTS
/begin AXIS_PTS CAL_ign_min_Y_load "Calibration: Y-axis (load) for the ignition minimum table (mg/stroke = val*4; 16-element array)." 0x4000B9BA NO_INPUT_QUANTITY RL_AXIS_UBYTE 0 CM_u8_load_4mg_stroke 16 0 1020 /end AXIS_PTS
/begin CHARACTERISTIC CAL_ign_min "Calibration: ignition minimum (° = val/4−20; 256-element array)." MAP 0x4000B9CA RL_VALUE_UBYTE 0 CM_u8_angle_1_4_20deg -20 43.75
 /begin AXIS_DESCR COM_AXIS NO_INPUT_QUANTITY CM_u8_rspeed_125_4_500rpm 16 500 8468.75 AXIS_PTS_REF CAL_ign_min_X_engine_speed /end AXIS_DESCR
 /begin AXIS_DESCR COM_AXIS NO_INPUT_QUANTITY CM_u8_load_4mg_stroke 16 0 1020 AXIS_PTS_REF CAL_ign_min_Y_load /end AXIS_DESCR
/end CHARACTERISTIC
/begin AXIS_PTS CAL_idle_target_ips_X_coolant_temp "Calibration: X-axis (coolant temp) for the idle target IPS table (°C = val*5/8−40; 16-element array)." 0x4000BACA NO_INPUT_QUANTITY RL_AXIS_UBYTE 0 CM_u8_temp_5_8_40c 16 -40 119.375 /end AXIS_PTS
/begin CHARACTERISTIC CAL_idle_target_ips "Calibration: idle target IPS (RPM = val*4+500; 16-element array)." CURVE 0x4000BADA RL_VALUE_UBYTE 0 CM_u8_rspeed_4_500rpm 500 1520
 /begin AXIS_DESCR COM_AXIS NO_INPUT_QUANTITY CM_u8_temp_5_8_40c 16 -40 119.375 AXIS_PTS_REF CAL_idle_target_ips_X_coolant_temp /end AXIS_DESCR
/end CHARACTERISTIC
/begin AXIS_PTS CAL_torque_limit_base_factor_X_rpm "Calibration: X-axis (rpm) for the torque limit base factor table (RPM = val*125/4+500; 16-element array)." 0x4000BAEA NO_INPUT_QUANTITY RL_AXIS_UBYTE 0 CM_u8_rspeed_125_4_500rpm 16 500 8468.75 /end AXIS_PTS
/begin AXIS_PTS CAL_torque_limit_base_factor_Y_load "Calibration: Y-axis (load) for the torque limit base factor table (mg/stroke = val*4; 16-element array)." 0x4000BAFA NO_INPUT_QUANTITY RL_AXIS_UBYTE 0 CM_u8_load_4mg_stroke 16 0 1020 /end AXIS_PTS
/begin CHARACTERISTIC CAL_torque_limit_base_factor "// Used in cylinder cut calculation" MAP 0x4000BB0A RL_VALUE_UBYTE 0 CM_u8_factor_1_255 0 100
 /begin AXIS_DESCR COM_AXIS NO_INPUT_QUANTITY CM_u8_rspeed_125_4_500rpm 16 500 8468.75 AXIS_PTS_REF CAL_torque_limit_base_factor_X_rpm /end AXIS_DESCR
 /begin AXIS_DESCR COM_AXIS NO_INPUT_QUANTITY CM_u8_load_4mg_stroke 16 0 1020 AXIS_PTS_REF CAL_torque_limit_base_factor_Y_load /end AXIS_DESCR
/end CHARACTERISTIC
/begin AXIS_PTS CAL_torque_engine_friction_temp_component_X_coolant "Calibration: X-axis (coolant) for the torque engine friction temperature component table (°C = val*5/8−40; 8-element array)." 0x4000BC0A NO_INPUT_QUANTITY RL_AXIS_UBYTE 0 CM_u8_temp_5_8_40c 8 -40 119.375 /end AXIS_PTS
/begin AXIS_PTS CAL_torque_engine_friction_temp_component_Y_load "Calibration: Y-axis (load) for the torque engine friction temperature component table (mg/stroke = val*4; 8-element array)." 0x4000BC12 NO_INPUT_QUANTITY RL_AXIS_UBYTE 0 CM_u8_load_4mg_stroke 8 0 1020 /end AXIS_PTS
/begin CHARACTERISTIC CAL_torque_engine_friction_temp_component "Calibration: torque engine friction temperature component (Nm; 64-element array)." MAP 0x4000BC1A RL_VALUE_UBYTE 0 CM_u8_torque_nm 0 255
 /begin AXIS_DESCR COM_AXIS NO_INPUT_QUANTITY CM_u8_temp_5_8_40c 8 -40 119.375 AXIS_PTS_REF CAL_torque_engine_friction_temp_component_X_coolant /end AXIS_DESCR
 /begin AXIS_DESCR COM_AXIS NO_INPUT_QUANTITY CM_u8_load_4mg_stroke 8 0 1020 AXIS_PTS_REF CAL_torque_engine_friction_temp_component_Y_load /end AXIS_DESCR
/end CHARACTERISTIC
/begin AXIS_PTS CAL_torque_spark_efficiency_X_rpm "Calibration: X-axis (rpm) for the torque spark efficiency table (16-element array)." 0x4000BC5A NO_INPUT_QUANTITY RL_AXIS_UBYTE 0 NO_COMPU_METHOD 16 0 255 /end AXIS_PTS
/begin AXIS_PTS CAL_torque_spark_efficiency_Y_ign_retard_from_mbt "Calibration: Y-axis (ign retard from mbt) for the torque spark efficiency table (° = val/4; 16-element array)." 0x4000BC6A NO_INPUT_QUANTITY RL_AXIS_UBYTE 0 CM_u8_angle_1_4deg 16 0 63.75 /end AXIS_PTS
/begin CHARACTERISTIC CAL_torque_spark_efficiency "Calibration: torque spark efficiency (val/255; 256-element array)." MAP 0x4000BC7A RL_VALUE_UBYTE 0 CM_u8_factor_1_255 0 100
 /begin AXIS_DESCR COM_AXIS NO_INPUT_QUANTITY NO_COMPU_METHOD 16 0 255 AXIS_PTS_REF CAL_torque_spark_efficiency_X_rpm /end AXIS_DESCR
 /begin AXIS_DESCR COM_AXIS NO_INPUT_QUANTITY CM_u8_angle_1_4deg 16 0 63.75 AXIS_PTS_REF CAL_torque_spark_efficiency_Y_ign_retard_from_mbt /end AXIS_DESCR
/end CHARACTERISTIC
/begin AXIS_PTS CAL_torque_spark_efficiency_slope_X_rpm "Calibration: X-axis (rpm) for the torque spark efficiency slope table (RPM = val*125/4+500; 16-element array)." 0x4000BD7A NO_INPUT_QUANTITY RL_AXIS_UBYTE 0 CM_u8_rspeed_125_4_500rpm 16 500 8468.75 /end AXIS_PTS
/begin AXIS_PTS CAL_torque_spark_efficiency_slope_Y_load "Calibration: Y-axis (load) for the torque spark efficiency slope table (mg/stroke = val*4; 16-element array)." 0x4000BD8A NO_INPUT_QUANTITY RL_AXIS_UBYTE 0 CM_u8_load_4mg_stroke 16 0 1020 /end AXIS_PTS
/begin CHARACTERISTIC CAL_torque_spark_efficiency_slope "Calibration: torque spark efficiency slope (256-element array)." MAP 0x4000BD9A RL_VALUE_UBYTE 0 NO_COMPU_METHOD 0 255
 /begin AXIS_DESCR COM_AXIS NO_INPUT_QUANTITY CM_u8_rspeed_125_4_500rpm 16 500 8468.75 AXIS_PTS_REF CAL_torque_spark_efficiency_slope_X_rpm /end AXIS_DESCR
 /begin AXIS_DESCR COM_AXIS NO_INPUT_QUANTITY CM_u8_load_4mg_stroke 16 0 1020 AXIS_PTS_REF CAL_torque_spark_efficiency_slope_Y_load /end AXIS_DESCR
/end CHARACTERISTIC
/begin AXIS_PTS CAL_ign_comp_coolant_ips_noflags_X_coolant_temp "Calibration: X-axis (coolant temp) for the ignition compensation coolant IPS noflags table (°C = val*5/8−40; 16-element array)." 0x4000BFFA NO_INPUT_QUANTITY RL_AXIS_UBYTE 0 CM_u8_temp_5_8_40c 16 -40 119.375 /end AXIS_PTS
/begin CHARACTERISTIC CAL_ign_comp_coolant_ips_noflags "Calibration: ignition compensation coolant IPS noflags (° = val/4; 16-element array)." CURVE 0x4000C00A RL_VALUE_UBYTE 0 CM_u8_angle_1_4deg 0 63.75
 /begin AXIS_DESCR COM_AXIS NO_INPUT_QUANTITY CM_u8_temp_5_8_40c 16 -40 119.375 AXIS_PTS_REF CAL_ign_comp_coolant_ips_noflags_X_coolant_temp /end AXIS_DESCR
/end CHARACTERISTIC
/begin AXIS_PTS CAL_revlimit_speedbase_manual_sport_X_coolant_temp "Calibration: X-axis (coolant temp) for the rev-limit speedbase manual sport table (°C = val*5/8−40; 4-element array)." 0x4000C01A NO_INPUT_QUANTITY RL_AXIS_UWORD 0 CM_u8_temp_5_8_40c 4 -40 40919.375 /end AXIS_PTS
/begin AXIS_PTS CAL_revlimit_speedbase_manual_sport_Y_timer "Calibration: Y-axis (timer) for the rev-limit speedbase manual sport table (ms = val*5; 4-element array)." 0x4000C022 NO_INPUT_QUANTITY RL_AXIS_UWORD 0 CM_u8_time_5ms 4 0 327675 /end AXIS_PTS
/begin CHARACTERISTIC CAL_revlimit_speedbase_manual_sport "Calibration: rev-limit speedbase manual sport (RPM; 16-element array)." MAP 0x4000C02A RL_VALUE_UWORD 0 CM_u16_rspeed_rpm 0 65535
 /begin AXIS_DESCR COM_AXIS NO_INPUT_QUANTITY CM_u8_temp_5_8_40c 4 -40 40919.375 AXIS_PTS_REF CAL_revlimit_speedbase_manual_sport_X_coolant_temp /end AXIS_DESCR
 /begin AXIS_DESCR COM_AXIS NO_INPUT_QUANTITY CM_u8_time_5ms 4 0 327675 AXIS_PTS_REF CAL_revlimit_speedbase_manual_sport_Y_timer /end AXIS_DESCR
/end CHARACTERISTIC
/begin AXIS_PTS CAL_revlimit_speedbase_ips_tour_X_coolant_temp "Calibration: X-axis (coolant temp) for the rev-limit speedbase IPS tour table (°C = val*5/8−40; 4-element array)." 0x4000C04A NO_INPUT_QUANTITY RL_AXIS_UWORD 0 CM_u8_temp_5_8_40c 4 -40 40919.375 /end AXIS_PTS
/begin AXIS_PTS CAL_revlimit_speedbase_ips_tour_Y_timer "Calibration: Y-axis (timer) for the rev-limit speedbase IPS tour table (ms = val*5; 4-element array)." 0x4000C052 NO_INPUT_QUANTITY RL_AXIS_UWORD 0 CM_u8_time_5ms 4 0 327675 /end AXIS_PTS
/begin CHARACTERISTIC CAL_revlimit_speedbase_ips_tour "Calibration: rev-limit speedbase IPS tour (RPM; 16-element array)." MAP 0x4000C05A RL_VALUE_UWORD 0 CM_u16_rspeed_rpm 0 65535
 /begin AXIS_DESCR COM_AXIS NO_INPUT_QUANTITY CM_u8_temp_5_8_40c 4 -40 40919.375 AXIS_PTS_REF CAL_revlimit_speedbase_ips_tour_X_coolant_temp /end AXIS_DESCR
 /begin AXIS_DESCR COM_AXIS NO_INPUT_QUANTITY CM_u8_time_5ms 4 0 327675 AXIS_PTS_REF CAL_revlimit_speedbase_ips_tour_Y_timer /end AXIS_DESCR
/end CHARACTERISTIC
/begin AXIS_PTS CAL_revlimit_speedbase_ips_sport_X_coolant_temp "Calibration: X-axis (coolant temp) for the rev-limit speedbase IPS sport table (°C = val*5/8−40; 4-element array)." 0x4000C07A NO_INPUT_QUANTITY RL_AXIS_UWORD 0 CM_u8_temp_5_8_40c 4 -40 40919.375 /end AXIS_PTS
/begin AXIS_PTS CAL_revlimit_speedbase_ips_sport_Y_timer "Calibration: Y-axis (timer) for the rev-limit speedbase IPS sport table (ms = val*5; 4-element array)." 0x4000C082 NO_INPUT_QUANTITY RL_AXIS_UWORD 0 CM_u8_time_5ms 4 0 327675 /end AXIS_PTS
/begin CHARACTERISTIC CAL_revlimit_speedbase_ips_sport "Calibration: rev-limit speedbase IPS sport (RPM; 16-element array)." MAP 0x4000C08A RL_VALUE_UWORD 0 CM_u16_rspeed_rpm 0 65535
 /begin AXIS_DESCR COM_AXIS NO_INPUT_QUANTITY CM_u8_temp_5_8_40c 4 -40 40919.375 AXIS_PTS_REF CAL_revlimit_speedbase_ips_sport_X_coolant_temp /end AXIS_DESCR
 /begin AXIS_DESCR COM_AXIS NO_INPUT_QUANTITY CM_u8_time_5ms 4 0 327675 AXIS_PTS_REF CAL_revlimit_speedbase_ips_sport_Y_timer /end AXIS_DESCR
/end CHARACTERISTIC
/begin AXIS_PTS CAL_revlimit_coldstart_rpm_envelope_X_index "Calibration: X-axis (index) for the rev-limit coldstart RPM envelope table (4-element array)." 0x4000C0AA NO_INPUT_QUANTITY RL_AXIS_UWORD 0 NO_COMPU_METHOD 4 0 65535 /end AXIS_PTS
/begin CHARACTERISTIC CAL_revlimit_coldstart_rpm_envelope "Calibration: rev-limit coldstart RPM envelope (RPM; 4-element array)." CURVE 0x4000C0B2 RL_VALUE_UWORD 0 CM_u16_rspeed_rpm 0 65535
 /begin AXIS_DESCR COM_AXIS NO_INPUT_QUANTITY NO_COMPU_METHOD 4 0 65535 AXIS_PTS_REF CAL_revlimit_coldstart_rpm_envelope_X_index /end AXIS_DESCR
/end CHARACTERISTIC
/begin AXIS_PTS CAL_idle_comp_carspeed_ips_X_carspeed "Calibration: X-axis (carspeed) for the idle compensation carspeed IPS table (km/h; 8-element array)." 0x4000C0BA NO_INPUT_QUANTITY RL_AXIS_UBYTE 0 CM_u8_speed_kph 8 0 255 /end AXIS_PTS
/begin CHARACTERISTIC CAL_idle_comp_carspeed_ips "Calibration: idle compensation carspeed IPS (RPM = val*4; 8-element array)." CURVE 0x4000C0C2 RL_VALUE_UBYTE 0 CM_u8_rspeed_4rpm 0 1020
 /begin AXIS_DESCR COM_AXIS NO_INPUT_QUANTITY CM_u8_speed_kph 8 0 255 AXIS_PTS_REF CAL_idle_comp_carspeed_ips_X_carspeed /end AXIS_DESCR
/end CHARACTERISTIC
/begin AXIS_PTS CAL_ign_min_engine_off_X_engine_speed "Calibration: X-axis (engine speed) for the ignition minimum engine off table (RPM = val*125/4+500; 3-element array)." 0x4000C0CB NO_INPUT_QUANTITY RL_AXIS_UBYTE 0 CM_u8_rspeed_125_4_500rpm 3 500 8468.75 /end AXIS_PTS
/begin AXIS_PTS CAL_ign_min_engine_off_Y_load "Calibration: Y-axis (load) for the ignition minimum engine off table (mg/stroke = val*4; 3-element array)." 0x4000C0CE NO_INPUT_QUANTITY RL_AXIS_UBYTE 0 CM_u8_load_4mg_stroke 3 0 1020 /end AXIS_PTS
/begin CHARACTERISTIC CAL_ign_min_engine_off "Calibration: ignition minimum engine off (° = val/4−20; 9-element array)." MAP 0x4000C0D1 RL_VALUE_UBYTE 0 CM_u8_angle_1_4_20deg -20 43.75
 /begin AXIS_DESCR COM_AXIS NO_INPUT_QUANTITY CM_u8_rspeed_125_4_500rpm 3 500 8468.75 AXIS_PTS_REF CAL_ign_min_engine_off_X_engine_speed /end AXIS_DESCR
 /begin AXIS_DESCR COM_AXIS NO_INPUT_QUANTITY CM_u8_load_4mg_stroke 3 0 1020 AXIS_PTS_REF CAL_ign_min_engine_off_Y_load /end AXIS_DESCR
/end CHARACTERISTIC
/begin AXIS_PTS CAL_inj_bank_balance_X_engine_speed "Calibration: X-axis (engine speed) for the injector bank balance table (RPM = val*125/4+500; 20-element array)." 0x4000C0DA NO_INPUT_QUANTITY RL_AXIS_UBYTE 0 CM_u8_rspeed_125_4_500rpm 20 500 8468.75 /end AXIS_PTS
/begin AXIS_PTS CAL_inj_bank_balance_Y_load "Calibration: Y-axis (load) for the injector bank balance table (mg/stroke = val*1173; 20-element array)." 0x4000C0EE NO_INPUT_QUANTITY RL_AXIS_UBYTE 0 CM_u8_load_1173mg_255stroke 20 0 1173 /end AXIS_PTS
/begin CHARACTERISTIC CAL_inj_bank_balance "Calibration: injector bank balance (val/200; 400-element array)." MAP 0x4000C102 RL_VALUE_UBYTE 0 CM_u8_factor_1_200 0 127.5
 /begin AXIS_DESCR COM_AXIS NO_INPUT_QUANTITY CM_u8_rspeed_125_4_500rpm 20 500 8468.75 AXIS_PTS_REF CAL_inj_bank_balance_X_engine_speed /end AXIS_DESCR
 /begin AXIS_DESCR COM_AXIS NO_INPUT_QUANTITY CM_u8_load_1173mg_255stroke 20 0 1173 AXIS_PTS_REF CAL_inj_bank_balance_Y_load /end AXIS_DESCR
/end CHARACTERISTIC
/begin AXIS_PTS CAL_ign_mbt_modeled_X_engine_speed "Calibration: X-axis (engine speed) for the ignition MBT modeled table (RPM = val*125/4+500; 20-element array)." 0x4000C292 NO_INPUT_QUANTITY RL_AXIS_UBYTE 0 CM_u8_rspeed_125_4_500rpm 20 500 8468.75 /end AXIS_PTS
/begin AXIS_PTS CAL_ign_mbt_modeled_Y_load "Calibration: Y-axis (load) for the ignition MBT modeled table (mg/stroke = val*1173; 20-element array)." 0x4000C2A6 NO_INPUT_QUANTITY RL_AXIS_UBYTE 0 CM_u8_load_1173mg_255stroke 20 0 1173 /end AXIS_PTS
/begin CHARACTERISTIC CAL_ign_mbt_modeled "Calibration: ignition MBT modeled (° = val/4−10; 400-element array)." MAP 0x4000C2BA RL_VALUE_UBYTE 0 CM_u8_angle_1_4_10deg -10 53.75
 /begin AXIS_DESCR COM_AXIS NO_INPUT_QUANTITY CM_u8_rspeed_125_4_500rpm 20 500 8468.75 AXIS_PTS_REF CAL_ign_mbt_modeled_X_engine_speed /end AXIS_DESCR
 /begin AXIS_DESCR COM_AXIS NO_INPUT_QUANTITY CM_u8_load_1173mg_255stroke 20 0 1173 AXIS_PTS_REF CAL_ign_mbt_modeled_Y_load /end AXIS_DESCR
/end CHARACTERISTIC
/begin AXIS_PTS CAL_inj_post_start_transient_scaler_X_mass_accum "u8_mass_32mg[8]" 0x4000C44A NO_INPUT_QUANTITY RL_AXIS_UBYTE 0 CM_u8_mass_32mg 8 0 8160 /end AXIS_PTS
/begin AXIS_PTS CAL_inj_post_start_transient_scaler_Y_coolant_temp "u8_temp_5/8-40c[8]" 0x4000C452 NO_INPUT_QUANTITY RL_AXIS_UBYTE 0 CM_u8_temp_5_8_40c 8 -40 119.375 /end AXIS_PTS
/begin CHARACTERISTIC CAL_inj_post_start_transient_scaler "u8_factor_1/255[64]" MAP 0x4000C45A RL_VALUE_UBYTE 0 CM_u8_factor_1_255 0 100
 /begin AXIS_DESCR COM_AXIS NO_INPUT_QUANTITY CM_u8_mass_32mg 8 0 8160 AXIS_PTS_REF CAL_inj_post_start_transient_scaler_X_mass_accum /end AXIS_DESCR
 /begin AXIS_DESCR COM_AXIS NO_INPUT_QUANTITY CM_u8_temp_5_8_40c 8 -40 119.375 AXIS_PTS_REF CAL_inj_post_start_transient_scaler_Y_coolant_temp /end AXIS_DESCR
/end CHARACTERISTIC
/begin AXIS_PTS CAL_inj_coldstart_enrichment_X_coolant_temp "Calibration: X-axis (coolant temp) for the injector coldstart enrichment table (°C = val*5/8−40; 8-element array)." 0x4000C49A NO_INPUT_QUANTITY RL_AXIS_UBYTE 0 CM_u8_temp_5_8_40c 8 -40 119.375 /end AXIS_PTS
/begin AXIS_PTS CAL_inj_coldstart_enrichment_Y_maf_accum "Calibration: Y-axis (maf accum) for the injector coldstart enrichment table (8-element array)." 0x4000C4A2 NO_INPUT_QUANTITY RL_AXIS_UBYTE 0 NO_COMPU_METHOD 8 0 255 /end AXIS_PTS
/begin CHARACTERISTIC CAL_inj_coldstart_enrichment "Calibration: injector coldstart enrichment (64-element array)." MAP 0x4000C4AA RL_VALUE_UBYTE 0 NO_COMPU_METHOD 0 255
 /begin AXIS_DESCR COM_AXIS NO_INPUT_QUANTITY CM_u8_temp_5_8_40c 8 -40 119.375 AXIS_PTS_REF CAL_inj_coldstart_enrichment_X_coolant_temp /end AXIS_DESCR
 /begin AXIS_DESCR COM_AXIS NO_INPUT_QUANTITY NO_COMPU_METHOD 8 0 255 AXIS_PTS_REF CAL_inj_coldstart_enrichment_Y_maf_accum /end AXIS_DESCR
/end CHARACTERISTIC
/begin AXIS_PTS CAL_load_baro_gain_X_rpm "Calibration: X-axis (rpm) for the load baro gain table (RPM = val*125/4+500; 16-element array)." 0x4000C51A NO_INPUT_QUANTITY RL_AXIS_UBYTE 0 CM_u8_rspeed_125_4_500rpm 16 500 8468.75 /end AXIS_PTS
/begin AXIS_PTS CAL_load_baro_gain_Y_load "Calibration: Y-axis (load) for the load baro gain table (mg/stroke = val*4; 16-element array)." 0x4000C52A NO_INPUT_QUANTITY RL_AXIS_UBYTE 0 CM_u8_load_4mg_stroke 16 0 1020 /end AXIS_PTS
/begin CHARACTERISTIC CAL_load_baro_gain "Calibration: load baro gain (256-element array)." MAP 0x4000C53A RL_VALUE_UBYTE 0 NO_COMPU_METHOD 0 255
 /begin AXIS_DESCR COM_AXIS NO_INPUT_QUANTITY CM_u8_rspeed_125_4_500rpm 16 500 8468.75 AXIS_PTS_REF CAL_load_baro_gain_X_rpm /end AXIS_DESCR
 /begin AXIS_DESCR COM_AXIS NO_INPUT_QUANTITY CM_u8_load_4mg_stroke 16 0 1020 AXIS_PTS_REF CAL_load_baro_gain_Y_load /end AXIS_DESCR
/end CHARACTERISTIC
/begin AXIS_PTS CAL_idle_comp_while_moving_X_rpm "Calibration: X-axis (rpm) for the idle compensation while moving table (RPM; 16-element array)." 0x4000C63A NO_INPUT_QUANTITY RL_AXIS_UWORD 0 CM_u16_rspeed_rpm 16 0 65535 /end AXIS_PTS
/begin CHARACTERISTIC CAL_idle_comp_while_moving "Calibration: idle compensation while moving (mg/s = val*100; 16-element array)." CURVE 0x4000C65A RL_VALUE_UWORD 0 CM_u16_flow_100mg_s 0 6553500
 /begin AXIS_DESCR COM_AXIS NO_INPUT_QUANTITY CM_u16_rspeed_rpm 16 0 65535 AXIS_PTS_REF CAL_idle_comp_while_moving_X_rpm /end AXIS_DESCR
/end CHARACTERISTIC
/begin CHARACTERISTIC CAL_cluster_shiftlight_rpm_offset_ips "Calibration: cluster shiftlight RPM offset IPS (8-element array)." VAL_BLK 0x4000C67A RL_VALUE_UBYTE 0 NO_COMPU_METHOD 0 255 NUMBER 8 /end CHARACTERISTIC
/begin CHARACTERISTIC CAL_cluster_shiftlight_rpm_offset_ips_4000C682 "Calibration: cluster shiftlight RPM offset IPS (RPM = val*8; 8-element array)." VAL_BLK 0x4000C682 RL_VALUE_UBYTE 0 CM_u8_rspeed_8rpm 0 2040 NUMBER 8 /end CHARACTERISTIC
/begin AXIS_PTS CAL_vvt_exhaust_comp_temp_X_coolant_temp "Calibration: X-axis (coolant temp) for the VVT exhaust compensation temperature table (°C = val*5/8−40; 16-element array)." 0x4000C68A NO_INPUT_QUANTITY RL_AXIS_UBYTE 0 CM_u8_temp_5_8_40c 16 -40 119.375 /end AXIS_PTS
/begin CHARACTERISTIC CAL_vvt_exhaust_comp_temp "Calibration: VVT exhaust compensation temperature (° = val/4; 16-element array)." CURVE 0x4000C69A RL_VALUE_UBYTE 0 CM_u8_angle_1_4deg 0 63.75
 /begin AXIS_DESCR COM_AXIS NO_INPUT_QUANTITY CM_u8_temp_5_8_40c 16 -40 119.375 AXIS_PTS_REF CAL_vvt_exhaust_comp_temp_X_coolant_temp /end AXIS_DESCR
/end CHARACTERISTIC
/begin AXIS_PTS CAL_idle_comp_steering_X_steering_load "Calibration: X-axis (steering load) for the idle compensation steering table (4-element array)." 0x4000C6AA NO_INPUT_QUANTITY RL_AXIS_UBYTE 0 NO_COMPU_METHOD 4 0 255 /end AXIS_PTS
/begin CHARACTERISTIC CAL_idle_comp_steering "Calibration: idle compensation steering (4-element array)." CURVE 0x4000C6AE RL_VALUE_UBYTE 0 NO_COMPU_METHOD 0 255
 /begin AXIS_DESCR COM_AXIS NO_INPUT_QUANTITY NO_COMPU_METHOD 4 0 255 AXIS_PTS_REF CAL_idle_comp_steering_X_steering_load /end AXIS_DESCR
/end CHARACTERISTIC
/begin AXIS_PTS CAL_ign_comp_coolant_manual_vvt_alt_X_coolant_temp "Calibration: X-axis (coolant temp) for the ignition compensation coolant manual VVT alt table (°C = val*5/8−40; 16-element array)." 0x4000C6B2 NO_INPUT_QUANTITY RL_AXIS_UBYTE 0 CM_u8_temp_5_8_40c 16 -40 119.375 /end AXIS_PTS
/begin CHARACTERISTIC CAL_ign_comp_coolant_manual_vvt_alt "Calibration: ignition compensation coolant manual VVT alt (° = val/4; 16-element array)." CURVE 0x4000C6C2 RL_VALUE_UBYTE 0 CM_u8_angle_1_4deg 0 63.75
 /begin AXIS_DESCR COM_AXIS NO_INPUT_QUANTITY CM_u8_temp_5_8_40c 16 -40 119.375 AXIS_PTS_REF CAL_ign_comp_coolant_manual_vvt_alt_X_coolant_temp /end AXIS_DESCR
/end CHARACTERISTIC
/begin AXIS_PTS CAL_ign_comp_coolant_ips_flags_X_coolant_temp "Calibration: X-axis (coolant temp) for the ignition compensation coolant IPS flags table (°C = val*5/8−40; 16-element array)." 0x4000C6D2 NO_INPUT_QUANTITY RL_AXIS_UBYTE 0 CM_u8_temp_5_8_40c 16 -40 119.375 /end AXIS_PTS
/begin CHARACTERISTIC CAL_ign_comp_coolant_ips_flags "Calibration: ignition compensation coolant IPS flags (° = val/4; 16-element array)." CURVE 0x4000C6E2 RL_VALUE_UBYTE 0 CM_u8_angle_1_4deg 0 63.75
 /begin AXIS_DESCR COM_AXIS NO_INPUT_QUANTITY CM_u8_temp_5_8_40c 16 -40 119.375 AXIS_PTS_REF CAL_ign_comp_coolant_ips_flags_X_coolant_temp /end AXIS_DESCR
/end CHARACTERISTIC
/begin AXIS_PTS CAL_vvt_intake_advance_base_low_load_X_engine_speed "Calibration: X-axis (engine speed) for the VVT intake advance base low load table (RPM = val*125/4+500; 6-element array)." 0x4000C6F2 NO_INPUT_QUANTITY RL_AXIS_UBYTE 0 CM_u8_rspeed_125_4_500rpm 6 500 8468.75 /end AXIS_PTS
/begin AXIS_PTS CAL_vvt_intake_advance_base_low_load_Y_load "Calibration: Y-axis (load) for the VVT intake advance base low load table (mg/stroke = val*4; 6-element array)." 0x4000C6F8 NO_INPUT_QUANTITY RL_AXIS_UBYTE 0 CM_u8_load_4mg_stroke 6 0 1020 /end AXIS_PTS
/begin CHARACTERISTIC CAL_vvt_intake_advance_base_low_load "Calibration: VVT intake advance base low load (° = val/4; 36-element array)." MAP 0x4000C6FE RL_VALUE_UBYTE 0 CM_u8_angle_1_4deg 0 63.75
 /begin AXIS_DESCR COM_AXIS NO_INPUT_QUANTITY CM_u8_rspeed_125_4_500rpm 6 500 8468.75 AXIS_PTS_REF CAL_vvt_intake_advance_base_low_load_X_engine_speed /end AXIS_DESCR
 /begin AXIS_DESCR COM_AXIS NO_INPUT_QUANTITY CM_u8_load_4mg_stroke 6 0 1020 AXIS_PTS_REF CAL_vvt_intake_advance_base_low_load_Y_load /end AXIS_DESCR
/end CHARACTERISTIC
/begin AXIS_PTS CAL_injtip_dfco_enable_rpm_ips_firstgear_X_coolant "Calibration: X-axis (coolant) for the injector tip-in decel fuel cut-off enable RPM IPS firstgear table (°C = val*5/8−40; 4-element array)." 0x4000C722 NO_INPUT_QUANTITY RL_AXIS_UBYTE 0 CM_u8_temp_5_8_40c 4 -40 119.375 /end AXIS_PTS
/begin CHARACTERISTIC CAL_injtip_dfco_enable_rpm_ips_firstgear "Calibration: injector tip-in decel fuel cut-off enable RPM IPS firstgear (RPM = val*50; 4-element array)." CURVE 0x4000C726 RL_VALUE_UBYTE 0 CM_u8_rspeed_50rpm 0 12750
 /begin AXIS_DESCR COM_AXIS NO_INPUT_QUANTITY CM_u8_temp_5_8_40c 4 -40 119.375 AXIS_PTS_REF CAL_injtip_dfco_enable_rpm_ips_firstgear_X_coolant /end AXIS_DESCR
/end CHARACTERISTIC
/begin AXIS_PTS CAL_vvt_exhaust_advance_base_low_load_X_engine_speed "Calibration: X-axis (engine speed) for the VVT exhaust advance base low load table (RPM = val*125/4+500; 6-element array)." 0x4000C76A NO_INPUT_QUANTITY RL_AXIS_UBYTE 0 CM_u8_rspeed_125_4_500rpm 6 500 8468.75 /end AXIS_PTS
/begin AXIS_PTS CAL_vvt_exhaust_advance_base_low_load_Y_load "Calibration: Y-axis (load) for the VVT exhaust advance base low load table (mg/stroke = val*4; 6-element array)." 0x4000C770 NO_INPUT_QUANTITY RL_AXIS_UBYTE 0 CM_u8_load_4mg_stroke 6 0 1020 /end AXIS_PTS
/begin CHARACTERISTIC CAL_vvt_exhaust_advance_base_low_load "Calibration: VVT exhaust advance base low load (° = val/4; 36-element array)." MAP 0x4000C776 RL_VALUE_UBYTE 0 CM_u8_angle_1_4deg 0 63.75
 /begin AXIS_DESCR COM_AXIS NO_INPUT_QUANTITY CM_u8_rspeed_125_4_500rpm 6 500 8468.75 AXIS_PTS_REF CAL_vvt_exhaust_advance_base_low_load_X_engine_speed /end AXIS_DESCR
 /begin AXIS_DESCR COM_AXIS NO_INPUT_QUANTITY CM_u8_load_4mg_stroke 6 0 1020 AXIS_PTS_REF CAL_vvt_exhaust_advance_base_low_load_Y_load /end AXIS_DESCR
/end CHARACTERISTIC
/begin AXIS_PTS CAL_idle_air_control_proportional_X_speed_error "Calibration: X-axis (speed error) for the idle air control proportional table (16-element array)." 0x4000C7A2 NO_INPUT_QUANTITY RL_AXIS_UWORD 0 NO_COMPU_METHOD 16 0 65535 /end AXIS_PTS
/begin CHARACTERISTIC CAL_idle_air_control_proportional "Calibration: idle air control proportional (16-element array)." CURVE 0x4000C7C2 RL_VALUE_UWORD 0 NO_COMPU_METHOD 0 65535
 /begin AXIS_DESCR COM_AXIS NO_INPUT_QUANTITY NO_COMPU_METHOD 16 0 65535 AXIS_PTS_REF CAL_idle_air_control_proportional_X_speed_error /end AXIS_DESCR
/end CHARACTERISTIC
/begin AXIS_PTS CAL_ign_comp_startup_ips_X_coolant_temp_engine_stopped "Calibration: X-axis (coolant temp engine stopped) for the ignition compensation startup IPS table (°C = val*5/8−40; 4-element array)." 0x4000C7E2 NO_INPUT_QUANTITY RL_AXIS_UWORD 0 CM_u8_temp_5_8_40c 4 -40 40919.375 /end AXIS_PTS
/begin AXIS_PTS CAL_ign_comp_startup_ips_Y_maf_accumulated "Calibration: Y-axis (maf accumulated) for the ignition compensation startup IPS table (10-element array)." 0x4000C7EA NO_INPUT_QUANTITY RL_AXIS_UWORD 0 NO_COMPU_METHOD 10 0 65535 /end AXIS_PTS
/begin CHARACTERISTIC CAL_ign_comp_startup_ips "Calibration: ignition compensation startup IPS (° = val/4; 40-element array)." MAP 0x4000C7FE RL_VALUE_SWORD 0 CM_u8_angle_1_4deg -8192 8191.75
 /begin AXIS_DESCR COM_AXIS NO_INPUT_QUANTITY CM_u8_temp_5_8_40c 4 -40 40919.375 AXIS_PTS_REF CAL_ign_comp_startup_ips_X_coolant_temp_engine_stopped /end AXIS_DESCR
 /begin AXIS_DESCR COM_AXIS NO_INPUT_QUANTITY NO_COMPU_METHOD 10 0 65535 AXIS_PTS_REF CAL_ign_comp_startup_ips_Y_maf_accumulated /end AXIS_DESCR
/end CHARACTERISTIC
/begin AXIS_PTS CAL_revlimit_trim_per_gear_X_gear "Calibration: X-axis (gear) for the rev-limit trim per gear table (7-element array)." 0x4000C84E NO_INPUT_QUANTITY RL_AXIS_UBYTE 0 NO_COMPU_METHOD 7 0 255 /end AXIS_PTS
/begin CHARACTERISTIC CAL_revlimit_trim_per_gear "Calibration: rev-limit trim per gear (RPM = val*2; 7-element array)." CURVE 0x4000C855 RL_VALUE_UBYTE 0 CM_u8_rspeed_2rpm 0 510
 /begin AXIS_DESCR COM_AXIS NO_INPUT_QUANTITY NO_COMPU_METHOD 7 0 255 AXIS_PTS_REF CAL_revlimit_trim_per_gear_X_gear /end AXIS_DESCR
/end CHARACTERISTIC
/begin AXIS_PTS CAL_revlimit_airflow_threshold_X_gear "Calibration: X-axis (gear) for the rev-limit airflow threshold table (7-element array)." 0x4000C85C NO_INPUT_QUANTITY RL_AXIS_UBYTE 0 NO_COMPU_METHOD 7 0 255 /end AXIS_PTS
/begin CHARACTERISTIC CAL_revlimit_airflow_threshold "Calibration: rev-limit airflow threshold (g/s = val*2; 7-element array)." CURVE 0x4000C863 RL_VALUE_UBYTE 0 CM_u8_flow_2g_s 0 510
 /begin AXIS_DESCR COM_AXIS NO_INPUT_QUANTITY NO_COMPU_METHOD 7 0 255 AXIS_PTS_REF CAL_revlimit_airflow_threshold_X_gear /end AXIS_DESCR
/end CHARACTERISTIC
/begin AXIS_PTS CAL_ecu_engine_speed_target_tour_X_pps "Calibration: X-axis (pps) for the ECU engine speed target tour table (val/1023; 10-element array)." 0x4000C86A NO_INPUT_QUANTITY RL_AXIS_UWORD 0 CM_u16_factor_1_1023 10 0 6406.15835777126 /end AXIS_PTS
/begin CHARACTERISTIC CAL_ecu_engine_speed_target_tour "Calibration: ECU engine speed target tour (RPM = val/4; 10-element array)." CURVE 0x4000C87E RL_VALUE_UWORD 0 CM_u16_rspeed_1_4rpm 0 16383.75
 /begin AXIS_DESCR COM_AXIS NO_INPUT_QUANTITY CM_u16_factor_1_1023 10 0 6406.15835777126 AXIS_PTS_REF CAL_ecu_engine_speed_target_tour_X_pps /end AXIS_DESCR
/end CHARACTERISTIC
/begin AXIS_PTS CAL_idle_error_correction_unknown_X_speed_error "Calibration: X-axis (speed error) for the idle error correction table (16-element array)." 0x4000C892 NO_INPUT_QUANTITY RL_AXIS_UWORD 0 NO_COMPU_METHOD 16 0 65535 /end AXIS_PTS
/begin CHARACTERISTIC CAL_idle_error_correction_unknown "Calibration: idle error correction (16-element array)." CURVE 0x4000C8B2 RL_VALUE_UWORD 0 NO_COMPU_METHOD 0 65535
 /begin AXIS_DESCR COM_AXIS NO_INPUT_QUANTITY NO_COMPU_METHOD 16 0 65535 AXIS_PTS_REF CAL_idle_error_correction_unknown_X_speed_error /end AXIS_DESCR
/end CHARACTERISTIC
/begin AXIS_PTS CAL_dca_tps_limit_manual_X_time "Calibration: X-axis (time) for the drive-cycle-assist throttle position limit manual table (ms = val*50; 8-element array)." 0x4000C8D2 NO_INPUT_QUANTITY RL_AXIS_UBYTE 0 CM_u8_time_50ms 8 0 12750 /end AXIS_PTS
/begin CHARACTERISTIC CAL_dca_tps_limit_manual "Calibration: drive-cycle-assist throttle position limit manual (val/255; 8-element array)." CURVE 0x4000C8DA RL_VALUE_UBYTE 0 CM_u8_factor_1_255 0 100
 /begin AXIS_DESCR COM_AXIS NO_INPUT_QUANTITY CM_u8_time_50ms 8 0 12750 AXIS_PTS_REF CAL_dca_tps_limit_manual_X_time /end AXIS_DESCR
/end CHARACTERISTIC
/begin AXIS_PTS CAL_dca_unknown_ips_nolc_X_time "Calibration: X-axis (time) for the drive-cycle-assist IPS nolc table (ms = val*50; 8-element array)." 0x4000C8E2 NO_INPUT_QUANTITY RL_AXIS_UBYTE 0 CM_u8_time_50ms 8 0 12750 /end AXIS_PTS
/begin CHARACTERISTIC CAL_dca_unknown_ips_nolc "Calibration: drive-cycle-assist IPS nolc (val/255; 8-element array)." CURVE 0x4000C8EA RL_VALUE_UBYTE 0 CM_u8_factor_1_255 0 100
 /begin AXIS_DESCR COM_AXIS NO_INPUT_QUANTITY CM_u8_time_50ms 8 0 12750 AXIS_PTS_REF CAL_dca_unknown_ips_nolc_X_time /end AXIS_DESCR
/end CHARACTERISTIC
/begin AXIS_PTS CAL_idle_comp_misfire_X_failed_cyl_count "Calibration: X-axis (failed cyl count) for the idle compensation misfire table (8-element array)." 0x4000C8F2 NO_INPUT_QUANTITY RL_AXIS_UBYTE 0 NO_COMPU_METHOD 8 0 255 /end AXIS_PTS
/begin CHARACTERISTIC CAL_idle_comp_misfire "Calibration: idle compensation misfire (g/s; 8-element array)." CURVE 0x4000C8FA RL_VALUE_UBYTE 0 CM_u8_flow_g_s 0 255
 /begin AXIS_DESCR COM_AXIS NO_INPUT_QUANTITY NO_COMPU_METHOD 8 0 255 AXIS_PTS_REF CAL_idle_comp_misfire_X_failed_cyl_count /end AXIS_DESCR
/end CHARACTERISTIC
/begin CHARACTERISTIC CAL_dca_tps_limit_ips_x_time "Calibration: drive-cycle-assist throttle position limit IPS x time (ms = val*50; 8-element array)." VAL_BLK 0x4000C902 RL_VALUE_UBYTE 0 CM_u8_time_50ms 0 12750 NUMBER 8 /end CHARACTERISTIC
/begin CHARACTERISTIC CAL_dca_tps_limit_ips "Calibration: drive-cycle-assist throttle position limit IPS (val/255; 8-element array)." VAL_BLK 0x4000C90A RL_VALUE_UBYTE 0 CM_u8_factor_1_255 0 100 NUMBER 8 /end CHARACTERISTIC
/begin AXIS_PTS CAL_tpstarget_tour_shifting_X_pps "Calibration: X-axis (pps) for the tpstarget tour shifting table (val/1023; 16-element array)." 0x4000C912 NO_INPUT_QUANTITY RL_AXIS_UWORD 0 CM_u16_factor_1_1023 16 0 6406.15835777126 /end AXIS_PTS
/begin CHARACTERISTIC CAL_tpstarget_tour_shifting "Calibration: tpstarget tour shifting (val/1023; 16-element array)." CURVE 0x4000C932 RL_VALUE_UWORD 0 CM_u16_factor_1_1023 0 6406.15835777126
 /begin AXIS_DESCR COM_AXIS NO_INPUT_QUANTITY CM_u16_factor_1_1023 16 0 6406.15835777126 AXIS_PTS_REF CAL_tpstarget_tour_shifting_X_pps /end AXIS_DESCR
/end CHARACTERISTIC
/begin AXIS_PTS CAL_tpstarget_sport_shifting_X_pps "Calibration: X-axis (pps) for the tpstarget sport shifting table (val/1023; 16-element array)." 0x4000C952 NO_INPUT_QUANTITY RL_AXIS_UWORD 0 CM_u16_factor_1_1023 16 0 6406.15835777126 /end AXIS_PTS
/begin CHARACTERISTIC CAL_tpstarget_sport_shifting "Calibration: tpstarget sport shifting (val/1023; 16-element array)." CURVE 0x4000C972 RL_VALUE_UWORD 0 CM_u16_factor_1_1023 0 6406.15835777126
 /begin AXIS_DESCR COM_AXIS NO_INPUT_QUANTITY CM_u16_factor_1_1023 16 0 6406.15835777126 AXIS_PTS_REF CAL_tpstarget_sport_shifting_X_pps /end AXIS_DESCR
/end CHARACTERISTIC
/begin AXIS_PTS CAL_revlimit_airflow_gain_from_rpm_delta_X_gear "Calibration: X-axis (gear) for the rev-limit airflow gain from RPM delta table (7-element array)." 0x4000C992 NO_INPUT_QUANTITY RL_AXIS_UBYTE 0 NO_COMPU_METHOD 7 0 255 /end AXIS_PTS
/begin CHARACTERISTIC CAL_revlimit_airflow_gain_from_rpm_delta "Calibration: rev-limit airflow gain from RPM delta (val/255; 7-element array)." CURVE 0x4000C999 RL_VALUE_UBYTE 0 CM_u8_factor_1_255 0 100
 /begin AXIS_DESCR COM_AXIS NO_INPUT_QUANTITY NO_COMPU_METHOD 7 0 255 AXIS_PTS_REF CAL_revlimit_airflow_gain_from_rpm_delta_X_gear /end AXIS_DESCR
/end CHARACTERISTIC
/begin AXIS_PTS CAL_revlimit_airflow_gain_from_integrator_X_gear "Calibration: X-axis (gear) for the rev-limit airflow gain from integrator table (7-element array)." 0x4000C9A0 NO_INPUT_QUANTITY RL_AXIS_UBYTE 0 NO_COMPU_METHOD 7 0 255 /end AXIS_PTS
/begin CHARACTERISTIC CAL_revlimit_airflow_gain_from_integrator "Calibration: rev-limit airflow gain from integrator (val/255; 7-element array)." CURVE 0x4000C9A7 RL_VALUE_UBYTE 0 CM_u8_factor_1_255 0 100
 /begin AXIS_DESCR COM_AXIS NO_INPUT_QUANTITY NO_COMPU_METHOD 7 0 255 AXIS_PTS_REF CAL_revlimit_airflow_gain_from_integrator_X_gear /end AXIS_DESCR
/end CHARACTERISTIC
/begin AXIS_PTS CAL_revlimit_airflow_gain_from_rpm_X_gear "Calibration: X-axis (gear) for the rev-limit airflow gain from RPM table (7-element array)." 0x4000C9AE NO_INPUT_QUANTITY RL_AXIS_UBYTE 0 NO_COMPU_METHOD 7 0 255 /end AXIS_PTS
/begin CHARACTERISTIC CAL_revlimit_airflow_gain_from_rpm "Calibration: rev-limit airflow gain from RPM (val/255; 7-element array)." CURVE 0x4000C9B5 RL_VALUE_UBYTE 0 CM_u8_factor_1_255 0 100
 /begin AXIS_DESCR COM_AXIS NO_INPUT_QUANTITY NO_COMPU_METHOD 7 0 255 AXIS_PTS_REF CAL_revlimit_airflow_gain_from_rpm_X_gear /end AXIS_DESCR
/end CHARACTERISTIC
/begin CHARACTERISTIC CAL_obd_ii_coolant_warmup_thresholds "Calibration: OBD-II coolant warmup thresholds (2-element array)." VAL_BLK 0x4000C9C4 RL_VALUE_UBYTE 0 NO_COMPU_METHOD 0 255 NUMBER 2 /end CHARACTERISTIC
/begin CHARACTERISTIC CAL_obd_ii_similar_cond_load_window "undefined1" VALUE 0x4000C9C7 RL_VALUE_UBYTE 0 NO_COMPU_METHOD 0 255 /end CHARACTERISTIC
/begin CHARACTERISTIC CAL_obd_ii_cat_monitor_maf_min "undefined1" VALUE 0x4000C9C9 RL_VALUE_UBYTE 0 NO_COMPU_METHOD 0 255 /end CHARACTERISTIC
/begin CHARACTERISTIC CAL_obd_ii_o2_lean_period_excess_max "undefined2" VALUE 0x4000C9CE RL_VALUE_UWORD 0 NO_COMPU_METHOD 0 65535 /end CHARACTERISTIC
/begin CHARACTERISTIC CAL_obd_ii_o2_rich_period_excess_max "undefined2" VALUE 0x4000C9D0 RL_VALUE_UWORD 0 NO_COMPU_METHOD 0 65535 /end CHARACTERISTIC
/begin CHARACTERISTIC CAL_oil_pressure_low_timer_threshold "Calibration: oil pressure low timer threshold." VALUE 0x4000C9D6 RL_VALUE_UBYTE 0 NO_COMPU_METHOD 0 255 /end CHARACTERISTIC
/begin CHARACTERISTIC CAL_cac_dutycycle_tolerance "Calibration: charge-air-cooler dutycycle tolerance (val/255)." VALUE 0x4000C9D7 RL_VALUE_UBYTE 0 CM_u8_factor_1_255 0 100 /end CHARACTERISTIC
/begin CHARACTERISTIC CAL_cluster_test_enable_ "Calibration: cluster test enable (boolean flag)." VALUE 0x4000C9D8 RL_VALUE_UBYTE 0 NO_COMPU_METHOD 0 255 /end CHARACTERISTIC
/begin CHARACTERISTIC CAL_obd_ii_monitor_debounce_cycles "Calibration: OBD-II monitor debounce cycles." VALUE 0x4000C9D9 RL_VALUE_UBYTE 0 NO_COMPU_METHOD 0 255 /end CHARACTERISTIC
/begin CHARACTERISTIC CAL_evap_pressure_filter_coeff "undefined1" VALUE 0x4000C9E1 RL_VALUE_UBYTE 0 NO_COMPU_METHOD 0 255 /end CHARACTERISTIC
/begin CHARACTERISTIC CAL_obd_ii_o2_sensor1_voltage_threshold "undefined2" VALUE 0x4000C9E6 RL_VALUE_UWORD 0 NO_COMPU_METHOD 0 65535 /end CHARACTERISTIC
/begin CHARACTERISTIC CAL_obd_ii_o2_sensor1_voltage_limit "undefined2" VALUE 0x4000C9E8 RL_VALUE_UWORD 0 NO_COMPU_METHOD 0 65535 /end CHARACTERISTIC
/begin CHARACTERISTIC CAL_obd_ii_o2_sensor2_voltage_threshold "undefined2" VALUE 0x4000C9EA RL_VALUE_UWORD 0 NO_COMPU_METHOD 0 65535 /end CHARACTERISTIC
/begin CHARACTERISTIC CAL_obd_ii_o2_sensor2_voltage_limit "undefined2" VALUE 0x4000C9EC RL_VALUE_UWORD 0 NO_COMPU_METHOD 0 65535 /end CHARACTERISTIC
/begin CHARACTERISTIC CAL_sensor_iat_voltage_threshold "Calibration: sensor intake air temp voltage threshold (V = val*5/1023; 2-element array)." VAL_BLK 0x4000C9EE RL_VALUE_UWORD 0 CM_u16_voltage_5_1023v 0 320.307917888563 NUMBER 2 /end CHARACTERISTIC
/begin CHARACTERISTIC CAL_obd_ii_cat_monitor_ect_min "undefined1" VALUE 0x4000C9F4 RL_VALUE_UBYTE 0 NO_COMPU_METHOD 0 255 /end CHARACTERISTIC
/begin CHARACTERISTIC CAL_obd_ii_P0420_maf_min "undefined2" VALUE 0x4000C9F6 RL_VALUE_UWORD 0 NO_COMPU_METHOD 0 65535 /end CHARACTERISTIC
/begin CHARACTERISTIC CAL_obd_ii_P0420_maf_max "undefined2" VALUE 0x4000C9F8 RL_VALUE_UWORD 0 NO_COMPU_METHOD 0 65535 /end CHARACTERISTIC
/begin CHARACTERISTIC CAL_obd_ii_postcat_o2_mean_filter_gain "Calibration: OBD-II postcat O2 voltage scaling." VALUE 0x4000C9FA RL_VALUE_UBYTE 0 CM_u8_factor_1_2560 0 9.9609375 /end CHARACTERISTIC
/begin CHARACTERISTIC CAL_obd_ii_o2_activity_rate_inband "undefined1" VALUE 0x4000C9FD RL_VALUE_UBYTE 0 NO_COMPU_METHOD 0 255 /end CHARACTERISTIC
/begin CHARACTERISTIC CAL_obd_ii_P0420_car_speed_max "undefined1" VALUE 0x4000C9FE RL_VALUE_UBYTE 0 NO_COMPU_METHOD 0 255 /end CHARACTERISTIC
/begin CHARACTERISTIC CAL_obd_ii_P0420_car_speed_min "undefined1" VALUE 0x4000C9FF RL_VALUE_UBYTE 0 NO_COMPU_METHOD 0 255 /end CHARACTERISTIC
/begin CHARACTERISTIC CAL_sensor_coolant_voltage_threshold "Calibration: sensor coolant voltage threshold (V = val*5/1023; 2-element array)." VAL_BLK 0x4000CA04 RL_VALUE_UWORD 0 CM_u16_voltage_5_1023v 0 320.307917888563 NUMBER 2 /end CHARACTERISTIC
/begin CHARACTERISTIC CAL_revlimit_limp_mode "Calibration: rev-limit limp mode (RPM)." VALUE 0x4000CA08 RL_VALUE_UWORD 0 CM_u16_rspeed_rpm 0 65535 /end CHARACTERISTIC
/begin CHARACTERISTIC CAL_obd_ii_o2_slow_response_arm_dwell "undefined2" VALUE 0x4000CA0A RL_VALUE_UWORD 0 NO_COMPU_METHOD 0 65535 /end CHARACTERISTIC
/begin CHARACTERISTIC CAL_ecu_system_voltage_threshold "Calibration: ECU system voltage threshold (2-element array)." VAL_BLK 0x4000CA0C RL_VALUE_UWORD 0 CM_u16_voltage_18_1023v 0 1153.10850439883 NUMBER 2 /end CHARACTERISTIC
/begin CHARACTERISTIC CAL_sensor_baro_sensor_failure_fallback "Calibration: sensor baro sensor failure fallback (mbar)." VALUE 0x4000CA14 RL_VALUE_UWORD 0 CM_u16_pressure_mbar 0 65535 /end CHARACTERISTIC
/begin CHARACTERISTIC CAL_obd_ii_cat_precat_o2_lean_thresh "undefined2" VALUE 0x4000CA16 RL_VALUE_UWORD 0 NO_COMPU_METHOD 0 65535 /end CHARACTERISTIC
/begin CHARACTERISTIC CAL_obd_ii_cat_precat_o2_rich_thresh "undefined2" VALUE 0x4000CA18 RL_VALUE_UWORD 0 NO_COMPU_METHOD 0 65535 /end CHARACTERISTIC
/begin CHARACTERISTIC CAL_obd_ii_postcat_o2_switch_band_lean "undefined2" VALUE 0x4000CA1A RL_VALUE_UWORD 0 NO_COMPU_METHOD 0 65535 /end CHARACTERISTIC
/begin CHARACTERISTIC CAL_obd_ii_postcat_o2_switch_band_rich "undefined2" VALUE 0x4000CA1C RL_VALUE_UWORD 0 NO_COMPU_METHOD 0 65535 /end CHARACTERISTIC
/begin CHARACTERISTIC CAL_obd_ii_cat_switch_ratio_fail_threshold "undefined2" VALUE 0x4000CA1E RL_VALUE_UWORD 0 NO_COMPU_METHOD 0 65535 /end CHARACTERISTIC
/begin CHARACTERISTIC CAL_obd_ii_vvt_exhaust_error_bank1_limit "undefined2" VALUE 0x4000CA20 RL_VALUE_UWORD 0 NO_COMPU_METHOD 0 65535 /end CHARACTERISTIC
/begin CHARACTERISTIC CAL_obd_P0171_ltft_limit "undefined2" VALUE 0x4000CA22 RL_VALUE_UWORD 0 NO_COMPU_METHOD 0 65535 /end CHARACTERISTIC
/begin CHARACTERISTIC CAL_obd_P0172_ltft_limit "undefined2" VALUE 0x4000CA24 RL_VALUE_UWORD 0 NO_COMPU_METHOD 0 65535 /end CHARACTERISTIC
/begin CHARACTERISTIC CAL_obd_ii_o2_response_car_speed_min "undefined1" VALUE 0x4000CA26 RL_VALUE_UBYTE 0 NO_COMPU_METHOD 0 255 /end CHARACTERISTIC
/begin CHARACTERISTIC CAL_obd_ii_o2_response_car_speed_max "undefined1" VALUE 0x4000CA27 RL_VALUE_UBYTE 0 NO_COMPU_METHOD 0 255 /end CHARACTERISTIC
/begin CHARACTERISTIC CAL_obd_ii_o2_transition_count "undefined1" VALUE 0x4000CA28 RL_VALUE_UBYTE 0 NO_COMPU_METHOD 0 255 /end CHARACTERISTIC
/begin CHARACTERISTIC CAL_obd_ii_mode06_o2_switch_time_min "uint16_t" VALUE 0x4000CA2A RL_VALUE_UWORD 0 NO_COMPU_METHOD 0 65535 /end CHARACTERISTIC
/begin CHARACTERISTIC CAL_obd_ii_mode06_o2_switch_time_max "undefined2" VALUE 0x4000CA2C RL_VALUE_UWORD 0 NO_COMPU_METHOD 0 65535 /end CHARACTERISTIC
/begin CHARACTERISTIC CAL_misfire_enable_coolant_min "Calibration: misfire enable coolant minimum (°C = val*5/8−40)." VALUE 0x4000CA30 RL_VALUE_UBYTE 0 CM_u8_temp_5_8_40c -40 119.375 /end CHARACTERISTIC
/begin CHARACTERISTIC CAL_misfire_enable_coolant_max "Calibration: misfire enable coolant maximum (°C = val*5/8−40)." VALUE 0x4000CA31 RL_VALUE_UBYTE 0 CM_u8_temp_5_8_40c -40 119.375 /end CHARACTERISTIC
/begin CHARACTERISTIC CAL_cluster_coolant_warning "Calibration: cluster coolant warning (°C = val*5/8−40; 2-element array)." VAL_BLK 0x4000CA32 RL_VALUE_UBYTE 0 CM_u8_temp_5_8_40c -40 119.375 NUMBER 2 /end CHARACTERISTIC
/begin CHARACTERISTIC CAL_misfire_enable_rpm_min "Calibration: misfire enable RPM minimum (RPM = val*125/4+500)." VALUE 0x4000CA36 RL_VALUE_UBYTE 0 CM_u8_rspeed_125_4_500rpm 500 8468.75 /end CHARACTERISTIC
/begin CHARACTERISTIC CAL_misfire_enable_rpm_max "Calibration: misfire enable RPM maximum (RPM = val*125/4+500)." VALUE 0x4000CA37 RL_VALUE_UBYTE 0 CM_u8_rspeed_125_4_500rpm 500 8468.75 /end CHARACTERISTIC
/begin CHARACTERISTIC CAL_obd_ii_P0500_test_time "undefined2" VALUE 0x4000CA38 RL_VALUE_UWORD 0 NO_COMPU_METHOD 0 65535 /end CHARACTERISTIC
/begin CHARACTERISTIC CAL_misfire_failed_bank_scaling "Calibration: misfire failed bank scaling (val/255)." VALUE 0x4000CA3A RL_VALUE_UBYTE 0 CM_u8_factor_1_255 0 100 /end CHARACTERISTIC
/begin CHARACTERISTIC CAL_obd_ii_P0500_car_speed_min "u8_speed_kph" VALUE 0x4000CA3C RL_VALUE_UBYTE 0 CM_u8_speed_kph 0 255 /end CHARACTERISTIC
/begin CHARACTERISTIC CAL_obd_ii_crank_cam_error_count_max "undefined1" VALUE 0x4000CA3D RL_VALUE_UBYTE 0 NO_COMPU_METHOD 0 255 /end CHARACTERISTIC
/begin CHARACTERISTIC CAL_obd_ii_o2_activity_rate_outband "undefined1" VALUE 0x4000CA3E RL_VALUE_UBYTE 0 NO_COMPU_METHOD 0 255 /end CHARACTERISTIC
/begin CHARACTERISTIC CAL_idle_learn_ac_on_param "undefined1" VALUE 0x4000CA44 RL_VALUE_UBYTE 0 NO_COMPU_METHOD 0 255 /end CHARACTERISTIC
/begin CHARACTERISTIC CAL_obd_ii_idle_learn_limit "undefined1" VALUE 0x4000CA45 RL_VALUE_UBYTE 0 NO_COMPU_METHOD 0 255 /end CHARACTERISTIC
/begin CHARACTERISTIC CAL_obd_ii_idle_error_fail_count "undefined1" VALUE 0x4000CA46 RL_VALUE_UBYTE 0 NO_COMPU_METHOD 0 255 /end CHARACTERISTIC
/begin CHARACTERISTIC CAL_vvt_zero_target_timeout "Calibration: VVT zero target timeout (ms = val*100)." VALUE 0x4000CA47 RL_VALUE_UBYTE 0 CM_u8_time_100ms 0 25500 /end CHARACTERISTIC
/begin CHARACTERISTIC CAL_obd_ii_vvt_error_fail_count "undefined1" VALUE 0x4000CA49 RL_VALUE_UBYTE 0 NO_COMPU_METHOD 0 255 /end CHARACTERISTIC
/begin CHARACTERISTIC CAL_wheel_speed_rate_min "Calibration: wheel speed rate minimum." VALUE 0x4000CA54 RL_VALUE_UWORD 0 NO_COMPU_METHOD 0 65535 /end CHARACTERISTIC
/begin CHARACTERISTIC CAL_obd_P0171_learn_time_threshold "undefined1" VALUE 0x4000CA56 RL_VALUE_UBYTE 0 NO_COMPU_METHOD 0 255 /end CHARACTERISTIC
/begin CHARACTERISTIC CAL_obd_P0172_learn_time_threshold "undefined1" VALUE 0x4000CA57 RL_VALUE_UBYTE 0 NO_COMPU_METHOD 0 255 /end CHARACTERISTIC
/begin CHARACTERISTIC CAL_coolant_temp_threshold "undefined1" VALUE 0x4000CA5C RL_VALUE_UBYTE 0 NO_COMPU_METHOD 0 255 /end CHARACTERISTIC
/begin CHARACTERISTIC CAL_obd_ii_o2_sensors_present "Calibration: OBD-II O2 sensors present." VALUE 0x4000CA5D RL_VALUE_UBYTE 0 NO_COMPU_METHOD 0 255 /end CHARACTERISTIC
/begin CHARACTERISTIC CAL_obd_ii_standards_supported "Calibration: OBD-II standards supported." VALUE 0x4000CA5E RL_VALUE_UBYTE 0 NO_COMPU_METHOD 0 255 /end CHARACTERISTIC
/begin CHARACTERISTIC CAL_obd_ii_o2_slow_response_sample_count "undefined1" VALUE 0x4000CA5F RL_VALUE_UBYTE 0 NO_COMPU_METHOD 0 255 /end CHARACTERISTIC
/begin CHARACTERISTIC CAL_obd_ii_o2_r2l_time_max_asym "undefined1" VALUE 0x4000CA60 RL_VALUE_UBYTE 0 NO_COMPU_METHOD 0 255 /end CHARACTERISTIC
/begin CHARACTERISTIC CAL_obd_ii_o2_l2r_time_max_asym "undefined1" VALUE 0x4000CA61 RL_VALUE_UBYTE 0 NO_COMPU_METHOD 0 255 /end CHARACTERISTIC
/begin CHARACTERISTIC CAL_obd_ii_o2_slow_response_limit_lean_to_rich "undefined2" VALUE 0x4000CA62 RL_VALUE_UWORD 0 NO_COMPU_METHOD 0 65535 /end CHARACTERISTIC
/begin CHARACTERISTIC CAL_obd_ii_o2_slow_response_limit_rich_to_lean "undefined2" VALUE 0x4000CA64 RL_VALUE_UWORD 0 NO_COMPU_METHOD 0 65535 /end CHARACTERISTIC
/begin CHARACTERISTIC CAL_lea_misfire_baseline_set "undefined1" VALUE 0x4000CA66 RL_VALUE_UBYTE 0 NO_COMPU_METHOD 0 255 /end CHARACTERISTIC
/begin CHARACTERISTIC CAL_obd_ii_P0133_min_coolant_temp "undefined1" VALUE 0x4000CA69 RL_VALUE_UBYTE 0 NO_COMPU_METHOD 0 255 /end CHARACTERISTIC
/begin CHARACTERISTIC CAL_sensor_o2_heater_undercurrent_threshold "Calibration: sensor O2 heater undercurrent threshold (mA)." VALUE 0x4000CA6A RL_VALUE_UWORD 0 CM_u16_current_mA 0 65535 /end CHARACTERISTIC
/begin CHARACTERISTIC CAL_sensor_o2_heater_overcurrent_threshold_mA "Calibration: sensor O2 heater overcurrent threshold mA (mA)." VALUE 0x4000CA6C RL_VALUE_UWORD 0 CM_u16_current_mA 0 65535 /end CHARACTERISTIC
/begin CHARACTERISTIC CAL_obd_ii_switch_voltage_debounce "undefined1" VALUE 0x4000CA6E RL_VALUE_UBYTE 0 NO_COMPU_METHOD 0 255 /end CHARACTERISTIC
/begin CHARACTERISTIC CAL_obd_ii_vvt_ok_pass_count "undefined1" VALUE 0x4000CA70 RL_VALUE_UBYTE 0 NO_COMPU_METHOD 0 255 /end CHARACTERISTIC
/begin CHARACTERISTIC CAL_load_mass_per_stroke_raw_limit_1 "undefined2" VALUE 0x4000CA72 RL_VALUE_UWORD 0 NO_COMPU_METHOD 0 65535 /end CHARACTERISTIC
/begin CHARACTERISTIC CAL_load_mass_per_stroke_raw_limit_2 "undefined2" VALUE 0x4000CA74 RL_VALUE_UWORD 0 NO_COMPU_METHOD 0 65535 /end CHARACTERISTIC
/begin CHARACTERISTIC CAL_engine_speed_3_threshold_2 "undefined1" VALUE 0x4000CA76 RL_VALUE_UBYTE 0 NO_COMPU_METHOD 0 255 /end CHARACTERISTIC
/begin CHARACTERISTIC CAL_engine_speed_3_threshold_3 "undefined1" VALUE 0x4000CA77 RL_VALUE_UBYTE 0 NO_COMPU_METHOD 0 255 /end CHARACTERISTIC
/begin CHARACTERISTIC CAL_obd_ii_o2_switch_time_threshold "undefined1" VALUE 0x4000CA78 RL_VALUE_UBYTE 0 NO_COMPU_METHOD 0 255 /end CHARACTERISTIC
/begin CHARACTERISTIC CAL_obd_ii_o2_switch_time_min "undefined1" VALUE 0x4000CA79 RL_VALUE_UBYTE 0 NO_COMPU_METHOD 0 255 /end CHARACTERISTIC
/begin CHARACTERISTIC CAL_sensor_accel_pedal_pos_d_threshold "Calibration: sensor accelerator pedal position d threshold (2-element array)." VAL_BLK 0x4000CA7A RL_VALUE_UWORD 0 NO_COMPU_METHOD 0 65535 NUMBER 2 /end CHARACTERISTIC
/begin CHARACTERISTIC CAL_sensor_accel_pedal_pos_e_threshold "Calibration: sensor accelerator pedal position e threshold (2-element array)." VAL_BLK 0x4000CA7E RL_VALUE_UWORD 0 NO_COMPU_METHOD 0 65535 NUMBER 2 /end CHARACTERISTIC
/begin CHARACTERISTIC CAL_tps_obd_throttle_monitor_error_parity_mask "uint16_t" VALUE 0x4000CA86 RL_VALUE_UWORD 0 NO_COMPU_METHOD 0 65535 /end CHARACTERISTIC
/begin CHARACTERISTIC CAL_obd_ii_o2_precat_diag_timer "Calibration: OBD-II O2 precat diag timer." VALUE 0x4000CA8A RL_VALUE_UWORD 0 NO_COMPU_METHOD 0 65535 /end CHARACTERISTIC
/begin CHARACTERISTIC CAL_obd_ii_mode2f_timeout "Calibration: OBD-II mode2f timeout (ms = val*100)." VALUE 0x4000CA8C RL_VALUE_UWORD 0 CM_u8_time_100ms 0 6553500 /end CHARACTERISTIC
/begin CHARACTERISTIC CAL_ecu_obd_mode2F_timer "Calibration: ECU OBD mode2F timer (ms = val*5)." VALUE 0x4000CA90 RL_VALUE_UWORD 0 CM_u8_time_5ms 0 327675 /end CHARACTERISTIC
/begin CHARACTERISTIC CAL_obd_ii_mode2f_injector_test_pulse_10us "undefined2" VALUE 0x4000CA94 RL_VALUE_UWORD 0 NO_COMPU_METHOD 0 65535 /end CHARACTERISTIC
/begin CHARACTERISTIC CAL_obd_ii_mode2f_injector_test_duration "undefined2" VALUE 0x4000CA96 RL_VALUE_UWORD 0 NO_COMPU_METHOD 0 65535 /end CHARACTERISTIC
/begin CHARACTERISTIC CAL_obd_ii_mode08_evap_test_duration "undefined2" VALUE 0x4000CA98 RL_VALUE_UWORD 0 NO_COMPU_METHOD 0 65535 /end CHARACTERISTIC
/begin CHARACTERISTIC CAL_tps_commanded_during_fault "Calibration: throttle position commanded during fault (val/255)." VALUE 0x4000CA9B RL_VALUE_UBYTE 0 CM_u8_factor_1_255 0 100 /end CHARACTERISTIC
/begin CHARACTERISTIC CAL_sensor_iat_fallback "Calibration: sensor intake air temp fallback (°C = val*5/8−40)." VALUE 0x4000CA9C RL_VALUE_UBYTE 0 CM_u8_temp_5_8_40c -40 119.375 /end CHARACTERISTIC
/begin CHARACTERISTIC CAL_sensor_coolant_temp_fallback_value "Calibration: sensor coolant temperature fallback value (°C = val*5/8−40)." VALUE 0x4000CA9D RL_VALUE_UBYTE 0 CM_u8_temp_5_8_40c -40 119.375 /end CHARACTERISTIC
/begin CHARACTERISTIC CAL_cluster_fuel_level_warning_threshold "Calibration: cluster fuel level warning threshold (gal = val/10; 2-element array)." VAL_BLK 0x4000CAA0 RL_VALUE_UWORD 0 CM_u8_volume_1_10gallon 0 6553.5 NUMBER 2 /end CHARACTERISTIC
/begin CHARACTERISTIC CAL_sensor_manifold_temp_sensor_present "Calibration: sensor manifold temperature sensor present (boolean flag)." VALUE 0x4000CAA2 RL_VALUE_UBYTE 0 NO_COMPU_METHOD 0 255 /end CHARACTERISTIC
/begin CHARACTERISTIC CAL_load_alphaN_use_tmap_density "Calibration: load alphaN use TMAP density (boolean flag)." VALUE 0x4000CAA3 RL_VALUE_UBYTE 0 NO_COMPU_METHOD 0 255 /end CHARACTERISTIC
/begin CHARACTERISTIC CAL_obd_ii_P0106_partload_rpm_window "u8_rspeed_125/4+500rpm" VALUE 0x4000CAA6 RL_VALUE_UBYTE 0 CM_u8_rspeed_125_4_500rpm 500 8468.75 /end CHARACTERISTIC
/begin CHARACTERISTIC CAL_tmap_use_for_load "Calibration: TMAP use for load (boolean flag)." VALUE 0x4000CAAC RL_VALUE_UBYTE 0 NO_COMPU_METHOD 0 255 /end CHARACTERISTIC
/begin CHARACTERISTIC CAL_obd_ii_mode2f_coil_test_pulse_count "undefined2" VALUE 0x4000CAAE RL_VALUE_UWORD 0 NO_COMPU_METHOD 0 65535 /end CHARACTERISTIC
/begin CHARACTERISTIC CAL_oil_pressure_switch_startup_time "Calibration: oil pressure switch startup time (s)." VALUE 0x4000CAB0 RL_VALUE_UBYTE 0 CM_u8_time_s 0 255 /end CHARACTERISTIC
/begin CHARACTERISTIC CAL_obd_ii_oil_pressure_switch_low_voltage "Calibration: OBD-II oil pressure switch low voltage (V = val*5/1023)." VALUE 0x4000CAB4 RL_VALUE_UWORD 0 CM_u16_voltage_5_1023v 0 320.307917888563 /end CHARACTERISTIC
/begin CHARACTERISTIC CAL_sensor_intake_air_temp_voltage_threshold "Calibration: sensor intake air temperature voltage threshold (V = val*5/1023; 2-element array)." VAL_BLK 0x4000CAB6 RL_VALUE_UWORD 0 CM_u16_voltage_5_1023v 0 320.307917888563 NUMBER 2 /end CHARACTERISTIC
/begin CHARACTERISTIC CAL_obd_ii_o2_precat_activity_window "undefined2" VALUE 0x4000CAC4 RL_VALUE_UWORD 0 NO_COMPU_METHOD 0 65535 /end CHARACTERISTIC
/begin CHARACTERISTIC CAL_obd_ii_o2_postcat_activity_min "undefined2" VALUE 0x4000CAC6 RL_VALUE_UWORD 0 NO_COMPU_METHOD 0 65535 /end CHARACTERISTIC
/begin CHARACTERISTIC CAL_obd_ii_o2_slow_response_runtime_limit_unknown "undefined2" VALUE 0x4000CAC8 RL_VALUE_UWORD 0 NO_COMPU_METHOD 0 65535 /end CHARACTERISTIC
/begin CHARACTERISTIC CAL_sensor_o2_lean_voltage_threshold "Calibration: sensor O2 lean voltage threshold (V = val*5/1023)." VALUE 0x4000CACC RL_VALUE_UWORD 0 CM_u16_voltage_5_1023v 0 320.307917888563 /end CHARACTERISTIC
/begin CHARACTERISTIC CAL_sensor_o2_rich_voltage_threshold "Calibration: sensor O2 rich voltage threshold (V = val*5/1023)." VALUE 0x4000CACE RL_VALUE_UWORD 0 CM_u16_voltage_5_1023v 0 320.307917888563 /end CHARACTERISTIC
/begin CHARACTERISTIC CAL_obd_ii_cat_monitor_min_engine_runtime "Calibration: OBD-II cat monitor minimum engine runtime (ms = val*5)." VALUE 0x4000CAD0 RL_VALUE_UWORD 0 CM_u8_time_5ms 0 327675 /end CHARACTERISTIC
/begin CHARACTERISTIC CAL_sensor_o2_rich_voltage_threshold_4000CAD2 "Calibration: sensor O2 rich voltage threshold (V = val*5/1023)." VALUE 0x4000CAD2 RL_VALUE_UWORD 0 CM_u16_voltage_5_1023v 0 320.307917888563 /end CHARACTERISTIC
/begin CHARACTERISTIC CAL_sensor_o2_lean_voltage_threshold_4000CAD4 "Calibration: sensor O2 lean voltage threshold (V = val*5/1023)." VALUE 0x4000CAD4 RL_VALUE_UWORD 0 CM_u16_voltage_5_1023v 0 320.307917888563 /end CHARACTERISTIC
/begin CHARACTERISTIC CAL_misfire_emissions_limit "Calibration: misfire emissions limit." VALUE 0x4000CAD8 RL_VALUE_UBYTE 0 NO_COMPU_METHOD 0 255 /end CHARACTERISTIC
/begin CHARACTERISTIC CAL_obd_ii_fuel_type "Calibration: OBD-II fuel type." VALUE 0x4000CAE2 RL_VALUE_UBYTE 0 NO_COMPU_METHOD 0 255 /end CHARACTERISTIC
/begin CHARACTERISTIC CAL_sensor_fuel_level_sensor_voltage_threshold "Calibration: sensor fuel level sensor voltage threshold (V = val*5/1023; 2-element array)." VAL_BLK 0x4000CAEA RL_VALUE_UWORD 0 CM_u16_voltage_5_1023v 0 320.307917888563 NUMBER 2 /end CHARACTERISTIC
/begin CHARACTERISTIC CAL_cac_pwm_mismatch_threshold "Calibration: charge-air-cooler PWM mismatch threshold." VALUE 0x4000CAF2 RL_VALUE_UBYTE 0 NO_COMPU_METHOD 0 255 /end CHARACTERISTIC
/begin CHARACTERISTIC CAL_cat_check_unknown4 "undefined2" VALUE 0x4000CAF4 RL_VALUE_UWORD 0 NO_COMPU_METHOD 0 65535 /end CHARACTERISTIC
/begin CHARACTERISTIC CAL_obd_ii_commanded_evap_purge_threshold "undefined2" VALUE 0x4000CAF6 RL_VALUE_UWORD 0 NO_COMPU_METHOD 0 65535 /end CHARACTERISTIC
/begin CHARACTERISTIC CAL_evap_tank_vacuum_flow_threshold "undefined2" VALUE 0x4000CAF8 RL_VALUE_UWORD 0 NO_COMPU_METHOD 0 65535 /end CHARACTERISTIC
/begin CHARACTERISTIC CAL_evap_system_state_flags_param "undefined2" VALUE 0x4000CAFA RL_VALUE_UWORD 0 NO_COMPU_METHOD 0 65535 /end CHARACTERISTIC
/begin CHARACTERISTIC CAL_evap_purge_flow_state_timer_init "undefined1" VALUE 0x4000CAFC RL_VALUE_UBYTE 0 NO_COMPU_METHOD 0 255 /end CHARACTERISTIC
/begin CHARACTERISTIC CAL_evap_canister_purge_solenoid_timer_init "undefined1" VALUE 0x4000CAFD RL_VALUE_UBYTE 0 NO_COMPU_METHOD 0 255 /end CHARACTERISTIC
/begin CHARACTERISTIC CAL_evap_purge_min_load "undefined1" VALUE 0x4000CAFE RL_VALUE_UBYTE 0 NO_COMPU_METHOD 0 255 /end CHARACTERISTIC
/begin CHARACTERISTIC CAL_evap_purge_vacuum_min "undefined2" VALUE 0x4000CB00 RL_VALUE_UWORD 0 NO_COMPU_METHOD 0 65535 /end CHARACTERISTIC
/begin CHARACTERISTIC CAL_sensor_coolant_filter_alpha "undefined1" VALUE 0x4000CB03 RL_VALUE_UBYTE 0 NO_COMPU_METHOD 0 255 /end CHARACTERISTIC
/begin CHARACTERISTIC CAL_evap_leak_test_fuel_level_max "undefined1" VALUE 0x4000CB07 RL_VALUE_UBYTE 0 NO_COMPU_METHOD 0 255 /end CHARACTERISTIC
/begin CHARACTERISTIC CAL_evap_purge_flow_vacuum_min "undefined2" VALUE 0x4000CB08 RL_VALUE_UWORD 0 NO_COMPU_METHOD 0 65535 /end CHARACTERISTIC
/begin CHARACTERISTIC CAL_evap_leak_test_purge_settle_delay "undefined1" VALUE 0x4000CB0B RL_VALUE_UBYTE 0 NO_COMPU_METHOD 0 255 /end CHARACTERISTIC
/begin CHARACTERISTIC CAL_evap_leak_test_settle_samples "undefined1" VALUE 0x4000CB0C RL_VALUE_UBYTE 0 NO_COMPU_METHOD 0 255 /end CHARACTERISTIC
/begin CHARACTERISTIC CAL_cooling_thermostat_open "Calibration: cooling thermostat open (°C = val*5/8−40)." VALUE 0x4000CB22 RL_VALUE_UBYTE 0 CM_u8_temp_5_8_40c -40 119.375 /end CHARACTERISTIC
/begin CHARACTERISTIC CAL_sensor_knock_voltage_threshold "Calibration: sensor knock voltage threshold (2-element array)." VAL_BLK 0x4000CB24 RL_VALUE_UWORD 0 NO_COMPU_METHOD 0 65535 NUMBER 2 /end CHARACTERISTIC
/begin CHARACTERISTIC CAL_obd_ii_cat_unknown3 "undefined2" VALUE 0x4000CB2C RL_VALUE_UWORD 0 NO_COMPU_METHOD 0 65535 /end CHARACTERISTIC
/begin CHARACTERISTIC CAL_obd_ii_cat_monitor_stable_time "undefined2" VALUE 0x4000CB3A RL_VALUE_UWORD 0 NO_COMPU_METHOD 0 65535 /end CHARACTERISTIC
/begin CHARACTERISTIC CAL_obd_evap_entry_settle_delay "undefined1" VALUE 0x4000CB3D RL_VALUE_UBYTE 0 NO_COMPU_METHOD 0 255 /end CHARACTERISTIC
/begin CHARACTERISTIC CAL_wheel_speed_multiplier_front "Calibration: wheel speed multiplier front (mm_div2)." VALUE 0x4000CB46 RL_VALUE_UWORD 0 CM_u16_distance_mm_div2 0 32767.5 /end CHARACTERISTIC
/begin CHARACTERISTIC CAL_wheel_speed_multiplier_rear "Calibration: wheel speed multiplier rear (mm_div2)." VALUE 0x4000CB48 RL_VALUE_UWORD 0 CM_u16_distance_mm_div2 0 32767.5 /end CHARACTERISTIC
/begin CHARACTERISTIC CAL_sensor_temp_diagnostic_startup_delay "Calibration: sensor temperature diagnostic startup delay (ms = val*5)." VALUE 0x4000CB4A RL_VALUE_UWORD 0 CM_u8_time_5ms 0 327675 /end CHARACTERISTIC
/begin CHARACTERISTIC CAL_obd_ac_load_diag_tolerance_pct "undefined1" VALUE 0x4000CB4C RL_VALUE_UBYTE 0 NO_COMPU_METHOD 0 255 /end CHARACTERISTIC
/begin CHARACTERISTIC CAL_sensor_tps_voltage_theshold1 "Calibration: sensor throttle position voltage theshold1 (V = val*5/1023; 2-element array)." VAL_BLK 0x4000CB50 RL_VALUE_UWORD 0 CM_u16_voltage_5_1023v 0 320.307917888563 NUMBER 2 /end CHARACTERISTIC
/begin CHARACTERISTIC CAL_sensor_tps_voltage_theshold2 "Calibration: sensor throttle position voltage theshold2 (V = val*5/1023; 2-element array)." VAL_BLK 0x4000CB54 RL_VALUE_UWORD 0 CM_u16_voltage_5_1023v 0 320.307917888563 NUMBER 2 /end CHARACTERISTIC
/begin CHARACTERISTIC CAL_vvt_cam_park_offset_max "undefined1" VALUE 0x4000CB58 RL_VALUE_UBYTE 0 NO_COMPU_METHOD 0 255 /end CHARACTERISTIC
/begin CHARACTERISTIC CAL_clutch_pos_voltage_threshold "undefined2" VALUE 0x4000CB62 RL_VALUE_UWORD 0 NO_COMPU_METHOD 0 65535 /end CHARACTERISTIC
/begin CHARACTERISTIC CAL_trans_gear_ratio_sport "Calibration: transmission gear ratio sport (12-element array)." VAL_BLK 0x4000CB6A RL_VALUE_UWORD 0 NO_COMPU_METHOD 0 65535 NUMBER 12 /end CHARACTERISTIC
/begin CHARACTERISTIC CAL_closedloop_stft_idle_max_limit "Calibration: closedloop short-term fuel trim idle maximum limit." VALUE 0x4000CB82 RL_VALUE_SWORD 0 NO_COMPU_METHOD -32768 32767 /end CHARACTERISTIC
/begin CHARACTERISTIC CAL_closedloop_o2_switch_threshold_ips "undefined1" VALUE 0x4000CB84 RL_VALUE_UBYTE 0 NO_COMPU_METHOD 0 255 /end CHARACTERISTIC
/begin CHARACTERISTIC CAL_closedloop_max_tipin_enrichment "Calibration: closedloop maximum tipin enrichment (µs = val*10)." VALUE 0x4000CB88 RL_VALUE_UBYTE 0 CM_u8_time_10us 0 2550 /end CHARACTERISTIC
/begin CHARACTERISTIC CAL_closedloop_max_tipout_enleanment "Calibration: closedloop maximum tipout enleanment (µs = val*10)." VALUE 0x4000CB89 RL_VALUE_UBYTE 0 CM_u8_time_10us 0 2550 /end CHARACTERISTIC
/begin CHARACTERISTIC CAL_fuel_usage_to_flow_scaling "Calibration: fuel usage to flow scaling." VALUE 0x4000CB8E RL_VALUE_UWORD 0 NO_COMPU_METHOD 0 65535 /end CHARACTERISTIC
/begin CHARACTERISTIC CAL_closedloop_tipout_holdoff_ticks "undefined1" VALUE 0x4000CB97 RL_VALUE_UBYTE 0 NO_COMPU_METHOD 0 255 /end CHARACTERISTIC
/begin CHARACTERISTIC CAL_closedloop_tipout_rpm_threshold "u16_rspeed_rpm" VALUE 0x4000CB98 RL_VALUE_UWORD 0 CM_u16_rspeed_rpm 0 65535 /end CHARACTERISTIC
/begin CHARACTERISTIC CAL_obd_ii_P0111_maf_low_band "undefined1" VALUE 0x4000CB9C RL_VALUE_UBYTE 0 NO_COMPU_METHOD 0 255 /end CHARACTERISTIC
/begin CHARACTERISTIC CAL_maf_flow_1_limit_0 "undefined1" VALUE 0x4000CB9D RL_VALUE_UBYTE 0 NO_COMPU_METHOD 0 255 /end CHARACTERISTIC
/begin CHARACTERISTIC CAL_obd_ii_P0111_maf_debounce_time "undefined1" VALUE 0x4000CB9E RL_VALUE_UBYTE 0 NO_COMPU_METHOD 0 255 /end CHARACTERISTIC
/begin CHARACTERISTIC CAL_obd_ii_high_load_monitor_afr_max "undefined2" VALUE 0x4000CBA2 RL_VALUE_UWORD 0 NO_COMPU_METHOD 0 65535 /end CHARACTERISTIC
/begin CHARACTERISTIC CAL_obd_ii_P2191_lean_confirm_time "undefined1" VALUE 0x4000CBA4 RL_VALUE_UBYTE 0 NO_COMPU_METHOD 0 255 /end CHARACTERISTIC
/begin CHARACTERISTIC CAL_obd_ii_P2192_rich_confirm_time "undefined1" VALUE 0x4000CBA5 RL_VALUE_UBYTE 0 NO_COMPU_METHOD 0 255 /end CHARACTERISTIC
/begin CHARACTERISTIC CAL_obd_ii_high_load_monitor_load_min "undefined1" VALUE 0x4000CBA6 RL_VALUE_UBYTE 0 NO_COMPU_METHOD 0 255 /end CHARACTERISTIC
/begin CHARACTERISTIC CAL_obd_ii_drive_cycle_idle_time "undefined2" VALUE 0x4000CBA8 RL_VALUE_UWORD 0 NO_COMPU_METHOD 0 65535 /end CHARACTERISTIC
/begin CHARACTERISTIC CAL_obd_ii_monitor_rpm_delta_max "undefined2" VALUE 0x4000CBAE RL_VALUE_UWORD 0 NO_COMPU_METHOD 0 65535 /end CHARACTERISTIC
/begin CHARACTERISTIC CAL_idle_sensor_fault_coolant_temp "Calibration: idle sensor fault coolant temperature (°C = val*5/8−40)." VALUE 0x4000CBB0 RL_VALUE_UBYTE 0 CM_u8_temp_5_8_40c -40 119.375 /end CHARACTERISTIC
/begin CHARACTERISTIC CAL_obd_ii_evap_purge_settle_debounce "undefined1" VALUE 0x4000CBB3 RL_VALUE_UBYTE 0 NO_COMPU_METHOD 0 255 /end CHARACTERISTIC
/begin CHARACTERISTIC CAL_evap_pressure_deviation_max "undefined1" VALUE 0x4000CBB4 RL_VALUE_UBYTE 0 NO_COMPU_METHOD 0 255 /end CHARACTERISTIC
/begin CHARACTERISTIC CAL_obd_ii_P0451_debounce_count "undefined1" VALUE 0x4000CBB5 RL_VALUE_UBYTE 0 NO_COMPU_METHOD 0 255 /end CHARACTERISTIC
/begin CHARACTERISTIC CAL_obd_ii_o2_period_consistency_tol "undefined1" VALUE 0x4000CBB8 RL_VALUE_UBYTE 0 NO_COMPU_METHOD 0 255 /end CHARACTERISTIC
/begin CHARACTERISTIC CAL_obd_ii_o2_slow_response_maf_limit_unknown2 "undefined2" VALUE 0x4000CBBA RL_VALUE_UWORD 0 NO_COMPU_METHOD 0 65535 /end CHARACTERISTIC
/begin CHARACTERISTIC CAL_obd_o2_precat_diag_init_counter "undefined2" VALUE 0x4000CBBC RL_VALUE_UWORD 0 NO_COMPU_METHOD 0 65535 /end CHARACTERISTIC
/begin CHARACTERISTIC CAL_obd_ii_o2_period_excess_max "undefined1" VALUE 0x4000CBBE RL_VALUE_UBYTE 0 NO_COMPU_METHOD 0 255 /end CHARACTERISTIC
/begin CHARACTERISTIC CAL_obd_ii_o2_imbalance_accum_cap "undefined1" VALUE 0x4000CBBF RL_VALUE_UBYTE 0 NO_COMPU_METHOD 0 255 /end CHARACTERISTIC
/begin CHARACTERISTIC CAL_wheel_speed_min "Calibration: wheel speed minimum." VALUE 0x4000CBC4 RL_VALUE_UWORD 0 NO_COMPU_METHOD 0 65535 /end CHARACTERISTIC
/begin CHARACTERISTIC CAL_obd_ii_o2_slow_response_maf_limit_unknown "undefined2" VALUE 0x4000CBC8 RL_VALUE_UWORD 0 NO_COMPU_METHOD 0 65535 /end CHARACTERISTIC
/begin CHARACTERISTIC CAL_obd_o2_precat_diag_reset_counter "undefined2" VALUE 0x4000CBCA RL_VALUE_UWORD 0 NO_COMPU_METHOD 0 65535 /end CHARACTERISTIC
/begin CHARACTERISTIC CAL_sensor_accel_pedal_midpoint_voltage_range "Calibration: sensor accelerator pedal midpoint voltage range (V = val*5/1023; 2-element array)." VAL_BLK 0x4000CBCC RL_VALUE_UWORD 0 CM_u16_voltage_5_1023v 0 320.307917888563 NUMBER 2 /end CHARACTERISTIC
/begin CHARACTERISTIC CAL_obd_ii_P0579_stuck_timeout "undefined1" VALUE 0x4000CBD1 RL_VALUE_UBYTE 0 NO_COMPU_METHOD 0 255 /end CHARACTERISTIC
/begin CHARACTERISTIC CAL_clutch_sensor_confidence_max "Calibration: clutch sensor confidence maximum." VALUE 0x4000CBD2 RL_VALUE_UWORD 0 NO_COMPU_METHOD 0 65535 /end CHARACTERISTIC
/begin CHARACTERISTIC CAL_clutch_variance_threshold "Calibration: clutch variance threshold." VALUE 0x4000CBD4 RL_VALUE_UBYTE 0 NO_COMPU_METHOD 0 255 /end CHARACTERISTIC
/begin CHARACTERISTIC CAL_clutch_confidence_decrement "Calibration: clutch confidence decrement." VALUE 0x4000CBD5 RL_VALUE_UBYTE 0 NO_COMPU_METHOD 0 255 /end CHARACTERISTIC
/begin CHARACTERISTIC CAL_clutch_confidence_increment "Calibration: clutch confidence increment." VALUE 0x4000CBD6 RL_VALUE_UBYTE 0 NO_COMPU_METHOD 0 255 /end CHARACTERISTIC
/begin CHARACTERISTIC CAL_load_mass_per_stroke_raw_limit_3 "undefined2" VALUE 0x4000CBD8 RL_VALUE_UWORD 0 NO_COMPU_METHOD 0 65535 /end CHARACTERISTIC
/begin CHARACTERISTIC CAL_obd_high_load_monitor_load_max "undefined2" VALUE 0x4000CBDA RL_VALUE_UWORD 0 NO_COMPU_METHOD 0 65535 /end CHARACTERISTIC
/begin CHARACTERISTIC CAL_engine_speed_3_limit_0 "undefined1" VALUE 0x4000CBDC RL_VALUE_UBYTE 0 NO_COMPU_METHOD 0 255 /end CHARACTERISTIC
/begin CHARACTERISTIC CAL_engine_speed_3_threshold_4 "undefined1" VALUE 0x4000CBDD RL_VALUE_UBYTE 0 NO_COMPU_METHOD 0 255 /end CHARACTERISTIC
/begin CHARACTERISTIC CAL_maf_flow_1_limit_2 "undefined2" VALUE 0x4000CBDE RL_VALUE_UWORD 0 NO_COMPU_METHOD 0 65535 /end CHARACTERISTIC
/begin CHARACTERISTIC CAL_maf_flow_1_threshold_4 "undefined2" VALUE 0x4000CBE0 RL_VALUE_UWORD 0 NO_COMPU_METHOD 0 65535 /end CHARACTERISTIC
/begin CHARACTERISTIC CAL_coolant_temp_limit_2 "undefined1" VALUE 0x4000CBE4 RL_VALUE_UBYTE 0 NO_COMPU_METHOD 0 255 /end CHARACTERISTIC
/begin CHARACTERISTIC CAL_obd_ii_o2_imbalance_threshold "undefined2" VALUE 0x4000CBEA RL_VALUE_UWORD 0 NO_COMPU_METHOD 0 65535 /end CHARACTERISTIC
/begin CHARACTERISTIC CAL_obd_ii_P0101_plausibility_enable "undefined1" VALUE 0x4000CBF4 RL_VALUE_UBYTE 0 NO_COMPU_METHOD 0 255 /end CHARACTERISTIC
/begin CHARACTERISTIC CAL_obd_ii_knock_no_activity_count "undefined1" VALUE 0x4000CBF5 RL_VALUE_UBYTE 0 NO_COMPU_METHOD 0 255 /end CHARACTERISTIC
/begin CHARACTERISTIC CAL_knock_octane_scaler_short_term_limit "undefined2" VALUE 0x4000CBF8 RL_VALUE_UWORD 0 NO_COMPU_METHOD 0 65535 /end CHARACTERISTIC
/begin CHARACTERISTIC CAL_knock_threshold_obd_ii_check_enable_engine_speed "Calibration: knock threshold OBD-II check enable engine speed (RPM)." VALUE 0x4000CBFA RL_VALUE_UWORD 0 CM_u16_rspeed_rpm 0 65535 /end CHARACTERISTIC
/begin CHARACTERISTIC CAL_knock_threshold_obd_ii_check_enable_load "Calibration: knock threshold OBD-II check enable load (val/100)." VALUE 0x4000CBFC RL_VALUE_UBYTE 0 CM_u8_factor_1_100 0 255 /end CHARACTERISTIC
/begin CHARACTERISTIC CAL_sensor_lat_accel_raw_threshold "Calibration: sensor lateral accelerator threshold (g = val/255)." VALUE 0x4000CC01 RL_VALUE_UBYTE 0 CM_u8_accel_1_255g 0 1 /end CHARACTERISTIC
/begin CHARACTERISTIC CAL_sensor_lat_accel_smoothing_factor "Calibration: sensor lateral accelerator smoothing factor (val/255)." VALUE 0x4000CC02 RL_VALUE_UBYTE 0 CM_u8_factor_1_255 0 100 /end CHARACTERISTIC
/begin CHARACTERISTIC CAL_slip_gear_speed_ratios_ips "Calibration: slip gear speed ratios IPS (6-element array)." VAL_BLK 0x4000CC04 RL_VALUE_UWORD 0 NO_COMPU_METHOD 0 65535 NUMBER 6 /end CHARACTERISTIC
/begin CHARACTERISTIC CAL_slip_gear_speed_ratios_cr "Calibration: slip gear speed ratios cr (6-element array)." VAL_BLK 0x4000CC10 RL_VALUE_UWORD 0 NO_COMPU_METHOD 0 65535 NUMBER 6 /end CHARACTERISTIC
/begin CHARACTERISTIC CAL_slip_gear_speed_ratios_long "Calibration: slip gear speed ratios long (6-element array)." VAL_BLK 0x4000CC1C RL_VALUE_UWORD 0 NO_COMPU_METHOD 0 65535 NUMBER 6 /end CHARACTERISTIC
/begin CHARACTERISTIC CAL_slip_threshold_1st_Gear "Calibration: slip threshold 1st Gear (RPM = val*4+500)." VALUE 0x4000CC28 RL_VALUE_UBYTE 0 CM_u8_rspeed_4_500rpm 500 1520 /end CHARACTERISTIC
/begin CHARACTERISTIC CAL_slip_threshold_per_gear_manual "Calibration: slip threshold per gear manual (RPM = val*4+500; 5-element array)." VAL_BLK 0x4000CC29 RL_VALUE_UBYTE 0 CM_u8_rspeed_4_500rpm 500 1520 NUMBER 5 /end CHARACTERISTIC
/begin CHARACTERISTIC CAL_slip_slip_threshold_per_gear_ips "Calibration: slip slip threshold per gear IPS (RPM = val*4+500; 5-element array)." VAL_BLK 0x4000CC2E RL_VALUE_UBYTE 0 CM_u8_rspeed_4_500rpm 500 1520 NUMBER 5 /end CHARACTERISTIC
/begin CHARACTERISTIC CAL_slip_detect_mode "Calibration: slip detect mode (enumerated state)." VALUE 0x4000CC33 RL_VALUE_UBYTE 0 NO_COMPU_METHOD 0 255 /end CHARACTERISTIC
/begin CHARACTERISTIC CAL_slip_inhibit_accel_pedal_min "Calibration: slip inhibit accelerator pedal minimum (val/1023)." VALUE 0x4000CC34 RL_VALUE_UWORD 0 CM_u16_factor_1_1023 0 6406.15835777126 /end CHARACTERISTIC
/begin CHARACTERISTIC CAL_slip_steering_angle_max_unknown "Calibration: slip steering angle maximum (° = val/10)." VALUE 0x4000CC36 RL_VALUE_UWORD 0 CM_u16_angle_1_10deg 0 6553.5 /end CHARACTERISTIC
/begin CHARACTERISTIC CAL_slip_car_speed_unknown1 "Calibration: slip car speed unknown1 (km/h = val/100)." VALUE 0x4000CC38 RL_VALUE_UWORD 0 CM_u8_speed_1_100kph 0 655.35 /end CHARACTERISTIC
/begin CHARACTERISTIC CAL_slip_threshold_car_speed "Calibration: slip threshold car speed (km/h)." VALUE 0x4000CC3A RL_VALUE_UBYTE 0 CM_u8_speed_kph 0 255 /end CHARACTERISTIC
/begin CHARACTERISTIC CAL_slip_coldstart_coolant_threshold "Calibration: slip coldstart coolant threshold (°C = val*5/8−40)." VALUE 0x4000CC3B RL_VALUE_UBYTE 0 CM_u8_temp_5_8_40c -40 119.375 /end CHARACTERISTIC
/begin CHARACTERISTIC CAL_slip_timer_per_gear_intervention "Calibration: slip timer per gear intervention (ms = val*100)." VALUE 0x4000CC3C RL_VALUE_UBYTE 0 CM_u8_time_100ms 0 25500 /end CHARACTERISTIC
/begin CHARACTERISTIC CAL_slip_inhibit_cornering_base "Calibration: slip inhibit cornering base (val/255)." VALUE 0x4000CC3D RL_VALUE_UBYTE 0 CM_u8_factor_1_255 0 100 /end CHARACTERISTIC
/begin CHARACTERISTIC CAL_slip_inhibit_cornering_offset "Calibration: slip inhibit cornering offset (val/255)." VALUE 0x4000CC3E RL_VALUE_UBYTE 0 CM_u8_factor_1_255 0 100 /end CHARACTERISTIC
/begin CHARACTERISTIC CAL_slip_steering_rate_factor "Calibration: slip steering rate factor (val/100)." VALUE 0x4000CC3F RL_VALUE_UBYTE 0 CM_u8_factor_1_100 0 255 /end CHARACTERISTIC
/begin CHARACTERISTIC CAL_slip_steering_increase_factor_min "Calibration: slip steering increase factor minimum (val/255)." VALUE 0x4000CC40 RL_VALUE_UBYTE 0 CM_u8_factor_1_255 0 100 /end CHARACTERISTIC
/begin CHARACTERISTIC CAL_slip_steering_angle_smooth_factor "Calibration: slip steering angle smooth factor (val/255)." VALUE 0x4000CC41 RL_VALUE_UBYTE 0 CM_u8_factor_1_255 0 100 /end CHARACTERISTIC
/begin CHARACTERISTIC CAL_slip_inhibit_accel_pedal_timer "Calibration: slip inhibit accelerator pedal timer (ms = val*100)." VALUE 0x4000CC42 RL_VALUE_UBYTE 0 CM_u8_time_100ms 0 25500 /end CHARACTERISTIC
/begin CHARACTERISTIC CAL_slip_threshold_hysteresis_offset "Calibration: slip threshold hysteresis offset (RPM = val*4+500)." VALUE 0x4000CC44 RL_VALUE_UBYTE 0 CM_u8_rspeed_4_500rpm 500 1520 /end CHARACTERISTIC
/begin CHARACTERISTIC CAL_slip_timer_intervention2 "Calibration: slip timer intervention2 (ms = val*100)." VALUE 0x4000CC45 RL_VALUE_UBYTE 0 CM_u8_time_100ms 0 25500 /end CHARACTERISTIC
/begin CHARACTERISTIC CAL_slip_gear_offset_unknown "Calibration: slip gear offset." VALUE 0x4000CC46 RL_VALUE_UBYTE 0 NO_COMPU_METHOD 0 255 /end CHARACTERISTIC
/begin CHARACTERISTIC CAL_slip_wheelspeed_front_accel_threshold "Calibration: slip wheelspeed front accelerator threshold." VALUE 0x4000CC48 RL_VALUE_UBYTE 0 NO_COMPU_METHOD 0 255 /end CHARACTERISTIC
/begin CHARACTERISTIC CAL_slip_enable_speed "Calibration: slip enable speed (km/h)." VALUE 0x4000CC49 RL_VALUE_UBYTE 0 CM_u8_speed_kph 0 255 /end CHARACTERISTIC
/begin CHARACTERISTIC CAL_tps_obd_throttle_model_gain_opening "uint8_t" VALUE 0x4000CC4E RL_VALUE_UBYTE 0 NO_COMPU_METHOD 0 255 /end CHARACTERISTIC
/begin CHARACTERISTIC CAL_tps_obd_throttle_model_gain_closing "uint8_t" VALUE 0x4000CC4F RL_VALUE_UBYTE 0 NO_COMPU_METHOD 0 255 /end CHARACTERISTIC
/begin CHARACTERISTIC CAL_tps_obd_throttle_model_step_max_opening "uint16_t" VALUE 0x4000CC50 RL_VALUE_UWORD 0 NO_COMPU_METHOD 0 65535 /end CHARACTERISTIC
/begin CHARACTERISTIC CAL_tps_obd_throttle_model_step_max_closing "uint16_t" VALUE 0x4000CC52 RL_VALUE_UWORD 0 NO_COMPU_METHOD 0 65535 /end CHARACTERISTIC
/begin CHARACTERISTIC CAL_tps_obd_throttle_model_slewrate_accel "uint8_t" VALUE 0x4000CC54 RL_VALUE_UBYTE 0 NO_COMPU_METHOD 0 255 /end CHARACTERISTIC
/begin CHARACTERISTIC CAL_tps_obd_throttle_model_slewrate_rev_closing "uint8_t" VALUE 0x4000CC56 RL_VALUE_UBYTE 0 NO_COMPU_METHOD 0 255 /end CHARACTERISTIC
/begin CHARACTERISTIC CAL_tps_obd_throttle_model_slewrate_rev_opening "uint8_t" VALUE 0x4000CC57 RL_VALUE_UBYTE 0 NO_COMPU_METHOD 0 255 /end CHARACTERISTIC
/begin CHARACTERISTIC CAL_tps_obd_throttle_monitor_error_threshold "uint16_t" VALUE 0x4000CC58 RL_VALUE_UWORD 0 NO_COMPU_METHOD 0 65535 /end CHARACTERISTIC
/begin CHARACTERISTIC CAL_tps_obd_throttle_monitor_fail_threshold "uint16_t" VALUE 0x4000CC5A RL_VALUE_UWORD 0 NO_COMPU_METHOD 0 65535 /end CHARACTERISTIC
/begin CHARACTERISTIC CAL_tps_obd_throttle_monitor_tps_rate_blank_threshold "uint16_t" VALUE 0x4000CC5C RL_VALUE_UWORD 0 NO_COMPU_METHOD 0 65535 /end CHARACTERISTIC
/begin CHARACTERISTIC CAL_tps_obd_throttle_monitor_blank_time "u8_time_5ms" VALUE 0x4000CC5E RL_VALUE_UBYTE 0 CM_u8_time_5ms 0 1275 /end CHARACTERISTIC
/begin CHARACTERISTIC CAL_trans_pump_carspeed_enable "Calibration: transmission pump carspeed enable (km/h; 2-element array)." VAL_BLK 0x4000CC94 RL_VALUE_UBYTE 0 CM_u8_speed_kph 0 255 NUMBER 2 /end CHARACTERISTIC
/begin CHARACTERISTIC CAL_trans_pump_ect_on_min "Calibration: transmission pump ect on minimum (°C = val*5/8−40)." VALUE 0x4000CC96 RL_VALUE_UBYTE 0 CM_u8_temp_5_8_40c -40 119.375 /end CHARACTERISTIC
/begin CHARACTERISTIC CAL_trans_pump_ect_off_min "Calibration: transmission pump ect off minimum (°C = val*5/8−40)." VALUE 0x4000CC97 RL_VALUE_UBYTE 0 CM_u8_temp_5_8_40c -40 119.375 /end CHARACTERISTIC
/begin CHARACTERISTIC CAL_trans_pump_cold_cutoff "Calibration: transmission pump cold cutoff (°C = val*5/8−40)." VALUE 0x4000CC98 RL_VALUE_UBYTE 0 CM_u8_temp_5_8_40c -40 119.375 /end CHARACTERISTIC
/begin CHARACTERISTIC CAL_trans_pump_warmup_min "Calibration: transmission pump warmup minimum (°C = val*5/8−40)." VALUE 0x4000CC99 RL_VALUE_UBYTE 0 CM_u8_temp_5_8_40c -40 119.375 /end CHARACTERISTIC
/begin CHARACTERISTIC CAL_trans_pump_warmup_max "Calibration: transmission pump warmup maximum (°C = val*5/8−40)." VALUE 0x4000CC9A RL_VALUE_UBYTE 0 CM_u8_temp_5_8_40c -40 119.375 /end CHARACTERISTIC
/begin CHARACTERISTIC CAL_trans_pump_no_cool_min "Calibration: transmission pump no cool minimum (°C = val*5/8−40)." VALUE 0x4000CC9B RL_VALUE_UBYTE 0 CM_u8_temp_5_8_40c -40 119.375 /end CHARACTERISTIC
/begin CHARACTERISTIC CAL_trans_pump_ect_off_max "Calibration: transmission pump ect off maximum (°C = val*5/8−40)." VALUE 0x4000CC9C RL_VALUE_UBYTE 0 CM_u8_temp_5_8_40c -40 119.375 /end CHARACTERISTIC
/begin CHARACTERISTIC CAL_trans_pump_ect_on_max "Calibration: transmission pump ect on maximum (°C = val*5/8−40)." VALUE 0x4000CC9D RL_VALUE_UBYTE 0 CM_u8_temp_5_8_40c -40 119.375 /end CHARACTERISTIC
/begin CHARACTERISTIC CAL_trans_pump_cool_off "Calibration: transmission pump cool off (°C = val*5/8−40)." VALUE 0x4000CC9E RL_VALUE_UBYTE 0 CM_u8_temp_5_8_40c -40 119.375 /end CHARACTERISTIC
/begin CHARACTERISTIC CAL_trans_pump_no_cool_max "Calibration: transmission pump no cool maximum (°C = val*5/8−40)." VALUE 0x4000CC9F RL_VALUE_UBYTE 0 CM_u8_temp_5_8_40c -40 119.375 /end CHARACTERISTIC
/begin CHARACTERISTIC CAL_trans_temp_voltage_threshold "Calibration: transmission temperature voltage threshold (2-element array)." VAL_BLK 0x4000CCA4 RL_VALUE_UWORD 0 NO_COMPU_METHOD 0 65535 NUMBER 2 /end CHARACTERISTIC
/begin CHARACTERISTIC CAL_trans_fluid_P2797_threshold "Calibration: transmission fluid P2797 threshold (°C = val*5/8−40)." VALUE 0x4000CCA8 RL_VALUE_UBYTE 0 CM_u8_temp_5_8_40c -40 119.375 /end CHARACTERISTIC
/begin CHARACTERISTIC CAL_exhaust_flap_stationary_override_enable "Calibration: exhaust flap stationary override enable (enumerated state)." VALUE 0x4000CCA9 RL_VALUE_UBYTE 0 NO_COMPU_METHOD 0 255 /end CHARACTERISTIC
/begin CHARACTERISTIC CAL_dpm_min_engine_rpm "Calibration: driver performance mode minimum engine RPM (RPM)." VALUE 0x4000CCAE RL_VALUE_UWORD 0 CM_u16_rspeed_rpm 0 65535 /end CHARACTERISTIC
/begin CHARACTERISTIC CAL_dpm_cornering_lr_speed_diff_threshold "Calibration: driver performance mode lr diff threshold (km/h = val/100)." VALUE 0x4000CCB0 RL_VALUE_UWORD 0 CM_u8_speed_1_100kph 0 655.35 /end CHARACTERISTIC
/begin CHARACTERISTIC CAL_dpm_cornering_release_delay "\\Direct mode\\ (flag bit 2) likely means more aggressive TC intervention when there's significant left-right wheel speed difference - i.e., one wheel spinning more than the other." VALUE 0x4000CCB2 RL_VALUE_UWORD 0 CM_u8_time_5ms 0 327675 /end CHARACTERISTIC
/begin CHARACTERISTIC CAL_dpm_cornering_detect_delay "\\Direct mode\\ (flag bit 2) likely means more aggressive TC intervention when there's significant left-right wheel speed difference - i.e., one wheel spinning more than the other." VALUE 0x4000CCB4 RL_VALUE_UWORD 0 CM_u8_time_5ms 0 327675 /end CHARACTERISTIC
/begin CHARACTERISTIC CAL_dpm_integral_update_period "Integral adapation is very slow. It seems to be used to account for tire condition changes and surface changes." VALUE 0x4000CCB6 RL_VALUE_UWORD 0 CM_u8_time_5ms 0 327675 /end CHARACTERISTIC
/begin CHARACTERISTIC CAL_dpm_torque_min_allowed "Calibration: driver performance mode torque minimum allowed (Nm)." VALUE 0x4000CCB8 RL_VALUE_UWORD 0 CM_u8_torque_nm 0 65535 /end CHARACTERISTIC
/begin CHARACTERISTIC CAL_dpm_slip_target_straight_line_offset "A fixed extra slip allowance, in 1/8 % steps (u8_slip_1/8pct), added to the pedal-derived target dpm_slip_target_from_pedal to give the final dpm_slip_target. It's only applied while flag bit 2 is clear. dpm_system_state_manager_200hz sets that bit w" VALUE 0x4000CCBA RL_VALUE_UBYTE 0 CM_u16_slip_1_8pct 0 31.875 /end CHARACTERISTIC
/begin CHARACTERISTIC CAL_dpm_max_vehicle_speed "Calibration: driver performance mode maximum vehicle speed (km/h)." VALUE 0x4000CCBB RL_VALUE_UBYTE 0 CM_u8_speed_kph 0 255 /end CHARACTERISTIC
/begin CHARACTERISTIC CAL_dpm_min_vehicle_speed "Calibration: driver performance mode minimum vehicle speed (km/h)." VALUE 0x4000CCBC RL_VALUE_UBYTE 0 CM_u8_speed_kph 0 255 /end CHARACTERISTIC
/begin CHARACTERISTIC CAL_dpm_intervention_threshold "Calibration: driver performance mode intervention threshold (% = val/8)." VALUE 0x4000CCBD RL_VALUE_UBYTE 0 CM_u16_slip_1_8pct 0 31.875 /end CHARACTERISTIC
/begin CHARACTERISTIC CAL_dpm_torque_cut_i_gain "Calibration: driver performance mode integral gain." VALUE 0x4000CCBE RL_VALUE_UBYTE 0 NO_COMPU_METHOD 0 255 /end CHARACTERISTIC
/begin CHARACTERISTIC CAL_dpm_torque_cut_i_limit "Calibration: driver performance mode integral limit." VALUE 0x4000CCBF RL_VALUE_UBYTE 0 NO_COMPU_METHOD 0 255 /end CHARACTERISTIC
/begin CHARACTERISTIC CAL_dpm_torque_margin_factor "Calibration: driver performance mode torque margin factor (val/255)." VALUE 0x4000CCC1 RL_VALUE_UBYTE 0 CM_u8_factor_1_255 0 100 /end CHARACTERISTIC
/begin CHARACTERISTIC CAL_load_filter_low_pass_coeff "Calibration: load filter low pass coeff (val/255)." VALUE 0x4000CCC3 RL_VALUE_UBYTE 0 CM_u8_factor_1_255 0 100 /end CHARACTERISTIC
/begin CHARACTERISTIC CAL_torque_limit_tps_rate_limit "Calibration: torque limit throttle position rate limit (2-element array)." VAL_BLK 0x4000CCC4 RL_VALUE_UWORD 0 NO_COMPU_METHOD 0 65535 NUMBER 2 /end CHARACTERISTIC
/begin CHARACTERISTIC CAL_torque_limit_cooldown_timer "uint16_t" VALUE 0x4000CCC8 RL_VALUE_UWORD 0 NO_COMPU_METHOD 0 65535 /end CHARACTERISTIC
/begin CHARACTERISTIC CAL_torque_limit_cooldown_tps_rate_threshold "u8_factor_1/255" VALUE 0x4000CCCA RL_VALUE_UBYTE 0 CM_u8_factor_1_255 0 100 /end CHARACTERISTIC
/begin AXIS_PTS CAL_torque_load_to_torque_X_engine_speed "Calibration: X-axis (engine speed) for the torque load to torque table (RPM; 16-element array)." 0x4000CDB4 NO_INPUT_QUANTITY RL_AXIS_UWORD 0 CM_u16_rspeed_rpm 16 0 65535 /end AXIS_PTS
/begin AXIS_PTS CAL_torque_load_to_torque_Y_load "Calibration: Y-axis (load) for the torque load to torque table (mg/stroke; 16-element array)." 0x4000CDD4 NO_INPUT_QUANTITY RL_AXIS_UWORD 0 CM_u16_load_mg_stroke 16 0 65535 /end AXIS_PTS
/begin CHARACTERISTIC CAL_torque_load_to_torque "Calibration: torque load to torque (Nm; 256-element array)." MAP 0x4000CDF4 RL_VALUE_UWORD 0 CM_u8_torque_nm 0 65535
 /begin AXIS_DESCR COM_AXIS NO_INPUT_QUANTITY CM_u16_rspeed_rpm 16 0 65535 AXIS_PTS_REF CAL_torque_load_to_torque_X_engine_speed /end AXIS_DESCR
 /begin AXIS_DESCR COM_AXIS NO_INPUT_QUANTITY CM_u16_load_mg_stroke 16 0 65535 AXIS_PTS_REF CAL_torque_load_to_torque_Y_load /end AXIS_DESCR
/end CHARACTERISTIC
/begin AXIS_PTS CAL_ign_base_ips_X_engine_speed "Calibration: X-axis (engine speed) for the ignition base IPS table (RPM = val*125/4+500; 20-element array)." 0x4000CFF4 NO_INPUT_QUANTITY RL_AXIS_UBYTE 0 CM_u8_rspeed_125_4_500rpm 20 500 8468.75 /end AXIS_PTS
/begin AXIS_PTS CAL_ign_base_ips_Y_load "Calibration: Y-axis (load) for the ignition base IPS table (mg/stroke = val*1173; 20-element array)." 0x4000D008 NO_INPUT_QUANTITY RL_AXIS_UBYTE 0 CM_u8_load_1173mg_255stroke 20 0 1173 /end AXIS_PTS
/begin CHARACTERISTIC CAL_ign_base_ips "Calibration: ignition base IPS (° = val/4−10; 400-element array)." MAP 0x4000D01C RL_VALUE_UBYTE 0 CM_u8_angle_1_4_10deg -10 53.75
 /begin AXIS_DESCR COM_AXIS NO_INPUT_QUANTITY CM_u8_rspeed_125_4_500rpm 20 500 8468.75 AXIS_PTS_REF CAL_ign_base_ips_X_engine_speed /end AXIS_DESCR
 /begin AXIS_DESCR COM_AXIS NO_INPUT_QUANTITY CM_u8_load_1173mg_255stroke 20 0 1173 AXIS_PTS_REF CAL_ign_base_ips_Y_load /end AXIS_DESCR
/end CHARACTERISTIC
/begin CHARACTERISTIC CAL_obd_ii_P0712 "Calibration: OBD-II P0712 (OBD-II monitor enable level)." VALUE 0x4000D1AC RL_VALUE_UBYTE 0 NO_COMPU_METHOD 0 255 /end CHARACTERISTIC
/begin CHARACTERISTIC CAL_obd_ii_P0106 "Calibration: OBD-II P0106 (OBD-II monitor enable level)." VALUE 0x4000D1AD RL_VALUE_UBYTE 0 NO_COMPU_METHOD 0 255 /end CHARACTERISTIC
/begin CHARACTERISTIC CAL_obd_ii_P0107 "Calibration: OBD-II P0107 (OBD-II monitor enable level)." VALUE 0x4000D1AE RL_VALUE_UBYTE 0 NO_COMPU_METHOD 0 255 /end CHARACTERISTIC
/begin CHARACTERISTIC CAL_obd_ii_P0108 "Calibration: OBD-II P0108 (OBD-II monitor enable level)." VALUE 0x4000D1AF RL_VALUE_UBYTE 0 NO_COMPU_METHOD 0 255 /end CHARACTERISTIC
/begin CHARACTERISTIC CAL_obd_ii_P0713 "Calibration: OBD-II P0713 (OBD-II monitor enable level)." VALUE 0x4000D1B0 RL_VALUE_UBYTE 0 NO_COMPU_METHOD 0 255 /end CHARACTERISTIC
/begin CHARACTERISTIC CAL_obd_ii_P0111 "Calibration: OBD-II P0111 (OBD-II monitor enable level)." VALUE 0x4000D1B1 RL_VALUE_UBYTE 0 NO_COMPU_METHOD 0 255 /end CHARACTERISTIC
/begin CHARACTERISTIC CAL_obd_ii_P0112 "Calibration: OBD-II P0112 (OBD-II monitor enable level)." VALUE 0x4000D1B2 RL_VALUE_UBYTE 0 NO_COMPU_METHOD 0 255 /end CHARACTERISTIC
/begin CHARACTERISTIC CAL_obd_ii_P0113 "Calibration: OBD-II P0113 (OBD-II monitor enable level)." VALUE 0x4000D1B3 RL_VALUE_UBYTE 0 NO_COMPU_METHOD 0 255 /end CHARACTERISTIC
/begin CHARACTERISTIC CAL_obd_ii_P0071 "Calibration: OBD-II P0071 (OBD-II monitor enable level)." VALUE 0x4000D1B4 RL_VALUE_UBYTE 0 NO_COMPU_METHOD 0 255 /end CHARACTERISTIC
/begin CHARACTERISTIC CAL_obd_ii_P0116 "Calibration: OBD-II P0116 (OBD-II monitor enable level)." VALUE 0x4000D1B5 RL_VALUE_UBYTE 0 NO_COMPU_METHOD 0 255 /end CHARACTERISTIC
/begin CHARACTERISTIC CAL_obd_ii_P0117 "Calibration: OBD-II P0117 (OBD-II monitor enable level)." VALUE 0x4000D1B6 RL_VALUE_UBYTE 0 NO_COMPU_METHOD 0 255 /end CHARACTERISTIC
/begin CHARACTERISTIC CAL_obd_ii_P0118 "Calibration: OBD-II P0118 (OBD-II monitor enable level)." VALUE 0x4000D1B7 RL_VALUE_UBYTE 0 NO_COMPU_METHOD 0 255 /end CHARACTERISTIC
/begin CHARACTERISTIC CAL_obd_ii_P2170 "Calibration: OBD-II P2170 (OBD-II monitor enable level)." VALUE 0x4000D1B8 RL_VALUE_UBYTE 0 NO_COMPU_METHOD 0 255 /end CHARACTERISTIC
/begin CHARACTERISTIC CAL_obd_ii_P2171 "Calibration: OBD-II P2171 (OBD-II monitor enable level)." VALUE 0x4000D1B9 RL_VALUE_UBYTE 0 NO_COMPU_METHOD 0 255 /end CHARACTERISTIC
/begin CHARACTERISTIC CAL_obd_ii_P0122 "Calibration: OBD-II P0122 (OBD-II monitor enable level)." VALUE 0x4000D1BA RL_VALUE_UBYTE 0 NO_COMPU_METHOD 0 255 /end CHARACTERISTIC
/begin CHARACTERISTIC CAL_obd_ii_P0123 "Calibration: OBD-II P0123 (OBD-II monitor enable level)." VALUE 0x4000D1BB RL_VALUE_UBYTE 0 NO_COMPU_METHOD 0 255 /end CHARACTERISTIC
/begin CHARACTERISTIC CAL_obd_ii_P2191 "Calibration: OBD-II P2191 (OBD-II monitor enable level)." VALUE 0x4000D1BC RL_VALUE_UBYTE 0 NO_COMPU_METHOD 0 255 /end CHARACTERISTIC
/begin CHARACTERISTIC CAL_obd_ii_P0128 "Calibration: OBD-II P0128 (OBD-II monitor enable level)." VALUE 0x4000D1BD RL_VALUE_UBYTE 0 NO_COMPU_METHOD 0 255 /end CHARACTERISTIC
/begin CHARACTERISTIC CAL_obd_ii_P0131 "Calibration: OBD-II P0131 (OBD-II monitor enable level)." VALUE 0x4000D1BE RL_VALUE_UBYTE 0 NO_COMPU_METHOD 0 255 /end CHARACTERISTIC
/begin CHARACTERISTIC CAL_obd_ii_P0132 "Calibration: OBD-II P0132 (OBD-II monitor enable level)." VALUE 0x4000D1BF RL_VALUE_UBYTE 0 NO_COMPU_METHOD 0 255 /end CHARACTERISTIC
/begin CHARACTERISTIC CAL_obd_ii_P0133 "Calibration: OBD-II P0133 (OBD-II monitor enable level)." VALUE 0x4000D1C0 RL_VALUE_UBYTE 0 NO_COMPU_METHOD 0 255 /end CHARACTERISTIC
/begin CHARACTERISTIC CAL_obd_ii_P0134 "Calibration: OBD-II P0134 (OBD-II monitor enable level)." VALUE 0x4000D1C1 RL_VALUE_UBYTE 0 NO_COMPU_METHOD 0 255 /end CHARACTERISTIC
/begin CHARACTERISTIC CAL_obd_ii_P0135 "Calibration: OBD-II P0135 (OBD-II monitor enable level)." VALUE 0x4000D1C2 RL_VALUE_UBYTE 0 NO_COMPU_METHOD 0 255 /end CHARACTERISTIC
/begin CHARACTERISTIC CAL_obd_ii_P2193 "Calibration: OBD-II P2193 (OBD-II monitor enable level)." VALUE 0x4000D1C3 RL_VALUE_UBYTE 0 NO_COMPU_METHOD 0 255 /end CHARACTERISTIC
/begin CHARACTERISTIC CAL_obd_ii_P0137 "Calibration: OBD-II P0137 (OBD-II monitor enable level)." VALUE 0x4000D1C4 RL_VALUE_UBYTE 0 NO_COMPU_METHOD 0 255 /end CHARACTERISTIC
/begin CHARACTERISTIC CAL_obd_ii_P0138 "Calibration: OBD-II P0138 (OBD-II monitor enable level)." VALUE 0x4000D1C5 RL_VALUE_UBYTE 0 NO_COMPU_METHOD 0 255 /end CHARACTERISTIC
/begin CHARACTERISTIC CAL_obd_ii_P0139 "Calibration: OBD-II P0139 (OBD-II monitor enable level)." VALUE 0x4000D1C6 RL_VALUE_UBYTE 0 NO_COMPU_METHOD 0 255 /end CHARACTERISTIC
/begin CHARACTERISTIC CAL_obd_ii_P0140 "Calibration: OBD-II P0140 (OBD-II monitor enable level)." VALUE 0x4000D1C7 RL_VALUE_UBYTE 0 NO_COMPU_METHOD 0 255 /end CHARACTERISTIC
/begin CHARACTERISTIC CAL_obd_ii_P0141 "Calibration: OBD-II P0141 (OBD-II monitor enable level)." VALUE 0x4000D1C8 RL_VALUE_UBYTE 0 NO_COMPU_METHOD 0 255 /end CHARACTERISTIC
/begin CHARACTERISTIC CAL_obd_ii_P0102 "Calibration: OBD-II P0102 (OBD-II monitor enable level)." VALUE 0x4000D1C9 RL_VALUE_UBYTE 0 NO_COMPU_METHOD 0 255 /end CHARACTERISTIC
/begin CHARACTERISTIC CAL_obd_ii_P0103 "Calibration: OBD-II P0103 (OBD-II monitor enable level)." VALUE 0x4000D1CA RL_VALUE_UBYTE 0 NO_COMPU_METHOD 0 255 /end CHARACTERISTIC
/begin CHARACTERISTIC CAL_obd_ii_P0101_manual "Calibration: OBD-II P0101 manual (OBD-II monitor enable level)." VALUE 0x4000D1CB RL_VALUE_UBYTE 0 NO_COMPU_METHOD 0 255 /end CHARACTERISTIC
/begin CHARACTERISTIC CAL_obd_ii_P2122 "Calibration: OBD-II P2122 (OBD-II monitor enable level)." VALUE 0x4000D1CC RL_VALUE_UBYTE 0 NO_COMPU_METHOD 0 255 /end CHARACTERISTIC
/begin CHARACTERISTIC CAL_obd_ii_P2123 "Calibration: OBD-II P2123 (OBD-II monitor enable level)." VALUE 0x4000D1CD RL_VALUE_UBYTE 0 NO_COMPU_METHOD 0 255 /end CHARACTERISTIC
/begin CHARACTERISTIC CAL_obd_ii_P2127 "Calibration: OBD-II P2127 (OBD-II monitor enable level)." VALUE 0x4000D1CE RL_VALUE_UBYTE 0 NO_COMPU_METHOD 0 255 /end CHARACTERISTIC
/begin CHARACTERISTIC CAL_obd_ii_P2128 "Calibration: OBD-II P2128 (OBD-II monitor enable level)." VALUE 0x4000D1CF RL_VALUE_UBYTE 0 NO_COMPU_METHOD 0 255 /end CHARACTERISTIC
/begin CHARACTERISTIC CAL_obd_ii_P0222 "Calibration: OBD-II P0222 (OBD-II monitor enable level)." VALUE 0x4000D1D0 RL_VALUE_UBYTE 0 NO_COMPU_METHOD 0 255 /end CHARACTERISTIC
/begin CHARACTERISTIC CAL_obd_ii_P0223 "Calibration: OBD-II P0223 (OBD-II monitor enable level)." VALUE 0x4000D1D1 RL_VALUE_UBYTE 0 NO_COMPU_METHOD 0 255 /end CHARACTERISTIC
/begin CHARACTERISTIC CAL_obd_ii_P2135 "Calibration: OBD-II P2135 (OBD-II monitor enable level)." VALUE 0x4000D1D2 RL_VALUE_UBYTE 0 NO_COMPU_METHOD 0 255 /end CHARACTERISTIC
/begin CHARACTERISTIC CAL_obd_ii_P0638 "Calibration: OBD-II P0638 (OBD-II monitor enable level)." VALUE 0x4000D1D3 RL_VALUE_UBYTE 0 NO_COMPU_METHOD 0 255 /end CHARACTERISTIC
/begin CHARACTERISTIC CAL_obd_ii_P2119 "Calibration: OBD-II P2119 (OBD-II monitor enable level)." VALUE 0x4000D1D4 RL_VALUE_UBYTE 0 NO_COMPU_METHOD 0 255 /end CHARACTERISTIC
/begin CHARACTERISTIC CAL_obd_ii_P1106 "Calibration: OBD-II P1106 (OBD-II monitor enable level)." VALUE 0x4000D1D5 RL_VALUE_UBYTE 0 NO_COMPU_METHOD 0 255 /end CHARACTERISTIC
/begin CHARACTERISTIC CAL_obd_ii_P0171 "Calibration: OBD-II P0171 (OBD-II monitor enable level)." VALUE 0x4000D1D6 RL_VALUE_UBYTE 0 NO_COMPU_METHOD 0 255 /end CHARACTERISTIC
/begin CHARACTERISTIC CAL_obd_ii_P0172 "Calibration: OBD-II P0172 (OBD-II monitor enable level)." VALUE 0x4000D1D7 RL_VALUE_UBYTE 0 NO_COMPU_METHOD 0 255 /end CHARACTERISTIC
/begin CHARACTERISTIC CAL_obd_ii_P0627 "Calibration: OBD-II P0627 (OBD-II monitor enable level)." VALUE 0x4000D1D8 RL_VALUE_UBYTE 0 NO_COMPU_METHOD 0 255 /end CHARACTERISTIC
/begin CHARACTERISTIC CAL_obd_ii_P0076 "Calibration: OBD-II P0076 (OBD-II monitor enable level)." VALUE 0x4000D1D9 RL_VALUE_UBYTE 0 NO_COMPU_METHOD 0 255 /end CHARACTERISTIC
/begin CHARACTERISTIC CAL_obd_ii_P0077 "Calibration: OBD-II P0077 (OBD-II monitor enable level)." VALUE 0x4000D1DA RL_VALUE_UBYTE 0 NO_COMPU_METHOD 0 255 /end CHARACTERISTIC
/begin CHARACTERISTIC CAL_obd_ii_P0261 "Calibration: OBD-II P0261 (OBD-II monitor enable level)." VALUE 0x4000D1DB RL_VALUE_UBYTE 0 NO_COMPU_METHOD 0 255 /end CHARACTERISTIC
/begin CHARACTERISTIC CAL_obd_ii_P0262 "Calibration: OBD-II P0262 (OBD-II monitor enable level)." VALUE 0x4000D1DC RL_VALUE_UBYTE 0 NO_COMPU_METHOD 0 255 /end CHARACTERISTIC
/begin CHARACTERISTIC CAL_obd_ii_P0264 "Calibration: OBD-II P0264 (OBD-II monitor enable level)." VALUE 0x4000D1DD RL_VALUE_UBYTE 0 NO_COMPU_METHOD 0 255 /end CHARACTERISTIC
/begin CHARACTERISTIC CAL_obd_ii_P0265 "Calibration: OBD-II P0265 (OBD-II monitor enable level)." VALUE 0x4000D1DE RL_VALUE_UBYTE 0 NO_COMPU_METHOD 0 255 /end CHARACTERISTIC
/begin CHARACTERISTIC CAL_obd_ii_P0267 "Calibration: OBD-II P0267 (OBD-II monitor enable level)." VALUE 0x4000D1DF RL_VALUE_UBYTE 0 NO_COMPU_METHOD 0 255 /end CHARACTERISTIC
/begin CHARACTERISTIC CAL_obd_ii_P0268 "Calibration: OBD-II P0268 (OBD-II monitor enable level)." VALUE 0x4000D1E0 RL_VALUE_UBYTE 0 NO_COMPU_METHOD 0 255 /end CHARACTERISTIC
/begin CHARACTERISTIC CAL_obd_ii_P0270 "Calibration: OBD-II P0270 (OBD-II monitor enable level)." VALUE 0x4000D1E1 RL_VALUE_UBYTE 0 NO_COMPU_METHOD 0 255 /end CHARACTERISTIC
/begin CHARACTERISTIC CAL_obd_ii_P0271 "Calibration: OBD-II P0271 (OBD-II monitor enable level)." VALUE 0x4000D1E2 RL_VALUE_UBYTE 0 NO_COMPU_METHOD 0 255 /end CHARACTERISTIC
/begin CHARACTERISTIC CAL_obd_ii_P0273 "Calibration: OBD-II P0273 (OBD-II monitor enable level)." VALUE 0x4000D1E3 RL_VALUE_UBYTE 0 NO_COMPU_METHOD 0 255 /end CHARACTERISTIC
/begin CHARACTERISTIC CAL_obd_ii_P0274 "Calibration: OBD-II P0274 (OBD-II monitor enable level)." VALUE 0x4000D1E4 RL_VALUE_UBYTE 0 NO_COMPU_METHOD 0 255 /end CHARACTERISTIC
/begin CHARACTERISTIC CAL_obd_ii_P0276 "Calibration: OBD-II P0276 (OBD-II monitor enable level)." VALUE 0x4000D1E5 RL_VALUE_UBYTE 0 NO_COMPU_METHOD 0 255 /end CHARACTERISTIC
/begin CHARACTERISTIC CAL_obd_ii_P0277 "Calibration: OBD-II P0277 (OBD-II monitor enable level)." VALUE 0x4000D1E6 RL_VALUE_UBYTE 0 NO_COMPU_METHOD 0 255 /end CHARACTERISTIC
/begin CHARACTERISTIC CAL_obd_ii_P025C "Calibration: OBD-II P025C (OBD-II monitor enable level)." VALUE 0x4000D1E7 RL_VALUE_UBYTE 0 NO_COMPU_METHOD 0 255 /end CHARACTERISTIC
/begin CHARACTERISTIC CAL_obd_ii_P0351 "Calibration: OBD-II P0351 (OBD-II monitor enable level)." VALUE 0x4000D1E8 RL_VALUE_UBYTE 0 NO_COMPU_METHOD 0 255 /end CHARACTERISTIC
/begin CHARACTERISTIC CAL_obd_ii_P0352 "Calibration: OBD-II P0352 (OBD-II monitor enable level)." VALUE 0x4000D1E9 RL_VALUE_UBYTE 0 NO_COMPU_METHOD 0 255 /end CHARACTERISTIC
/begin CHARACTERISTIC CAL_obd_ii_P0353 "Calibration: OBD-II P0353 (OBD-II monitor enable level)." VALUE 0x4000D1EA RL_VALUE_UBYTE 0 NO_COMPU_METHOD 0 255 /end CHARACTERISTIC
/begin CHARACTERISTIC CAL_obd_ii_P0354 "Calibration: OBD-II P0354 (OBD-II monitor enable level)." VALUE 0x4000D1EB RL_VALUE_UBYTE 0 NO_COMPU_METHOD 0 255 /end CHARACTERISTIC
/begin CHARACTERISTIC CAL_obd_ii_P025D "Calibration: OBD-II P025D (OBD-II monitor enable level)." VALUE 0x4000D1EC RL_VALUE_UBYTE 0 NO_COMPU_METHOD 0 255 /end CHARACTERISTIC
/begin CHARACTERISTIC CAL_obd_ii_P0300 "Calibration: OBD-II P0300 (OBD-II monitor enable level)." VALUE 0x4000D1ED RL_VALUE_UBYTE 0 NO_COMPU_METHOD 0 255 /end CHARACTERISTIC
/begin CHARACTERISTIC CAL_obd_ii_P0301 "Calibration: OBD-II P0301 (OBD-II monitor enable level)." VALUE 0x4000D1EE RL_VALUE_UBYTE 0 NO_COMPU_METHOD 0 255 /end CHARACTERISTIC
/begin CHARACTERISTIC CAL_obd_ii_P0302 "Calibration: OBD-II P0302 (OBD-II monitor enable level)." VALUE 0x4000D1EF RL_VALUE_UBYTE 0 NO_COMPU_METHOD 0 255 /end CHARACTERISTIC
/begin CHARACTERISTIC CAL_obd_ii_P0303 "Calibration: OBD-II P0303 (OBD-II monitor enable level)." VALUE 0x4000D1F0 RL_VALUE_UBYTE 0 NO_COMPU_METHOD 0 255 /end CHARACTERISTIC
/begin CHARACTERISTIC CAL_obd_ii_P0304 "Calibration: OBD-II P0304 (OBD-II monitor enable level)." VALUE 0x4000D1F1 RL_VALUE_UBYTE 0 NO_COMPU_METHOD 0 255 /end CHARACTERISTIC
/begin CHARACTERISTIC CAL_obd_ii_P0305 "Calibration: OBD-II P0305 (OBD-II monitor enable level)." VALUE 0x4000D1F2 RL_VALUE_UBYTE 0 NO_COMPU_METHOD 0 255 /end CHARACTERISTIC
/begin CHARACTERISTIC CAL_obd_ii_P0306 "Calibration: OBD-II P0306 (OBD-II monitor enable level)." VALUE 0x4000D1F3 RL_VALUE_UBYTE 0 NO_COMPU_METHOD 0 255 /end CHARACTERISTIC
/begin CHARACTERISTIC CAL_obd_ii_P0700 "Calibration: OBD-II P0700 (OBD-II monitor enable level)." VALUE 0x4000D1F4 RL_VALUE_UBYTE 0 NO_COMPU_METHOD 0 255 /end CHARACTERISTIC
/begin CHARACTERISTIC CAL_obd_ii_P0571 "Calibration: OBD-II P0571 (OBD-II monitor enable level)." VALUE 0x4000D1F5 RL_VALUE_UBYTE 0 NO_COMPU_METHOD 0 255 /end CHARACTERISTIC
/begin CHARACTERISTIC CAL_obd_ii_P0327 "Calibration: OBD-II P0327 (OBD-II monitor enable level)." VALUE 0x4000D1F6 RL_VALUE_UBYTE 0 NO_COMPU_METHOD 0 255 /end CHARACTERISTIC
/begin CHARACTERISTIC CAL_obd_ii_P0328 "Calibration: OBD-II P0328 (OBD-II monitor enable level)." VALUE 0x4000D1F7 RL_VALUE_UBYTE 0 NO_COMPU_METHOD 0 255 /end CHARACTERISTIC
/begin CHARACTERISTIC CAL_obd_ii_P0335 "Calibration: OBD-II P0335 (OBD-II monitor enable level)." VALUE 0x4000D1F8 RL_VALUE_UBYTE 0 NO_COMPU_METHOD 0 255 /end CHARACTERISTIC
/begin CHARACTERISTIC CAL_obd_ii_P0826 "Calibration: OBD-II P0826 (OBD-II monitor enable level)." VALUE 0x4000D1F9 RL_VALUE_UBYTE 0 NO_COMPU_METHOD 0 255 /end CHARACTERISTIC
/begin CHARACTERISTIC CAL_obd_ii_P1301 "Calibration: OBD-II P1301 (OBD-II monitor enable level)." VALUE 0x4000D1FA RL_VALUE_UBYTE 0 NO_COMPU_METHOD 0 255 /end CHARACTERISTIC
/begin CHARACTERISTIC CAL_obd_ii_P1302 "Calibration: OBD-II P1302 (OBD-II monitor enable level)." VALUE 0x4000D1FB RL_VALUE_UBYTE 0 NO_COMPU_METHOD 0 255 /end CHARACTERISTIC
/begin CHARACTERISTIC CAL_obd_ii_P0014 "Calibration: OBD-II P0014 (OBD-II monitor enable level)." VALUE 0x4000D1FC RL_VALUE_UBYTE 0 NO_COMPU_METHOD 0 255 /end CHARACTERISTIC
/begin CHARACTERISTIC CAL_obd_ii_P0015 "Calibration: OBD-II P0015 (OBD-II monitor enable level)." VALUE 0x4000D1FD RL_VALUE_UBYTE 0 NO_COMPU_METHOD 0 255 /end CHARACTERISTIC
/begin CHARACTERISTIC CAL_obd_ii_P0024 "Calibration: OBD-II P0024 (OBD-II monitor enable level)." VALUE 0x4000D1FE RL_VALUE_UBYTE 0 NO_COMPU_METHOD 0 255 /end CHARACTERISTIC
/begin CHARACTERISTIC CAL_obd_ii_P0025 "Calibration: OBD-II P0025 (OBD-II monitor enable level)." VALUE 0x4000D1FF RL_VALUE_UBYTE 0 NO_COMPU_METHOD 0 255 /end CHARACTERISTIC
/begin CHARACTERISTIC CAL_obd_ii_P0079 "Calibration: OBD-II P0079 (OBD-II monitor enable level)." VALUE 0x4000D200 RL_VALUE_UBYTE 0 NO_COMPU_METHOD 0 255 /end CHARACTERISTIC
/begin CHARACTERISTIC CAL_obd_ii_P0080 "Calibration: OBD-II P0080 (OBD-II monitor enable level)." VALUE 0x4000D201 RL_VALUE_UBYTE 0 NO_COMPU_METHOD 0 255 /end CHARACTERISTIC
/begin CHARACTERISTIC CAL_obd_ii_P0082 "Calibration: OBD-II P0082 (OBD-II monitor enable level)." VALUE 0x4000D202 RL_VALUE_UBYTE 0 NO_COMPU_METHOD 0 255 /end CHARACTERISTIC
/begin CHARACTERISTIC CAL_obd_ii_P0083 "Calibration: OBD-II P0083 (OBD-II monitor enable level)." VALUE 0x4000D203 RL_VALUE_UBYTE 0 NO_COMPU_METHOD 0 255 /end CHARACTERISTIC
/begin CHARACTERISTIC CAL_obd_ii_P0420 "Calibration: OBD-II P0420 (OBD-II monitor enable level)." VALUE 0x4000D204 RL_VALUE_UBYTE 0 NO_COMPU_METHOD 0 255 /end CHARACTERISTIC
/begin CHARACTERISTIC CAL_obd_ii_P0085 "Calibration: OBD-II P0085 (OBD-II monitor enable level)." VALUE 0x4000D205 RL_VALUE_UBYTE 0 NO_COMPU_METHOD 0 255 /end CHARACTERISTIC
/begin CHARACTERISTIC CAL_obd_ii_P0086 "Calibration: OBD-II P0086 (OBD-II monitor enable level)." VALUE 0x4000D206 RL_VALUE_UBYTE 0 NO_COMPU_METHOD 0 255 /end CHARACTERISTIC
/begin CHARACTERISTIC CAL_obd_ii_P0827 "Calibration: OBD-II P0827 (OBD-II monitor enable level)." VALUE 0x4000D207 RL_VALUE_UBYTE 0 NO_COMPU_METHOD 0 255 /end CHARACTERISTIC
/begin CHARACTERISTIC CAL_obd_ii_P1809 "Calibration: OBD-II P1809 (OBD-II monitor enable level)." VALUE 0x4000D208 RL_VALUE_UBYTE 0 NO_COMPU_METHOD 0 255 /end CHARACTERISTIC
/begin CHARACTERISTIC CAL_obd_ii_P0430 "Calibration: OBD-II P0430 (OBD-II monitor enable level)." VALUE 0x4000D209 RL_VALUE_UBYTE 0 NO_COMPU_METHOD 0 255 /end CHARACTERISTIC
/begin CHARACTERISTIC CAL_obd_ii_P0355 "Calibration: OBD-II P0355 (OBD-II monitor enable level)." VALUE 0x4000D20A RL_VALUE_UBYTE 0 NO_COMPU_METHOD 0 255 /end CHARACTERISTIC
/begin CHARACTERISTIC CAL_obd_ii_P0356 "Calibration: OBD-II P0356 (OBD-II monitor enable level)." VALUE 0x4000D20B RL_VALUE_UBYTE 0 NO_COMPU_METHOD 0 255 /end CHARACTERISTIC
/begin CHARACTERISTIC CAL_obd_ii_P0579 "Calibration: OBD-II P0579 (OBD-II monitor enable level)." VALUE 0x4000D20C RL_VALUE_UBYTE 0 NO_COMPU_METHOD 0 255 /end CHARACTERISTIC
/begin CHARACTERISTIC CAL_obd_ii_P1104 "Calibration: OBD-II P1104 (OBD-II monitor enable level)." VALUE 0x4000D20D RL_VALUE_UBYTE 0 NO_COMPU_METHOD 0 255 /end CHARACTERISTIC
/begin CHARACTERISTIC CAL_obd_ii_P0828 "Calibration: OBD-II P0828 (OBD-II monitor enable level)." VALUE 0x4000D20E RL_VALUE_UBYTE 0 NO_COMPU_METHOD 0 255 /end CHARACTERISTIC
/begin CHARACTERISTIC CAL_obd_ii_P0441 "Calibration: OBD-II P0441 (OBD-II monitor enable level)." VALUE 0x4000D20F RL_VALUE_UBYTE 0 NO_COMPU_METHOD 0 255 /end CHARACTERISTIC
/begin CHARACTERISTIC CAL_obd_ii_P0442 "Calibration: OBD-II P0442 (OBD-II monitor enable level)." VALUE 0x4000D210 RL_VALUE_UBYTE 0 NO_COMPU_METHOD 0 255 /end CHARACTERISTIC
/begin CHARACTERISTIC CAL_obd_ii_P050B "Calibration: OBD-II P050B (OBD-II monitor enable level)." VALUE 0x4000D211 RL_VALUE_UBYTE 0 NO_COMPU_METHOD 0 255 /end CHARACTERISTIC
/begin CHARACTERISTIC CAL_obd_ii_P0444 "Calibration: OBD-II P0444 (OBD-II monitor enable level)." VALUE 0x4000D212 RL_VALUE_UBYTE 0 NO_COMPU_METHOD 0 255 /end CHARACTERISTIC
/begin CHARACTERISTIC CAL_obd_ii_P0445 "Calibration: OBD-II P0445 (OBD-II monitor enable level)." VALUE 0x4000D213 RL_VALUE_UBYTE 0 NO_COMPU_METHOD 0 255 /end CHARACTERISTIC
/begin CHARACTERISTIC CAL_obd_ii_P0446 "Calibration: OBD-II P0446 (OBD-II monitor enable level)." VALUE 0x4000D214 RL_VALUE_UBYTE 0 NO_COMPU_METHOD 0 255 /end CHARACTERISTIC
/begin CHARACTERISTIC CAL_obd_ii_P0447 "Calibration: OBD-II P0447 (OBD-II monitor enable level)." VALUE 0x4000D215 RL_VALUE_UBYTE 0 NO_COMPU_METHOD 0 255 /end CHARACTERISTIC
/begin CHARACTERISTIC CAL_obd_ii_P0448 "Calibration: OBD-II P0448 (OBD-II monitor enable level)." VALUE 0x4000D216 RL_VALUE_UBYTE 0 NO_COMPU_METHOD 0 255 /end CHARACTERISTIC
/begin CHARACTERISTIC CAL_obd_ii_P050A "Calibration: OBD-II P050A (OBD-II monitor enable level)." VALUE 0x4000D217 RL_VALUE_UBYTE 0 NO_COMPU_METHOD 0 255 /end CHARACTERISTIC
/begin CHARACTERISTIC CAL_obd_ii_P0451 "Calibration: OBD-II P0451 (OBD-II monitor enable level)." VALUE 0x4000D218 RL_VALUE_UBYTE 0 NO_COMPU_METHOD 0 255 /end CHARACTERISTIC
/begin CHARACTERISTIC CAL_obd_ii_P0452 "Calibration: OBD-II P0452 (OBD-II monitor enable level)." VALUE 0x4000D219 RL_VALUE_UBYTE 0 NO_COMPU_METHOD 0 255 /end CHARACTERISTIC
/begin CHARACTERISTIC CAL_obd_ii_P0453 "Calibration: OBD-II P0453 (OBD-II monitor enable level)." VALUE 0x4000D21A RL_VALUE_UBYTE 0 NO_COMPU_METHOD 0 255 /end CHARACTERISTIC
/begin CHARACTERISTIC CAL_obd_ii_P0480 "Calibration: OBD-II P0480 (OBD-II monitor enable level)." VALUE 0x4000D21B RL_VALUE_UBYTE 0 NO_COMPU_METHOD 0 255 /end CHARACTERISTIC
/begin CHARACTERISTIC CAL_obd_ii_P1109 "Calibration: OBD-II P1109 (OBD-II monitor enable level)." VALUE 0x4000D21C RL_VALUE_UBYTE 0 NO_COMPU_METHOD 0 255 /end CHARACTERISTIC
/begin CHARACTERISTIC CAL_obd_ii_P0341 "Calibration: OBD-II P0341 (OBD-II monitor enable level)." VALUE 0x4000D21D RL_VALUE_UBYTE 0 NO_COMPU_METHOD 0 255 /end CHARACTERISTIC
/begin CHARACTERISTIC CAL_obd_ii_P0346 "Calibration: OBD-II P0346 (OBD-II monitor enable level)." VALUE 0x4000D21E RL_VALUE_UBYTE 0 NO_COMPU_METHOD 0 255 /end CHARACTERISTIC
/begin CHARACTERISTIC CAL_obd_ii_P0366 "Calibration: OBD-II P0366 (OBD-II monitor enable level)." VALUE 0x4000D21F RL_VALUE_UBYTE 0 NO_COMPU_METHOD 0 255 /end CHARACTERISTIC
/begin CHARACTERISTIC CAL_obd_ii_P0391 "Calibration: OBD-II P0391 (OBD-II monitor enable level)." VALUE 0x4000D220 RL_VALUE_UBYTE 0 NO_COMPU_METHOD 0 255 /end CHARACTERISTIC
/begin CHARACTERISTIC CAL_obd_ii_P0482 "Calibration: OBD-II P0482 (OBD-II monitor enable level)." VALUE 0x4000D221 RL_VALUE_UBYTE 0 NO_COMPU_METHOD 0 255 /end CHARACTERISTIC
/begin CHARACTERISTIC CAL_obd_ii_P0461 "Calibration: OBD-II P0461 (OBD-II monitor enable level)." VALUE 0x4000D222 RL_VALUE_UBYTE 0 NO_COMPU_METHOD 0 255 /end CHARACTERISTIC
/begin CHARACTERISTIC CAL_obd_ii_P0462 "Calibration: OBD-II P0462 (OBD-II monitor enable level)." VALUE 0x4000D223 RL_VALUE_UBYTE 0 NO_COMPU_METHOD 0 255 /end CHARACTERISTIC
/begin CHARACTERISTIC CAL_obd_ii_P0463 "Calibration: OBD-II P0463 (OBD-II monitor enable level)." VALUE 0x4000D224 RL_VALUE_UBYTE 0 NO_COMPU_METHOD 0 255 /end CHARACTERISTIC
/begin CHARACTERISTIC CAL_obd_ii_P0523 "Calibration: OBD-II P0523 (OBD-II monitor enable level)." VALUE 0x4000D225 RL_VALUE_UBYTE 0 NO_COMPU_METHOD 0 255 /end CHARACTERISTIC
/begin CHARACTERISTIC CAL_obd_ii_P0563 "Calibration: OBD-II P0563 (OBD-II monitor enable level)." VALUE 0x4000D226 RL_VALUE_UBYTE 0 NO_COMPU_METHOD 0 255 /end CHARACTERISTIC
/begin CHARACTERISTIC CAL_obd_ii_P0562 "Calibration: OBD-II P0562 (OBD-II monitor enable level)." VALUE 0x4000D227 RL_VALUE_UBYTE 0 NO_COMPU_METHOD 0 255 /end CHARACTERISTIC
/begin CHARACTERISTIC CAL_obd_ii_P0685 "Calibration: OBD-II P0685 (OBD-II monitor enable level)." VALUE 0x4000D228 RL_VALUE_UBYTE 0 NO_COMPU_METHOD 0 255 /end CHARACTERISTIC
/begin CHARACTERISTIC CAL_obd_ii_P0610 "Calibration: OBD-II P0610 (OBD-II monitor enable level)." VALUE 0x4000D229 RL_VALUE_UBYTE 0 NO_COMPU_METHOD 0 255 /end CHARACTERISTIC
/begin CHARACTERISTIC CAL_obd_ii_P0646 "Calibration: OBD-II P0646 (OBD-II monitor enable level)." VALUE 0x4000D22A RL_VALUE_UBYTE 0 NO_COMPU_METHOD 0 255 /end CHARACTERISTIC
/begin CHARACTERISTIC CAL_obd_ii_P0647 "Calibration: OBD-II P0647 (OBD-II monitor enable level)." VALUE 0x4000D22B RL_VALUE_UBYTE 0 NO_COMPU_METHOD 0 255 /end CHARACTERISTIC
/begin CHARACTERISTIC CAL_obd_ii_P0500 "Calibration: OBD-II P0500 (OBD-II monitor enable level)." VALUE 0x4000D22C RL_VALUE_UBYTE 0 NO_COMPU_METHOD 0 255 /end CHARACTERISTIC
/begin CHARACTERISTIC CAL_obd_ii_P0506 "Calibration: OBD-II P0506 (OBD-II monitor enable level)." VALUE 0x4000D22D RL_VALUE_UBYTE 0 NO_COMPU_METHOD 0 255 /end CHARACTERISTIC
/begin CHARACTERISTIC CAL_obd_ii_P0507 "Calibration: OBD-II P0507 (OBD-II monitor enable level)." VALUE 0x4000D22E RL_VALUE_UBYTE 0 NO_COMPU_METHOD 0 255 /end CHARACTERISTIC
/begin CHARACTERISTIC CAL_obd_ii_P0096 "Calibration: OBD-II P0096 (OBD-II monitor enable level)." VALUE 0x4000D22F RL_VALUE_UBYTE 0 NO_COMPU_METHOD 0 255 /end CHARACTERISTIC
/begin CHARACTERISTIC CAL_obd_ii_P0072 "Calibration: OBD-II P0072 (OBD-II monitor enable level)." VALUE 0x4000D230 RL_VALUE_UBYTE 0 NO_COMPU_METHOD 0 255 /end CHARACTERISTIC
/begin CHARACTERISTIC CAL_obd_ii_P0073 "Calibration: OBD-II P0073 (OBD-II monitor enable level)." VALUE 0x4000D231 RL_VALUE_UBYTE 0 NO_COMPU_METHOD 0 255 /end CHARACTERISTIC
/begin CHARACTERISTIC CAL_obd_ii_P0616 "Calibration: OBD-II P0616 (OBD-II monitor enable level)." VALUE 0x4000D232 RL_VALUE_UBYTE 0 NO_COMPU_METHOD 0 255 /end CHARACTERISTIC
/begin CHARACTERISTIC CAL_obd_ii_P0617 "Calibration: OBD-II P0617 (OBD-II monitor enable level)." VALUE 0x4000D233 RL_VALUE_UBYTE 0 NO_COMPU_METHOD 0 255 /end CHARACTERISTIC
/begin CHARACTERISTIC CAL_obd_ii_P0630 "Calibration: OBD-II P0630 (OBD-II monitor enable level)." VALUE 0x4000D234 RL_VALUE_UBYTE 0 NO_COMPU_METHOD 0 255 /end CHARACTERISTIC
/begin CHARACTERISTIC CAL_obd_ii_P2138 "Calibration: OBD-II P2138 (OBD-II monitor enable level)." VALUE 0x4000D235 RL_VALUE_UBYTE 0 NO_COMPU_METHOD 0 255 /end CHARACTERISTIC
/begin CHARACTERISTIC CAL_obd_ii_P2602 "Calibration: OBD-II P2602 (OBD-II monitor enable level)." VALUE 0x4000D236 RL_VALUE_UBYTE 0 NO_COMPU_METHOD 0 255 /end CHARACTERISTIC
/begin CHARACTERISTIC CAL_obd_ii_P2603 "Calibration: OBD-II P2603 (OBD-II monitor enable level)." VALUE 0x4000D237 RL_VALUE_UBYTE 0 NO_COMPU_METHOD 0 255 /end CHARACTERISTIC
/begin CHARACTERISTIC CAL_obd_ii_P0011 "Calibration: OBD-II P0011 (OBD-II monitor enable level)." VALUE 0x4000D238 RL_VALUE_UBYTE 0 NO_COMPU_METHOD 0 255 /end CHARACTERISTIC
/begin CHARACTERISTIC CAL_obd_ii_P0012 "Calibration: OBD-II P0012 (OBD-II monitor enable level)." VALUE 0x4000D239 RL_VALUE_UBYTE 0 NO_COMPU_METHOD 0 255 /end CHARACTERISTIC
/begin CHARACTERISTIC CAL_obd_ii_P0601 "Calibration: OBD-II P0601 (OBD-II monitor enable level)." VALUE 0x4000D23A RL_VALUE_UBYTE 0 NO_COMPU_METHOD 0 255 /end CHARACTERISTIC
/begin CHARACTERISTIC CAL_obd_ii_P0606 "Calibration: OBD-II P0606 (OBD-II monitor enable level)." VALUE 0x4000D23B RL_VALUE_UBYTE 0 NO_COMPU_METHOD 0 255 /end CHARACTERISTIC
/begin CHARACTERISTIC CAL_obd_ii_P0455 "Calibration: OBD-II P0455 (OBD-II monitor enable level)." VALUE 0x4000D23C RL_VALUE_UBYTE 0 NO_COMPU_METHOD 0 255 /end CHARACTERISTIC
/begin CHARACTERISTIC CAL_obd_ii_P0456 "Calibration: OBD-II P0456 (OBD-II monitor enable level)." VALUE 0x4000D23D RL_VALUE_UBYTE 0 NO_COMPU_METHOD 0 255 /end CHARACTERISTIC
/begin CHARACTERISTIC CAL_obd_ii_P0016 "Calibration: OBD-II P0016 (OBD-II monitor enable level)." VALUE 0x4000D23E RL_VALUE_UBYTE 0 NO_COMPU_METHOD 0 255 /end CHARACTERISTIC
/begin CHARACTERISTIC CAL_obd_ii_P2173 "Calibration: OBD-II P2173 (OBD-II monitor enable level)." VALUE 0x4000D23F RL_VALUE_UBYTE 0 NO_COMPU_METHOD 0 255 /end CHARACTERISTIC
/begin CHARACTERISTIC CAL_obd_ii_P2104 "Calibration: OBD-II P2104 (OBD-II monitor enable level)." VALUE 0x4000D240 RL_VALUE_UBYTE 0 NO_COMPU_METHOD 0 255 /end CHARACTERISTIC
/begin CHARACTERISTIC CAL_obd_ii_P2105 "Calibration: OBD-II P2105 (OBD-II monitor enable level)." VALUE 0x4000D241 RL_VALUE_UBYTE 0 NO_COMPU_METHOD 0 255 /end CHARACTERISTIC
/begin CHARACTERISTIC CAL_obd_ii_P2106 "Calibration: OBD-II P2106 (OBD-II monitor enable level)." VALUE 0x4000D242 RL_VALUE_UBYTE 0 NO_COMPU_METHOD 0 255 /end CHARACTERISTIC
/begin CHARACTERISTIC CAL_obd_ii_P2107 "Calibration: OBD-II P2107 (OBD-II monitor enable level)." VALUE 0x4000D243 RL_VALUE_UBYTE 0 NO_COMPU_METHOD 0 255 /end CHARACTERISTIC
/begin CHARACTERISTIC CAL_obd_ii_P2100 "Calibration: OBD-II P2100 (OBD-II monitor enable level)." VALUE 0x4000D244 RL_VALUE_UBYTE 0 NO_COMPU_METHOD 0 255 /end CHARACTERISTIC
/begin CHARACTERISTIC CAL_obd_ii_P2102 "Calibration: OBD-II P2102 (OBD-II monitor enable level)." VALUE 0x4000D245 RL_VALUE_UBYTE 0 NO_COMPU_METHOD 0 255 /end CHARACTERISTIC
/begin CHARACTERISTIC CAL_obd_ii_P2103 "Calibration: OBD-II P2103 (OBD-II monitor enable level)." VALUE 0x4000D246 RL_VALUE_UBYTE 0 NO_COMPU_METHOD 0 255 /end CHARACTERISTIC
/begin CHARACTERISTIC CAL_obd_ii_P2108 "Calibration: OBD-II P2108 (OBD-II monitor enable level)." VALUE 0x4000D247 RL_VALUE_UBYTE 0 NO_COMPU_METHOD 0 255 /end CHARACTERISTIC
/begin CHARACTERISTIC CAL_obd_ii_P0151 "Calibration: OBD-II P0151 (OBD-II monitor enable level)." VALUE 0x4000D248 RL_VALUE_UBYTE 0 NO_COMPU_METHOD 0 255 /end CHARACTERISTIC
/begin CHARACTERISTIC CAL_obd_ii_P0152 "Calibration: OBD-II P0152 (OBD-II monitor enable level)." VALUE 0x4000D249 RL_VALUE_UBYTE 0 NO_COMPU_METHOD 0 255 /end CHARACTERISTIC
/begin CHARACTERISTIC CAL_obd_ii_P0153 "Calibration: OBD-II P0153 (OBD-II monitor enable level)." VALUE 0x4000D24A RL_VALUE_UBYTE 0 NO_COMPU_METHOD 0 255 /end CHARACTERISTIC
/begin CHARACTERISTIC CAL_obd_ii_P0154 "Calibration: OBD-II P0154 (OBD-II monitor enable level)." VALUE 0x4000D24B RL_VALUE_UBYTE 0 NO_COMPU_METHOD 0 255 /end CHARACTERISTIC
/begin CHARACTERISTIC CAL_obd_ii_P0155 "Calibration: OBD-II P0155 (OBD-II monitor enable level)." VALUE 0x4000D24C RL_VALUE_UBYTE 0 NO_COMPU_METHOD 0 255 /end CHARACTERISTIC
/begin CHARACTERISTIC CAL_obd_ii_P0157 "Calibration: OBD-II P0157 (OBD-II monitor enable level)." VALUE 0x4000D24D RL_VALUE_UBYTE 0 NO_COMPU_METHOD 0 255 /end CHARACTERISTIC
/begin CHARACTERISTIC CAL_obd_ii_P0158 "Calibration: OBD-II P0158 (OBD-II monitor enable level)." VALUE 0x4000D24E RL_VALUE_UBYTE 0 NO_COMPU_METHOD 0 255 /end CHARACTERISTIC
/begin CHARACTERISTIC CAL_obd_ii_P0159 "Calibration: OBD-II P0159 (OBD-II monitor enable level)." VALUE 0x4000D24F RL_VALUE_UBYTE 0 NO_COMPU_METHOD 0 255 /end CHARACTERISTIC
/begin CHARACTERISTIC CAL_obd_ii_P0160 "Calibration: OBD-II P0160 (OBD-II monitor enable level)." VALUE 0x4000D250 RL_VALUE_UBYTE 0 NO_COMPU_METHOD 0 255 /end CHARACTERISTIC
/begin CHARACTERISTIC CAL_obd_ii_P0161 "Calibration: OBD-II P0161 (OBD-II monitor enable level)." VALUE 0x4000D251 RL_VALUE_UBYTE 0 NO_COMPU_METHOD 0 255 /end CHARACTERISTIC
/begin CHARACTERISTIC CAL_obd_ii_P0174 "Calibration: OBD-II P0174 (OBD-II monitor enable level)." VALUE 0x4000D252 RL_VALUE_UBYTE 0 NO_COMPU_METHOD 0 255 /end CHARACTERISTIC
/begin CHARACTERISTIC CAL_obd_ii_P0175 "Calibration: OBD-II P0175 (OBD-II monitor enable level)." VALUE 0x4000D253 RL_VALUE_UBYTE 0 NO_COMPU_METHOD 0 255 /end CHARACTERISTIC
/begin CHARACTERISTIC CAL_obd_ii_P0332 "Calibration: OBD-II P0332 (OBD-II monitor enable level)." VALUE 0x4000D254 RL_VALUE_UBYTE 0 NO_COMPU_METHOD 0 255 /end CHARACTERISTIC
/begin CHARACTERISTIC CAL_obd_ii_P0333 "Calibration: OBD-II P0333 (OBD-II monitor enable level)." VALUE 0x4000D255 RL_VALUE_UBYTE 0 NO_COMPU_METHOD 0 255 /end CHARACTERISTIC
/begin CHARACTERISTIC CAL_obd_ii_P0021 "Calibration: OBD-II P0021 (OBD-II monitor enable level)." VALUE 0x4000D256 RL_VALUE_UBYTE 0 NO_COMPU_METHOD 0 255 /end CHARACTERISTIC
/begin CHARACTERISTIC CAL_obd_ii_P0022 "Calibration: OBD-II P0022 (OBD-II monitor enable level)." VALUE 0x4000D257 RL_VALUE_UBYTE 0 NO_COMPU_METHOD 0 255 /end CHARACTERISTIC
/begin CHARACTERISTIC CAL_obd_ii_P0017 "Calibration: OBD-II P0017 (OBD-II monitor enable level)." VALUE 0x4000D258 RL_VALUE_UBYTE 0 NO_COMPU_METHOD 0 255 /end CHARACTERISTIC
/begin CHARACTERISTIC CAL_obd_ii_P0018 "Calibration: OBD-II P0018 (OBD-II monitor enable level)." VALUE 0x4000D259 RL_VALUE_UBYTE 0 NO_COMPU_METHOD 0 255 /end CHARACTERISTIC
/begin CHARACTERISTIC CAL_obd_ii_P0019 "Calibration: OBD-II P0019 (OBD-II monitor enable level)." VALUE 0x4000D25A RL_VALUE_UBYTE 0 NO_COMPU_METHOD 0 255 /end CHARACTERISTIC
/begin CHARACTERISTIC CAL_obd_ii_P0578 "Calibration: OBD-II P0578 (OBD-II monitor enable level)." VALUE 0x4000D25B RL_VALUE_UBYTE 0 NO_COMPU_METHOD 0 255 /end CHARACTERISTIC
/begin CHARACTERISTIC CAL_obd_ii_P0564 "Calibration: OBD-II P0564 (OBD-II monitor enable level)." VALUE 0x4000D25C RL_VALUE_UBYTE 0 NO_COMPU_METHOD 0 255 /end CHARACTERISTIC
/begin CHARACTERISTIC CAL_obd_ii_P0806 "Calibration: OBD-II P0806 (OBD-II monitor enable level)." VALUE 0x4000D25D RL_VALUE_UBYTE 0 NO_COMPU_METHOD 0 255 /end CHARACTERISTIC
/begin CHARACTERISTIC CAL_obd_ii_P0807 "Calibration: OBD-II P0807 (OBD-II monitor enable level)." VALUE 0x4000D25E RL_VALUE_UBYTE 0 NO_COMPU_METHOD 0 255 /end CHARACTERISTIC
/begin CHARACTERISTIC CAL_obd_ii_P0808 "Calibration: OBD-II P0808 (OBD-II monitor enable level)." VALUE 0x4000D25F RL_VALUE_UBYTE 0 NO_COMPU_METHOD 0 255 /end CHARACTERISTIC
/begin CHARACTERISTIC CAL_obd_ii_P2612 "Calibration: OBD-II P2612 (OBD-II monitor enable level)." VALUE 0x4000D260 RL_VALUE_UBYTE 0 NO_COMPU_METHOD 0 255 /end CHARACTERISTIC
/begin CHARACTERISTIC CAL_obd_ii_P2613 "Calibration: OBD-II P2613 (OBD-II monitor enable level)." VALUE 0x4000D261 RL_VALUE_UBYTE 0 NO_COMPU_METHOD 0 255 /end CHARACTERISTIC
/begin CHARACTERISTIC CAL_obd_ii_P0537 "Calibration: OBD-II P0537 (OBD-II monitor enable level)." VALUE 0x4000D262 RL_VALUE_UBYTE 0 NO_COMPU_METHOD 0 255 /end CHARACTERISTIC
/begin CHARACTERISTIC CAL_obd_ii_P0538 "Calibration: OBD-II P0538 (OBD-II monitor enable level)." VALUE 0x4000D263 RL_VALUE_UBYTE 0 NO_COMPU_METHOD 0 255 /end CHARACTERISTIC
/begin CHARACTERISTIC CAL_obd_ii_U0155 "Calibration: OBD-II U0155 (OBD-II monitor enable level)." VALUE 0x4000D264 RL_VALUE_UBYTE 0 NO_COMPU_METHOD 0 255 /end CHARACTERISTIC
/begin CHARACTERISTIC CAL_obd_ii_U0101 "Calibration: OBD-II U0101 (OBD-II monitor enable level)." VALUE 0x4000D265 RL_VALUE_UBYTE 0 NO_COMPU_METHOD 0 255 /end CHARACTERISTIC
/begin CHARACTERISTIC CAL_obd_ii_U0122 "Calibration: OBD-II U0122 (OBD-II monitor enable level)." VALUE 0x4000D266 RL_VALUE_UBYTE 0 NO_COMPU_METHOD 0 255 /end CHARACTERISTIC
/begin CHARACTERISTIC CAL_obd_ii_U0316 "Calibration: OBD-II U0316 (OBD-II monitor enable level)." VALUE 0x4000D267 RL_VALUE_UBYTE 0 NO_COMPU_METHOD 0 255 /end CHARACTERISTIC
/begin CHARACTERISTIC CAL_obd_ii_U0141 "Calibration: OBD-II U0141 (OBD-II monitor enable level)." VALUE 0x4000D268 RL_VALUE_UBYTE 0 NO_COMPU_METHOD 0 255 /end CHARACTERISTIC
/begin CHARACTERISTIC CAL_obd_ii_U0302 "Calibration: OBD-II U0302 (OBD-II monitor enable level)." VALUE 0x4000D269 RL_VALUE_UBYTE 0 NO_COMPU_METHOD 0 255 /end CHARACTERISTIC
/begin CHARACTERISTIC CAL_obd_ii_U0416 "Calibration: OBD-II U0416 (OBD-II monitor enable level)." VALUE 0x4000D26A RL_VALUE_UBYTE 0 NO_COMPU_METHOD 0 255 /end CHARACTERISTIC
/begin CHARACTERISTIC CAL_obd_ii_U0123 "Calibration: OBD-II U0123 (OBD-II monitor enable level)." VALUE 0x4000D26B RL_VALUE_UBYTE 0 NO_COMPU_METHOD 0 255 /end CHARACTERISTIC
/begin CHARACTERISTIC CAL_obd_ii_U0513 "Calibration: OBD-II U0513 (OBD-II monitor enable level)." VALUE 0x4000D26C RL_VALUE_UBYTE 0 NO_COMPU_METHOD 0 255 /end CHARACTERISTIC
/begin CHARACTERISTIC CAL_obd_ii_U0109 "Calibration: OBD-II U0109 (OBD-II monitor enable level)." VALUE 0x4000D26D RL_VALUE_UBYTE 0 NO_COMPU_METHOD 0 255 /end CHARACTERISTIC
/begin CHARACTERISTIC CAL_obd_ii_B1422 "Calibration: OBD-II B1422 (OBD-II monitor enable level)." VALUE 0x4000D278 RL_VALUE_UBYTE 0 NO_COMPU_METHOD 0 255 /end CHARACTERISTIC
/begin CHARACTERISTIC CAL_obd_ii_P219A "Calibration: OBD-II P219A (OBD-II monitor enable level)." VALUE 0x4000D279 RL_VALUE_UBYTE 0 NO_COMPU_METHOD 0 255 /end CHARACTERISTIC
/begin CHARACTERISTIC CAL_obd_ii_P219B "Calibration: OBD-II P219B (OBD-II monitor enable level)." VALUE 0x4000D27A RL_VALUE_UBYTE 0 NO_COMPU_METHOD 0 255 /end CHARACTERISTIC
/begin CHARACTERISTIC CAL_obd_ii_P2336 "Calibration: OBD-II P2336 (OBD-II monitor enable level)." VALUE 0x4000D27B RL_VALUE_UBYTE 0 NO_COMPU_METHOD 0 255 /end CHARACTERISTIC
/begin CHARACTERISTIC CAL_obd_ii_P2337 "Calibration: OBD-II P2337 (OBD-II monitor enable level)." VALUE 0x4000D27C RL_VALUE_UBYTE 0 NO_COMPU_METHOD 0 255 /end CHARACTERISTIC
/begin CHARACTERISTIC CAL_obd_ii_P2338 "Calibration: OBD-II P2338 (OBD-II monitor enable level)." VALUE 0x4000D27D RL_VALUE_UBYTE 0 NO_COMPU_METHOD 0 255 /end CHARACTERISTIC
/begin CHARACTERISTIC CAL_obd_ii_P2339 "Calibration: OBD-II P2339 (OBD-II monitor enable level)." VALUE 0x4000D27E RL_VALUE_UBYTE 0 NO_COMPU_METHOD 0 255 /end CHARACTERISTIC
/begin CHARACTERISTIC CAL_obd_ii_P2340 "Calibration: OBD-II P2340 (OBD-II monitor enable level)." VALUE 0x4000D27F RL_VALUE_UBYTE 0 NO_COMPU_METHOD 0 255 /end CHARACTERISTIC
/begin CHARACTERISTIC CAL_obd_ii_P2341 "Calibration: OBD-II P2341 (OBD-II monitor enable level)." VALUE 0x4000D280 RL_VALUE_UBYTE 0 NO_COMPU_METHOD 0 255 /end CHARACTERISTIC
/begin CHARACTERISTIC CAL_obd_ii_P1562 "Calibration: OBD-II P1562 (OBD-II monitor enable level)." VALUE 0x4000D281 RL_VALUE_UBYTE 0 NO_COMPU_METHOD 0 255 /end CHARACTERISTIC
/begin CHARACTERISTIC CAL_obd_ii_P0097 "Calibration: OBD-II P0097 (OBD-II monitor enable level)." VALUE 0x4000D282 RL_VALUE_UBYTE 0 NO_COMPU_METHOD 0 255 /end CHARACTERISTIC
/begin CHARACTERISTIC CAL_obd_ii_P0098 "Calibration: OBD-II P0098 (OBD-II monitor enable level)." VALUE 0x4000D283 RL_VALUE_UBYTE 0 NO_COMPU_METHOD 0 255 /end CHARACTERISTIC
/begin CHARACTERISTIC CAL_obd_ii_P1107 "Calibration: OBD-II P1107 (OBD-II monitor enable level)." VALUE 0x4000D284 RL_VALUE_UBYTE 0 NO_COMPU_METHOD 0 255 /end CHARACTERISTIC
/begin CHARACTERISTIC CAL_obd_ii_P1108 "Calibration: OBD-II P1108 (OBD-II monitor enable level)." VALUE 0x4000D285 RL_VALUE_UBYTE 0 NO_COMPU_METHOD 0 255 /end CHARACTERISTIC
/begin CHARACTERISTIC CAL_obd_ii_P0522 "Calibration: OBD-II P0522 (OBD-II monitor enable level)." VALUE 0x4000D286 RL_VALUE_UBYTE 0 NO_COMPU_METHOD 0 255 /end CHARACTERISTIC
/begin CHARACTERISTIC CAL_obd_ii_P0524 "Calibration: OBD-II P0524 (OBD-II monitor enable level)." VALUE 0x4000D287 RL_VALUE_UBYTE 0 NO_COMPU_METHOD 0 255 /end CHARACTERISTIC
/begin CHARACTERISTIC CAL_obd_ii_P0192 "Calibration: OBD-II P0192 (OBD-II monitor enable level)." VALUE 0x4000D288 RL_VALUE_UBYTE 0 NO_COMPU_METHOD 0 255 /end CHARACTERISTIC
/begin CHARACTERISTIC CAL_obd_ii_P0193 "Calibration: OBD-II P0193 (OBD-II monitor enable level)." VALUE 0x4000D289 RL_VALUE_UBYTE 0 NO_COMPU_METHOD 0 255 /end CHARACTERISTIC
/begin CHARACTERISTIC CAL_obd_ii_P023B "Calibration: OBD-II P023B (OBD-II monitor enable level)." VALUE 0x4000D28A RL_VALUE_UBYTE 0 NO_COMPU_METHOD 0 255 /end CHARACTERISTIC
/begin CHARACTERISTIC CAL_obd_ii_P023C "Calibration: OBD-II P023C (OBD-II monitor enable level)." VALUE 0x4000D28B RL_VALUE_UBYTE 0 NO_COMPU_METHOD 0 255 /end CHARACTERISTIC
/begin CHARACTERISTIC CAL_obd_ii_P123B "Calibration: OBD-II P123B (OBD-II monitor enable level)." VALUE 0x4000D28C RL_VALUE_UBYTE 0 NO_COMPU_METHOD 0 255 /end CHARACTERISTIC
/begin CHARACTERISTIC CAL_obd_ii_P123C "Calibration: OBD-II P123C (OBD-II monitor enable level)." VALUE 0x4000D28D RL_VALUE_UBYTE 0 NO_COMPU_METHOD 0 255 /end CHARACTERISTIC
/begin CHARACTERISTIC CAL_obd_ii_P0087 "Calibration: OBD-II P0087 (OBD-II monitor enable level)." VALUE 0x4000D28E RL_VALUE_UBYTE 0 NO_COMPU_METHOD 0 255 /end CHARACTERISTIC
/begin CHARACTERISTIC CAL_obd_ii_P0088 "Calibration: OBD-II P0088 (OBD-II monitor enable level)." VALUE 0x4000D28F RL_VALUE_UBYTE 0 NO_COMPU_METHOD 0 255 /end CHARACTERISTIC
/begin CHARACTERISTIC CAL_obd_ii_P0191 "Calibration: OBD-II P0191 (OBD-II monitor enable level)." VALUE 0x4000D290 RL_VALUE_UBYTE 0 NO_COMPU_METHOD 0 255 /end CHARACTERISTIC
/begin CHARACTERISTIC CAL_obd_ii_P2754 "Calibration: OBD-II P2754 (OBD-II monitor enable level)." VALUE 0x4000D291 RL_VALUE_UBYTE 0 NO_COMPU_METHOD 0 255 /end CHARACTERISTIC
/begin CHARACTERISTIC CAL_obd_ii_P2755 "Calibration: OBD-II P2755 (OBD-II monitor enable level)." VALUE 0x4000D292 RL_VALUE_UBYTE 0 NO_COMPU_METHOD 0 255 /end CHARACTERISTIC
/begin CHARACTERISTIC CAL_obd_ii_P0897 "Calibration: OBD-II P0897 (OBD-II monitor enable level)." VALUE 0x4000D293 RL_VALUE_UBYTE 0 NO_COMPU_METHOD 0 255 /end CHARACTERISTIC
/begin CHARACTERISTIC CAL_obd_ii_P2797 "Calibration: OBD-II P2797 (OBD-II monitor enable level)." VALUE 0x4000D294 RL_VALUE_UBYTE 0 NO_COMPU_METHOD 0 255 /end CHARACTERISTIC
/begin CHARACTERISTIC CAL_obd_ii_P0101_ips "Calibration: OBD-II P0101 IPS (OBD-II monitor enable level)." VALUE 0x4000D295 RL_VALUE_UBYTE 0 NO_COMPU_METHOD 0 255 /end CHARACTERISTIC
/begin CHARACTERISTIC CAL_obd_ii_P0014_maturing_limit "undefined1" VALUE 0x4000D3A6 RL_VALUE_UBYTE 0 NO_COMPU_METHOD 0 255 /end CHARACTERISTIC
/begin CHARACTERISTIC CAL_obd_ii_P0015_maturing_limit "undefined1" VALUE 0x4000D3AA RL_VALUE_UBYTE 0 NO_COMPU_METHOD 0 255 /end CHARACTERISTIC
/begin CHARACTERISTIC CAL_obd_ii_P0024_maturing_limit "undefined1" VALUE 0x4000D3AE RL_VALUE_UBYTE 0 NO_COMPU_METHOD 0 255 /end CHARACTERISTIC
/begin CHARACTERISTIC CAL_unknown15 "undefined1" VALUE 0x4000D3B6 RL_VALUE_UBYTE 0 NO_COMPU_METHOD 0 255 /end CHARACTERISTIC
/begin CHARACTERISTIC CAL_obd_ii_P0132_fail_count "undefined1" VALUE 0x4000D3B7 RL_VALUE_UBYTE 0 NO_COMPU_METHOD 0 255 /end CHARACTERISTIC
/begin CHARACTERISTIC CAL_obd_ii_P0137_fail_count "undefined1" VALUE 0x4000D3B8 RL_VALUE_UBYTE 0 NO_COMPU_METHOD 0 255 /end CHARACTERISTIC
/begin CHARACTERISTIC CAL_obd_ii_P0138_fail_count "undefined1" VALUE 0x4000D3B9 RL_VALUE_UBYTE 0 NO_COMPU_METHOD 0 255 /end CHARACTERISTIC
/begin CHARACTERISTIC CAL_obd_monitor_sentinel_init "undefined1" VALUE 0x4000D3BC RL_VALUE_UBYTE 0 NO_COMPU_METHOD 0 255 /end CHARACTERISTIC
/begin CHARACTERISTIC CAL_obd_ii_P0128_fail_count "undefined1" VALUE 0x4000D3BE RL_VALUE_UBYTE 0 NO_COMPU_METHOD 0 255 /end CHARACTERISTIC
/begin CHARACTERISTIC CAL_obd_ii_P0076_debounce_count "undefined1" VALUE 0x4000D3BF RL_VALUE_UBYTE 0 NO_COMPU_METHOD 0 255 /end CHARACTERISTIC
/begin CHARACTERISTIC CAL_obd_ii_P0077_debounce_count "undefined1" VALUE 0x4000D3C0 RL_VALUE_UBYTE 0 NO_COMPU_METHOD 0 255 /end CHARACTERISTIC
/begin CHARACTERISTIC CAL_tps_obd_throttle_monitor_pass_threshold "u8_count" VALUE 0x4000D3F1 RL_VALUE_UBYTE 0 NO_COMPU_METHOD 0 255 /end CHARACTERISTIC
/begin CHARACTERISTIC CAL_idle_unknown10 "undefined1" VALUE 0x4000D409 RL_VALUE_UBYTE 0 NO_COMPU_METHOD 0 255 /end CHARACTERISTIC
/begin CHARACTERISTIC CAL_obd_ii_P0151_fail_count "undefined1" VALUE 0x4000D426 RL_VALUE_UBYTE 0 NO_COMPU_METHOD 0 255 /end CHARACTERISTIC
/begin CHARACTERISTIC CAL_obd_ii_P0152_fail_count "undefined1" VALUE 0x4000D427 RL_VALUE_UBYTE 0 NO_COMPU_METHOD 0 255 /end CHARACTERISTIC
/begin CHARACTERISTIC CAL_obd_ii_P0157_fail_count "undefined1" VALUE 0x4000D428 RL_VALUE_UBYTE 0 NO_COMPU_METHOD 0 255 /end CHARACTERISTIC
/begin CHARACTERISTIC CAL_obd_ii_P0158_fail_count "undefined1" VALUE 0x4000D429 RL_VALUE_UBYTE 0 NO_COMPU_METHOD 0 255 /end CHARACTERISTIC
/begin CHARACTERISTIC CAL_obd_ii_U0316_debounce_count "undefined1" VALUE 0x4000D44F RL_VALUE_UBYTE 0 NO_COMPU_METHOD 0 255 /end CHARACTERISTIC
/begin CHARACTERISTIC CAL_obd_ii_P0141_debounce_count "undefined1" VALUE 0x4000D450 RL_VALUE_UBYTE 0 NO_COMPU_METHOD 0 255 /end CHARACTERISTIC
/begin CHARACTERISTIC CAL_obd_ii_P050B_maturing_limit "undefined1" VALUE 0x4000D453 RL_VALUE_UBYTE 0 NO_COMPU_METHOD 0 255 /end CHARACTERISTIC
/begin CHARACTERISTIC CAL_obd_ii_P2336_maturing_limit "undefined1" VALUE 0x4000D45E RL_VALUE_UBYTE 0 NO_COMPU_METHOD 0 255 /end CHARACTERISTIC
/begin CHARACTERISTIC CAL_obd_ii_P2337_maturing_limit "undefined1" VALUE 0x4000D45F RL_VALUE_UBYTE 0 NO_COMPU_METHOD 0 255 /end CHARACTERISTIC
/begin CHARACTERISTIC CAL_obd_ii_P2338_maturing_limit "undefined1" VALUE 0x4000D460 RL_VALUE_UBYTE 0 NO_COMPU_METHOD 0 255 /end CHARACTERISTIC
/begin CHARACTERISTIC CAL_obd_ii_P2339_maturing_limit "undefined1" VALUE 0x4000D461 RL_VALUE_UBYTE 0 NO_COMPU_METHOD 0 255 /end CHARACTERISTIC
/begin AXIS_PTS CAL_fuel_pump_command_X_pressure "Calibration: X-axis (pressure) for the fuel pump command table (mbar; 8-element array)." 0x4000D4F0 NO_INPUT_QUANTITY RL_AXIS_UWORD 0 CM_u16_pressure_mbar 8 0 65535 /end AXIS_PTS
/begin AXIS_PTS CAL_fuel_pump_command_Y_estimated_inj_flow "Calibration: Y-axis (estimated inj flow) for the fuel pump command table (8-element array)." 0x4000D500 NO_INPUT_QUANTITY RL_AXIS_UWORD 0 NO_COMPU_METHOD 8 0 65535 /end AXIS_PTS
/begin CHARACTERISTIC CAL_fuel_pump_command "Calibration: fuel pump command (val/10000; 64-element array)." MAP 0x4000D510 RL_VALUE_UWORD 0 CM_u16_factor_1_10000 0 655.35
 /begin AXIS_DESCR COM_AXIS NO_INPUT_QUANTITY CM_u16_pressure_mbar 8 0 65535 AXIS_PTS_REF CAL_fuel_pump_command_X_pressure /end AXIS_DESCR
 /begin AXIS_DESCR COM_AXIS NO_INPUT_QUANTITY NO_COMPU_METHOD 8 0 65535 AXIS_PTS_REF CAL_fuel_pump_command_Y_estimated_inj_flow /end AXIS_DESCR
/end CHARACTERISTIC
/begin AXIS_PTS CAL_misfire_comp_maf_manual_X_coolant_temp "Calibration: X-axis (coolant temp) for the misfire compensation MAF manual table (°C = val*5/8−40; 4-element array)." 0x4000D5A0 NO_INPUT_QUANTITY RL_AXIS_UWORD 0 CM_u8_temp_5_8_40c 4 -40 40919.375 /end AXIS_PTS
/begin AXIS_PTS CAL_misfire_comp_maf_manual_Y_maf_accum "Calibration: Y-axis (maf accum) for the misfire compensation MAF manual table (mg; 5-element array)." 0x4000D5A8 NO_INPUT_QUANTITY RL_AXIS_UWORD 0 CM_u16_mass_mg 5 0 65535 /end AXIS_PTS
/begin CHARACTERISTIC CAL_misfire_comp_maf_manual "Calibration: misfire compensation MAF manual (20-element array)." MAP 0x4000D5B2 RL_VALUE_UWORD 0 NO_COMPU_METHOD 0 65535
 /begin AXIS_DESCR COM_AXIS NO_INPUT_QUANTITY CM_u8_temp_5_8_40c 4 -40 40919.375 AXIS_PTS_REF CAL_misfire_comp_maf_manual_X_coolant_temp /end AXIS_DESCR
 /begin AXIS_DESCR COM_AXIS NO_INPUT_QUANTITY CM_u16_mass_mg 5 0 65535 AXIS_PTS_REF CAL_misfire_comp_maf_manual_Y_maf_accum /end AXIS_DESCR
/end CHARACTERISTIC
/begin AXIS_PTS CAL_misfire_comp_maf_ips_X_coolant_temp "Calibration: X-axis (coolant temp) for the misfire compensation MAF IPS table (°C = val*5/8−40; 4-element array)." 0x4000D5DA NO_INPUT_QUANTITY RL_AXIS_UWORD 0 CM_u8_temp_5_8_40c 4 -40 40919.375 /end AXIS_PTS
/begin AXIS_PTS CAL_misfire_comp_maf_ips_Y_maf_accum "Calibration: Y-axis (maf accum) for the misfire compensation MAF IPS table (mg; 5-element array)." 0x4000D5E2 NO_INPUT_QUANTITY RL_AXIS_UWORD 0 CM_u16_mass_mg 5 0 65535 /end AXIS_PTS
/begin CHARACTERISTIC CAL_misfire_comp_maf_ips "Calibration: misfire compensation MAF IPS (20-element array)." MAP 0x4000D5EC RL_VALUE_SWORD 0 NO_COMPU_METHOD -32768 32767
 /begin AXIS_DESCR COM_AXIS NO_INPUT_QUANTITY CM_u8_temp_5_8_40c 4 -40 40919.375 AXIS_PTS_REF CAL_misfire_comp_maf_ips_X_coolant_temp /end AXIS_DESCR
 /begin AXIS_DESCR COM_AXIS NO_INPUT_QUANTITY CM_u16_mass_mg 5 0 65535 AXIS_PTS_REF CAL_misfire_comp_maf_ips_Y_maf_accum /end AXIS_DESCR
/end CHARACTERISTIC
/begin AXIS_PTS CAL_ecu_engine_speed_target_ramp_gain_tour_X_rpm "Calibration: X-axis (rpm) for the ECU engine speed target ramp gain tour table (RPM = val*125/4+500; 4-element array)." 0x4000D614 NO_INPUT_QUANTITY RL_AXIS_UBYTE 0 CM_u8_rspeed_125_4_500rpm 4 500 8468.75 /end AXIS_PTS
/begin AXIS_PTS CAL_ecu_engine_speed_target_ramp_gain_tour_Y_coolant_temp "Calibration: Y-axis (coolant temp) for the ECU engine speed target ramp gain tour table (°C = val*5/8−40; 4-element array)." 0x4000D618 NO_INPUT_QUANTITY RL_AXIS_UBYTE 0 CM_u8_temp_5_8_40c 4 -40 119.375 /end AXIS_PTS
/begin CHARACTERISTIC CAL_ecu_engine_speed_target_ramp_gain_tour "Calibration: ECU engine speed target ramp gain tour (val/2560; 16-element array)." MAP 0x4000D61C RL_VALUE_UBYTE 0 CM_u8_factor_1_2560 0 9.9609375
 /begin AXIS_DESCR COM_AXIS NO_INPUT_QUANTITY CM_u8_rspeed_125_4_500rpm 4 500 8468.75 AXIS_PTS_REF CAL_ecu_engine_speed_target_ramp_gain_tour_X_rpm /end AXIS_DESCR
 /begin AXIS_DESCR COM_AXIS NO_INPUT_QUANTITY CM_u8_temp_5_8_40c 4 -40 119.375 AXIS_PTS_REF CAL_ecu_engine_speed_target_ramp_gain_tour_Y_coolant_temp /end AXIS_DESCR
/end CHARACTERISTIC
/begin AXIS_PTS CAL_ecu_engine_speed_target_ramp_gain_sport_X_rpm "Calibration: X-axis (rpm) for the ECU engine speed target ramp gain sport table (RPM = val*125/4+500; 4-element array)." 0x4000D62C NO_INPUT_QUANTITY RL_AXIS_UBYTE 0 CM_u8_rspeed_125_4_500rpm 4 500 8468.75 /end AXIS_PTS
/begin AXIS_PTS CAL_ecu_engine_speed_target_ramp_gain_sport_Y_coolant_temp "Calibration: Y-axis (coolant temp) for the ECU engine speed target ramp gain sport table (°C = val*5/8−40; 4-element array)." 0x4000D630 NO_INPUT_QUANTITY RL_AXIS_UBYTE 0 CM_u8_temp_5_8_40c 4 -40 119.375 /end AXIS_PTS
/begin CHARACTERISTIC CAL_ecu_engine_speed_target_ramp_gain_sport "Calibration: ECU engine speed target ramp gain sport (val/2560; 16-element array)." MAP 0x4000D634 RL_VALUE_UBYTE 0 CM_u8_factor_1_2560 0 9.9609375
 /begin AXIS_DESCR COM_AXIS NO_INPUT_QUANTITY CM_u8_rspeed_125_4_500rpm 4 500 8468.75 AXIS_PTS_REF CAL_ecu_engine_speed_target_ramp_gain_sport_X_rpm /end AXIS_DESCR
 /begin AXIS_DESCR COM_AXIS NO_INPUT_QUANTITY CM_u8_temp_5_8_40c 4 -40 119.375 AXIS_PTS_REF CAL_ecu_engine_speed_target_ramp_gain_sport_Y_coolant_temp /end AXIS_DESCR
/end CHARACTERISTIC
/begin AXIS_PTS CAL_dpm_slip_target_base_X_dpm_level "Calibration: X-axis (dpm level) for the driver performance mode slip target base table (16-element array)." 0x4000D644 NO_INPUT_QUANTITY RL_AXIS_UBYTE 0 NO_COMPU_METHOD 16 0 255 /end AXIS_PTS
/begin CHARACTERISTIC CAL_dpm_slip_target_base "Calibration: driver performance mode slip target base (% = val/8; 16-element array)." CURVE 0x4000D654 RL_VALUE_UBYTE 0 CM_u16_slip_1_8pct 0 31.875
 /begin AXIS_DESCR COM_AXIS NO_INPUT_QUANTITY NO_COMPU_METHOD 16 0 255 AXIS_PTS_REF CAL_dpm_slip_target_base_X_dpm_level /end AXIS_DESCR
/end CHARACTERISTIC
/begin AXIS_PTS CAL_sensor_o2_afr_diag_scaling_X_voltage "Calibration: X-axis (voltage) for the sensor O2 AFR diag scaling table (V = val*5/1023; 16-element array)." 0x4000D664 NO_INPUT_QUANTITY RL_AXIS_UWORD 0 CM_u16_voltage_5_1023v 16 0 320.307917888563 /end AXIS_PTS
/begin CHARACTERISTIC CAL_sensor_o2_afr_diag_scaling "Calibration: sensor O2 AFR diag scaling (val/100; 16-element array)." CURVE 0x4000D684 RL_VALUE_UWORD 0 CM_u16_afr_1_100 0 655.35
 /begin AXIS_DESCR COM_AXIS NO_INPUT_QUANTITY CM_u16_voltage_5_1023v 16 0 320.307917888563 AXIS_PTS_REF CAL_sensor_o2_afr_diag_scaling_X_voltage /end AXIS_DESCR
/end CHARACTERISTIC
/begin AXIS_PTS CAL_cooling_fan_duty_cycle_stopped_X_coolant_temp "Calibration: X-axis (coolant temp) for the cooling fan duty cycle stopped table (°C = val*5/8−40; 8-element array)." 0x4000D6B4 NO_INPUT_QUANTITY RL_AXIS_UBYTE 0 CM_u8_temp_5_8_40c 8 -40 119.375 /end AXIS_PTS
/begin CHARACTERISTIC CAL_cooling_fan_duty_cycle_stopped "Calibration: cooling fan duty cycle stopped (% = val*100/255; 8-element array)." CURVE 0x4000D6BC RL_VALUE_UBYTE 0 CM_u8_factor_1_255 0 100
 /begin AXIS_DESCR COM_AXIS NO_INPUT_QUANTITY CM_u8_temp_5_8_40c 8 -40 119.375 AXIS_PTS_REF CAL_cooling_fan_duty_cycle_stopped_X_coolant_temp /end AXIS_DESCR
/end CHARACTERISTIC
/begin AXIS_PTS CAL_cooling_fan_ac_off_X_air_temp "Calibration: X-axis (air temp) for the cooling fan A/C off table (°C = val*5/8−40; 8-element array)." 0x4000D6C4 NO_INPUT_QUANTITY RL_AXIS_UBYTE 0 CM_u8_temp_5_8_40c 8 -40 119.375 /end AXIS_PTS
/begin AXIS_PTS CAL_cooling_fan_ac_off_Y_carspeed "Calibration: Y-axis (carspeed) for the cooling fan A/C off table (8-element array)." 0x4000D6CC NO_INPUT_QUANTITY RL_AXIS_UBYTE 0 NO_COMPU_METHOD 8 0 255 /end AXIS_PTS
/begin CHARACTERISTIC CAL_cooling_fan_ac_off "Calibration: cooling fan A/C off (% = val*100/255; 64-element array)." MAP 0x4000D6D4 RL_VALUE_UBYTE 0 CM_u8_factor_1_255 0 100
 /begin AXIS_DESCR COM_AXIS NO_INPUT_QUANTITY CM_u8_temp_5_8_40c 8 -40 119.375 AXIS_PTS_REF CAL_cooling_fan_ac_off_X_air_temp /end AXIS_DESCR
 /begin AXIS_DESCR COM_AXIS NO_INPUT_QUANTITY NO_COMPU_METHOD 8 0 255 AXIS_PTS_REF CAL_cooling_fan_ac_off_Y_carspeed /end AXIS_DESCR
/end CHARACTERISTIC
/begin AXIS_PTS CAL_cooling_fan_scaling_X_dutycycle "Calibration: X-axis (dutycycle) for the cooling fan scaling table (% = val*100/255; 8-element array)." 0x4000D714 NO_INPUT_QUANTITY RL_AXIS_UBYTE 0 CM_u8_factor_1_255 8 0 100 /end AXIS_PTS
/begin CHARACTERISTIC CAL_cooling_fan_scaling "Calibration: cooling fan scaling (8-element array)." CURVE 0x4000D71C RL_VALUE_UBYTE 0 NO_COMPU_METHOD 0 255
 /begin AXIS_DESCR COM_AXIS NO_INPUT_QUANTITY CM_u8_factor_1_255 8 0 100 AXIS_PTS_REF CAL_cooling_fan_scaling_X_dutycycle /end AXIS_DESCR
/end CHARACTERISTIC
/begin AXIS_PTS CAL_cac_pump_dutycycle_X_manifold_temp "Calibration: X-axis (manifold temp) for the charge-air-cooler pump dutycycle table (°C = val*5/8−40; 8-element array)." 0x4000D724 NO_INPUT_QUANTITY RL_AXIS_UBYTE 0 CM_u8_temp_5_8_40c 8 -40 119.375 /end AXIS_PTS
/begin CHARACTERISTIC CAL_cac_pump_dutycycle "Calibration: charge-air-cooler pump dutycycle (val/255; 8-element array)." CURVE 0x4000D72C RL_VALUE_UBYTE 0 CM_u8_factor_1_255 0 100
 /begin AXIS_DESCR COM_AXIS NO_INPUT_QUANTITY CM_u8_temp_5_8_40c 8 -40 119.375 AXIS_PTS_REF CAL_cac_pump_dutycycle_X_manifold_temp /end AXIS_DESCR
/end CHARACTERISTIC
/begin AXIS_PTS CAL_ign_retard_recovery_step_X_engine_speed "Calibration: X-axis (engine speed) for the ignition retard recovery step table (RPM = val*125/4+500; 8-element array)." 0x4000D73C NO_INPUT_QUANTITY RL_AXIS_UBYTE 0 CM_u8_rspeed_125_4_500rpm 8 500 8468.75 /end AXIS_PTS
/begin AXIS_PTS CAL_ign_retard_recovery_step_Y_load "Calibration: Y-axis (load) for the ignition retard recovery step table (mg/stroke = val*4; 8-element array)." 0x4000D744 NO_INPUT_QUANTITY RL_AXIS_UBYTE 0 CM_u8_load_4mg_stroke 8 0 1020 /end AXIS_PTS
/begin CHARACTERISTIC CAL_ign_retard_recovery_step "Calibration: ignition retard recovery step (° = val/4; 64-element array)." MAP 0x4000D74C RL_VALUE_SBYTE 0 CM_u8_angle_1_4deg -32 31.75
 /begin AXIS_DESCR COM_AXIS NO_INPUT_QUANTITY CM_u8_rspeed_125_4_500rpm 8 500 8468.75 AXIS_PTS_REF CAL_ign_retard_recovery_step_X_engine_speed /end AXIS_DESCR
 /begin AXIS_DESCR COM_AXIS NO_INPUT_QUANTITY CM_u8_load_4mg_stroke 8 0 1020 AXIS_PTS_REF CAL_ign_retard_recovery_step_Y_load /end AXIS_DESCR
/end CHARACTERISTIC
/begin AXIS_PTS CAL_misfire_sensitivity_manual_X_rpm "Calibration: X-axis (rpm) for the misfire sensitivity manual table (RPM; 8-element array)." 0x4000D78C NO_INPUT_QUANTITY RL_AXIS_UWORD 0 CM_u16_rspeed_rpm 8 0 65535 /end AXIS_PTS
/begin AXIS_PTS CAL_misfire_sensitivity_manual_Y_load "Calibration: Y-axis (load) for the misfire sensitivity manual table (mg/stroke; 8-element array)." 0x4000D79C NO_INPUT_QUANTITY RL_AXIS_UWORD 0 CM_u16_load_mg_stroke 8 0 65535 /end AXIS_PTS
/begin CHARACTERISTIC CAL_misfire_sensitivity_manual "Calibration: misfire sensitivity manual (64-element array)." MAP 0x4000D7AC RL_VALUE_UWORD 0 NO_COMPU_METHOD 0 65535
 /begin AXIS_DESCR COM_AXIS NO_INPUT_QUANTITY CM_u16_rspeed_rpm 8 0 65535 AXIS_PTS_REF CAL_misfire_sensitivity_manual_X_rpm /end AXIS_DESCR
 /begin AXIS_DESCR COM_AXIS NO_INPUT_QUANTITY CM_u16_load_mg_stroke 8 0 65535 AXIS_PTS_REF CAL_misfire_sensitivity_manual_Y_load /end AXIS_DESCR
/end CHARACTERISTIC
/begin AXIS_PTS CAL_misfire_sensitivity_ips_X_rpm "Calibration: X-axis (rpm) for the misfire sensitivity IPS table (RPM; 8-element array)." 0x4000D82C NO_INPUT_QUANTITY RL_AXIS_UWORD 0 CM_u16_rspeed_rpm 8 0 65535 /end AXIS_PTS
/begin AXIS_PTS CAL_misfire_sensitivity_ips_Y_load "Calibration: Y-axis (load) for the misfire sensitivity IPS table (mg/stroke; 8-element array)." 0x4000D83C NO_INPUT_QUANTITY RL_AXIS_UWORD 0 CM_u16_load_mg_stroke 8 0 65535 /end AXIS_PTS
/begin CHARACTERISTIC CAL_misfire_sensitivity_ips "Calibration: misfire sensitivity IPS (64-element array)." MAP 0x4000D84C RL_VALUE_UWORD 0 NO_COMPU_METHOD 0 65535
 /begin AXIS_DESCR COM_AXIS NO_INPUT_QUANTITY CM_u16_rspeed_rpm 8 0 65535 AXIS_PTS_REF CAL_misfire_sensitivity_ips_X_rpm /end AXIS_DESCR
 /begin AXIS_DESCR COM_AXIS NO_INPUT_QUANTITY CM_u16_load_mg_stroke 8 0 65535 AXIS_PTS_REF CAL_misfire_sensitivity_ips_Y_load /end AXIS_DESCR
/end CHARACTERISTIC
/begin AXIS_PTS CAL_obd_cat_monitor_threshold_ips_X_maf_flow "Calibration: X-axis (maf flow) for the emissions compensation IPS table (g; 8-element array)." 0x4000D8CC NO_INPUT_QUANTITY RL_AXIS_UBYTE 0 CM_u8_mass_g 8 0 255 /end AXIS_PTS
/begin CHARACTERISTIC CAL_obd_cat_monitor_threshold_ips "Calibration: MAF compensation IPS (8-element array)." CURVE 0x4000D8D4 RL_VALUE_UBYTE 0 NO_COMPU_METHOD 0 255
 /begin AXIS_DESCR COM_AXIS NO_INPUT_QUANTITY CM_u8_mass_g 8 0 255 AXIS_PTS_REF CAL_obd_cat_monitor_threshold_ips_X_maf_flow /end AXIS_DESCR
/end CHARACTERISTIC
/begin AXIS_PTS CAL_cac_pump_dc_drive_output_X_target_dutycycle "Calibration: X-axis (target dutycycle) for the charge-air-cooler pump duty cycle drive output table (val/255; 8-element array)." 0x4000D8DC NO_INPUT_QUANTITY RL_AXIS_UBYTE 0 CM_u8_factor_1_255 8 0 100 /end AXIS_PTS
/begin CHARACTERISTIC CAL_cac_pump_dc_drive_output "Calibration: charge-air-cooler pump duty cycle drive output (val/255; 8-element array)." CURVE 0x4000D8E4 RL_VALUE_UBYTE 0 CM_u8_factor_1_255 0 100
 /begin AXIS_DESCR COM_AXIS NO_INPUT_QUANTITY CM_u8_factor_1_255 8 0 100 AXIS_PTS_REF CAL_cac_pump_dc_drive_output_X_target_dutycycle /end AXIS_DESCR
/end CHARACTERISTIC
/begin AXIS_PTS CAL_sensor_tmap_expected_temp_X_rpm "Calibration: X-axis (rpm) for the sensor TMAP expected temperature table (RPM = val*125/4+500; 8-element array)." 0x4000D90C NO_INPUT_QUANTITY RL_AXIS_UBYTE 0 CM_u8_rspeed_125_4_500rpm 8 500 8468.75 /end AXIS_PTS
/begin AXIS_PTS CAL_sensor_tmap_expected_temp_Y_load "Calibration: Y-axis (load) for the sensor TMAP expected temperature table (mg/stroke = val*4; 8-element array)." 0x4000D914 NO_INPUT_QUANTITY RL_AXIS_UBYTE 0 CM_u8_load_4mg_stroke 8 0 1020 /end AXIS_PTS
/begin CHARACTERISTIC CAL_sensor_tmap_expected_temp "Calibration: sensor TMAP expected temperature (°C = val*5/8−40; 64-element array)." MAP 0x4000D91C RL_VALUE_UBYTE 0 CM_u8_temp_5_8_40c -40 119.375
 /begin AXIS_DESCR COM_AXIS NO_INPUT_QUANTITY CM_u8_rspeed_125_4_500rpm 8 500 8468.75 AXIS_PTS_REF CAL_sensor_tmap_expected_temp_X_rpm /end AXIS_DESCR
 /begin AXIS_DESCR COM_AXIS NO_INPUT_QUANTITY CM_u8_load_4mg_stroke 8 0 1020 AXIS_PTS_REF CAL_sensor_tmap_expected_temp_Y_load /end AXIS_DESCR
/end CHARACTERISTIC
/begin AXIS_PTS CAL_slip_comp_maf_accum_manual_X_maf_accum "Calibration: X-axis (maf accum) for the slip compensation MAF accum manual table (mg; 4-element array)." 0x4000D95C NO_INPUT_QUANTITY RL_AXIS_UWORD 0 CM_u16_mass_mg 4 0 65535 /end AXIS_PTS
/begin CHARACTERISTIC CAL_slip_comp_maf_accum_manual "Calibration: slip compensation MAF accum manual (4-element array)." CURVE 0x4000D964 RL_VALUE_UWORD 0 NO_COMPU_METHOD 0 65535
 /begin AXIS_DESCR COM_AXIS NO_INPUT_QUANTITY CM_u16_mass_mg 4 0 65535 AXIS_PTS_REF CAL_slip_comp_maf_accum_manual_X_maf_accum /end AXIS_DESCR
/end CHARACTERISTIC
/begin AXIS_PTS CAL_slip_power_based_rpm_thresholds_X_power "Calibration: X-axis (power) for the slip power based RPM thresholds table (kW = val/100; 8-element array)." 0x4000D96C NO_INPUT_QUANTITY RL_AXIS_UWORD 0 CM_u16_power_1_100kw 8 0 655.35 /end AXIS_PTS
/begin CHARACTERISTIC CAL_slip_power_based_rpm_thresholds "Calibration: slip power based RPM thresholds (RPM; 8-element array)." CURVE 0x4000D97C RL_VALUE_UWORD 0 CM_u16_rspeed_rpm 0 65535
 /begin AXIS_DESCR COM_AXIS NO_INPUT_QUANTITY CM_u16_power_1_100kw 8 0 655.35 AXIS_PTS_REF CAL_slip_power_based_rpm_thresholds_X_power /end AXIS_DESCR
/end CHARACTERISTIC
/begin AXIS_PTS CAL_load_plausibility_test_delta_X_rpm "Calibration: X-axis (rpm) for the load plausibility test delta table (RPM = val*125/4+500; 8-element array)." 0x4000D98C NO_INPUT_QUANTITY RL_AXIS_UBYTE 0 CM_u8_rspeed_125_4_500rpm 8 500 8468.75 /end AXIS_PTS
/begin AXIS_PTS CAL_load_plausibility_test_delta_Y_tps "Calibration: Y-axis (tps) for the load plausibility test delta table (val/255; 8-element array)." 0x4000D994 NO_INPUT_QUANTITY RL_AXIS_UBYTE 0 CM_u8_factor_1_255 8 0 100 /end AXIS_PTS
/begin CHARACTERISTIC CAL_load_plausibility_test_delta "Calibration: load plausibility test delta (mg/stroke = val*2; 64-element array)." MAP 0x4000D99C RL_VALUE_UBYTE 0 CM_u8_load_2mg_stroke 0 510
 /begin AXIS_DESCR COM_AXIS NO_INPUT_QUANTITY CM_u8_rspeed_125_4_500rpm 8 500 8468.75 AXIS_PTS_REF CAL_load_plausibility_test_delta_X_rpm /end AXIS_DESCR
 /begin AXIS_DESCR COM_AXIS NO_INPUT_QUANTITY CM_u8_factor_1_255 8 0 100 AXIS_PTS_REF CAL_load_plausibility_test_delta_Y_tps /end AXIS_DESCR
/end CHARACTERISTIC
/begin AXIS_PTS CAL_misfire_detect_torque_threshold_X_rpm "Calibration: X-axis (rpm) for the misfire detect torque threshold table (RPM = val*125/4+500; 8-element array)." 0x4000D9DC NO_INPUT_QUANTITY RL_AXIS_UBYTE 0 CM_u8_rspeed_125_4_500rpm 8 500 8468.75 /end AXIS_PTS
/begin CHARACTERISTIC CAL_misfire_detect_torque_threshold "Calibration: misfire detect torque threshold (Nm; 8-element array)." CURVE 0x4000D9E4 RL_VALUE_UBYTE 0 CM_u8_torque_nm 0 255
 /begin AXIS_DESCR COM_AXIS NO_INPUT_QUANTITY CM_u8_rspeed_125_4_500rpm 8 500 8468.75 AXIS_PTS_REF CAL_misfire_detect_torque_threshold_X_rpm /end AXIS_DESCR
/end CHARACTERISTIC
/begin CHARACTERISTIC CAL_misc_calid "Calibration: misc calid (16-element array)." ASCII 0x4000D9F0 RL_VALUE_UBYTE 0 NO_COMPU_METHOD 0 255 NUMBER 16 /end CHARACTERISTIC
/begin AXIS_PTS CAL_misfire_base_threshold_manual_X_rpm "Calibration: X-axis (rpm) for the misfire base threshold manual table (RPM; 16-element array)." 0x4000DA10 NO_INPUT_QUANTITY RL_AXIS_UWORD 0 CM_u16_rspeed_rpm 16 0 65535 /end AXIS_PTS
/begin AXIS_PTS CAL_misfire_base_threshold_manual_Y_load "Calibration: Y-axis (load) for the misfire base threshold manual table (mg/stroke; 16-element array)." 0x4000DA30 NO_INPUT_QUANTITY RL_AXIS_UWORD 0 CM_u16_load_mg_stroke 16 0 65535 /end AXIS_PTS
/begin CHARACTERISTIC CAL_misfire_base_threshold_manual "Calibration: misfire base threshold manual (256-element array)." MAP 0x4000DA50 RL_VALUE_UWORD 0 NO_COMPU_METHOD 0 65535
 /begin AXIS_DESCR COM_AXIS NO_INPUT_QUANTITY CM_u16_rspeed_rpm 16 0 65535 AXIS_PTS_REF CAL_misfire_base_threshold_manual_X_rpm /end AXIS_DESCR
 /begin AXIS_DESCR COM_AXIS NO_INPUT_QUANTITY CM_u16_load_mg_stroke 16 0 65535 AXIS_PTS_REF CAL_misfire_base_threshold_manual_Y_load /end AXIS_DESCR
/end CHARACTERISTIC
/begin AXIS_PTS CAL_misfire_cat_damage_limit_X_rpm "Calibration: X-axis (rpm) for the misfire cat damage limit table (RPM = val*125/4+500; 8-element array)." 0x4000DC50 NO_INPUT_QUANTITY RL_AXIS_UBYTE 0 CM_u8_rspeed_125_4_500rpm 8 500 8468.75 /end AXIS_PTS
/begin AXIS_PTS CAL_misfire_cat_damage_limit_Y_load "Calibration: Y-axis (load) for the misfire cat damage limit table (mg/stroke = val*4; 8-element array)." 0x4000DC58 NO_INPUT_QUANTITY RL_AXIS_UBYTE 0 CM_u8_load_4mg_stroke 8 0 1020 /end AXIS_PTS
/begin CHARACTERISTIC CAL_misfire_cat_damage_limit "Calibration: misfire cat damage limit (64-element array)." MAP 0x4000DC60 RL_VALUE_UBYTE 0 NO_COMPU_METHOD 0 255
 /begin AXIS_DESCR COM_AXIS NO_INPUT_QUANTITY CM_u8_rspeed_125_4_500rpm 8 500 8468.75 AXIS_PTS_REF CAL_misfire_cat_damage_limit_X_rpm /end AXIS_DESCR
 /begin AXIS_DESCR COM_AXIS NO_INPUT_QUANTITY CM_u8_load_4mg_stroke 8 0 1020 AXIS_PTS_REF CAL_misfire_cat_damage_limit_Y_load /end AXIS_DESCR
/end CHARACTERISTIC
/begin AXIS_PTS CAL_misfire_base_threshold_ips_X_rpm "Calibration: X-axis (rpm) for the misfire base threshold IPS table (RPM; 16-element array)." 0x4000DCA0 NO_INPUT_QUANTITY RL_AXIS_UWORD 0 CM_u16_rspeed_rpm 16 0 65535 /end AXIS_PTS
/begin AXIS_PTS CAL_misfire_base_threshold_ips_Y_load "Calibration: Y-axis (load) for the misfire base threshold IPS table (mg/stroke; 16-element array)." 0x4000DCC0 NO_INPUT_QUANTITY RL_AXIS_UWORD 0 CM_u16_load_mg_stroke 16 0 65535 /end AXIS_PTS
/begin CHARACTERISTIC CAL_misfire_base_threshold_ips "Calibration: misfire base threshold IPS (256-element array)." MAP 0x4000DCE0 RL_VALUE_SWORD 0 NO_COMPU_METHOD -32768 32767
 /begin AXIS_DESCR COM_AXIS NO_INPUT_QUANTITY CM_u16_rspeed_rpm 16 0 65535 AXIS_PTS_REF CAL_misfire_base_threshold_ips_X_rpm /end AXIS_DESCR
 /begin AXIS_DESCR COM_AXIS NO_INPUT_QUANTITY CM_u16_load_mg_stroke 16 0 65535 AXIS_PTS_REF CAL_misfire_base_threshold_ips_Y_load /end AXIS_DESCR
/end CHARACTERISTIC
/begin AXIS_PTS CAL_emissions_cat_efficiency_unknown1_X_coolant_temp "Calibration: X-axis (coolant temp) for the emissions cat efficiency unknown1 table (°C = val*5/8−40; 8-element array)." 0x4000DEE0 NO_INPUT_QUANTITY RL_AXIS_UBYTE 0 CM_u8_temp_5_8_40c 8 -40 119.375 /end AXIS_PTS
/begin CHARACTERISTIC CAL_emissions_cat_efficiency_unknown1 "Calibration: emissions cat efficiency unknown1 (8-element array)." CURVE 0x4000DEE8 RL_VALUE_UBYTE 0 NO_COMPU_METHOD 0 255
 /begin AXIS_DESCR COM_AXIS NO_INPUT_QUANTITY CM_u8_temp_5_8_40c 8 -40 119.375 AXIS_PTS_REF CAL_emissions_cat_efficiency_unknown1_X_coolant_temp /end AXIS_DESCR
/end CHARACTERISTIC
/begin AXIS_PTS CAL_obd_cat_monitor_threshold_manual_X_maf_flow "Calibration: X-axis (maf flow) for the emissions compensation manual table (g; 8-element array)." 0x4000DEF0 NO_INPUT_QUANTITY RL_AXIS_UBYTE 0 CM_u8_mass_g 8 0 255 /end AXIS_PTS
/begin CHARACTERISTIC CAL_obd_cat_monitor_threshold_manual "Calibration: MAF compensation manual (8-element array)." CURVE 0x4000DEF8 RL_VALUE_UBYTE 0 NO_COMPU_METHOD 0 255
 /begin AXIS_DESCR COM_AXIS NO_INPUT_QUANTITY CM_u8_mass_g 8 0 255 AXIS_PTS_REF CAL_obd_cat_monitor_threshold_manual_X_maf_flow /end AXIS_DESCR
/end CHARACTERISTIC
/begin AXIS_PTS CAL_cooling_thermostat_warmup_load_factor_X_load "Calibration: X-axis (load) for the cooling thermostat warmup load factor table (mg/stroke = val*4; 8-element array)." 0x4000DFD8 NO_INPUT_QUANTITY RL_AXIS_UBYTE 0 CM_u8_load_4mg_stroke 8 0 1020 /end AXIS_PTS
/begin CHARACTERISTIC CAL_cooling_thermostat_warmup_load_factor "Calibration: cooling thermostat warmup load factor (8-element array)." CURVE 0x4000DFE0 RL_VALUE_UBYTE 0 NO_COMPU_METHOD 0 255
 /begin AXIS_DESCR COM_AXIS NO_INPUT_QUANTITY CM_u8_load_4mg_stroke 8 0 1020 AXIS_PTS_REF CAL_cooling_thermostat_warmup_load_factor_X_load /end AXIS_DESCR
/end CHARACTERISTIC
/begin CHARACTERISTIC CAL_ecu_thermostat_diag_maf_threshold_manual "uint8_t[18]" VAL_BLK 0x4000DFE8 RL_VALUE_UBYTE 0 NO_COMPU_METHOD 0 255 NUMBER 18 /end CHARACTERISTIC
/begin AXIS_PTS CAL_inj_cranking_enrichment_load_X_load "Calibration: X-axis (load) for the injector cranking enrichment load table (mg/stroke = val*4; 6-element array)." 0x4000E00A NO_INPUT_QUANTITY RL_AXIS_UBYTE 0 CM_u8_load_4mg_stroke 6 0 1020 /end AXIS_PTS
/begin CHARACTERISTIC CAL_inj_cranking_enrichment_load "Calibration: injector cranking enrichment load (val/255; 6-element array)." CURVE 0x4000E010 RL_VALUE_UBYTE 0 CM_u8_factor_1_255 0 100
 /begin AXIS_DESCR COM_AXIS NO_INPUT_QUANTITY CM_u8_load_4mg_stroke 6 0 1020 AXIS_PTS_REF CAL_inj_cranking_enrichment_load_X_load /end AXIS_DESCR
/end CHARACTERISTIC
/begin CHARACTERISTIC CAL_ecu_thermostat_diag_maf_threshold_ips "uint8_t[18]" VAL_BLK 0x4000E016 RL_VALUE_UBYTE 0 NO_COMPU_METHOD 0 255 NUMBER 18 /end CHARACTERISTIC
/begin CHARACTERISTIC CAL_prog_version "Calibration: prog version (32-element array)." ASCII 0x4000E028 RL_VALUE_UBYTE 0 NO_COMPU_METHOD 0 255 NUMBER 32 /end CHARACTERISTIC
/begin AXIS_PTS CAL_sensor_obd_ii_p0106_maf_pressure_correction_X_maf_flow "Calibration: X-axis (maf flow) for the sensor OBD-II P0106 MAF pressure correction table (g/s; 8-element array)." 0x4000E048 NO_INPUT_QUANTITY RL_AXIS_UBYTE 0 CM_u8_flow_g_s 8 0 255 /end AXIS_PTS
/begin CHARACTERISTIC CAL_sensor_obd_ii_p0106_maf_pressure_correction "Calibration: sensor OBD-II P0106 MAF pressure correction (mbar; 8-element array)." CURVE 0x4000E050 RL_VALUE_UBYTE 0 CM_u16_pressure_mbar 0 255
 /begin AXIS_DESCR COM_AXIS NO_INPUT_QUANTITY CM_u8_flow_g_s 8 0 255 AXIS_PTS_REF CAL_sensor_obd_ii_p0106_maf_pressure_correction_X_maf_flow /end AXIS_DESCR
/end CHARACTERISTIC
/begin AXIS_PTS CAL_inj_flow_rate_X_fuel_pressure "Calibration: X-axis (fuel pressure) for the injector flow rate table (mbar; 8-element array)." 0x4000E168 NO_INPUT_QUANTITY RL_AXIS_UWORD 0 CM_u16_pressure_mbar 8 0 65535 /end AXIS_PTS
/begin CHARACTERISTIC CAL_inj_flow_rate "Calibration: injector flow rate (mg/s; 8-element array)." CURVE 0x4000E178 RL_VALUE_UWORD 0 CM_u16_flow_mg_s 0 65535
 /begin AXIS_DESCR COM_AXIS NO_INPUT_QUANTITY CM_u16_pressure_mbar 8 0 65535 AXIS_PTS_REF CAL_inj_flow_rate_X_fuel_pressure /end AXIS_DESCR
/end CHARACTERISTIC
/begin CHARACTERISTIC CAL_idle_air_warmup_factor_ips_Y_maf_accum "undefined" VALUE 0x4000E1A0 RL_VALUE_ULONG 0 NO_COMPU_METHOD 0 4294967295 /end CHARACTERISTIC
/begin CHARACTERISTIC CAL_idle_air_warmup_factor_ips "undefined" VALUE 0x4000E1A8 RL_VALUE_ULONG 0 NO_COMPU_METHOD 0 4294967295 /end CHARACTERISTIC
/begin AXIS_PTS CAL_tpstarget_low_gear_tour_manual_X_pps "Calibration: X-axis (pps) for the tpstarget low gear tour manual table (val/1023; 16-element array)." 0x4000E228 NO_INPUT_QUANTITY RL_AXIS_UWORD 0 CM_u16_factor_1_1023 16 0 6406.15835777126 /end AXIS_PTS
/begin CHARACTERISTIC CAL_tpstarget_low_gear_tour_manual "Calibration: tpstarget low gear tour manual (val/1023; 16-element array)." CURVE 0x4000E248 RL_VALUE_UWORD 0 CM_u16_factor_1_1023 0 6406.15835777126
 /begin AXIS_DESCR COM_AXIS NO_INPUT_QUANTITY CM_u16_factor_1_1023 16 0 6406.15835777126 AXIS_PTS_REF CAL_tpstarget_low_gear_tour_manual_X_pps /end AXIS_DESCR
/end CHARACTERISTIC
/begin AXIS_PTS CAL_tpssmooth_increment_parking_X_tps_diff "Calibration: X-axis (tps diff) for the tpssmooth increment parking table (val/255; 8-element array)." 0x4000E268 NO_INPUT_QUANTITY RL_AXIS_UBYTE 0 CM_u8_factor_1_255 8 0 100 /end AXIS_PTS
/begin CHARACTERISTIC CAL_tpssmooth_increment_parking "Calibration: tpssmooth increment parking (val/255; 8-element array)." CURVE 0x4000E270 RL_VALUE_UBYTE 0 CM_u8_factor_1_255 0 100
 /begin AXIS_DESCR COM_AXIS NO_INPUT_QUANTITY CM_u8_factor_1_255 8 0 100 AXIS_PTS_REF CAL_tpssmooth_increment_parking_X_tps_diff /end AXIS_DESCR
/end CHARACTERISTIC
/begin AXIS_PTS CAL_injtip_fuel_film_alpha_inc_X_mass_per_time "Calibration: X-axis (mass per time) for the injector tip-in fuel film alpha inc table (8-element array)." 0x4000E278 NO_INPUT_QUANTITY RL_AXIS_UBYTE 0 NO_COMPU_METHOD 8 0 255 /end AXIS_PTS
/begin CHARACTERISTIC CAL_injtip_fuel_film_alpha_inc "Calibration: injector tip-in fuel film alpha inc (val/255; 8-element array)." CURVE 0x4000E280 RL_VALUE_UBYTE 0 CM_u8_factor_1_255 0 100
 /begin AXIS_DESCR COM_AXIS NO_INPUT_QUANTITY NO_COMPU_METHOD 8 0 255 AXIS_PTS_REF CAL_injtip_fuel_film_alpha_inc_X_mass_per_time /end AXIS_DESCR
/end CHARACTERISTIC
/begin AXIS_PTS CAL_injtip_fuel_film_alpha_dec_X_mass_per_time "Calibration: X-axis (mass per time) for the injector tip-in fuel film alpha dec table (8-element array)." 0x4000E288 NO_INPUT_QUANTITY RL_AXIS_UBYTE 0 NO_COMPU_METHOD 8 0 255 /end AXIS_PTS
/begin CHARACTERISTIC CAL_injtip_fuel_film_alpha_dec "Calibration: injector tip-in fuel film alpha dec (val/255; 8-element array)." CURVE 0x4000E290 RL_VALUE_UBYTE 0 CM_u8_factor_1_255 0 100
 /begin AXIS_DESCR COM_AXIS NO_INPUT_QUANTITY NO_COMPU_METHOD 8 0 255 AXIS_PTS_REF CAL_injtip_fuel_film_alpha_dec_X_mass_per_time /end AXIS_DESCR
/end CHARACTERISTIC
/begin AXIS_PTS CAL_injtip_fuel_film_X_factor_X_load "Calibration: X-axis (factor X load) for the injector tip-in fuel film table (mg/stroke = val*4; 16-element array)." 0x4000E298 NO_INPUT_QUANTITY RL_AXIS_UBYTE 0 CM_u8_load_4mg_stroke 16 0 1020 /end AXIS_PTS
/begin CHARACTERISTIC CAL_injtip_fuel_film_X_factor "Calibration: X-axis (factor) for the injector tip-in fuel film table (val/255; 16-element array)." CURVE 0x4000E2A8 RL_VALUE_UBYTE 0 CM_u8_factor_1_255 0 100
 /begin AXIS_DESCR COM_AXIS NO_INPUT_QUANTITY CM_u8_load_4mg_stroke 16 0 1020 AXIS_PTS_REF CAL_injtip_fuel_film_X_factor_X_load /end AXIS_DESCR
/end CHARACTERISTIC
/begin AXIS_PTS CAL_dpm_slip_filter_coeff_X_carspeed "Calibration: X-axis (carspeed) for the driver performance mode slip filter coeff table (km/h; 8-element array)." 0x4000E2B8 NO_INPUT_QUANTITY RL_AXIS_UBYTE 0 CM_u8_speed_kph 8 0 255 /end AXIS_PTS
/begin CHARACTERISTIC CAL_dpm_slip_filter_coeff "Calibration: driver performance mode slip filter coeff (val/255; 8-element array)." CURVE 0x4000E2C0 RL_VALUE_UBYTE 0 CM_u8_factor_1_255 0 100
 /begin AXIS_DESCR COM_AXIS NO_INPUT_QUANTITY CM_u8_speed_kph 8 0 255 AXIS_PTS_REF CAL_dpm_slip_filter_coeff_X_carspeed /end AXIS_DESCR
/end CHARACTERISTIC
/begin AXIS_PTS CAL_exhaust_flap_state_control_tour_X_rpm "Calibration: X-axis (rpm) for the exhaust flap state control tour table (RPM = val*50; 8-element array)." 0x4000E2C8 NO_INPUT_QUANTITY RL_AXIS_UBYTE 0 CM_u8_rspeed_50rpm 8 0 12750 /end AXIS_PTS
/begin AXIS_PTS CAL_exhaust_flap_state_control_tour_Y_accel_pedal "Calibration: Y-axis (accel pedal) for the exhaust flap state control tour table (val/255; 8-element array)." 0x4000E2D0 NO_INPUT_QUANTITY RL_AXIS_UBYTE 0 CM_u8_factor_1_255 8 0 100 /end AXIS_PTS
/begin CHARACTERISTIC CAL_exhaust_flap_state_control_tour "Calibration: exhaust flap state control tour (64-element array)." MAP 0x4000E2D8 RL_VALUE_UBYTE 0 NO_COMPU_METHOD 0 255
 /begin AXIS_DESCR COM_AXIS NO_INPUT_QUANTITY CM_u8_rspeed_50rpm 8 0 12750 AXIS_PTS_REF CAL_exhaust_flap_state_control_tour_X_rpm /end AXIS_DESCR
 /begin AXIS_DESCR COM_AXIS NO_INPUT_QUANTITY CM_u8_factor_1_255 8 0 100 AXIS_PTS_REF CAL_exhaust_flap_state_control_tour_Y_accel_pedal /end AXIS_DESCR
/end CHARACTERISTIC
/begin AXIS_PTS CAL_exhaust_flap_state_control_sport_X_rpm "Calibration: X-axis (rpm) for the exhaust flap state control sport table (RPM = val*50; 8-element array)." 0x4000E318 NO_INPUT_QUANTITY RL_AXIS_UBYTE 0 CM_u8_rspeed_50rpm 8 0 12750 /end AXIS_PTS
/begin AXIS_PTS CAL_exhaust_flap_state_control_sport_Y_accel_pedal "Calibration: Y-axis (accel pedal) for the exhaust flap state control sport table (val/255; 8-element array)." 0x4000E320 NO_INPUT_QUANTITY RL_AXIS_UBYTE 0 CM_u8_factor_1_255 8 0 100 /end AXIS_PTS
/begin CHARACTERISTIC CAL_exhaust_flap_state_control_sport "Calibration: exhaust flap state control sport (64-element array)." MAP 0x4000E328 RL_VALUE_UBYTE 0 NO_COMPU_METHOD 0 255
 /begin AXIS_DESCR COM_AXIS NO_INPUT_QUANTITY CM_u8_rspeed_50rpm 8 0 12750 AXIS_PTS_REF CAL_exhaust_flap_state_control_sport_X_rpm /end AXIS_DESCR
 /begin AXIS_DESCR COM_AXIS NO_INPUT_QUANTITY CM_u8_factor_1_255 8 0 100 AXIS_PTS_REF CAL_exhaust_flap_state_control_sport_Y_accel_pedal /end AXIS_DESCR
/end CHARACTERISTIC
/begin AXIS_PTS CAL_idle_comp_timer_carspeed_ips_X_airtemp "Calibration: X-axis (airtemp) for the idle compensation timer carspeed IPS table (°C = val*5/8−40; 8-element array)." 0x4000E368 NO_INPUT_QUANTITY RL_AXIS_UBYTE 0 CM_u8_temp_5_8_40c 8 -40 119.375 /end AXIS_PTS
/begin AXIS_PTS CAL_idle_comp_timer_carspeed_ips_Y_time_above_speed "Calibration: Y-axis (time above speed) for the idle compensation timer carspeed IPS table (8-element array)." 0x4000E370 NO_INPUT_QUANTITY RL_AXIS_UBYTE 0 NO_COMPU_METHOD 8 0 255 /end AXIS_PTS
/begin CHARACTERISTIC CAL_idle_comp_timer_carspeed_ips "Calibration: idle compensation timer carspeed IPS (RPM = val*8; 64-element array)." MAP 0x4000E378 RL_VALUE_UBYTE 0 CM_u8_rspeed_8rpm 0 2040
 /begin AXIS_DESCR COM_AXIS NO_INPUT_QUANTITY CM_u8_temp_5_8_40c 8 -40 119.375 AXIS_PTS_REF CAL_idle_comp_timer_carspeed_ips_X_airtemp /end AXIS_DESCR
 /begin AXIS_DESCR COM_AXIS NO_INPUT_QUANTITY NO_COMPU_METHOD 8 0 255 AXIS_PTS_REF CAL_idle_comp_timer_carspeed_ips_Y_time_above_speed /end AXIS_DESCR
/end CHARACTERISTIC
/begin AXIS_PTS CAL_inj_angle_X_engine_speed "Calibration: X-axis (engine speed) for the injector angle table (RPM = val*125/4+500; 16-element array)." 0x4000E3B8 NO_INPUT_QUANTITY RL_AXIS_UBYTE 0 CM_u8_rspeed_125_4_500rpm 16 500 8468.75 /end AXIS_PTS
/begin AXIS_PTS CAL_inj_angle_Y_load "Calibration: Y-axis (load) for the injector angle table (mg/stroke = val*4; 16-element array)." 0x4000E3C8 NO_INPUT_QUANTITY RL_AXIS_UBYTE 0 CM_u8_load_4mg_stroke 16 0 1020 /end AXIS_PTS
/begin CHARACTERISTIC CAL_inj_angle "Calibration: injector angle (° = val*720/256; 256-element array)." MAP 0x4000E3D8 RL_VALUE_UBYTE 0 CM_u8_angle_720_256deg 0 717.1875
 /begin AXIS_DESCR COM_AXIS NO_INPUT_QUANTITY CM_u8_rspeed_125_4_500rpm 16 500 8468.75 AXIS_PTS_REF CAL_inj_angle_X_engine_speed /end AXIS_DESCR
 /begin AXIS_DESCR COM_AXIS NO_INPUT_QUANTITY CM_u8_load_4mg_stroke 16 0 1020 AXIS_PTS_REF CAL_inj_angle_Y_load /end AXIS_DESCR
/end CHARACTERISTIC
/begin AXIS_PTS CAL_torque_external_request_overshoot_margin_X_rpm "Calibration: X-axis (rpm) for the torque external request overshoot margin table (RPM = val*125/4+500; 16-element array)." 0x4000E4E8 NO_INPUT_QUANTITY RL_AXIS_UBYTE 0 CM_u8_rspeed_125_4_500rpm 16 500 8468.75 /end AXIS_PTS
/begin AXIS_PTS CAL_torque_external_request_overshoot_margin_Y_torque "Calibration: Y-axis (torque) for the torque external request overshoot margin table (Nm = val*4; 16-element array)." 0x4000E4F8 NO_INPUT_QUANTITY RL_AXIS_UBYTE 0 CM_u8_torque_4nm 16 0 1020 /end AXIS_PTS
/begin CHARACTERISTIC CAL_torque_external_request_overshoot_margin "Calibration: torque external request overshoot margin (val/100; 256-element array)." MAP 0x4000E508 RL_VALUE_UBYTE 0 CM_u8_factor_1_100 0 255
 /begin AXIS_DESCR COM_AXIS NO_INPUT_QUANTITY CM_u8_rspeed_125_4_500rpm 16 500 8468.75 AXIS_PTS_REF CAL_torque_external_request_overshoot_margin_X_rpm /end AXIS_DESCR
 /begin AXIS_DESCR COM_AXIS NO_INPUT_QUANTITY CM_u8_torque_4nm 16 0 1020 AXIS_PTS_REF CAL_torque_external_request_overshoot_margin_Y_torque /end AXIS_DESCR
/end CHARACTERISTIC
/end MODULE
/end PROJECT
