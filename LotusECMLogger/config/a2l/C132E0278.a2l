/*
* Drafted by LotusECMLogger A2lGenerator v1 from the C132E0278 symbol catalog for C132E0278.
* 132 axes have an InputQuantity from the reviewed <build>.inputs.csv; the rest have
* NO_INPUT_QUANTITY. Bind more only after checking the lookup in the decompile
* (scope, conditions, input transforms; CCP-client-plan.md section 5). Inputs are raw values, as the lookups compare them.
* Maps are ROW_DIR: the first AXIS_DESCR is X, stored fastest, as the firmware reads lut[y * size_x + x].
* Generator warnings:
* torque_limit_dpm_spark: also at another address; this one (0x4000163C) is named torque_limit_dpm_spark_4000163C.
* torque_limit_dpm_throttle: also at another address; this one (0x4000163E) is named torque_limit_dpm_throttle_4000163E.
* exhaust_flap_state: also at another address; this one (0x40001B11) is named exhaust_flap_state_40001B11.
* timer_main_start1: also at another address; this one (0x40002F00) is named timer_main_start1_40002F00.
* timer_main_start2: also at another address; this one (0x40002F04) is named timer_main_start2_40002F04.
* LEA_fuel_learn_lean_time_bank1: also at another address; this one (0x40003B98) is named LEA_fuel_learn_lean_time_bank1_40003B98.
* LEA_fuel_learn_lean_time_bank2: also at another address; this one (0x40003B9A) is named LEA_fuel_learn_lean_time_bank2_40003B9A.
* LEA_unused_byte3: also at another address; this one (0x40004C37) is named LEA_unused_byte3_40004C37.
* CAL_ign_comp_coolant_engine_stopped_min: also at another address; this one (0x400086A2) is named CAL_ign_comp_coolant_engine_stopped_min_400086A2.
* CAL_tps_limit_severe_misfire_1_cut: also at another address; this one (0x40008868) is named CAL_tps_limit_severe_misfire_1_cut_40008868.
* CAL_cluster_shiftlight_rpm_offset_manual: also at another address; this one (0x40009BA2) is named CAL_cluster_shiftlight_rpm_offset_manual_40009BA2.
* CAL_cluster_shiftlight_rpm_offset_ips: also at another address; this one (0x4000C682) is named CAL_cluster_shiftlight_rpm_offset_ips_4000C682.
* CAL_sensor_o2_rich_voltage_threshold: also at another address; this one (0x4000CAD2) is named CAL_sensor_o2_rich_voltage_threshold_4000CAD2.
* CAL_sensor_o2_lean_voltage_threshold: also at another address; this one (0x4000CAD4) is named CAL_sensor_o2_lean_voltage_threshold_4000CAD4.
* CAL_idle_air_warmup_factor_manual_X_coolant_temp: named like an axis but is a scalar.
* CAL_idle_air_warmup_factor_manual_Y_maf_accumulated: named like an axis but is a scalar.
* CAL_idle_air_warmup_factor_ips_Y_maf_accum: named like an axis but is a scalar.
* CAL_idle_air_warmup_factor_ips: 1 values for a 16-point axis; written as a VALUE without axes.
*/
ASAP2_VERSION 1 61
/begin PROJECT C132E0278 "Lotus T6 C132E0278"
/begin HEADER "" VERSION "generated v1" /end HEADER
/begin MODULE C132E0278 ""
/begin MOD_COMMON "" BYTE_ORDER MSB_FIRST ALIGNMENT_BYTE 1 ALIGNMENT_WORD 2 ALIGNMENT_LONG 4 /end MOD_COMMON
/begin MOD_PAR "" EPK "C132E0278" ADDR_EPK 0x40008654
 /begin MEMORY_SEGMENT CAL "Calibration RAM" DATA RAM INTERN 0x40008654 0x69AC -1 -1 -1 -1 -1 /end MEMORY_SEGMENT
/end MOD_PAR
/begin RECORD_LAYOUT RL_VALUE_UBYTE FNC_VALUES 1 UBYTE ROW_DIR DIRECT /end RECORD_LAYOUT
/begin RECORD_LAYOUT RL_AXIS_UBYTE AXIS_PTS_X 1 UBYTE INDEX_INCR DIRECT /end RECORD_LAYOUT
/begin RECORD_LAYOUT RL_VALUE_SBYTE FNC_VALUES 1 SBYTE ROW_DIR DIRECT /end RECORD_LAYOUT
/begin RECORD_LAYOUT RL_VALUE_UWORD FNC_VALUES 1 UWORD ROW_DIR DIRECT /end RECORD_LAYOUT
/begin RECORD_LAYOUT RL_AXIS_UWORD AXIS_PTS_X 1 UWORD INDEX_INCR DIRECT /end RECORD_LAYOUT
/begin RECORD_LAYOUT RL_VALUE_SWORD FNC_VALUES 1 SWORD ROW_DIR DIRECT /end RECORD_LAYOUT
/begin RECORD_LAYOUT RL_VALUE_ULONG FNC_VALUES 1 ULONG ROW_DIR DIRECT /end RECORD_LAYOUT
/begin COMPU_METHOD CM_i16_factor_1_20 "i16_factor_1/20" RAT_FUNC "%8.0" "%" COEFFS 0 1 0 0 0 5 /end COMPU_METHOD
/begin COMPU_METHOD CM_u16_afr_1_100 "u16_afr_1/100" RAT_FUNC "%10.2" "AFR" COEFFS 0 1 0 0 0 0.01 /end COMPU_METHOD
/begin COMPU_METHOD CM_u16_current_mA "u16_current_mA" RAT_FUNC "%8.0" "mA" COEFFS 0 1 0 0 0 1 /end COMPU_METHOD
/begin COMPU_METHOD CM_u16_factor_1_10000 "u16_factor_1/10000" RAT_FUNC "%10.2" "%" COEFFS 0 1 0 0 0 0.01 /end COMPU_METHOD
/begin COMPU_METHOD CM_u16_factor_1_1023 "u16_factor_1/1023" RAT_FUNC "%12.4" "%" COEFFS 0 1 0 0 0 0.0977517106549365 /end COMPU_METHOD
/begin COMPU_METHOD CM_u16_factor_1_32 "u16_factor_1/32" RAT_FUNC "%11.3" "%" COEFFS 0 1 0 0 0 3.125 /end COMPU_METHOD
/begin COMPU_METHOD CM_u16_factor_1_4095 "u16_factor_1/4095" RAT_FUNC "%12.4" "%" COEFFS 0 1 0 0 0 0.0244200244200244 /end COMPU_METHOD
/begin COMPU_METHOD CM_u16_flow_10mg_s "u16_flow_10mg/s" RAT_FUNC "%8.0" "mg/s" COEFFS 0 1 0 0 0 10 /end COMPU_METHOD
/begin COMPU_METHOD CM_u16_flow_mg_s "u16_flow_mg/s" RAT_FUNC "%8.0" "mg/s" COEFFS 0 1 0 0 0 1 /end COMPU_METHOD
/begin COMPU_METHOD CM_u16_mass_mg "u16_mass_mg" RAT_FUNC "%8.0" "mg" COEFFS 0 1 0 0 0 1 /end COMPU_METHOD
/begin COMPU_METHOD CM_u16_pressure_mbar "u16_pressure_mbar" RAT_FUNC "%8.0" "mbar" COEFFS 0 1 0 0 0 1 /end COMPU_METHOD
/begin COMPU_METHOD CM_u16_rspeed_1_4rpm "u16_rspeed_1/4rpm" RAT_FUNC "%10.2" "rpm" COEFFS 0 1 0 0 0 0.25 /end COMPU_METHOD
/begin COMPU_METHOD CM_u16_rspeed_rpm "u16_rspeed_rpm" RAT_FUNC "%8.0" "rpm" COEFFS 0 1 0 0 0 1 /end COMPU_METHOD
/begin COMPU_METHOD CM_u16_voltage_18_1023v "u16_voltage_18/1023v" RAT_FUNC "%12.4" "V" COEFFS 0 1 0 0 0 0.0175953079178886 /end COMPU_METHOD
/begin COMPU_METHOD CM_u16_voltage_5_1023v "u16_voltage_5/1023v" RAT_FUNC "%12.4" "V" COEFFS 0 1 0 0 0 0.00488758553274682 /end COMPU_METHOD
/begin COMPU_METHOD CM_u16_volume_cc "u16_volume_cc" RAT_FUNC "%8.0" "cc" COEFFS 0 1 0 0 0 1 /end COMPU_METHOD
/begin COMPU_METHOD CM_u8__127 "u8_-127" RAT_FUNC "%8.0" "" COEFFS 0 1 127 0 0 1 /end COMPU_METHOD
/begin COMPU_METHOD CM_u8_accel_1_255g "u8_accel_1/255g" RAT_FUNC "%12.4" "g" COEFFS 0 1 0 0 0 0.00392156862745098 /end COMPU_METHOD
/begin COMPU_METHOD CM_u8_afr_1_20_5 "u8_afr_1/20+5" RAT_FUNC "%10.2" "AFR" COEFFS 0 1 -5 0 0 0.05 /end COMPU_METHOD
/begin COMPU_METHOD CM_u8_angle_1_4_10deg "u8_angle_1/4-10deg" RAT_FUNC "%10.2" "deg" COEFFS 0 1 10 0 0 0.25 /end COMPU_METHOD
/begin COMPU_METHOD CM_u8_angle_1_4_20deg "u8_angle_1/4-20deg" RAT_FUNC "%10.2" "deg" COEFFS 0 1 20 0 0 0.25 /end COMPU_METHOD
/begin COMPU_METHOD CM_u8_angle_1_4_32deg "u8_angle_1/4-32deg" RAT_FUNC "%10.2" "deg" COEFFS 0 1 32 0 0 0.25 /end COMPU_METHOD
/begin COMPU_METHOD CM_u8_angle_1_4deg "u8_angle_1/4deg" RAT_FUNC "%10.2" "deg" COEFFS 0 1 0 0 0 0.25 /end COMPU_METHOD
/begin COMPU_METHOD CM_u8_angle_720_256deg "u8_angle_720/256deg" RAT_FUNC "%12.4" "deg" COEFFS 0 1 0 0 0 2.8125 /end COMPU_METHOD
/begin COMPU_METHOD CM_u8_count_8x "u8_count_8x" RAT_FUNC "%8.0" "x" COEFFS 0 1 0 0 0 8 /end COMPU_METHOD
/begin COMPU_METHOD CM_u8_factor_1_100 "u8_factor_1/100" RAT_FUNC "%8.0" "%" COEFFS 0 1 0 0 0 1 /end COMPU_METHOD
/begin COMPU_METHOD CM_u8_factor_1_128 "u8_factor_1/128" RAT_FUNC "%12.4" "%" COEFFS 0 1 0 0 0 0.78125 /end COMPU_METHOD
/begin COMPU_METHOD CM_u8_factor_1_200 "u8_factor_1/200" RAT_FUNC "%9.1" "%" COEFFS 0 1 0 0 0 0.5 /end COMPU_METHOD
/begin COMPU_METHOD CM_u8_factor_1_255 "u8_factor_1/255" RAT_FUNC "%12.4" "%" COEFFS 0 1 0 0 0 0.392156862745098 /end COMPU_METHOD
/begin COMPU_METHOD CM_u8_factor_1_64 "u8_factor_1/64" RAT_FUNC "%12.4" "%" COEFFS 0 1 0 0 0 1.5625 /end COMPU_METHOD
/begin COMPU_METHOD CM_u8_flow_g_s "u8_flow_g/s" RAT_FUNC "%8.0" "g/s" COEFFS 0 1 0 0 0 1 /end COMPU_METHOD
/begin COMPU_METHOD CM_u8_load_1173mg_255stroke "u8_load_1173mg/255stroke" RAT_FUNC "%9.1" "mg/stroke" COEFFS 0 1 0 0 0 4.6 /end COMPU_METHOD
/begin COMPU_METHOD CM_u8_load_2mg_stroke "u8_load_2mg/stroke" RAT_FUNC "%8.0" "mg/stroke" COEFFS 0 1 0 0 0 2 /end COMPU_METHOD
/begin COMPU_METHOD CM_u8_load_4mg_stroke "u8_load_4mg/stroke" RAT_FUNC "%8.0" "mg/stroke" COEFFS 0 1 0 0 0 4 /end COMPU_METHOD
/begin COMPU_METHOD CM_u8_mass_32mg "u8_mass_32mg" RAT_FUNC "%8.0" "mg" COEFFS 0 1 0 0 0 32 /end COMPU_METHOD
/begin COMPU_METHOD CM_u8_mass_8g "u8_mass_8g" RAT_FUNC "%8.0" "g" COEFFS 0 1 0 0 0 8 /end COMPU_METHOD
/begin COMPU_METHOD CM_u8_mass_g "u8_mass_g" RAT_FUNC "%8.0" "g" COEFFS 0 1 0 0 0 1 /end COMPU_METHOD
/begin COMPU_METHOD CM_u8_pressure_50mbar "u8_pressure_50mbar" RAT_FUNC "%8.0" "mbar" COEFFS 0 1 0 0 0 50 /end COMPU_METHOD
/begin COMPU_METHOD CM_u8_rspeed_10rpm "u8_rspeed_10rpm" RAT_FUNC "%8.0" "rpm" COEFFS 0 1 0 0 0 10 /end COMPU_METHOD
/begin COMPU_METHOD CM_u8_rspeed_125_4_500rpm "u8_rspeed_125/4+500rpm" RAT_FUNC "%10.2" "rpm" COEFFS 0 1 -500 0 0 31.25 /end COMPU_METHOD
/begin COMPU_METHOD CM_u8_rspeed_50rpm "u8_rspeed_50rpm" RAT_FUNC "%8.0" "rpm" COEFFS 0 1 0 0 0 50 /end COMPU_METHOD
/begin COMPU_METHOD CM_u8_rspeed__128 "u8_rspeed_-128" RAT_FUNC "%8.0" "rpm" COEFFS 0 1 128 0 0 1 /end COMPU_METHOD
/begin COMPU_METHOD CM_u8_speed_kph "u8_speed_kph" RAT_FUNC "%8.0" "km/h" COEFFS 0 1 0 0 0 1 /end COMPU_METHOD
/begin COMPU_METHOD CM_u8_temp_5_8_40c "u8_temp_5/8-40c" RAT_FUNC "%11.3" "°C" COEFFS 0 1 40 0 0 0.625 /end COMPU_METHOD
/begin COMPU_METHOD CM_u8_time_100ms "u8_time_100ms" RAT_FUNC "%8.0" "ms" COEFFS 0 1 0 0 0 100 /end COMPU_METHOD
/begin COMPU_METHOD CM_u8_time_10ms "u8_time_10ms" RAT_FUNC "%8.0" "ms" COEFFS 0 1 0 0 0 10 /end COMPU_METHOD
/begin COMPU_METHOD CM_u8_time_10us "u8_time_10us" RAT_FUNC "%8.0" "us" COEFFS 0 1 0 0 0 10 /end COMPU_METHOD
/begin COMPU_METHOD CM_u8_time_20us "u8_time_20us" RAT_FUNC "%8.0" "us" COEFFS 0 1 0 0 0 20 /end COMPU_METHOD
/begin COMPU_METHOD CM_u8_time_256us "u8_time_256us" RAT_FUNC "%8.0" "us" COEFFS 0 1 0 0 0 256 /end COMPU_METHOD
/begin COMPU_METHOD CM_u8_time_50ms "u8_time_50ms" RAT_FUNC "%8.0" "ms" COEFFS 0 1 0 0 0 50 /end COMPU_METHOD
/begin COMPU_METHOD CM_u8_time_5ms "u8_time_5ms" RAT_FUNC "%8.0" "ms" COEFFS 0 1 0 0 0 5 /end COMPU_METHOD
/begin COMPU_METHOD CM_u8_time_64us "u8_time_64us" RAT_FUNC "%8.0" "us" COEFFS 0 1 0 0 0 64 /end COMPU_METHOD
/begin COMPU_METHOD CM_u8_time_hours "u8_time_hours" RAT_FUNC "%8.0" "hours" COEFFS 0 1 0 0 0 1 /end COMPU_METHOD
/begin COMPU_METHOD CM_u8_time_ms "u8_time_ms" RAT_FUNC "%8.0" "ms" COEFFS 0 1 0 0 0 1 /end COMPU_METHOD
/begin COMPU_METHOD CM_u8_time_s "u8_time_s" RAT_FUNC "%8.0" "s" COEFFS 0 1 0 0 0 1 /end COMPU_METHOD
/begin COMPU_METHOD CM_u8_voltage_5_255v "u8_voltage_5/255v" RAT_FUNC "%12.4" "V" COEFFS 0 1 0 0 0 0.0196078431372549 /end COMPU_METHOD
/begin COMPU_METHOD CM_u8_voltage_72_1023v "u8_voltage_72/1023v" RAT_FUNC "%12.4" "V" COEFFS 0 1 0 0 0 0.0703812316715543 /end COMPU_METHOD
/begin COMPU_METHOD CM_u8_volume_1_10gallon "u8_volume_1/10gallon" RAT_FUNC "%9.1" "gallon" COEFFS 0 1 0 0 0 0.1 /end COMPU_METHOD
/begin CHARACTERISTIC CAL_tpssmooth_rate_closing_clamp_thresholds "Calibration: tpssmooth rate closing clamp thresholds (val/1023; 2-element array)." VAL_BLK 0x40008676 RL_VALUE_UWORD 0 CM_u16_factor_1_1023 0 6406.15835777126 NUMBER 2 /end CHARACTERISTIC
/begin CHARACTERISTIC CAL_sensor_evap_purge_pressure_scaling "Calibration: sensor evaporative purge pressure scaling." VALUE 0x40008680 RL_VALUE_UWORD 0 NO_COMPU_METHOD 0 65535 /end CHARACTERISTIC
/begin CHARACTERISTIC CAL_sensor_manifold_pressure_sensor_scaling "Calibration: sensor manifold pressure sensor scaling." VALUE 0x40008684 RL_VALUE_UWORD 0 NO_COMPU_METHOD 0 65535 /end CHARACTERISTIC
/begin CHARACTERISTIC CAL_sensor_manifold_pressure_sensor_offset "Calibration: sensor manifold pressure sensor offset (mbar)." VALUE 0x40008686 RL_VALUE_UWORD 0 CM_u16_pressure_mbar 0 65535 /end CHARACTERISTIC
/begin CHARACTERISTIC CAL_ign_tps_rate_decay_period_opening "u8_time_5ms" VALUE 0x40008689 RL_VALUE_UBYTE 0 CM_u8_time_5ms 0 1275 /end CHARACTERISTIC
/begin CHARACTERISTIC CAL_ign_tps_rate_decay_period_closing "u8_time_5ms" VALUE 0x4000868A RL_VALUE_UBYTE 0 CM_u8_time_5ms 0 1275 /end CHARACTERISTIC
/begin CHARACTERISTIC CAL_cac_pump_diag_dutycycle_min "Calibration: charge-air-cooler pump diag dutycycle minimum (val/255)." VALUE 0x40008690 RL_VALUE_UBYTE 0 CM_u8_factor_1_255 0 100 /end CHARACTERISTIC
/begin CHARACTERISTIC CAL_fuel_level_debounce_window_low "Calibration: fuel level debounce window low (gal = val/10)." VALUE 0x40008693 RL_VALUE_UBYTE 0 CM_u8_volume_1_10gallon 0 25.5 /end CHARACTERISTIC
/begin CHARACTERISTIC CAL_fuel_level_debounce_window_high_ "Calibration: fuel level debounce window high (gal = val/10)." VALUE 0x40008695 RL_VALUE_UWORD 0 CM_u8_volume_1_10gallon 0 6553.5 /end CHARACTERISTIC
/begin CHARACTERISTIC CAL_fuel_level_holdoff_count "u8_count_8x" VALUE 0x40008696 RL_VALUE_UBYTE 0 CM_u8_count_8x 0 2040 /end CHARACTERISTIC
/begin CHARACTERISTIC CAL_fuel_level_stable_count "u8_count" VALUE 0x40008697 RL_VALUE_UBYTE 0 NO_COMPU_METHOD 0 255 /end CHARACTERISTIC
/begin CHARACTERISTIC CAL_load_alphaN_hold_time "Calibration: load alphaN hold time (ms = val*5)." VALUE 0x40008698 RL_VALUE_UBYTE 0 CM_u8_time_5ms 0 1275 /end CHARACTERISTIC
/begin CHARACTERISTIC CAL_ign_comp_coolant_engine_stopped_max "undefined1" VALUE 0x40008699 RL_VALUE_UBYTE 0 NO_COMPU_METHOD 0 255 /end CHARACTERISTIC
/begin CHARACTERISTIC CAL_tps_rate_steadystate_window_size "Calibration: tpssmooth rate calculated window size." VALUE 0x4000869B RL_VALUE_UBYTE 0 NO_COMPU_METHOD 0 255 /end CHARACTERISTIC
/begin CHARACTERISTIC CAL_injtip_fuel_film_disable_default_coeff "Calibration: injector tip-in fuel film disable default coeff (val/255)." VALUE 0x400086A0 RL_VALUE_UBYTE 0 CM_u8_factor_1_255 0 100 /end CHARACTERISTIC
/begin CHARACTERISTIC CAL_ign_comp_coolant_engine_stopped_min "Calibration: ignition compensation coolant engine stopped minimum (°C = val*5/8−40)." VALUE 0x400086A1 RL_VALUE_UBYTE 0 CM_u8_temp_5_8_40c -40 119.375 /end CHARACTERISTIC
/begin CHARACTERISTIC CAL_ign_comp_coolant_engine_stopped_min_400086A2 "Calibration: ignition compensation coolant engine stopped minimum (°C = val*5/8−40)." VALUE 0x400086A2 RL_VALUE_UBYTE 0 CM_u8_temp_5_8_40c -40 119.375 /end CHARACTERISTIC
/begin CHARACTERISTIC CAL_ign_fixed_timing_manual "Calibration: ignition fixed timing manual (° = val/4−10)." VALUE 0x400086A3 RL_VALUE_UBYTE 0 CM_u8_angle_1_4_10deg -10 53.75 /end CHARACTERISTIC
/begin CHARACTERISTIC CAL_injtip_in_adj_gears "Calibration: injector tip-in in adj gears (6-element array)." VAL_BLK 0x400086A5 RL_VALUE_UBYTE 0 NO_COMPU_METHOD 0 255 NUMBER 6 /end CHARACTERISTIC
/begin CHARACTERISTIC CAL_knock_baseline_min_clamp "Calibration: knock baseline minimum clamp." VALUE 0x400086AC RL_VALUE_UBYTE 0 NO_COMPU_METHOD 0 255 /end CHARACTERISTIC
/begin CHARACTERISTIC CAL_sensor_ac_evap_temp_filter_alpha "undefined1" VALUE 0x400086AD RL_VALUE_UBYTE 0 NO_COMPU_METHOD 0 255 /end CHARACTERISTIC
/begin CHARACTERISTIC CAL_ign_trim_per_cyl "Calibration: ignition trim per cyl (° = val/4; 6-element array)." VAL_BLK 0x400086AE RL_VALUE_UBYTE 0 CM_u8_angle_1_4deg 0 63.75 NUMBER 6 /end CHARACTERISTIC
/begin CHARACTERISTIC CAL_inj_max_duty_cycle_limit "Calibration: injector maximum duty cycle limit (val/255)." VALUE 0x400086B9 RL_VALUE_UBYTE 0 CM_u8_factor_1_255 0 100 /end CHARACTERISTIC
/begin CHARACTERISTIC CAL_fuel_trim_integral_max "undefined2" VALUE 0x400086BA RL_VALUE_UWORD 0 NO_COMPU_METHOD 0 65535 /end CHARACTERISTIC
/begin CHARACTERISTIC CAL_fuel_pressure_max "Calibration: fuel pressure maximum (mbar = val*50)." VALUE 0x400086BC RL_VALUE_UBYTE 0 CM_u8_pressure_50mbar 0 12750 /end CHARACTERISTIC
/begin CHARACTERISTIC CAL_fuel_pressure_target_max "Calibration: fuel pressure target maximum (mbar = val*50)." VALUE 0x400086BD RL_VALUE_UBYTE 0 CM_u8_pressure_50mbar 0 12750 /end CHARACTERISTIC
/begin CHARACTERISTIC CAL_fuel_pressure_target_min "Calibration: fuel pressure target minimum (mbar = val*50)." VALUE 0x400086BE RL_VALUE_UBYTE 0 CM_u8_pressure_50mbar 0 12750 /end CHARACTERISTIC
/begin CHARACTERISTIC CAL_closedloop_cross_bank_check_enable "Calibration: closedloop cross bank check enable." VALUE 0x400086C5 RL_VALUE_UBYTE 0 NO_COMPU_METHOD 0 255 /end CHARACTERISTIC
/begin CHARACTERISTIC CAL_closedloop_o2_switch_timeout_engine_cycles_ips "undefined1" VALUE 0x400086C7 RL_VALUE_UBYTE 0 NO_COMPU_METHOD 0 255 /end CHARACTERISTIC
/begin CHARACTERISTIC CAL_injtip_dfco_accel_pedal_max_manual_clutch_disengage "Calibration: injector tip-in decel fuel cut-off accelerator pedal maximum manual clutch disengage (val/255)." VALUE 0x400086CE RL_VALUE_UBYTE 0 CM_u8_factor_1_255 0 100 /end CHARACTERISTIC
/begin CHARACTERISTIC CAL_load_alphaN_learning_temp_threshold "Calibration: load alphaN learning temperature threshold (°C = val*5/8−40)." VALUE 0x400086D4 RL_VALUE_UBYTE 0 CM_u8_temp_5_8_40c -40 119.375 /end CHARACTERISTIC
/begin CHARACTERISTIC CAL_sensor_airtemp_tmaf_filter_alpha "undefined1" VALUE 0x400086D7 RL_VALUE_UBYTE 0 NO_COMPU_METHOD 0 255 /end CHARACTERISTIC
/begin CHARACTERISTIC CAL_sensor_coolant_temp_derived1_scaling "Calibration: sensor coolant temperature derived1 scaling." VALUE 0x400086D8 RL_VALUE_UBYTE 0 NO_COMPU_METHOD 0 255 /end CHARACTERISTIC
/begin CHARACTERISTIC CAL_sensor_intake_air_temp_filter_scaling "Calibration: sensor intake air temperature filter scaling (val/100)." VALUE 0x400086D9 RL_VALUE_UBYTE 0 CM_u8_factor_1_100 0 255 /end CHARACTERISTIC
/begin CHARACTERISTIC CAL_closedloop_lean_protect_max_rpm "Disabled from the factory" VALUE 0x400086DA RL_VALUE_UBYTE 0 CM_u8_rspeed_125_4_500rpm 500 8468.75 /end CHARACTERISTIC
/begin CHARACTERISTIC CAL_fuel_level_filter_coeff_rise "undefined1" VALUE 0x400086DB RL_VALUE_UBYTE 0 NO_COMPU_METHOD 0 255 /end CHARACTERISTIC
/begin CHARACTERISTIC CAL_injtip_dfco_enable_speed "Calibration: injector tip-in decel fuel cut-off enable speed (km/h)." VALUE 0x400086E0 RL_VALUE_UBYTE 0 CM_u8_speed_kph 0 255 /end CHARACTERISTIC
/begin CHARACTERISTIC CAL_injtip_dfco_low_speed_threshold "Calibration: injector tip-in decel fuel cut-off low speed threshold (km/h)." VALUE 0x400086E1 RL_VALUE_UBYTE 0 CM_u8_speed_kph 0 255 /end CHARACTERISTIC
/begin CHARACTERISTIC CAL_ign_enable_lea_knock_retard "Calibration: ignition enable lea knock retard (boolean flag)." VALUE 0x400086E2 RL_VALUE_UBYTE 0 NO_COMPU_METHOD 0 255 /end CHARACTERISTIC
/begin CHARACTERISTIC CAL_sensor_o2_heater_warmup_pwm_period "Calibration: sensor O2 heater warmup PWM period." VALUE 0x400086E3 RL_VALUE_UBYTE 0 NO_COMPU_METHOD 0 255 /end CHARACTERISTIC
/begin CHARACTERISTIC CAL_sensor_o2_heater_warmup_duration "Calibration: sensor O2 heater warmup duration (ms = val*5)." VALUE 0x400086E4 RL_VALUE_UWORD 0 CM_u8_time_5ms 0 327675 /end CHARACTERISTIC
/begin CHARACTERISTIC CAL_knock_corr_limit "Calibration: knock corr limit (° = val/4)." VALUE 0x400086E6 RL_VALUE_UBYTE 0 CM_u8_angle_1_4deg 0 63.75 /end CHARACTERISTIC
/begin CHARACTERISTIC CAL_knock_retard_hold_time "Calibration: knock retard hold time." VALUE 0x400086E7 RL_VALUE_UBYTE 0 NO_COMPU_METHOD 0 255 /end CHARACTERISTIC
/begin CHARACTERISTIC CAL_knock_ign_retard_decay_rate "Calibration: knock ignition retard decay rate (° = val/4)." VALUE 0x400086E8 RL_VALUE_UBYTE 0 CM_u8_angle_1_4deg 0 63.75 /end CHARACTERISTIC
/begin CHARACTERISTIC CAL_knock_octane_scaler_increment "Calibration: knock octane scaler increment." VALUE 0x400086E9 RL_VALUE_UBYTE 0 NO_COMPU_METHOD 0 255 /end CHARACTERISTIC
/begin CHARACTERISTIC CAL_knock_octane_scaler_decrement "Calibration: knock octane scaler decrement." VALUE 0x400086EA RL_VALUE_UBYTE 0 NO_COMPU_METHOD 0 255 /end CHARACTERISTIC
/begin CHARACTERISTIC CAL_knock_detection_engine_speed_max "Calibration: knock detection engine speed maximum (RPM = val*125/4+500)." VALUE 0x400086EB RL_VALUE_UBYTE 0 CM_u8_rspeed_125_4_500rpm 500 8468.75 /end CHARACTERISTIC
/begin CHARACTERISTIC CAL_knock_detection_engine_speed_min "Calibration: knock detection engine speed minimum (RPM = val*125/4+500)." VALUE 0x400086EC RL_VALUE_UBYTE 0 CM_u8_rspeed_125_4_500rpm 500 8468.75 /end CHARACTERISTIC
/begin CHARACTERISTIC CAL_knock_corr_temp_threshold "Calibration: knock corr temperature threshold (°C = val*5/8−40)." VALUE 0x400086ED RL_VALUE_UBYTE 0 CM_u8_temp_5_8_40c -40 119.375 /end CHARACTERISTIC
/begin CHARACTERISTIC CAL_knock_corr_octane_base "Calibration: knock corr octane base (° = val/4)." VALUE 0x400086EE RL_VALUE_UBYTE 0 CM_u8_angle_1_4deg 0 63.75 /end CHARACTERISTIC
/begin CHARACTERISTIC CAL_knock_baseline_filter_alpha "Calibration: knock baseline filter alpha." VALUE 0x400086EF RL_VALUE_UBYTE 0 NO_COMPU_METHOD 0 255 /end CHARACTERISTIC
/begin CHARACTERISTIC CAL_knock_detection_engine_speed_margin "Calibration: knock detection engine speed margin (RPM = val*125/4+500)." VALUE 0x400086F0 RL_VALUE_UBYTE 0 CM_u8_rspeed_125_4_500rpm 500 8468.75 /end CHARACTERISTIC
/begin CHARACTERISTIC CAL_knock_detection_load_margin_debounce "Calibration: knock detection load margin debounce (mg/stroke = val*4)." VALUE 0x400086F1 RL_VALUE_UBYTE 0 CM_u8_load_4mg_stroke 0 1020 /end CHARACTERISTIC
/begin CHARACTERISTIC CAL_knock_inhibit_timer_tps_rate "Calibration: knock inhibit timer throttle position rate (ms = val*5)." VALUE 0x400086F2 RL_VALUE_UBYTE 0 CM_u8_time_5ms 0 1275 /end CHARACTERISTIC
/begin CHARACTERISTIC CAL_knock_inhibit_tps_rate1 "Calibration: knock inhibit throttle position rate1 (val/1023)." VALUE 0x400086F4 RL_VALUE_UWORD 0 CM_u16_factor_1_1023 0 6406.15835777126 /end CHARACTERISTIC
/begin CHARACTERISTIC CAL_closedloop_stft_filter_unknown "undefined1" VALUE 0x400086F7 RL_VALUE_UBYTE 0 NO_COMPU_METHOD 0 255 /end CHARACTERISTIC
/begin CHARACTERISTIC CAL_ign_comp_ac_compressor_active "Calibration: ignition compensation A/C compressor active (° = val/4)." VALUE 0x40008703 RL_VALUE_SBYTE 0 CM_u8_angle_1_4deg -32 31.75 /end CHARACTERISTIC
/begin CHARACTERISTIC CAL_injtip_in_adj_gears_6 "Calibration: injector tip-in in adj gears 6." VALUE 0x40008705 RL_VALUE_UBYTE 0 NO_COMPU_METHOD 0 255 /end CHARACTERISTIC
/begin CHARACTERISTIC CAL_inj_comp_power_enrich_from_ign_retard "Calibration: injector compensation power enrich from ignition retard (val/100)." VALUE 0x4000870F RL_VALUE_UBYTE 0 CM_u8_factor_1_100 0 255 /end CHARACTERISTIC
/begin CHARACTERISTIC CAL_inj_fuel_learn_time_step "Calibration: fuel learn time step." VALUE 0x40008711 RL_VALUE_UBYTE 0 NO_COMPU_METHOD 0 255 /end CHARACTERISTIC
/begin CHARACTERISTIC CAL_sensor_pps_unknown1 "undefined1" VALUE 0x40008712 RL_VALUE_UBYTE 0 NO_COMPU_METHOD 0 255 /end CHARACTERISTIC
/begin CHARACTERISTIC CAL_tps_accel_pedal_zero_calibrate_timer "Calibration: throttle position accelerator pedal zero calibrate timer (ms = val*5)." VALUE 0x40008715 RL_VALUE_UBYTE 0 CM_u8_time_5ms 0 1275 /end CHARACTERISTIC
/begin CHARACTERISTIC CAL_sensor_map_avg_window_size "Calibration: sensor MAP avg window size." VALUE 0x40008717 RL_VALUE_UBYTE 0 NO_COMPU_METHOD 0 255 /end CHARACTERISTIC
/begin CHARACTERISTIC CAL_knock_agc_threshold "Calibration: knock AGC threshold (RPM = val*125/4+500; 3-element array)." VAL_BLK 0x4000871A RL_VALUE_UBYTE 0 CM_u8_rspeed_125_4_500rpm 500 8468.75 NUMBER 3 /end CHARACTERISTIC
/begin CHARACTERISTIC CAL_knock_agc_hysteresis_band "Calibration: knock AGC hysteresis band (RPM = val*125/4+500)." VALUE 0x4000871D RL_VALUE_UBYTE 0 CM_u8_rspeed_125_4_500rpm 500 8468.75 /end CHARACTERISTIC
/begin CHARACTERISTIC CAL_ign_zero_rpm_threshold "Calibration: ignition zero RPM threshold (RPM = val*125/4+500)." VALUE 0x40008728 RL_VALUE_UBYTE 0 CM_u8_rspeed_125_4_500rpm 500 8468.75 /end CHARACTERISTIC
/begin CHARACTERISTIC CAL_ign_comp_idle_transient_advance_max "u8_factor_1/255" VALUE 0x4000872B RL_VALUE_UBYTE 0 CM_u8_factor_1_255 0 100 /end CHARACTERISTIC
/begin CHARACTERISTIC CAL_knock_octane_scaler_shortterm_multiplier "Calibration: knock octane scaler shortterm multiplier." VALUE 0x40008734 RL_VALUE_UBYTE 0 NO_COMPU_METHOD 0 255 /end CHARACTERISTIC
/begin CHARACTERISTIC CAL_knock_octane_scaler_shortterm_decrement "Calibration: knock octane scaler shortterm decrement." VALUE 0x40008735 RL_VALUE_UBYTE 0 NO_COMPU_METHOD 0 255 /end CHARACTERISTIC
/begin CHARACTERISTIC CAL_injtip_overrun_inhibit_timer "Calibration: injector tip-in overrun inhibit timer (ms = val*5)." VALUE 0x40008738 RL_VALUE_UWORD 0 CM_u8_time_5ms 0 327675 /end CHARACTERISTIC
/begin CHARACTERISTIC CAL_etb_pid_kd "uint16_t" VALUE 0x4000873A RL_VALUE_UWORD 0 NO_COMPU_METHOD 0 65535 /end CHARACTERISTIC
/begin CHARACTERISTIC CAL_etb_tps1_max_count "undefined2" VALUE 0x4000873E RL_VALUE_UWORD 0 NO_COMPU_METHOD 0 65535 /end CHARACTERISTIC
/begin CHARACTERISTIC CAL_etb_tps2_max_count "undefined2" VALUE 0x40008742 RL_VALUE_UWORD 0 NO_COMPU_METHOD 0 65535 /end CHARACTERISTIC
/begin CHARACTERISTIC CAL_etb_pwm_period "uint16_t" VALUE 0x40008744 RL_VALUE_UWORD 0 NO_COMPU_METHOD 0 65535 /end CHARACTERISTIC
/begin CHARACTERISTIC CAL_etb_pid_kp "uint16_t" VALUE 0x4000874A RL_VALUE_UWORD 0 NO_COMPU_METHOD 0 65535 /end CHARACTERISTIC
/begin CHARACTERISTIC CAL_etb_pid_ki "uint16_t" VALUE 0x4000874E RL_VALUE_UWORD 0 NO_COMPU_METHOD 0 65535 /end CHARACTERISTIC
/begin CHARACTERISTIC CAL_injtip_overrun_hysteresis_timer "Calibration: injector tip-in overrun hysteresis timer (ms = val*5)." VALUE 0x40008750 RL_VALUE_UWORD 0 CM_u8_time_5ms 0 327675 /end CHARACTERISTIC
/begin CHARACTERISTIC CAL_etb_pid_integral_limit "uint16_t" VALUE 0x4000875A RL_VALUE_UWORD 0 NO_COMPU_METHOD 0 65535 /end CHARACTERISTIC
/begin CHARACTERISTIC CAL_tpssmooth_step_timer "Calibration: tpssmooth step timer." VALUE 0x4000875C RL_VALUE_UWORD 0 NO_COMPU_METHOD 0 65535 /end CHARACTERISTIC
/begin CHARACTERISTIC CAL_closedloop_bank_sync_max_hold "undefined1" VALUE 0x40008761 RL_VALUE_UBYTE 0 NO_COMPU_METHOD 0 255 /end CHARACTERISTIC
/begin CHARACTERISTIC CAL_sensor_clutch_engaged_threshold "Calibration: sensor clutch engaged threshold (V = val*5/1023)." VALUE 0x40008768 RL_VALUE_UWORD 0 CM_u16_voltage_5_1023v 0 320.307917888563 /end CHARACTERISTIC
/begin CHARACTERISTIC CAL_sensor_clutch_disengaged_threshold "Calibration: sensor clutch disengaged threshold (V = val*5/1023)." VALUE 0x4000876A RL_VALUE_UWORD 0 CM_u16_voltage_5_1023v 0 320.307917888563 /end CHARACTERISTIC
/begin CHARACTERISTIC CAL_tpssmooth_decrement_comp_gears_manual "Calibration: tpssmooth decrement compensation gears manual (val/255; 7-element array)." VAL_BLK 0x4000876D RL_VALUE_UBYTE 0 CM_u8_factor_1_255 0 100 NUMBER 7 /end CHARACTERISTIC
/begin CHARACTERISTIC CAL_load_alphaN_learning_rpm_rate_max "Calibration: load alphaN learning RPM rate maximum." VALUE 0x4000877A RL_VALUE_UWORD 0 NO_COMPU_METHOD 0 65535 /end CHARACTERISTIC
/begin CHARACTERISTIC CAL_closedloop_activate_timer_o2_check "Calibration: closedloop activate timer O2 check (ms = val*5)." VALUE 0x40008784 RL_VALUE_UWORD 0 CM_u8_time_5ms 0 327675 /end CHARACTERISTIC
/begin CHARACTERISTIC CAL_closedloop_afr "Calibration: closedloop AFR (val/100)." VALUE 0x4000879C RL_VALUE_UWORD 0 CM_u16_afr_1_100 0 655.35 /end CHARACTERISTIC
/begin CHARACTERISTIC CAL_closedloop_o2_sensor_voltage_switching_lean "Calibration: closedloop O2 sensor voltage switching lean (V = val*5/1023)." VALUE 0x4000879E RL_VALUE_UWORD 0 CM_u16_voltage_5_1023v 0 320.307917888563 /end CHARACTERISTIC
/begin CHARACTERISTIC CAL_closedloop_o2_sensor_voltage_switch_rich "Calibration: closedloop O2 sensor voltage switch rich (V = val*5/1023)." VALUE 0x400087A0 RL_VALUE_UWORD 0 CM_u16_voltage_5_1023v 0 320.307917888563 /end CHARACTERISTIC
/begin CHARACTERISTIC CAL_inj_stft_limit "Calibration: injector short-term fuel trim limit (val/20)." VALUE 0x400087A2 RL_VALUE_SWORD 0 CM_i16_factor_1_20 -163840 163835 /end CHARACTERISTIC
/begin CHARACTERISTIC CAL_ign_low_gear_number "Calibration: ignition low gear number." VALUE 0x400087A8 RL_VALUE_UBYTE 0 NO_COMPU_METHOD 0 255 /end CHARACTERISTIC
/begin CHARACTERISTIC CAL_load_learning_stabilization_delay "Calibration: load learning stabilization delay." VALUE 0x400087B2 RL_VALUE_UWORD 0 NO_COMPU_METHOD 0 65535 /end CHARACTERISTIC
/begin CHARACTERISTIC CAL_tps_idle_to_current_ratio_threshold "Calibration: throttle position idle to current ratio threshold (2-element array)." VAL_BLK 0x400087B4 RL_VALUE_UWORD 0 NO_COMPU_METHOD 0 65535 NUMBER 2 /end CHARACTERISTIC
/begin CHARACTERISTIC CAL_load_alphaN_learning_mass_accum_threshold "Calibration: load alphaN learning mass accum threshold (mg)." VALUE 0x400087B8 RL_VALUE_UWORD 0 CM_u16_mass_mg 0 65535 /end CHARACTERISTIC
/begin CHARACTERISTIC CAL_load_learning_holdoff_delay "Calibration: load learning holdoff delay." VALUE 0x400087BA RL_VALUE_UWORD 0 NO_COMPU_METHOD 0 65535 /end CHARACTERISTIC
/begin CHARACTERISTIC CAL_closedloop_prop_gain_lean_slow_switch_scale "undefined1" VALUE 0x400087C9 RL_VALUE_UBYTE 0 NO_COMPU_METHOD 0 255 /end CHARACTERISTIC
/begin CHARACTERISTIC CAL_sensor_maf_buffer_size "Calibration: sensor MAF buffer size." VALUE 0x400087CC RL_VALUE_UBYTE 0 NO_COMPU_METHOD 0 255 /end CHARACTERISTIC
/begin CHARACTERISTIC CAL_injtip_comp_base "Calibration: injector tip-in compensation base." VALUE 0x400087CE RL_VALUE_UBYTE 0 NO_COMPU_METHOD 0 255 /end CHARACTERISTIC
/begin CHARACTERISTIC CAL_tps_delta_rate_window_size "Calibration: throttle position delta rate window size." VALUE 0x400087CF RL_VALUE_UBYTE 0 NO_COMPU_METHOD 0 255 /end CHARACTERISTIC
/begin CHARACTERISTIC CAL_injtip_tipin_decay_rate_divider "Calibration: injector tip-in tipin decay rate divider." VALUE 0x400087D0 RL_VALUE_UBYTE 0 NO_COMPU_METHOD 0 255 /end CHARACTERISTIC
/begin CHARACTERISTIC CAL_injtip_tipout_decay_rate_divider "Calibration: injector tip-in tipout decay rate divider." VALUE 0x400087D1 RL_VALUE_UBYTE 0 NO_COMPU_METHOD 0 255 /end CHARACTERISTIC
/begin CHARACTERISTIC CAL_injtip_in_threshold "Calibration: injector tip-in in threshold (val/1023; 2-element array)." VAL_BLK 0x400087D2 RL_VALUE_UWORD 0 CM_u16_factor_1_1023 0 6406.15835777126 NUMBER 2 /end CHARACTERISTIC
/begin CHARACTERISTIC CAL_injtip_out_threshold "Calibration: injector tip-in out threshold (val/1023; 2-element array)." VAL_BLK 0x400087D6 RL_VALUE_UWORD 0 CM_u16_factor_1_1023 0 6406.15835777126 NUMBER 2 /end CHARACTERISTIC
/begin CHARACTERISTIC CAL_closedloop_stft_ramp_interval_manual "undefined1" VALUE 0x400087DA RL_VALUE_UBYTE 0 NO_COMPU_METHOD 0 255 /end CHARACTERISTIC
/begin CHARACTERISTIC CAL_closedloop_proportional_gain_scale "Calibration: closedloop proportional gain scale (val/64)." VALUE 0x400087DB RL_VALUE_UBYTE 0 CM_u8_factor_1_64 0 398.4375 /end CHARACTERISTIC
/begin CHARACTERISTIC CAL_closedloop_fuel_learn_iat_max "Calibration: closedloop fuel learn intake air temp maximum (°C = val*5/8−40)." VALUE 0x400087DC RL_VALUE_UBYTE 0 CM_u8_temp_5_8_40c -40 119.375 /end CHARACTERISTIC
/begin CHARACTERISTIC CAL_tps_warmup_max "u16_factor_1/1023" VALUE 0x400087E0 RL_VALUE_UWORD 0 CM_u16_factor_1_1023 0 6406.15835777126 /end CHARACTERISTIC
/begin CHARACTERISTIC CAL_tps_min "Effective TPS floor. TPS never be commanded less than this." VALUE 0x400087E2 RL_VALUE_UWORD 0 CM_u16_factor_1_1023 0 6406.15835777126 /end CHARACTERISTIC
/begin CHARACTERISTIC CAL_injtip_dfco_disable_accel_pedal "Calibration: injector tip-in decel fuel cut-off disable accelerator pedal (val/1023)." VALUE 0x400087E6 RL_VALUE_UBYTE 0 CM_u16_factor_1_1023 0 24.9266862170088 /end CHARACTERISTIC
/begin CHARACTERISTIC CAL_injtip_dfco_enable_accel_pedal "Calibration: injector tip-in decel fuel cut-off enable accelerator pedal (val/1023)." VALUE 0x400087E7 RL_VALUE_UBYTE 0 CM_u16_factor_1_1023 0 24.9266862170088 /end CHARACTERISTIC
/begin CHARACTERISTIC CAL_fuel_level_filter_coeff_fall "undefined1" VALUE 0x400087E9 RL_VALUE_UBYTE 0 NO_COMPU_METHOD 0 255 /end CHARACTERISTIC
/begin CHARACTERISTIC CAL_injtip_dfco_enable_temp "Calibration: injector tip-in decel fuel cut-off enable temperature (°C = val*5/8−40)." VALUE 0x400087EC RL_VALUE_UBYTE 0 CM_u8_temp_5_8_40c -40 119.375 /end CHARACTERISTIC
/begin CHARACTERISTIC CAL_injtip_dfco_disable_temp "Calibration: injector tip-in decel fuel cut-off disable temperature (°C = val*5/8−40)." VALUE 0x400087ED RL_VALUE_UBYTE 0 CM_u8_temp_5_8_40c -40 119.375 /end CHARACTERISTIC
/begin CHARACTERISTIC CAL_dfco_cyl_ramp_length "undefined1" VALUE 0x400087EE RL_VALUE_UBYTE 0 NO_COMPU_METHOD 0 255 /end CHARACTERISTIC
/begin CHARACTERISTIC CAL_injtip_dfco_min_runtime "Calibration: injector tip-in decel fuel cut-off minimum runtime (ms = val*50)." VALUE 0x400087F1 RL_VALUE_UBYTE 0 CM_u8_time_50ms 0 12750 /end CHARACTERISTIC
/begin CHARACTERISTIC CAL_load_alphaN_max_rpm "Calibration: load alphaN maximum RPM (RPM)." VALUE 0x400087F2 RL_VALUE_UWORD 0 CM_u16_rspeed_rpm 0 65535 /end CHARACTERISTIC
/begin CHARACTERISTIC CAL_load_alphaN_tps_rate_closing_threshold "Calibration: load alphaN throttle position rate closing threshold (val/255)." VALUE 0x400087F4 RL_VALUE_UWORD 0 CM_u8_factor_1_255 0 25700 /end CHARACTERISTIC
/begin CHARACTERISTIC CAL_closedloop_fuel_learn_baro_min "Calibration: closedloop fuel learn baro minimum (mbar)." VALUE 0x400087FC RL_VALUE_UWORD 0 CM_u16_pressure_mbar 0 65535 /end CHARACTERISTIC
/begin CHARACTERISTIC CAL_injtip_dfco_enable_rpm_manual_clutch_disengage "Calibration: injector tip-in decel fuel cut-off enable RPM manual clutch disengage (RPM = val*10)." VALUE 0x40008811 RL_VALUE_UBYTE 0 CM_u8_rspeed_10rpm 0 2550 /end CHARACTERISTIC
/begin CHARACTERISTIC CAL_closedloop_stft_increment_period "Calibration: closedloop short-term fuel trim increment period (ms = val*5)." VALUE 0x40008818 RL_VALUE_UBYTE 0 CM_u8_time_5ms 0 1275 /end CHARACTERISTIC
/begin CHARACTERISTIC CAL_load_alphaN_tps_rate_opening_threshold "Calibration: load alphaN throttle position rate opening threshold (val/255)." VALUE 0x40008822 RL_VALUE_UWORD 0 CM_u8_factor_1_255 0 25700 /end CHARACTERISTIC
/begin CHARACTERISTIC CAL_inj_fuel_learn_offset_maf_max "u16_flow_10mg/s" VALUE 0x4000882A RL_VALUE_UWORD 0 CM_u16_flow_10mg_s 0 655350 /end CHARACTERISTIC
/begin CHARACTERISTIC CAL_inj_fuel_learn_zone_2_maf_max "u16_flow_10mg/s" VALUE 0x4000882E RL_VALUE_UWORD 0 CM_u16_flow_10mg_s 0 655350 /end CHARACTERISTIC
/begin CHARACTERISTIC CAL_inj_fuel_learn_zone_2_maf_min "u16_flow_10mg/s" VALUE 0x40008830 RL_VALUE_UWORD 0 CM_u16_flow_10mg_s 0 655350 /end CHARACTERISTIC
/begin CHARACTERISTIC CAL_inj_fuel_learn_zone_2_load_max "undefined2" VALUE 0x40008832 RL_VALUE_UWORD 0 NO_COMPU_METHOD 0 65535 /end CHARACTERISTIC
/begin CHARACTERISTIC CAL_inj_fuel_learn_zone_2_load_min "undefined2" VALUE 0x40008834 RL_VALUE_UWORD 0 NO_COMPU_METHOD 0 65535 /end CHARACTERISTIC
/begin CHARACTERISTIC CAL_inj_fuel_learn_zone_3_maf_min "u16_flow_10mg/s" VALUE 0x40008836 RL_VALUE_UWORD 0 CM_u16_flow_10mg_s 0 655350 /end CHARACTERISTIC
/begin CHARACTERISTIC CAL_inj_fuel_learn_zone_3_load_min "undefined2" VALUE 0x40008838 RL_VALUE_UWORD 0 NO_COMPU_METHOD 0 65535 /end CHARACTERISTIC
/begin CHARACTERISTIC CAL_closedloop_fuel_learn_coolant_min "Calibration: closedloop fuel learn coolant minimum (°C = val*5/8−40)." VALUE 0x4000883A RL_VALUE_UBYTE 0 CM_u8_temp_5_8_40c -40 119.375 /end CHARACTERISTIC
/begin CHARACTERISTIC CAL_inj_fuel_learn_step_period "undefined1" VALUE 0x4000883B RL_VALUE_UBYTE 0 NO_COMPU_METHOD 0 255 /end CHARACTERISTIC
/begin CHARACTERISTIC CAL_inj_fuel_learn_stft_rich_limit "undefined2" VALUE 0x4000883E RL_VALUE_UWORD 0 NO_COMPU_METHOD 0 65535 /end CHARACTERISTIC
/begin CHARACTERISTIC CAL_inj_fuel_learn_lean_time_limit "undefined1" VALUE 0x40008840 RL_VALUE_UBYTE 0 NO_COMPU_METHOD 0 255 /end CHARACTERISTIC
/begin CHARACTERISTIC CAL_inj_fuel_learn_rich_time_limit "undefined1" VALUE 0x40008841 RL_VALUE_UBYTE 0 NO_COMPU_METHOD 0 255 /end CHARACTERISTIC
/begin CHARACTERISTIC CAL_inj_fuel_learn_zone_2_max "undefined1" VALUE 0x40008842 RL_VALUE_UBYTE 0 NO_COMPU_METHOD 0 255 /end CHARACTERISTIC
/begin CHARACTERISTIC CAL_inj_fuel_learn_zone_2_min "undefined1" VALUE 0x40008843 RL_VALUE_UBYTE 0 NO_COMPU_METHOD 0 255 /end CHARACTERISTIC
/begin CHARACTERISTIC CAL_inj_fuel_learn_zone_3_max "undefined1" VALUE 0x40008844 RL_VALUE_UBYTE 0 NO_COMPU_METHOD 0 255 /end CHARACTERISTIC
/begin CHARACTERISTIC CAL_inj_fuel_learn_zone_3_min "undefined1" VALUE 0x40008845 RL_VALUE_UBYTE 0 NO_COMPU_METHOD 0 255 /end CHARACTERISTIC
/begin CHARACTERISTIC CAL_closedloop_proportional_gain_rich_ips "Calibration: closedloop proportional gain rich IPS." VALUE 0x40008846 RL_VALUE_UWORD 0 NO_COMPU_METHOD 0 65535 /end CHARACTERISTIC
/begin CHARACTERISTIC CAL_closedloop_proportional_gain_lean_ips "Calibration: closedloop proportional gain lean IPS." VALUE 0x40008848 RL_VALUE_UWORD 0 NO_COMPU_METHOD 0 65535 /end CHARACTERISTIC
/begin CHARACTERISTIC CAL_closedloop_integral_gain_ips "Calibration: closedloop integral gain IPS." VALUE 0x4000884A RL_VALUE_UWORD 0 NO_COMPU_METHOD 0 65535 /end CHARACTERISTIC
/begin CHARACTERISTIC CAL_closedloop_derivative_gain_ips "Calibration: closedloop derivative gain IPS." VALUE 0x4000884C RL_VALUE_UWORD 0 NO_COMPU_METHOD 0 65535 /end CHARACTERISTIC
/begin CHARACTERISTIC CAL_closedloop_o2_sensor_threshold_rich "Calibration: closedloop O2 sensor threshold rich (V = val*5/1023)." VALUE 0x4000884E RL_VALUE_UWORD 0 CM_u16_voltage_5_1023v 0 320.307917888563 /end CHARACTERISTIC
/begin CHARACTERISTIC CAL_closedloop_o2_sensor_threshold_lean "Calibration: closedloop O2 sensor threshold lean (V = val*5/1023)." VALUE 0x40008850 RL_VALUE_UWORD 0 CM_u16_voltage_5_1023v 0 320.307917888563 /end CHARACTERISTIC
/begin CHARACTERISTIC CAL_fuel_level_change_threshold "Calibration: fuel level change threshold (gal = val/10)." VALUE 0x40008855 RL_VALUE_UWORD 0 CM_u8_volume_1_10gallon 0 6553.5 /end CHARACTERISTIC
/begin CHARACTERISTIC CAL_tps_idle_request_max "u16_factor_1/4095" VALUE 0x40008856 RL_VALUE_UWORD 0 CM_u16_factor_1_4095 0 1600.3663003663 /end CHARACTERISTIC
/begin CHARACTERISTIC CAL_tps_limit_severe_misfire_1_cut "u8_factor_1/255" VALUE 0x40008859 RL_VALUE_UBYTE 0 CM_u8_factor_1_255 0 100 /end CHARACTERISTIC
/begin CHARACTERISTIC CAL_ign_zero_load_threshold "Calibration: ignition zero load threshold (mg/stroke = val*4)." VALUE 0x4000885C RL_VALUE_UBYTE 0 CM_u8_load_4mg_stroke 0 1020 /end CHARACTERISTIC
/begin CHARACTERISTIC CAL_ign_zero_gear "Calibration: ignition zero gear." VALUE 0x4000885D RL_VALUE_UBYTE 0 NO_COMPU_METHOD 0 255 /end CHARACTERISTIC
/begin CHARACTERISTIC CAL_ign_comp_recovery_timer "Calibration: ignition compensation recovery timer (ms = val*5)." VALUE 0x4000885E RL_VALUE_UBYTE 0 CM_u8_time_5ms 0 1275 /end CHARACTERISTIC
/begin CHARACTERISTIC CAL_tps_limit_severe_misfire_multi_cut "u8_factor_1/255" VALUE 0x40008867 RL_VALUE_UBYTE 0 CM_u8_factor_1_255 0 100 /end CHARACTERISTIC
/begin CHARACTERISTIC CAL_tps_limit_severe_misfire_1_cut_40008868 "u8_factor_1/255" VALUE 0x40008868 RL_VALUE_UBYTE 0 CM_u8_factor_1_255 0 100 /end CHARACTERISTIC
/begin CHARACTERISTIC CAL_tps_limit_severe_misfire_no_cut "u8_factor_1/255" VALUE 0x40008869 RL_VALUE_UBYTE 0 CM_u8_factor_1_255 0 100 /end CHARACTERISTIC
/begin CHARACTERISTIC CAL_tps_limit_warmup_stepsize "Calibration: throttle position limit warmup stepsize (val/1023)." VALUE 0x40008871 RL_VALUE_UBYTE 0 CM_u16_factor_1_1023 0 24.9266862170088 /end CHARACTERISTIC
/begin CHARACTERISTIC CAL_tmap_use_for_inj "Calibration: TMAP use for injector (boolean flag)." VALUE 0x40008877 RL_VALUE_UBYTE 0 NO_COMPU_METHOD 0 255 /end CHARACTERISTIC
/begin CHARACTERISTIC CAL_load_cylinder_volume "Calibration: load cylinder volume (cc)." VALUE 0x40008878 RL_VALUE_UWORD 0 CM_u16_volume_cc 0 65535 /end CHARACTERISTIC
/begin CHARACTERISTIC CAL_tpssmooth_decrement_comp_gears_ips "Calibration: tpssmooth decrement compensation gears IPS (val/255; 7-element array)." VAL_BLK 0x4000887E RL_VALUE_UBYTE 0 CM_u8_factor_1_255 0 100 NUMBER 7 /end CHARACTERISTIC
/begin CHARACTERISTIC CAL_ign_idle_mode_holdover_time "hold-over timer that keeps the idle/cruise ignition modes selectable for a window after a fuel cut ends." VALUE 0x40008885 RL_VALUE_UBYTE 0 CM_u8_time_10ms 0 2550 /end CHARACTERISTIC
/begin CHARACTERISTIC CAL_closedloop_engine_run_learn_timer_unknown "Calibration: closedloop engine run learn timer (hours)." VALUE 0x40008886 RL_VALUE_UBYTE 0 CM_u8_time_hours 0 255 /end CHARACTERISTIC
/begin CHARACTERISTIC CAL_closedloop_integral_gain_scale_manual "Calibration: closedloop integral gain scale manual (val/255)." VALUE 0x40008887 RL_VALUE_UBYTE 0 CM_u8_factor_1_255 0 100 /end CHARACTERISTIC
/begin CHARACTERISTIC CAL_closedloop_entry_delay_power_enrich "Calibration: closedloop entry delay power enrich (ms)." VALUE 0x40008888 RL_VALUE_UBYTE 0 CM_u8_time_ms 0 255 /end CHARACTERISTIC
/begin CHARACTERISTIC CAL_closedloop_entry_delay_time_cruise "Calibration: closedloop entry delay time cruise (ms)." VALUE 0x4000888E RL_VALUE_UBYTE 0 CM_u8_time_ms 0 255 /end CHARACTERISTIC
/begin CHARACTERISTIC CAL_roughness_enable_rpm "Calibration: roughness enable RPM (RPM = val/4; 2-element array)." VAL_BLK 0x4000889A RL_VALUE_UWORD 0 CM_u16_rspeed_1_4rpm 0 16383.75 NUMBER 2 /end CHARACTERISTIC
/begin CHARACTERISTIC CAL_roughness_enable_load "Calibration: roughness enable load (mg/stroke = val*4; 2-element array)." VAL_BLK 0x4000889E RL_VALUE_UBYTE 0 CM_u8_load_4mg_stroke 0 1020 NUMBER 2 /end CHARACTERISTIC
/begin CHARACTERISTIC CAL_roughness_delta_rpm_smoothing_factor "Calibration: roughness delta RPM smoothing factor (val/100)." VALUE 0x400088A2 RL_VALUE_UBYTE 0 CM_u8_factor_1_100 0 255 /end CHARACTERISTIC
/begin CHARACTERISTIC CAL_roughness_min_edge_count "undefined1" VALUE 0x400088A3 RL_VALUE_UBYTE 0 NO_COMPU_METHOD 0 255 /end CHARACTERISTIC
/begin CHARACTERISTIC CAL_roughness_cycle_count_threshold "Calibration: roughness cycle count threshold." VALUE 0x400088A4 RL_VALUE_UBYTE 0 NO_COMPU_METHOD 0 255 /end CHARACTERISTIC
/begin CHARACTERISTIC CAL_roughness_peak_valley_imblance_threshold "Calibration: roughness peak valley imblance threshold." VALUE 0x400088A7 RL_VALUE_UBYTE 0 NO_COMPU_METHOD 0 255 /end CHARACTERISTIC
/begin CHARACTERISTIC CAL_roughness_ign_adv_min_sign_flipped "Calibration: roughness ignition adv minimum sign flipped (° = val/4)." VALUE 0x400088AA RL_VALUE_UBYTE 0 CM_u8_angle_1_4deg 0 63.75 /end CHARACTERISTIC
/begin CHARACTERISTIC CAL_roughness_ign_adv_max "Calibration: roughness ignition adv maximum (° = val/4)." VALUE 0x400088AB RL_VALUE_UBYTE 0 CM_u8_angle_1_4deg 0 63.75 /end CHARACTERISTIC
/begin CHARACTERISTIC CAL_ign_fixed_timing_ips "Calibration: ignition fixed timing IPS (° = val/4−10)." VALUE 0x400088C1 RL_VALUE_UBYTE 0 CM_u8_angle_1_4_10deg -10 53.75 /end CHARACTERISTIC
/begin CHARACTERISTIC CAL_knock_freq_band_centers "Calibration: knock freq band centers (11-element array)." VAL_BLK 0x400088C2 RL_VALUE_UWORD 0 NO_COMPU_METHOD 0 65535 NUMBER 11 /end CHARACTERISTIC
/begin CHARACTERISTIC CAL_tps_brake_wheeldecel_tps_cut_threshold "Calibration: throttle position brake wheeldecel throttle position cut threshold." VALUE 0x400088D8 RL_VALUE_UBYTE 0 NO_COMPU_METHOD 0 255 /end CHARACTERISTIC
/begin CHARACTERISTIC CAL_tps_brake_safety_floor "Calibration: throttle position brake safety floor (val/1023)." VALUE 0x400088D9 RL_VALUE_UBYTE 0 CM_u16_factor_1_1023 0 24.9266862170088 /end CHARACTERISTIC
/begin CHARACTERISTIC CAL_knock_agc_scaling_threshold "Calibration: knock AGC scaling threshold." VALUE 0x400088E0 RL_VALUE_UWORD 0 NO_COMPU_METHOD 0 65535 /end CHARACTERISTIC
/begin CHARACTERISTIC CAL_knock_mode "Calibration: knock mode (enumerated state)." VALUE 0x400088E2 RL_VALUE_UBYTE 0 NO_COMPU_METHOD 0 255 /end CHARACTERISTIC
/begin CHARACTERISTIC CAL_tpssmooth_accel_pedal_modes_enable "Calibration: tpssmooth accelerator pedal modes enable (boolean flag)." VALUE 0x400088E9 RL_VALUE_UBYTE 0 NO_COMPU_METHOD 0 255 /end CHARACTERISTIC
/begin CHARACTERISTIC CAL_tpstarget_pedalmap_low_gear_threshold "Calibration: tpstarget pedalmap low gear threshold." VALUE 0x400088EB RL_VALUE_UBYTE 0 NO_COMPU_METHOD 0 255 /end CHARACTERISTIC
/begin CHARACTERISTIC CAL_tpssmooth_parking_threshold_tps "Calibration: tpssmooth parking threshold throttle position (val/255)." VALUE 0x400088ED RL_VALUE_UBYTE 0 CM_u8_factor_1_255 0 100 /end CHARACTERISTIC
/begin CHARACTERISTIC CAL_tpssmooth_parking_threshold_carspeed "Calibration: tpssmooth parking threshold carspeed (km/h)." VALUE 0x400088EE RL_VALUE_UBYTE 0 CM_u8_speed_kph 0 255 /end CHARACTERISTIC
/begin CHARACTERISTIC CAL_tpssmooth_parking_threshold_gear "Calibration: tpssmooth parking threshold gear." VALUE 0x400088EF RL_VALUE_UBYTE 0 NO_COMPU_METHOD 0 255 /end CHARACTERISTIC
/begin CHARACTERISTIC CAL_tpssmooth_parking_clutch_threshold "Calibration: tpssmooth parking clutch threshold (V = val*5/255)." VALUE 0x4000892D RL_VALUE_UBYTE 0 CM_u8_voltage_5_255v 0 5 /end CHARACTERISTIC
/begin CHARACTERISTIC CAL_lfb_timer_entry "Calibration: lfb timer entry." VALUE 0x4000892E RL_VALUE_UBYTE 0 NO_COMPU_METHOD 0 255 /end CHARACTERISTIC
/begin CHARACTERISTIC CAL_lfb_timer_hold "Calibration: lfb timer hold." VALUE 0x4000892F RL_VALUE_UBYTE 0 NO_COMPU_METHOD 0 255 /end CHARACTERISTIC
/begin CHARACTERISTIC CAL_lfb_tps_max "Calibration: lfb throttle position maximum (val/255)." VALUE 0x40008931 RL_VALUE_UBYTE 0 CM_u8_factor_1_255 0 100 /end CHARACTERISTIC
/begin CHARACTERISTIC CAL_lfb_detect_carspeed_min "Calibration: lfb detect carspeed minimum (km/h)." VALUE 0x40008932 RL_VALUE_UBYTE 0 CM_u8_speed_kph 0 255 /end CHARACTERISTIC
/begin CHARACTERISTIC CAL_lfb_pedal_override_rate "undefined1" VALUE 0x40008933 RL_VALUE_UBYTE 0 NO_COMPU_METHOD 0 255 /end CHARACTERISTIC
/begin CHARACTERISTIC CAL_lfb_pulse_toggle_period "undefined1" VALUE 0x40008937 RL_VALUE_UBYTE 0 NO_COMPU_METHOD 0 255 /end CHARACTERISTIC
/begin CHARACTERISTIC CAL_lfb_pulse_enable "Calibration: lfb pulse enable (boolean flag)." VALUE 0x40008938 RL_VALUE_UBYTE 0 NO_COMPU_METHOD 0 255 /end CHARACTERISTIC
/begin CHARACTERISTIC CAL_lfb_clutch_threshold "Calibration: lfb clutch threshold (V = val*5/1023)." VALUE 0x4000893A RL_VALUE_UWORD 0 CM_u16_voltage_5_1023v 0 320.307917888563 /end CHARACTERISTIC
/begin CHARACTERISTIC CAL_sensor_fuel_pressure_scaling "Calibration: sensor fuel pressure scaling." VALUE 0x40008940 RL_VALUE_UWORD 0 NO_COMPU_METHOD 0 65535 /end CHARACTERISTIC
/begin CHARACTERISTIC CAL_sensor_fuel_pressure_offset "Calibration: sensor fuel pressure offset (mbar)." VALUE 0x40008942 RL_VALUE_UWORD 0 CM_u16_pressure_mbar 0 65535 /end CHARACTERISTIC
/begin CHARACTERISTIC CAL_injtip_dfco_recovery_enrichment_max_rpm "Calibration: injector tip-in decel fuel cut-off recovery enrichment maximum RPM (RPM)." VALUE 0x40008946 RL_VALUE_UWORD 0 CM_u16_rspeed_rpm 0 65535 /end CHARACTERISTIC
/begin CHARACTERISTIC CAL_lfb_brake_off_hold_ticks "undefined2" VALUE 0x4000894C RL_VALUE_UWORD 0 NO_COMPU_METHOD 0 65535 /end CHARACTERISTIC
/begin CHARACTERISTIC CAL_inj_soak_time_max "Calibration: injector soak time maximum (ms = val*100)." VALUE 0x40008962 RL_VALUE_UWORD 0 CM_u8_time_100ms 0 6553500 /end CHARACTERISTIC
/begin CHARACTERISTIC CAL_fuel_pump_integral_update_period "Calibration: fuel pump integral update period." VALUE 0x40008965 RL_VALUE_UBYTE 0 NO_COMPU_METHOD 0 255 /end CHARACTERISTIC
/begin CHARACTERISTIC CAL_fuel_pump_proportional_limit "Calibration: fuel pump proportional limit (val/100; 2-element array)." VAL_BLK 0x40008966 RL_VALUE_UBYTE 0 CM_u8_factor_1_100 0 255 NUMBER 2 /end CHARACTERISTIC
/begin CHARACTERISTIC CAL_fuel_pump_integral_gain "Calibration: fuel pump integral gain (val/100)." VALUE 0x40008968 RL_VALUE_UBYTE 0 CM_u8_factor_1_100 0 255 /end CHARACTERISTIC
/begin CHARACTERISTIC CAL_fuel_pump_integral_hold_on_dfco "Calibration: fuel pump integral hold on decel fuel cut-off (boolean flag)." VALUE 0x40008969 RL_VALUE_UBYTE 0 NO_COMPU_METHOD 0 255 /end CHARACTERISTIC
/begin CHARACTERISTIC CAL_fuel_pump_integral_pressure_deadband "Calibration: fuel pump integral pressure deadband." VALUE 0x4000896A RL_VALUE_UBYTE 0 NO_COMPU_METHOD 0 255 /end CHARACTERISTIC
/begin CHARACTERISTIC CAL_fuel_pump_integral_enable "Calibration: fuel pump integral enable (boolean flag)." VALUE 0x4000896E RL_VALUE_UBYTE 0 NO_COMPU_METHOD 0 255 /end CHARACTERISTIC
/begin CHARACTERISTIC CAL_fuel_pump_integral_fuel_level_min "Calibration: fuel pump integral fuel level minimum (gal = val/10)." VALUE 0x40008978 RL_VALUE_UWORD 0 CM_u8_volume_1_10gallon 0 6553.5 /end CHARACTERISTIC
/begin CHARACTERISTIC CAL_tpssmooth_rate_opening_clamp_thresholds "Calibration: tpssmooth rate opening clamp thresholds (val/1023; 2-element array)." VAL_BLK 0x4000897C RL_VALUE_UWORD 0 CM_u16_factor_1_1023 0 6406.15835777126 NUMBER 2 /end CHARACTERISTIC
/begin CHARACTERISTIC CAL_injtip_fuel_film_xtau_enable "Calibration: injector tip-in fuel film X-tau film enable (boolean flag)." VALUE 0x4000898B RL_VALUE_UBYTE 0 NO_COMPU_METHOD 0 255 /end CHARACTERISTIC
/begin CHARACTERISTIC CAL_fuel_pump_reference_voltage "Calibration: fuel pump reference voltage (V = val*18/1023)." VALUE 0x4000898C RL_VALUE_UWORD 0 CM_u16_voltage_18_1023v 0 1153.10850439883 /end CHARACTERISTIC
/begin CHARACTERISTIC CAL_tpssmooth_increment_b_neutral_tour "Calibration: tpssmooth increment b neutral tour (val/255)." VALUE 0x40008992 RL_VALUE_UBYTE 0 CM_u8_factor_1_255 0 100 /end CHARACTERISTIC
/begin CHARACTERISTIC CAL_tpssmooth_increment_b_neutral_sport "Calibration: tpssmooth increment b neutral sport (val/255)." VALUE 0x40008993 RL_VALUE_UBYTE 0 CM_u8_factor_1_255 0 100 /end CHARACTERISTIC
/begin CHARACTERISTIC CAL_ign_comp_idle_error_driveaway_speed_max "u8_speed_kph" VALUE 0x40008994 RL_VALUE_UBYTE 0 CM_u8_speed_kph 0 255 /end CHARACTERISTIC
/begin CHARACTERISTIC CAL_ign_comp_idle_error_driveaway_rpm_max "u8_rspeed_10rpm" VALUE 0x40008995 RL_VALUE_UBYTE 0 CM_u8_rspeed_10rpm 0 2550 /end CHARACTERISTIC
/begin AXIS_PTS CAL_ign_comp_idle_error_driveaway_X_rpm "Calibration: X-axis (rpm) for the ignition compensation idle error3 table (16-element array)." 0x40008996 NO_INPUT_QUANTITY RL_AXIS_UBYTE 0 CM_u8__127 16 -127 128 /end AXIS_PTS
/begin CHARACTERISTIC CAL_ign_comp_idle_error_driveaway "Calibration: ignition compensation idle error3 (° = val/4−32; 16-element array)." CURVE 0x400089A6 RL_VALUE_UBYTE 0 CM_u8_angle_1_4_32deg -32 31.75
 /begin AXIS_DESCR COM_AXIS NO_INPUT_QUANTITY CM_u8__127 16 -127 128 AXIS_PTS_REF CAL_ign_comp_idle_error_driveaway_X_rpm /end AXIS_DESCR
/end CHARACTERISTIC
/begin AXIS_PTS CAL_tpssmooth_rate_decay_opening_X_rpm "Calibration: X-axis (rpm) for the tpssmooth rate decay opening table (RPM = val*125/4+500; 8-element array)." 0x40008A6A NO_INPUT_QUANTITY RL_AXIS_UBYTE 0 CM_u8_rspeed_125_4_500rpm 8 500 8468.75 /end AXIS_PTS
/begin CHARACTERISTIC CAL_tpssmooth_rate_decay_opening "Calibration: tpssmooth rate decay opening (8-element array)." CURVE 0x40008A72 RL_VALUE_UBYTE 0 CM_u16_factor_1_1023 0 24.9266862170088
 /begin AXIS_DESCR COM_AXIS NO_INPUT_QUANTITY CM_u8_rspeed_125_4_500rpm 8 500 8468.75 AXIS_PTS_REF CAL_tpssmooth_rate_decay_opening_X_rpm /end AXIS_DESCR
/end CHARACTERISTIC
/begin AXIS_PTS CAL_tpssmooth_rate_decay_closing_X_rpm "Calibration: X-axis (rpm) for the tpssmooth rate decay closing table (RPM = val*125/4+500; 8-element array)." 0x40008A7A NO_INPUT_QUANTITY RL_AXIS_UBYTE 0 CM_u8_rspeed_125_4_500rpm 8 500 8468.75 /end AXIS_PTS
/begin CHARACTERISTIC CAL_tpssmooth_rate_decay_closing "Calibration: tpssmooth rate decay closing (8-element array)." CURVE 0x40008A82 RL_VALUE_UBYTE 0 CM_u16_factor_1_1023 0 24.9266862170088
 /begin AXIS_DESCR COM_AXIS NO_INPUT_QUANTITY CM_u8_rspeed_125_4_500rpm 8 500 8468.75 AXIS_PTS_REF CAL_tpssmooth_rate_decay_closing_X_rpm /end AXIS_DESCR
/end CHARACTERISTIC
/begin AXIS_PTS CAL_injtip_transient_throttle_response_time_X_coolant_tmp "Calibration: X-axis (coolant tmp) for the injector tip-in transient throttle response time table (°C = val*5/8−40; 8-element array)." 0x40008A8A coolant_temp RL_AXIS_UBYTE 0 CM_u8_temp_5_8_40c 8 -40 119.375 /end AXIS_PTS
/begin AXIS_PTS CAL_injtip_transient_throttle_response_time_Y_rpm "Calibration: Y-axis (rpm) for the injector tip-in transient throttle response time table (RPM = val*125/4+500; 8-element array)." 0x40008A92 NO_INPUT_QUANTITY RL_AXIS_UBYTE 0 CM_u8_rspeed_125_4_500rpm 8 500 8468.75 /end AXIS_PTS
/begin CHARACTERISTIC CAL_injtip_transient_throttle_response_time "Calibration: injector tip-in transient throttle response time (ms = val*5; 64-element array)." MAP 0x40008A9A RL_VALUE_UBYTE 0 CM_u8_time_5ms 0 1275
 /begin AXIS_DESCR COM_AXIS coolant_temp CM_u8_temp_5_8_40c 8 -40 119.375 AXIS_PTS_REF CAL_injtip_transient_throttle_response_time_X_coolant_tmp /end AXIS_DESCR
 /begin AXIS_DESCR COM_AXIS NO_INPUT_QUANTITY CM_u8_rspeed_125_4_500rpm 8 500 8468.75 AXIS_PTS_REF CAL_injtip_transient_throttle_response_time_Y_rpm /end AXIS_DESCR
/end CHARACTERISTIC
/begin AXIS_PTS CAL_injtip_comp_load1_X_load "Calibration: X-axis (load) for the injector tip-in compensation load1 table (mg/stroke = val*4; 16-element array)." 0x40008ADA load_mass_per_stroke RL_AXIS_UBYTE 0 CM_u8_load_4mg_stroke 16 0 1020 /end AXIS_PTS
/begin CHARACTERISTIC CAL_injtip_comp_load1 "Calibration: injector tip-in compensation load1 (16-element array)." CURVE 0x40008AEA RL_VALUE_UBYTE 0 NO_COMPU_METHOD 0 255
 /begin AXIS_DESCR COM_AXIS load_mass_per_stroke CM_u8_load_4mg_stroke 16 0 1020 AXIS_PTS_REF CAL_injtip_comp_load1_X_load /end AXIS_DESCR
/end CHARACTERISTIC
/begin AXIS_PTS CAL_inj_warmup_factor_ips_X_load "Calibration: X-axis (load) for the injector enrichment factor load n coolant IPS table (mg/stroke = val*4; 12-element array)." 0x40008AFA NO_INPUT_QUANTITY RL_AXIS_UBYTE 0 CM_u8_load_4mg_stroke 12 0 1020 /end AXIS_PTS
/begin AXIS_PTS CAL_inj_warmup_factor_ips_Y_coolant "Calibration: Y-axis (coolant) for the injector enrichment factor load n coolant IPS table (°C = val*5/8−40; 16-element array)." 0x40008B06 NO_INPUT_QUANTITY RL_AXIS_UBYTE 0 CM_u8_temp_5_8_40c 16 -40 119.375 /end AXIS_PTS
/begin CHARACTERISTIC CAL_inj_warmup_factor_ips "Calibration: injector enrichment factor load n coolant IPS (val/64; 192-element array)." MAP 0x40008B16 RL_VALUE_UBYTE 0 CM_u8_factor_1_64 0 398.4375
 /begin AXIS_DESCR COM_AXIS NO_INPUT_QUANTITY CM_u8_load_4mg_stroke 12 0 1020 AXIS_PTS_REF CAL_inj_warmup_factor_ips_X_load /end AXIS_DESCR
 /begin AXIS_DESCR COM_AXIS NO_INPUT_QUANTITY CM_u8_temp_5_8_40c 16 -40 119.375 AXIS_PTS_REF CAL_inj_warmup_factor_ips_Y_coolant /end AXIS_DESCR
/end CHARACTERISTIC
/begin AXIS_PTS CAL_inj_cranking_comp_air_temp_X_iat "Calibration: X-axis (air temp) for the injector compensation air temperature startup table (°C = val*5/8−40; 10-element array)." 0x40008BEE NO_INPUT_QUANTITY RL_AXIS_UBYTE 0 CM_u8_temp_5_8_40c 10 -40 119.375 /end AXIS_PTS
/begin AXIS_PTS CAL_inj_cranking_comp_air_temp_Y_maf_accum "Calibration: Y-axis (maf accum) for the injector compensation air temperature startup table (g; 10-element array)." 0x40008BF8 NO_INPUT_QUANTITY RL_AXIS_UBYTE 0 CM_u8_mass_g 10 0 255 /end AXIS_PTS
/begin CHARACTERISTIC CAL_inj_cranking_comp_air_temp "Calibration: injector compensation air temperature startup (100-element array)." MAP 0x40008C02 RL_VALUE_UBYTE 0 NO_COMPU_METHOD 0 255
 /begin AXIS_DESCR COM_AXIS NO_INPUT_QUANTITY CM_u8_temp_5_8_40c 10 -40 119.375 AXIS_PTS_REF CAL_inj_cranking_comp_air_temp_X_iat /end AXIS_DESCR
 /begin AXIS_DESCR COM_AXIS NO_INPUT_QUANTITY CM_u8_mass_g 10 0 255 AXIS_PTS_REF CAL_inj_cranking_comp_air_temp_Y_maf_accum /end AXIS_DESCR
/end CHARACTERISTIC
/begin CHARACTERISTIC CAL_sensor_engine_air_scaling "Calibration: sensor engine air scaling (°C = val*5/8−40; 33-element array)." VAL_BLK 0x40008C66 RL_VALUE_UBYTE 0 CM_u8_temp_5_8_40c -40 119.375 NUMBER 34 /end CHARACTERISTIC
/begin CHARACTERISTIC CAL_sensor_coolant_temp_sensor_engine_off_scaling "Calibration: sensor coolant temperature sensor engine off scaling (°C = val*5/8−40; 33-element array)." VAL_BLK 0x40008C88 RL_VALUE_UBYTE 0 CM_u8_temp_5_8_40c -40 119.375 NUMBER 34 /end CHARACTERISTIC
/begin CHARACTERISTIC CAL_sensor_intake_air_scaling "Calibration: sensor intake air scaling (32-element array)." VAL_BLK 0x40008CAA RL_VALUE_UBYTE 0 CM_u8_temp_5_8_40c -40 119.375 NUMBER 34 /end CHARACTERISTIC
/begin AXIS_PTS CAL_injtip_dfco_manual_default_X_coolant_temp "Calibration: X-axis (coolant temp) for the injector tip-in decel fuel cut-off manual default table (°C = val*5/8−40; 4-element array)." 0x40008CEC coolant_temp RL_AXIS_UBYTE 0 CM_u8_temp_5_8_40c 4 -40 119.375 /end AXIS_PTS
/begin CHARACTERISTIC CAL_injtip_dfco_manual_default "Calibration: injector tip-in decel fuel cut-off manual default (RPM = val*10; 4-element array)." CURVE 0x40008CF0 RL_VALUE_UBYTE 0 CM_u8_rspeed_10rpm 0 2550
 /begin AXIS_DESCR COM_AXIS coolant_temp CM_u8_temp_5_8_40c 4 -40 119.375 AXIS_PTS_REF CAL_injtip_dfco_manual_default_X_coolant_temp /end AXIS_DESCR
/end CHARACTERISTIC
/begin AXIS_PTS CAL_injtip_dfco_disasble_ingear_manual_X_coolant_temp "Calibration: X-axis (coolant temp) for the injector tip-in decel fuel cut-off disasble ingear manual table (°C = val*5/8−40; 4-element array)." 0x40008CF4 coolant_temp RL_AXIS_UBYTE 0 CM_u8_temp_5_8_40c 4 -40 119.375 /end AXIS_PTS
/begin CHARACTERISTIC CAL_injtip_dfco_disasble_ingear_manual "Calibration: injector tip-in decel fuel cut-off disasble ingear manual (RPM = val*10; 4-element array)." CURVE 0x40008CF8 RL_VALUE_UBYTE 0 CM_u8_rspeed_10rpm 0 2550
 /begin AXIS_DESCR COM_AXIS coolant_temp CM_u8_temp_5_8_40c 4 -40 119.375 AXIS_PTS_REF CAL_injtip_dfco_disasble_ingear_manual_X_coolant_temp /end AXIS_DESCR
/end CHARACTERISTIC
/begin AXIS_PTS CAL_injtip_dfco_disasble_neutral_X_coolant_temp "Calibration: X-axis (coolant temp) for the injector tip-in decel fuel cut-off disasble neutral table (°C = val*5/8−40; 4-element array)." 0x40008CFC coolant_temp RL_AXIS_UBYTE 0 CM_u8_temp_5_8_40c 4 -40 119.375 /end AXIS_PTS
/begin CHARACTERISTIC CAL_injtip_dfco_disasble_neutral "Calibration: injector tip-in decel fuel cut-off disasble neutral (RPM = val*10; 4-element array)." CURVE 0x40008D00 RL_VALUE_UBYTE 0 CM_u8_rspeed_10rpm 0 2550
 /begin AXIS_DESCR COM_AXIS coolant_temp CM_u8_temp_5_8_40c 4 -40 119.375 AXIS_PTS_REF CAL_injtip_dfco_disasble_neutral_X_coolant_temp /end AXIS_DESCR
/end CHARACTERISTIC
/begin AXIS_PTS CAL_ign_comp_coldstart_X_coolant_temp "Calibration: X-axis (coolant temp) for the ignition compensation coldstart table (°C = val*5/8−40; 8-element array)." 0x40008D09 NO_INPUT_QUANTITY RL_AXIS_UBYTE 0 CM_u8_temp_5_8_40c 8 -40 119.375 /end AXIS_PTS
/begin CHARACTERISTIC CAL_ign_comp_coldstart "Calibration: ignition compensation coldstart (° = val/4−10; 8-element array)." CURVE 0x40008D16 RL_VALUE_UBYTE 0 CM_u8_angle_1_4_10deg -10 53.75
 /begin AXIS_DESCR COM_AXIS NO_INPUT_QUANTITY CM_u8_temp_5_8_40c 8 -40 119.375 AXIS_PTS_REF CAL_ign_comp_coldstart_X_coolant_temp /end AXIS_DESCR
/end CHARACTERISTIC
/begin AXIS_PTS CAL_injtip_dfco_enable_rpm_manual_alt_X_coolant_temp "Calibration: X-axis (coolant temp) for the injector tip-in decel fuel cut-off enable RPM manual alt table (°C = val*5/8−40; 4-element array)." 0x40008D3E coolant_temp RL_AXIS_UBYTE 0 CM_u8_temp_5_8_40c 4 -40 119.375 /end AXIS_PTS
/begin CHARACTERISTIC CAL_injtip_dfco_enable_rpm_manual_alt "Calibration: injector tip-in decel fuel cut-off enable RPM manual alt (RPM = val*10; 4-element array)." CURVE 0x40008D42 RL_VALUE_UBYTE 0 CM_u8_rspeed_10rpm 0 2550
 /begin AXIS_DESCR COM_AXIS coolant_temp CM_u8_temp_5_8_40c 4 -40 119.375 AXIS_PTS_REF CAL_injtip_dfco_enable_rpm_manual_alt_X_coolant_temp /end AXIS_DESCR
/end CHARACTERISTIC
/begin CHARACTERISTIC CAL_injtip_dfco_recovery_enrich_by_duration "undefined" VALUE 0x40008D7E RL_VALUE_ULONG 0 NO_COMPU_METHOD 0 4294967295 /end CHARACTERISTIC
/begin AXIS_PTS CAL_ign_comp_idle_error_moving_X_rpm "Calibration: X-axis (idle speed error) for the ignition compensation idle error2 table (16-element array)." 0x40008D90 NO_INPUT_QUANTITY RL_AXIS_UBYTE 0 CM_u8__127 16 -127 128 /end AXIS_PTS
/begin CHARACTERISTIC CAL_ign_comp_idle_error_moving "Calibration: ignition compensation idle error2 (° = val/4−32; 16-element array)." CURVE 0x40008DA0 RL_VALUE_UBYTE 0 CM_u8_angle_1_4_32deg -32 31.75
 /begin AXIS_DESCR COM_AXIS NO_INPUT_QUANTITY CM_u8__127 16 -127 128 AXIS_PTS_REF CAL_ign_comp_idle_error_moving_X_rpm /end AXIS_DESCR
/end CHARACTERISTIC
/begin AXIS_PTS CAL_ign_target_step_advance_accel_pedal_manual_X_rpm "Calibration: X-axis (engine speed) for the ignition compensation throttle position manual table (RPM = val*125/4+500; 8-element array)." 0x40008DB0 NO_INPUT_QUANTITY RL_AXIS_UBYTE 0 CM_u8_rspeed_125_4_500rpm 8 500 8468.75 /end AXIS_PTS
/begin AXIS_PTS CAL_ign_target_step_advance_accel_pedal_manual_Y_pps "Calibration: Y-axis (accel pedal) for the ignition compensation throttle position manual table (val/255; 8-element array)." 0x40008DB8 NO_INPUT_QUANTITY RL_AXIS_UBYTE 0 CM_u8_factor_1_255 8 0 100 /end AXIS_PTS
/begin CHARACTERISTIC CAL_ign_target_step_advance_accel_pedal_manual "ign_target_step_advance — how fast timing comes back. This table sets the rate limit on ignition timing moving in the advance direction: when the ECU's timing target rises above what's currently being run, this is the biggest bite it's allowed to tak" MAP 0x40008DC0 RL_VALUE_UBYTE 0 CM_u8_angle_1_4deg 0 63.75
 /begin AXIS_DESCR COM_AXIS NO_INPUT_QUANTITY CM_u8_rspeed_125_4_500rpm 8 500 8468.75 AXIS_PTS_REF CAL_ign_target_step_advance_accel_pedal_manual_X_rpm /end AXIS_DESCR
 /begin AXIS_DESCR COM_AXIS NO_INPUT_QUANTITY CM_u8_factor_1_255 8 0 100 AXIS_PTS_REF CAL_ign_target_step_advance_accel_pedal_manual_Y_pps /end AXIS_DESCR
/end CHARACTERISTIC
/begin AXIS_PTS CAL_ign_target_step_advance_accel_pedal_ips_X_rpm "Calibration: X-axis (engine speed) for the ignition compensation throttle position IPS table (RPM = val*125/4+500; 7-element array)." 0x40008E00 NO_INPUT_QUANTITY RL_AXIS_UBYTE 0 CM_u8_rspeed_125_4_500rpm 7 500 8468.75 /end AXIS_PTS
/begin AXIS_PTS CAL_ign_target_step_advance_accel_pedal_ips_Y_pps "Calibration: Y-axis (pedal pos) for the ignition compensation throttle position IPS table (val/255; 8-element array)." 0x40008E07 NO_INPUT_QUANTITY RL_AXIS_UBYTE 0 CM_u8_factor_1_255 8 0 100 /end AXIS_PTS
/begin CHARACTERISTIC CAL_ign_target_step_advance_accel_pedal_ips "ign_target_step_advance — how fast timing comes back. This table sets the rate limit on ignition timing moving in the advance direction: when the ECU's timing target rises above what's currently being run, this is the biggest bite it's allowed to tak" MAP 0x40008E0F RL_VALUE_UBYTE 0 CM_u8_angle_1_4deg 0 63.75
 /begin AXIS_DESCR COM_AXIS NO_INPUT_QUANTITY CM_u8_rspeed_125_4_500rpm 7 500 8468.75 AXIS_PTS_REF CAL_ign_target_step_advance_accel_pedal_ips_X_rpm /end AXIS_DESCR
 /begin AXIS_DESCR COM_AXIS NO_INPUT_QUANTITY CM_u8_factor_1_255 8 0 100 AXIS_PTS_REF CAL_ign_target_step_advance_accel_pedal_ips_Y_pps /end AXIS_DESCR
/end CHARACTERISTIC
/begin CHARACTERISTIC CAL_closedloop_activate_engine_timer "Calibration: closedloop activate engine timer (s; 16-element array)." VAL_BLK 0x40008E62 RL_VALUE_UBYTE 0 CM_u8_time_s 0 255 NUMBER 16 /end CHARACTERISTIC
/begin AXIS_PTS CAL_inj_post_start_trim_decay_rich_X_mass_accum "u8_mass_32mg[8]" 0x40008FBA NO_INPUT_QUANTITY RL_AXIS_UBYTE 0 CM_u8_mass_32mg 8 0 8160 /end AXIS_PTS
/begin AXIS_PTS CAL_inj_post_start_trim_decay_rich_Y_coolant_temp "u8_temp_5/8-40c[8]" 0x40008FC2 NO_INPUT_QUANTITY RL_AXIS_UBYTE 0 CM_u8_temp_5_8_40c 8 -40 119.375 /end AXIS_PTS
/begin CHARACTERISTIC CAL_inj_post_start_trim_decay_rich "uint8_t[64]" MAP 0x40008FCA RL_VALUE_UBYTE 0 NO_COMPU_METHOD 0 255
 /begin AXIS_DESCR COM_AXIS NO_INPUT_QUANTITY CM_u8_mass_32mg 8 0 8160 AXIS_PTS_REF CAL_inj_post_start_trim_decay_rich_X_mass_accum /end AXIS_DESCR
 /begin AXIS_DESCR COM_AXIS NO_INPUT_QUANTITY CM_u8_temp_5_8_40c 8 -40 119.375 AXIS_PTS_REF CAL_inj_post_start_trim_decay_rich_Y_coolant_temp /end AXIS_DESCR
/end CHARACTERISTIC
/begin AXIS_PTS CAL_inj_post_start_trim_decay_lean_X_maf_accum "u8_mass_32mg[8]" 0x4000900A NO_INPUT_QUANTITY RL_AXIS_UBYTE 0 CM_u8_mass_32mg 8 0 8160 /end AXIS_PTS
/begin AXIS_PTS CAL_inj_post_start_trim_decay_lean_Y_coolant_temp "u8_temp_5/8-40c[8]" 0x40009012 NO_INPUT_QUANTITY RL_AXIS_UBYTE 0 CM_u8_temp_5_8_40c 8 -40 119.375 /end AXIS_PTS
/begin CHARACTERISTIC CAL_inj_post_start_trim_decay_lean "uint8_t[64]" MAP 0x4000901A RL_VALUE_UBYTE 0 NO_COMPU_METHOD 0 255
 /begin AXIS_DESCR COM_AXIS NO_INPUT_QUANTITY CM_u8_mass_32mg 8 0 8160 AXIS_PTS_REF CAL_inj_post_start_trim_decay_lean_X_maf_accum /end AXIS_DESCR
 /begin AXIS_DESCR COM_AXIS NO_INPUT_QUANTITY CM_u8_temp_5_8_40c 8 -40 119.375 AXIS_PTS_REF CAL_inj_post_start_trim_decay_lean_Y_coolant_temp /end AXIS_DESCR
/end CHARACTERISTIC
/begin AXIS_PTS CAL_load_alphaN_seed_X_tps "Calibration: X-axis (tps) for the load alphaN seed table (val/255; 16-element array)." 0x40009162 NO_INPUT_QUANTITY RL_AXIS_UBYTE 0 CM_u8_factor_1_255 16 0 100 /end AXIS_PTS
/begin CHARACTERISTIC CAL_load_alphaN_seed "Calibration: load alphaN seed (mg/stroke = val*4; 16-element array)." CURVE 0x40009172 RL_VALUE_UBYTE 0 CM_u8_load_4mg_stroke 0 1020
 /begin AXIS_DESCR COM_AXIS NO_INPUT_QUANTITY CM_u8_factor_1_255 16 0 100 AXIS_PTS_REF CAL_load_alphaN_seed_X_tps /end AXIS_DESCR
/end CHARACTERISTIC
/begin AXIS_PTS CAL_injtip_dfco_ips_default_X_coolant_temp "Calibration: X-axis (coolant temp) for the injector tip-in decel fuel cut-off IPS default table (°C = val*5/8−40; 4-element array)." 0x40009192 coolant_temp RL_AXIS_UBYTE 0 CM_u8_temp_5_8_40c 4 -40 119.375 /end AXIS_PTS
/begin CHARACTERISTIC CAL_injtip_dfco_ips_default "Calibration: injector tip-in decel fuel cut-off IPS default (RPM = val*10; 4-element array)." CURVE 0x40009196 RL_VALUE_UBYTE 0 CM_u8_rspeed_10rpm 0 2550
 /begin AXIS_DESCR COM_AXIS coolant_temp CM_u8_temp_5_8_40c 4 -40 119.375 AXIS_PTS_REF CAL_injtip_dfco_ips_default_X_coolant_temp /end AXIS_DESCR
/end CHARACTERISTIC
/begin AXIS_PTS CAL_injtip_dfco_disasble_ingear_ips_X_coolant_temp "Calibration: X-axis (coolant temp) for the injector tip-in decel fuel cut-off disasble ingear IPS table (°C = val*5/8−40; 4-element array)." 0x4000919A coolant_temp RL_AXIS_UBYTE 0 CM_u8_temp_5_8_40c 4 -40 119.375 /end AXIS_PTS
/begin CHARACTERISTIC CAL_injtip_dfco_disasble_ingear_ips "Calibration: injector tip-in decel fuel cut-off disasble ingear IPS (RPM = val*10; 4-element array)." CURVE 0x4000919E RL_VALUE_UBYTE 0 CM_u8_rspeed_10rpm 0 2550
 /begin AXIS_DESCR COM_AXIS coolant_temp CM_u8_temp_5_8_40c 4 -40 119.375 AXIS_PTS_REF CAL_injtip_dfco_disasble_ingear_ips_X_coolant_temp /end AXIS_DESCR
/end CHARACTERISTIC
/begin AXIS_PTS CAL_injtip_comp_negative_load_X_load "Calibration: X-axis (load) for the injector tip-in compensation negative load table (mg/stroke = val*4; 16-element array)." 0x400091A2 load_mass_per_stroke RL_AXIS_UBYTE 0 CM_u8_load_4mg_stroke 16 0 1020 /end AXIS_PTS
/begin CHARACTERISTIC CAL_injtip_comp_negative_load "Calibration: injector tip-in compensation negative load (16-element array)." CURVE 0x400091B2 RL_VALUE_UBYTE 0 NO_COMPU_METHOD 0 255
 /begin AXIS_DESCR COM_AXIS load_mass_per_stroke CM_u8_load_4mg_stroke 16 0 1020 AXIS_PTS_REF CAL_injtip_comp_negative_load_X_load /end AXIS_DESCR
/end CHARACTERISTIC
/begin AXIS_PTS CAL_tpssmooth_increment_rpm_X_rpm "Calibration: X-axis (rpm) for the tpssmooth increment RPM table (RPM = val*125/4+500; 8-element array)." 0x4000927A NO_INPUT_QUANTITY RL_AXIS_UBYTE 0 CM_u8_rspeed_125_4_500rpm 8 500 8468.75 /end AXIS_PTS
/begin CHARACTERISTIC CAL_tpssmooth_increment_rpm "Calibration: tpssmooth increment RPM (val/255; 8-element array)." CURVE 0x40009282 RL_VALUE_UBYTE 0 CM_u8_factor_1_255 0 100
 /begin AXIS_DESCR COM_AXIS NO_INPUT_QUANTITY CM_u8_rspeed_125_4_500rpm 8 500 8468.75 AXIS_PTS_REF CAL_tpssmooth_increment_rpm_X_rpm /end AXIS_DESCR
/end CHARACTERISTIC
/begin AXIS_PTS CAL_tpssmooth_increment_sport_X_tps_diff "Calibration: X-axis (tps diff) for the tpssmooth increment sport table (val/255; 8-element array)." 0x4000928A NO_INPUT_QUANTITY RL_AXIS_UBYTE 0 CM_u8_factor_1_255 8 0 100 /end AXIS_PTS
/begin CHARACTERISTIC CAL_tpssmooth_increment_sport "Calibration: tpssmooth increment sport (val/255; 8-element array)." CURVE 0x40009292 RL_VALUE_UBYTE 0 CM_u8_factor_1_255 0 100
 /begin AXIS_DESCR COM_AXIS NO_INPUT_QUANTITY CM_u8_factor_1_255 8 0 100 AXIS_PTS_REF CAL_tpssmooth_increment_sport_X_tps_diff /end AXIS_DESCR
/end CHARACTERISTIC
/begin AXIS_PTS CAL_ign_comp_coolant_manual1_X_coolant_temp "Calibration: X-axis (coolant temp) for the ignition compensation coolant manual1 table (°C = val*5/8−40; 16-element array)." 0x400092DA coolant_temp RL_AXIS_UBYTE 0 CM_u8_temp_5_8_40c 16 -40 119.375 /end AXIS_PTS
/begin CHARACTERISTIC CAL_ign_comp_coolant_manual1 "Calibration: ignition compensation coolant manual1 (° = val/4; 16-element array)." CURVE 0x400092EA RL_VALUE_UBYTE 0 CM_u8_angle_1_4deg 0 63.75
 /begin AXIS_DESCR COM_AXIS coolant_temp CM_u8_temp_5_8_40c 16 -40 119.375 AXIS_PTS_REF CAL_ign_comp_coolant_manual1_X_coolant_temp /end AXIS_DESCR
/end CHARACTERISTIC
/begin AXIS_PTS CAL_ign_comp_idle_error_X_rpm "Calibration: X-axis (rpm) for the ignition compensation idle error1 table (RPM = val−128; 16-element array)." 0x400092FA NO_INPUT_QUANTITY RL_AXIS_UBYTE 0 CM_u8_rspeed__128 16 -128 127 /end AXIS_PTS
/begin CHARACTERISTIC CAL_ign_comp_idle_error "Calibration: ignition compensation idle error1 (° = val/4−32; 16-element array)." CURVE 0x4000930A RL_VALUE_UBYTE 0 CM_u8_angle_1_4_32deg -32 31.75
 /begin AXIS_DESCR COM_AXIS NO_INPUT_QUANTITY CM_u8_rspeed__128 16 -128 127 AXIS_PTS_REF CAL_ign_comp_idle_error_X_rpm /end AXIS_DESCR
/end CHARACTERISTIC
/begin AXIS_PTS CAL_ign_comp_engine_air_X_air_temp "Calibration: X-axis (air temp) for the ignition compensation engine air table (°C = val*5/8−40; 16-element array)." 0x4000931A temp_engine_air RL_AXIS_UBYTE 0 CM_u8_temp_5_8_40c 16 -40 119.375 /end AXIS_PTS
/begin CHARACTERISTIC CAL_ign_comp_engine_air "Calibration: ignition compensation engine air (° = val/4−32; 16-element array)." CURVE 0x4000932A RL_VALUE_UBYTE 0 CM_u8_angle_1_4_32deg -32 31.75
 /begin AXIS_DESCR COM_AXIS temp_engine_air CM_u8_temp_5_8_40c 16 -40 119.375 AXIS_PTS_REF CAL_ign_comp_engine_air_X_air_temp /end AXIS_DESCR
/end CHARACTERISTIC
/begin AXIS_PTS CAL_injtip_in_rpm_scale_X_rpm "Calibration: X-axis (rpm) for the injector tip-in in RPM scale table (RPM = val*125/4+500; 16-element array)." 0x4000933A NO_INPUT_QUANTITY RL_AXIS_UBYTE 0 CM_u8_rspeed_125_4_500rpm 16 500 8468.75 /end AXIS_PTS
/begin CHARACTERISTIC CAL_injtip_in_rpm_scale "Calibration: injector tip-in in RPM scale (16-element array)." CURVE 0x4000934A RL_VALUE_UBYTE 0 NO_COMPU_METHOD 0 255
 /begin AXIS_DESCR COM_AXIS NO_INPUT_QUANTITY CM_u8_rspeed_125_4_500rpm 16 500 8468.75 AXIS_PTS_REF CAL_injtip_in_rpm_scale_X_rpm /end AXIS_DESCR
/end CHARACTERISTIC
/begin AXIS_PTS CAL_injtip_in_rpm_decay_X_rpm "Calibration: X-axis (rpm) for the injector tip-in in RPM decay table (RPM = val*125/4+500; 16-element array)." 0x4000935A NO_INPUT_QUANTITY RL_AXIS_UBYTE 0 CM_u8_rspeed_125_4_500rpm 16 500 8468.75 /end AXIS_PTS
/begin CHARACTERISTIC CAL_injtip_in_rpm_decay "Calibration: injector tip-in in RPM decay (16-element array)." CURVE 0x4000936A RL_VALUE_UBYTE 0 NO_COMPU_METHOD 0 255
 /begin AXIS_DESCR COM_AXIS NO_INPUT_QUANTITY CM_u8_rspeed_125_4_500rpm 16 500 8468.75 AXIS_PTS_REF CAL_injtip_in_rpm_decay_X_rpm /end AXIS_DESCR
/end CHARACTERISTIC
/begin AXIS_PTS CAL_injtip_in_coolant_scale_X_coolant_temp "Calibration: X-axis (coolant temp) for the injector tip-in in coolant scale table (°C = val*5/8−40; 16-element array)." 0x4000937A coolant_temp RL_AXIS_UBYTE 0 CM_u8_temp_5_8_40c 16 -40 119.375 /end AXIS_PTS
/begin CHARACTERISTIC CAL_injtip_in_coolant_scale "Calibration: injector tip-in in coolant scale (val/64; 16-element array)." CURVE 0x4000938A RL_VALUE_UBYTE 0 CM_u8_factor_1_64 0 398.4375
 /begin AXIS_DESCR COM_AXIS coolant_temp CM_u8_temp_5_8_40c 16 -40 119.375 AXIS_PTS_REF CAL_injtip_in_coolant_scale_X_coolant_temp /end AXIS_DESCR
/end CHARACTERISTIC
/begin AXIS_PTS CAL_injtip_out_rpm_scale_X_rpm "Calibration: X-axis (rpm) for the injector tip-in out RPM scale table (RPM = val*125/4+500; 16-element array)." 0x4000939A NO_INPUT_QUANTITY RL_AXIS_UBYTE 0 CM_u8_rspeed_125_4_500rpm 16 500 8468.75 /end AXIS_PTS
/begin CHARACTERISTIC CAL_injtip_out_rpm_scale "Calibration: injector tip-in out RPM scale (16-element array)." CURVE 0x400093AA RL_VALUE_UBYTE 0 NO_COMPU_METHOD 0 255
 /begin AXIS_DESCR COM_AXIS NO_INPUT_QUANTITY CM_u8_rspeed_125_4_500rpm 16 500 8468.75 AXIS_PTS_REF CAL_injtip_out_rpm_scale_X_rpm /end AXIS_DESCR
/end CHARACTERISTIC
/begin AXIS_PTS CAL_injtip_out_rpm_decay_X_rpm "Calibration: X-axis (rpm) for the injector tip-in out RPM decay table (RPM = val*125/4+500; 16-element array)." 0x400093BA NO_INPUT_QUANTITY RL_AXIS_UBYTE 0 CM_u8_rspeed_125_4_500rpm 16 500 8468.75 /end AXIS_PTS
/begin CHARACTERISTIC CAL_injtip_out_rpm_decay "Calibration: injector tip-in out RPM decay (val/1023; 16-element array)." CURVE 0x400093CA RL_VALUE_UBYTE 0 CM_u16_factor_1_1023 0 24.9266862170088
 /begin AXIS_DESCR COM_AXIS NO_INPUT_QUANTITY CM_u8_rspeed_125_4_500rpm 16 500 8468.75 AXIS_PTS_REF CAL_injtip_out_rpm_decay_X_rpm /end AXIS_DESCR
/end CHARACTERISTIC
/begin AXIS_PTS CAL_injtip_out_coolant_scale_X_rpm "Calibration: X-axis (rpm) for the injector tip-in out coolant scale table (°C = val*5/8−40; 16-element array)." 0x400093DA coolant_temp RL_AXIS_UBYTE 0 CM_u8_temp_5_8_40c 16 -40 119.375 /end AXIS_PTS
/begin CHARACTERISTIC CAL_injtip_out_coolant_scale "Calibration: injector tip-in out coolant scale (val/64; 16-element array)." CURVE 0x400093EA RL_VALUE_UBYTE 0 CM_u8_factor_1_64 0 398.4375
 /begin AXIS_DESCR COM_AXIS coolant_temp CM_u8_temp_5_8_40c 16 -40 119.375 AXIS_PTS_REF CAL_injtip_out_coolant_scale_X_rpm /end AXIS_DESCR
/end CHARACTERISTIC
/begin AXIS_PTS CAL_ign_limit_first_gear_manual_X_engine_speed "Calibration: X-axis (engine speed) for the ignition limit first gear manual table (RPM = val*125/4+500; 8-element array)." 0x4000940A NO_INPUT_QUANTITY RL_AXIS_UBYTE 0 CM_u8_rspeed_125_4_500rpm 8 500 8468.75 /end AXIS_PTS
/begin CHARACTERISTIC CAL_ign_limit_first_gear_manual "Calibration: ignition limit first gear manual (° = val/4−10; 8-element array)." CURVE 0x40009412 RL_VALUE_UBYTE 0 CM_u8_angle_1_4_10deg -10 53.75
 /begin AXIS_DESCR COM_AXIS NO_INPUT_QUANTITY CM_u8_rspeed_125_4_500rpm 8 500 8468.75 AXIS_PTS_REF CAL_ign_limit_first_gear_manual_X_engine_speed /end AXIS_DESCR
/end CHARACTERISTIC
/begin AXIS_PTS CAL_tpssmooth_decrement_by_rpm_X_rpm "Calibration: X-axis (rpm) for the tpssmooth decrement by RPM table (RPM = val*125/4+500; 8-element array)." 0x4000945A NO_INPUT_QUANTITY RL_AXIS_UBYTE 0 CM_u8_rspeed_125_4_500rpm 8 500 8468.75 /end AXIS_PTS
/begin CHARACTERISTIC CAL_tpssmooth_decrement_by_rpm "Calibration: tpssmooth decrement by RPM (val/255; 8-element array)." CURVE 0x40009462 RL_VALUE_UBYTE 0 CM_u8_factor_1_255 0 100
 /begin AXIS_DESCR COM_AXIS NO_INPUT_QUANTITY CM_u8_rspeed_125_4_500rpm 8 500 8468.75 AXIS_PTS_REF CAL_tpssmooth_decrement_by_rpm_X_rpm /end AXIS_DESCR
/end CHARACTERISTIC
/begin AXIS_PTS CAL_tps_scaling_factor_rpm_X_rpm "Calibration: X-axis (rpm) for the throttle position scaling factor RPM table (RPM = val*125/4+500; 16-element array)." 0x40009482 NO_INPUT_QUANTITY RL_AXIS_UBYTE 0 CM_u8_rspeed_125_4_500rpm 16 500 8468.75 /end AXIS_PTS
/begin CHARACTERISTIC CAL_tps_scaling_factor_rpm "Calibration: throttle position scaling factor RPM (val/255; 16-element array)." CURVE 0x40009492 RL_VALUE_UBYTE 0 CM_u8_factor_1_255 0 100
 /begin AXIS_DESCR COM_AXIS NO_INPUT_QUANTITY CM_u8_rspeed_125_4_500rpm 16 500 8468.75 AXIS_PTS_REF CAL_tps_scaling_factor_rpm_X_rpm /end AXIS_DESCR
/end CHARACTERISTIC
/begin AXIS_PTS CAL_injtip_dfco_enable_rpm_ips_alt_X_coolant_temp "Calibration: X-axis (coolant temp) for the injector tip-in decel fuel cut-off enable RPM IPS alt table (°C = val*5/8−40; 4-element array)." 0x400094B2 coolant_temp RL_AXIS_UBYTE 0 CM_u8_temp_5_8_40c 4 -40 119.375 /end AXIS_PTS
/begin CHARACTERISTIC CAL_injtip_dfco_enable_rpm_ips_alt "Calibration: injector tip-in decel fuel cut-off enable RPM IPS alt (RPM = val*10; 4-element array)." CURVE 0x400094B6 RL_VALUE_UBYTE 0 CM_u8_rspeed_10rpm 0 2550
 /begin AXIS_DESCR COM_AXIS coolant_temp CM_u8_temp_5_8_40c 4 -40 119.375 AXIS_PTS_REF CAL_injtip_dfco_enable_rpm_ips_alt_X_coolant_temp /end AXIS_DESCR
/end CHARACTERISTIC
/begin AXIS_PTS CAL_closedloop_proportional_gain_rich_table_X_rpm "Calibration: X-axis (rpm) for the closedloop proportional gain rich table table (RPM = val*125/4+500; 8-element array)." 0x400094BA NO_INPUT_QUANTITY RL_AXIS_UBYTE 0 CM_u8_rspeed_125_4_500rpm 8 500 8468.75 /end AXIS_PTS
/begin AXIS_PTS CAL_closedloop_proportional_gain_rich_table_Y_load "Calibration: Y-axis (load) for the closedloop proportional gain rich table table (mg/stroke = val*4; 8-element array)." 0x400094C2 load_mass_per_stroke RL_AXIS_UBYTE 0 CM_u8_load_4mg_stroke 8 0 1020 /end AXIS_PTS
/begin CHARACTERISTIC CAL_closedloop_proportional_gain_rich_table "Calibration: closedloop proportional gain rich table (val/255; 64-element array)." MAP 0x400094CA RL_VALUE_UBYTE 0 CM_u8_factor_1_255 0 100
 /begin AXIS_DESCR COM_AXIS NO_INPUT_QUANTITY CM_u8_rspeed_125_4_500rpm 8 500 8468.75 AXIS_PTS_REF CAL_closedloop_proportional_gain_rich_table_X_rpm /end AXIS_DESCR
 /begin AXIS_DESCR COM_AXIS load_mass_per_stroke CM_u8_load_4mg_stroke 8 0 1020 AXIS_PTS_REF CAL_closedloop_proportional_gain_rich_table_Y_load /end AXIS_DESCR
/end CHARACTERISTIC
/begin AXIS_PTS CAL_closedloop_proportional_gain_lean_table_X_rpm "Calibration: X-axis (rpm) for the closedloop proportional gain lean table table (RPM = val*125/4+500; 8-element array)." 0x4000950A NO_INPUT_QUANTITY RL_AXIS_UBYTE 0 CM_u8_rspeed_125_4_500rpm 8 500 8468.75 /end AXIS_PTS
/begin AXIS_PTS CAL_closedloop_proportional_gain_lean_table_Y_load "Calibration: Y-axis (load) for the closedloop proportional gain lean table table (mg/stroke = val*4; 8-element array)." 0x40009512 load_mass_per_stroke RL_AXIS_UBYTE 0 CM_u8_load_4mg_stroke 8 0 1020 /end AXIS_PTS
/begin CHARACTERISTIC CAL_closedloop_proportional_gain_lean_table "Calibration: closedloop proportional gain lean table (val/255; 64-element array)." MAP 0x4000951A RL_VALUE_UBYTE 0 CM_u8_factor_1_255 0 100
 /begin AXIS_DESCR COM_AXIS NO_INPUT_QUANTITY CM_u8_rspeed_125_4_500rpm 8 500 8468.75 AXIS_PTS_REF CAL_closedloop_proportional_gain_lean_table_X_rpm /end AXIS_DESCR
 /begin AXIS_DESCR COM_AXIS load_mass_per_stroke CM_u8_load_4mg_stroke 8 0 1020 AXIS_PTS_REF CAL_closedloop_proportional_gain_lean_table_Y_load /end AXIS_DESCR
/end CHARACTERISTIC
/begin AXIS_PTS CAL_closedloop_integral_gain_table_X_rpm "Calibration: X-axis (rpm) for the closedloop integral gain table table (RPM = val*125/4+500; 8-element array)." 0x4000955A NO_INPUT_QUANTITY RL_AXIS_UBYTE 0 CM_u8_rspeed_125_4_500rpm 8 500 8468.75 /end AXIS_PTS
/begin AXIS_PTS CAL_closedloop_integral_gain_table_Y_load "Calibration: Y-axis (load) for the closedloop integral gain table table (mg/stroke = val*4; 8-element array)." 0x40009562 load_mass_per_stroke RL_AXIS_UBYTE 0 CM_u8_load_4mg_stroke 8 0 1020 /end AXIS_PTS
/begin CHARACTERISTIC CAL_closedloop_integral_gain_table "Calibration: closedloop integral gain table (val/255; 64-element array)." MAP 0x4000956A RL_VALUE_UBYTE 0 CM_u8_factor_1_255 0 100
 /begin AXIS_DESCR COM_AXIS NO_INPUT_QUANTITY CM_u8_rspeed_125_4_500rpm 8 500 8468.75 AXIS_PTS_REF CAL_closedloop_integral_gain_table_X_rpm /end AXIS_DESCR
 /begin AXIS_DESCR COM_AXIS load_mass_per_stroke CM_u8_load_4mg_stroke 8 0 1020 AXIS_PTS_REF CAL_closedloop_integral_gain_table_Y_load /end AXIS_DESCR
/end CHARACTERISTIC
/begin AXIS_PTS CAL_closedloop_derivative_gain_table_X_rpm "Calibration: X-axis (rpm) for the closedloop derivative gain table table (RPM = val*125/4+500; 8-element array)." 0x400095AA NO_INPUT_QUANTITY RL_AXIS_UBYTE 0 CM_u8_rspeed_125_4_500rpm 8 500 8468.75 /end AXIS_PTS
/begin AXIS_PTS CAL_closedloop_derivative_gain_table_Y_load "Calibration: Y-axis (load) for the closedloop derivative gain table table (mg/stroke = val*4; 8-element array)." 0x400095B2 load_mass_per_stroke RL_AXIS_UBYTE 0 CM_u8_load_4mg_stroke 8 0 1020 /end AXIS_PTS
/begin CHARACTERISTIC CAL_closedloop_derivative_gain_table "Calibration: closedloop derivative gain table (val/255; 64-element array)." MAP 0x400095BA RL_VALUE_UBYTE 0 CM_u8_factor_1_255 0 100
 /begin AXIS_DESCR COM_AXIS NO_INPUT_QUANTITY CM_u8_rspeed_125_4_500rpm 8 500 8468.75 AXIS_PTS_REF CAL_closedloop_derivative_gain_table_X_rpm /end AXIS_DESCR
 /begin AXIS_DESCR COM_AXIS load_mass_per_stroke CM_u8_load_4mg_stroke 8 0 1020 AXIS_PTS_REF CAL_closedloop_derivative_gain_table_Y_load /end AXIS_DESCR
/end CHARACTERISTIC
/begin AXIS_PTS CAL_inj_efficiency_X_engine_speed "Calibration: X-axis (engine speed) for the injector efficiency table (RPM = val*125/4+500; 20-element array)." 0x400095FA NO_INPUT_QUANTITY RL_AXIS_UBYTE 0 CM_u8_rspeed_125_4_500rpm 20 500 8468.75 /end AXIS_PTS
/begin AXIS_PTS CAL_inj_efficiency_Y_engine_load "Calibration: Y-axis (engine load) for the injector efficiency table (mg/stroke = val*1173; 20-element array)." 0x4000960E NO_INPUT_QUANTITY RL_AXIS_UBYTE 0 CM_u8_load_1173mg_255stroke 20 0 1173 /end AXIS_PTS
/begin CHARACTERISTIC CAL_inj_efficiency "Calibration: injector efficiency (val/200; 400-element array)." MAP 0x40009622 RL_VALUE_UBYTE 0 CM_u8_factor_1_200 0 127.5
 /begin AXIS_DESCR COM_AXIS NO_INPUT_QUANTITY CM_u8_rspeed_125_4_500rpm 20 500 8468.75 AXIS_PTS_REF CAL_inj_efficiency_X_engine_speed /end AXIS_DESCR
 /begin AXIS_DESCR COM_AXIS NO_INPUT_QUANTITY CM_u8_load_1173mg_255stroke 20 0 1173 AXIS_PTS_REF CAL_inj_efficiency_Y_engine_load /end AXIS_DESCR
/end CHARACTERISTIC
/begin AXIS_PTS CAL_load_to_tps_mapping_X_rpm "Calibration: X-axis (rpm) for the load to throttle position mapping table (RPM = val*125/4+500; 20-element array)." 0x400097B2 NO_INPUT_QUANTITY RL_AXIS_UBYTE 0 CM_u8_rspeed_125_4_500rpm 20 500 8468.75 /end AXIS_PTS
/begin AXIS_PTS CAL_load_to_tps_mapping_Y_load "Calibration: Y-axis (load) for the load to throttle position mapping table (mg/stroke = val*1173; 20-element array)." 0x400097C6 NO_INPUT_QUANTITY RL_AXIS_UBYTE 0 CM_u8_load_1173mg_255stroke 20 0 1173 /end AXIS_PTS
/begin CHARACTERISTIC CAL_load_to_tps_mapping "Calibration: load to throttle position mapping (val/255; 400-element array)." MAP 0x400097DA RL_VALUE_UBYTE 0 CM_u8_factor_1_255 0 100
 /begin AXIS_DESCR COM_AXIS NO_INPUT_QUANTITY CM_u8_rspeed_125_4_500rpm 20 500 8468.75 AXIS_PTS_REF CAL_load_to_tps_mapping_X_rpm /end AXIS_DESCR
 /begin AXIS_DESCR COM_AXIS NO_INPUT_QUANTITY CM_u8_load_1173mg_255stroke 20 0 1173 AXIS_PTS_REF CAL_load_to_tps_mapping_Y_load /end AXIS_DESCR
/end CHARACTERISTIC
/begin AXIS_PTS CAL_inj_post_start_tipin_factor_X_rise_rate "uint8_t[8]" 0x40009A5A NO_INPUT_QUANTITY RL_AXIS_UBYTE 0 NO_COMPU_METHOD 8 0 255 /end AXIS_PTS
/begin CHARACTERISTIC CAL_inj_post_start_tipin_factor "u8_factor_1/255[8]" CURVE 0x40009A62 RL_VALUE_UBYTE 0 CM_u8_factor_1_255 0 100
 /begin AXIS_DESCR COM_AXIS NO_INPUT_QUANTITY NO_COMPU_METHOD 8 0 255 AXIS_PTS_REF CAL_inj_post_start_tipin_factor_X_rise_rate /end AXIS_DESCR
/end CHARACTERISTIC
/begin AXIS_PTS CAL_inj_post_start_tipout_factor_X_drop_rate "uint8_t[8]" 0x40009A6A NO_INPUT_QUANTITY RL_AXIS_UBYTE 0 NO_COMPU_METHOD 8 0 255 /end AXIS_PTS
/begin CHARACTERISTIC CAL_inj_post_start_tipout_factor "u8_factor_1/255[8]" CURVE 0x40009A72 RL_VALUE_UBYTE 0 CM_u8_factor_1_255 0 100
 /begin AXIS_DESCR COM_AXIS NO_INPUT_QUANTITY NO_COMPU_METHOD 8 0 255 AXIS_PTS_REF CAL_inj_post_start_tipout_factor_X_drop_rate /end AXIS_DESCR
/end CHARACTERISTIC
/begin AXIS_PTS CAL_load_reference_charge_X_rpm "Calibration: X-axis (rpm) for the load reference charge table (RPM = val*125/4+500; 16-element array)." 0x40009BAA NO_INPUT_QUANTITY RL_AXIS_UBYTE 0 CM_u8_rspeed_125_4_500rpm 16 500 8468.75 /end AXIS_PTS
/begin CHARACTERISTIC CAL_load_reference_charge "Calibration: load reference charge (mg/stroke = val*4; 16-element array)." CURVE 0x40009BBA RL_VALUE_UBYTE 0 CM_u8_load_4mg_stroke 0 1020
 /begin AXIS_DESCR COM_AXIS NO_INPUT_QUANTITY CM_u8_rspeed_125_4_500rpm 16 500 8468.75 AXIS_PTS_REF CAL_load_reference_charge_X_rpm /end AXIS_DESCR
/end CHARACTERISTIC
/begin AXIS_PTS CAL_tpssmooth_increment_tour_X_tps_diff "Calibration: X-axis (tps diff) for the tpssmooth increment tour table (val/255; 8-element array)." 0x40009BCA NO_INPUT_QUANTITY RL_AXIS_UBYTE 0 CM_u8_factor_1_255 8 0 100 /end AXIS_PTS
/begin CHARACTERISTIC CAL_tpssmooth_increment_tour "Calibration: tpssmooth increment tour (val/255; 8-element array)." CURVE 0x40009BD2 RL_VALUE_UBYTE 0 CM_u8_factor_1_255 0 100
 /begin AXIS_DESCR COM_AXIS NO_INPUT_QUANTITY CM_u8_factor_1_255 8 0 100 AXIS_PTS_REF CAL_tpssmooth_increment_tour_X_tps_diff /end AXIS_DESCR
/end CHARACTERISTIC
/begin AXIS_PTS CAL_load_unused1_X_rpm "Calibration: X-axis (rpm) for the load unused1 table (RPM = val*125/4+500; 16-element array)." 0x40009BDA NO_INPUT_QUANTITY RL_AXIS_UBYTE 0 CM_u8_rspeed_125_4_500rpm 16 500 8468.75 /end AXIS_PTS
/begin CHARACTERISTIC CAL_load_unused1 "Calibration: load unused1 (16-element array)." CURVE 0x40009BEA RL_VALUE_UBYTE 0 NO_COMPU_METHOD 0 255
 /begin AXIS_DESCR COM_AXIS NO_INPUT_QUANTITY CM_u8_rspeed_125_4_500rpm 16 500 8468.75 AXIS_PTS_REF CAL_load_unused1_X_rpm /end AXIS_DESCR
/end CHARACTERISTIC
/begin AXIS_PTS CAL_inj_warmup_factor_manual_X_load "Calibration: X-axis (load) for the injector enrichment factor load n coolant manual table (mg/stroke = val*4; 12-element array)." 0x40009BFA NO_INPUT_QUANTITY RL_AXIS_UBYTE 0 CM_u8_load_4mg_stroke 12 0 1020 /end AXIS_PTS
/begin AXIS_PTS CAL_inj_warmup_factor_manual_Y_cooland "Calibration: Y-axis (coolant) for the injector enrichment factor load n coolant manual table (°C = val*5/8−40; 16-element array)." 0x40009C06 NO_INPUT_QUANTITY RL_AXIS_UBYTE 0 CM_u8_temp_5_8_40c 16 -40 119.375 /end AXIS_PTS
/begin CHARACTERISTIC CAL_inj_warmup_factor_manual "Calibration: injector enrichment factor load n coolant manual (val/64; 192-element array)." MAP 0x40009C16 RL_VALUE_UBYTE 0 CM_u8_factor_1_64 0 398.4375
 /begin AXIS_DESCR COM_AXIS NO_INPUT_QUANTITY CM_u8_load_4mg_stroke 12 0 1020 AXIS_PTS_REF CAL_inj_warmup_factor_manual_X_load /end AXIS_DESCR
 /begin AXIS_DESCR COM_AXIS NO_INPUT_QUANTITY CM_u8_temp_5_8_40c 16 -40 119.375 AXIS_PTS_REF CAL_inj_warmup_factor_manual_Y_cooland /end AXIS_DESCR
/end CHARACTERISTIC
/begin AXIS_PTS CAL_inj_enrichment_charge_air_temp_X_load "Calibration: X-axis (load) for the injector compensation air temp2 table (mg/stroke = val*4; 8-element array)." 0x40009D1A NO_INPUT_QUANTITY RL_AXIS_UBYTE 0 CM_u8_load_4mg_stroke 8 0 1020 /end AXIS_PTS
/begin AXIS_PTS CAL_inj_enrichment_charge_air_temp_Y_charge_temp "Calibration: Y-axis (air temp) for the injector compensation air temp2 table (°C = val*5/8−40; 16-element array)." 0x40009D22 NO_INPUT_QUANTITY RL_AXIS_UBYTE 0 CM_u8_temp_5_8_40c 16 -40 119.375 /end AXIS_PTS
/begin CHARACTERISTIC CAL_inj_enrichment_charge_air_temp "Calibration: injector compensation air temp2 (128-element array)." MAP 0x40009D32 RL_VALUE_UBYTE 0 NO_COMPU_METHOD 0 255
 /begin AXIS_DESCR COM_AXIS NO_INPUT_QUANTITY CM_u8_load_4mg_stroke 8 0 1020 AXIS_PTS_REF CAL_inj_enrichment_charge_air_temp_X_load /end AXIS_DESCR
 /begin AXIS_DESCR COM_AXIS NO_INPUT_QUANTITY CM_u8_temp_5_8_40c 16 -40 119.375 AXIS_PTS_REF CAL_inj_enrichment_charge_air_temp_Y_charge_temp /end AXIS_DESCR
/end CHARACTERISTIC
/begin AXIS_PTS CAL_load_source_selection_threshold_by_tps_X_rpm "Calibration: X-axis (rpm) for the load source selection threshold by throttle position table (RPM = val*125/4+500; 16-element array)." 0x40009DB2 NO_INPUT_QUANTITY RL_AXIS_UBYTE 0 CM_u8_rspeed_125_4_500rpm 16 500 8468.75 /end AXIS_PTS
/begin CHARACTERISTIC CAL_load_source_selection_threshold_by_tps "Calibration: load source selection threshold by throttle position (val/255; 16-element array)." CURVE 0x40009DC2 RL_VALUE_UBYTE 0 CM_u8_factor_1_255 0 100
 /begin AXIS_DESCR COM_AXIS NO_INPUT_QUANTITY CM_u8_rspeed_125_4_500rpm 16 500 8468.75 AXIS_PTS_REF CAL_load_source_selection_threshold_by_tps_X_rpm /end AXIS_DESCR
/end CHARACTERISTIC
/begin AXIS_PTS CAL_knock_inhibit_tps_max_X_rpm "Calibration: X-axis (rpm) for the knock inhibit throttle position maximum table (RPM = val*125/4+500; 16-element array)." 0x40009E2A NO_INPUT_QUANTITY RL_AXIS_UBYTE 0 CM_u8_rspeed_125_4_500rpm 16 500 8468.75 /end AXIS_PTS
/begin CHARACTERISTIC CAL_knock_inhibit_tps_max "Calibration: knock inhibit throttle position maximum (val/255; 16-element array)." CURVE 0x40009E3A RL_VALUE_UBYTE 0 CM_u8_factor_1_255 0 100
 /begin AXIS_DESCR COM_AXIS NO_INPUT_QUANTITY CM_u8_rspeed_125_4_500rpm 16 500 8468.75 AXIS_PTS_REF CAL_knock_inhibit_tps_max_X_rpm /end AXIS_DESCR
/end CHARACTERISTIC
/begin AXIS_PTS CAL_fuel_pump_proportional_gain_X_error "Calibration: X-axis (error) for the fuel pump proportional gain table (mbar = val*50; 8-element array)." 0x40009EFA NO_INPUT_QUANTITY RL_AXIS_UBYTE 0 CM_u8_pressure_50mbar 8 0 12750 /end AXIS_PTS
/begin CHARACTERISTIC CAL_fuel_pump_proportional_gain "Calibration: fuel pump proportional gain (val/255; 8-element array)." CURVE 0x40009F02 RL_VALUE_UBYTE 0 CM_u8_factor_1_255 0 100
 /begin AXIS_DESCR COM_AXIS NO_INPUT_QUANTITY CM_u8_pressure_50mbar 8 0 12750 AXIS_PTS_REF CAL_fuel_pump_proportional_gain_X_error /end AXIS_DESCR
/end CHARACTERISTIC
/begin AXIS_PTS CAL_inj_startup_enrichment_offset_X_coolant_temp_engine_stopped "Calibration: X-axis (coolant temp engine stopped) for the injector startup enrichment offset table (°C = val*5/8−40; 16-element array)." 0x40009F0A coolant_temp_engine_stopped RL_AXIS_UBYTE 0 CM_u8_temp_5_8_40c 16 -40 119.375 /end AXIS_PTS
/begin CHARACTERISTIC CAL_inj_startup_enrichment_offset "Calibration: injector startup enrichment offset (µs = val*256; 16-element array)." CURVE 0x40009F1A RL_VALUE_UBYTE 0 CM_u8_time_256us 0 65280
 /begin AXIS_DESCR COM_AXIS coolant_temp_engine_stopped CM_u8_temp_5_8_40c 16 -40 119.375 AXIS_PTS_REF CAL_inj_startup_enrichment_offset_X_coolant_temp_engine_stopped /end AXIS_DESCR
/end CHARACTERISTIC
/begin CHARACTERISTIC CAL_inj_deadtime_comp_iat "Calibration: injector compensation intake air temp (val/100; 8-element array)." VAL_BLK 0x40009F42 RL_VALUE_UBYTE 0 CM_u8_factor_1_100 0 255 NUMBER 8 /end CHARACTERISTIC
/begin AXIS_PTS CAL_injtip_dfco_pedal_ramp_target_X_pps "Calibration: X-axis (pps) for the injector tip-in decel fuel cut-off pedal ramp target table (val/255; 4-element array)." 0x40009F9A V_CAL_injtip_dfco_pedal_ramp_target_X_pps RL_AXIS_UBYTE 0 CM_u8_factor_1_255 4 0 100 /end AXIS_PTS
/begin CHARACTERISTIC CAL_injtip_dfco_pedal_ramp_target "Calibration: injector tip-in decel fuel cut-off pedal ramp target (4-element array)." CURVE 0x40009F9E RL_VALUE_UBYTE 0 NO_COMPU_METHOD 0 255
 /begin AXIS_DESCR COM_AXIS V_CAL_injtip_dfco_pedal_ramp_target_X_pps CM_u8_factor_1_255 4 0 100 AXIS_PTS_REF CAL_injtip_dfco_pedal_ramp_target_X_pps /end AXIS_DESCR
/end CHARACTERISTIC
/begin AXIS_PTS CAL_ign_comp_startup_tps_X_maf_accum "Calibration: X-axis (maf accum) for the ignition compensation MAF accum table (g; 8-element array)." 0x40009FA2 NO_INPUT_QUANTITY RL_AXIS_UBYTE 0 CM_u8_mass_g 8 0 255 /end AXIS_PTS
/begin AXIS_PTS CAL_ign_comp_startup_tps_Y_tps "Calibration: Y-axis (tps) for the ignition compensation MAF accum table (val/255; 8-element array)." 0x40009FAA NO_INPUT_QUANTITY RL_AXIS_UBYTE 0 CM_u8_factor_1_255 8 0 100 /end AXIS_PTS
/begin CHARACTERISTIC CAL_ign_comp_startup_tps "Calibration: ignition compensation MAF accum (° = val/4; 64-element array)." MAP 0x40009FB2 RL_VALUE_SBYTE 0 CM_u8_angle_1_4deg -32 31.75
 /begin AXIS_DESCR COM_AXIS NO_INPUT_QUANTITY CM_u8_mass_g 8 0 255 AXIS_PTS_REF CAL_ign_comp_startup_tps_X_maf_accum /end AXIS_DESCR
 /begin AXIS_DESCR COM_AXIS NO_INPUT_QUANTITY CM_u8_factor_1_255 8 0 100 AXIS_PTS_REF CAL_ign_comp_startup_tps_Y_tps /end AXIS_DESCR
/end CHARACTERISTIC
/begin AXIS_PTS CAL_ign_dwell_time_X_rpm "Calibration: X-axis (rpm) for the ignition dwell time table (RPM = val*125/4+500; 8-element array)." 0x40009FF2 NO_INPUT_QUANTITY RL_AXIS_UBYTE 0 CM_u8_rspeed_125_4_500rpm 8 500 8468.75 /end AXIS_PTS
/begin AXIS_PTS CAL_ign_dwell_time_Y_ecu_voltage "Calibration: Y-axis (ecu voltage) for the ignition dwell time table (V = val*72/1023; 8-element array)." 0x40009FFA V_CAL_ign_dwell_time_Y_ecu_voltage RL_AXIS_UBYTE 0 CM_u8_voltage_72_1023v 8 0 17.9472140762463 /end AXIS_PTS
/begin CHARACTERISTIC CAL_ign_dwell_time "Calibration: ignition dwell time (µs = val*64; 64-element array)." MAP 0x4000A002 RL_VALUE_UBYTE 0 CM_u8_time_64us 0 16320
 /begin AXIS_DESCR COM_AXIS NO_INPUT_QUANTITY CM_u8_rspeed_125_4_500rpm 8 500 8468.75 AXIS_PTS_REF CAL_ign_dwell_time_X_rpm /end AXIS_DESCR
 /begin AXIS_DESCR COM_AXIS V_CAL_ign_dwell_time_Y_ecu_voltage CM_u8_voltage_72_1023v 8 0 17.9472140762463 AXIS_PTS_REF CAL_ign_dwell_time_Y_ecu_voltage /end AXIS_DESCR
/end CHARACTERISTIC
/begin AXIS_PTS CAL_ign_knock_safe_X_engine_speed "Calibration: X-axis (engine speed) for the ignition knock safe table (RPM = val*125/4+500; 20-element array)." 0x4000A042 NO_INPUT_QUANTITY RL_AXIS_UBYTE 0 CM_u8_rspeed_125_4_500rpm 20 500 8468.75 /end AXIS_PTS
/begin AXIS_PTS CAL_ign_knock_safe_Y_load "Calibration: Y-axis (load) for the ignition knock safe table (mg/stroke = val*1173; 20-element array)." 0x4000A056 NO_INPUT_QUANTITY RL_AXIS_UBYTE 0 CM_u8_load_1173mg_255stroke 20 0 1173 /end AXIS_PTS
/begin CHARACTERISTIC CAL_ign_knock_safe "Calibration: ignition knock safe (° = val/4−10; 400-element array)." MAP 0x4000A06A RL_VALUE_UBYTE 0 CM_u8_angle_1_4_10deg -10 53.75
 /begin AXIS_DESCR COM_AXIS NO_INPUT_QUANTITY CM_u8_rspeed_125_4_500rpm 20 500 8468.75 AXIS_PTS_REF CAL_ign_knock_safe_X_engine_speed /end AXIS_DESCR
 /begin AXIS_DESCR COM_AXIS NO_INPUT_QUANTITY CM_u8_load_1173mg_255stroke 20 0 1173 AXIS_PTS_REF CAL_ign_knock_safe_Y_load /end AXIS_DESCR
/end CHARACTERISTIC
/begin AXIS_PTS CAL_inj_afr_base_X_engine_speed "Calibration: X-axis (engine speed) for the injector AFR base table (RPM = val*125/4+500; 20-element array)." 0x4000A1FA NO_INPUT_QUANTITY RL_AXIS_UBYTE 0 CM_u8_rspeed_125_4_500rpm 20 500 8468.75 /end AXIS_PTS
/begin AXIS_PTS CAL_inj_afr_base_Y_engine_load "Calibration: Y-axis (engine load) for the injector AFR base table (mg/stroke = val*1173; 20-element array)." 0x4000A20E NO_INPUT_QUANTITY RL_AXIS_UBYTE 0 CM_u8_load_1173mg_255stroke 20 0 1173 /end AXIS_PTS
/begin CHARACTERISTIC CAL_inj_afr_base "Calibration: injector AFR base (val/20+5; 400-element array)." MAP 0x4000A222 RL_VALUE_UBYTE 0 CM_u8_afr_1_20_5 5 17.75
 /begin AXIS_DESCR COM_AXIS NO_INPUT_QUANTITY CM_u8_rspeed_125_4_500rpm 20 500 8468.75 AXIS_PTS_REF CAL_inj_afr_base_X_engine_speed /end AXIS_DESCR
 /begin AXIS_DESCR COM_AXIS NO_INPUT_QUANTITY CM_u8_load_1173mg_255stroke 20 0 1173 AXIS_PTS_REF CAL_inj_afr_base_Y_engine_load /end AXIS_DESCR
/end CHARACTERISTIC
/begin AXIS_PTS CAL_ign_base_manual_X_engine_speed "Calibration: X-axis (engine speed) for the ignition base manual table (RPM = val*125/4+500; 20-element array)." 0x4000A3B2 NO_INPUT_QUANTITY RL_AXIS_UBYTE 0 CM_u8_rspeed_125_4_500rpm 20 500 8468.75 /end AXIS_PTS
/begin AXIS_PTS CAL_ign_base_manual_Y_load "Calibration: Y-axis (load) for the ignition base manual table (mg/stroke = val*1173; 20-element array)." 0x4000A3C6 NO_INPUT_QUANTITY RL_AXIS_UBYTE 0 CM_u8_load_1173mg_255stroke 20 0 1173 /end AXIS_PTS
/begin CHARACTERISTIC CAL_ign_base_manual "Calibration: ignition base manual (° = val/4−10; 400-element array)." MAP 0x4000A3DA RL_VALUE_UBYTE 0 CM_u8_angle_1_4_10deg -10 53.75
 /begin AXIS_DESCR COM_AXIS NO_INPUT_QUANTITY CM_u8_rspeed_125_4_500rpm 20 500 8468.75 AXIS_PTS_REF CAL_ign_base_manual_X_engine_speed /end AXIS_DESCR
 /begin AXIS_DESCR COM_AXIS NO_INPUT_QUANTITY CM_u8_load_1173mg_255stroke 20 0 1173 AXIS_PTS_REF CAL_ign_base_manual_Y_load /end AXIS_DESCR
/end CHARACTERISTIC
/begin AXIS_PTS CAL_inj_cranking_enrichment_coolant_manual_X_coolant_engine_stopped "Calibration: X-axis (coolant engine stopped) for the injector cranking enrichment coolant manual table (°C = val*5/8−40; 12-element array)." 0x4000A722 coolant_temp_engine_stopped RL_AXIS_UWORD 0 CM_u8_temp_5_8_40c 12 -40 40919.375 /end AXIS_PTS
/begin AXIS_PTS CAL_inj_cranking_enrichment_coolant_manual_Y_maf_accumulated "Calibration: Y-axis (maf accumulated) for the injector cranking enrichment coolant manual table (mg; 14-element array)." 0x4000A73A maf_accumulated_since_start_raw RL_AXIS_UWORD 0 CM_u16_mass_mg 14 0 65535 /end AXIS_PTS
/begin CHARACTERISTIC CAL_inj_cranking_enrichment_coolant_manual "Calibration: injector cranking enrichment coolant manual (val/32; 168-element array)." MAP 0x4000A756 RL_VALUE_UWORD 0 CM_u16_factor_1_32 0 204796.875
 /begin AXIS_DESCR COM_AXIS coolant_temp_engine_stopped CM_u8_temp_5_8_40c 12 -40 40919.375 AXIS_PTS_REF CAL_inj_cranking_enrichment_coolant_manual_X_coolant_engine_stopped /end AXIS_DESCR
 /begin AXIS_DESCR COM_AXIS maf_accumulated_since_start_raw CM_u16_mass_mg 14 0 65535 AXIS_PTS_REF CAL_inj_cranking_enrichment_coolant_manual_Y_maf_accumulated /end AXIS_DESCR
/end CHARACTERISTIC
/begin AXIS_PTS CAL_tps_rate_steadystate_threshold_X_rpm "Calibration: X-axis (rpm) for the throttle position rate steadystate threshold table (RPM = val*125/4+500; 4-element array)." 0x4000A8A6 NO_INPUT_QUANTITY RL_AXIS_UBYTE 0 CM_u8_rspeed_125_4_500rpm 4 500 8468.75 /end AXIS_PTS
/begin AXIS_PTS CAL_tps_rate_steadystate_threshold_Y_tps "Calibration: Y-axis (tps) for the throttle position rate steadystate threshold table (val/255; 4-element array)." 0x4000A8AA NO_INPUT_QUANTITY RL_AXIS_UBYTE 0 CM_u8_factor_1_255 4 0 100 /end AXIS_PTS
/begin CHARACTERISTIC CAL_tps_rate_steadystate_threshold "Calibration: throttle position rate steadystate threshold (val/255; 16-element array)." MAP 0x4000A8AE RL_VALUE_UBYTE 0 CM_u8_factor_1_255 0 100
 /begin AXIS_DESCR COM_AXIS NO_INPUT_QUANTITY CM_u8_rspeed_125_4_500rpm 4 500 8468.75 AXIS_PTS_REF CAL_tps_rate_steadystate_threshold_X_rpm /end AXIS_DESCR
 /begin AXIS_DESCR COM_AXIS NO_INPUT_QUANTITY CM_u8_factor_1_255 4 0 100 AXIS_PTS_REF CAL_tps_rate_steadystate_threshold_Y_tps /end AXIS_DESCR
/end CHARACTERISTIC
/begin AXIS_PTS CAL_sensor_maf_scaling_X_signal "Calibration: X-axis (signal) for the sensor MAF scaling table (V = val*5/1023; 32-element array)." 0x4000A8C2 NO_INPUT_QUANTITY RL_AXIS_UWORD 0 CM_u16_voltage_5_1023v 32 0 320.307917888563 /end AXIS_PTS
/begin CHARACTERISTIC CAL_sensor_maf_scaling "Calibration: sensor MAF scaling (mg/s = val*10; 32-element array)." CURVE 0x4000A902 RL_VALUE_UWORD 0 CM_u16_flow_10mg_s 0 655350
 /begin AXIS_DESCR COM_AXIS NO_INPUT_QUANTITY CM_u16_voltage_5_1023v 32 0 320.307917888563 AXIS_PTS_REF CAL_sensor_maf_scaling_X_signal /end AXIS_DESCR
/end CHARACTERISTIC
/begin AXIS_PTS CAL_tpssmooth_decrement_by_delta_X_tps_delta "Calibration: X-axis (tps delta) for the tpssmooth decrement by delta table (val/255; 8-element array)." 0x4000A962 NO_INPUT_QUANTITY RL_AXIS_UBYTE 0 CM_u8_factor_1_255 8 0 100 /end AXIS_PTS
/begin CHARACTERISTIC CAL_tpssmooth_decrement_by_delta "Calibration: tpssmooth decrement by delta (val/255; 8-element array)." CURVE 0x4000A96A RL_VALUE_UBYTE 0 CM_u8_factor_1_255 0 100
 /begin AXIS_DESCR COM_AXIS NO_INPUT_QUANTITY CM_u8_factor_1_255 8 0 100 AXIS_PTS_REF CAL_tpssmooth_decrement_by_delta_X_tps_delta /end AXIS_DESCR
/end CHARACTERISTIC
/begin AXIS_PTS CAL_ign_comp_overtemp_X_rpm "Calibration: X-axis (rpm) for the ignition compensation overtemp table (RPM = val*125/4+500; 16-element array)." 0x4000A9C2 NO_INPUT_QUANTITY RL_AXIS_UBYTE 0 CM_u8_rspeed_125_4_500rpm 16 500 8468.75 /end AXIS_PTS
/begin CHARACTERISTIC CAL_ign_comp_overtemp "Calibration: ignition compensation overtemp (° = val/4−32; 16-element array)." CURVE 0x4000A9D2 RL_VALUE_UBYTE 0 CM_u8_angle_1_4_32deg -32 31.75
 /begin AXIS_DESCR COM_AXIS NO_INPUT_QUANTITY CM_u8_rspeed_125_4_500rpm 16 500 8468.75 AXIS_PTS_REF CAL_ign_comp_overtemp_X_rpm /end AXIS_DESCR
/end CHARACTERISTIC
/begin AXIS_PTS CAL_ign_comp_overtemp_coeff_X_coolant_temp "Calibration: X-axis (coolant temp) for the ignition compensation overtemp coeff table (°C = val*5/8−40; 8-element array)." 0x4000A9E2 coolant_temp RL_AXIS_UBYTE 0 CM_u8_temp_5_8_40c 8 -40 119.375 /end AXIS_PTS
/begin CHARACTERISTIC CAL_ign_comp_overtemp_coeff "Calibration: ignition compensation overtemp coeff (val/128; 8-element array)." CURVE 0x4000A9EA RL_VALUE_UBYTE 0 CM_u8_factor_1_128 0 199.21875
 /begin AXIS_DESCR COM_AXIS coolant_temp CM_u8_temp_5_8_40c 8 -40 119.375 AXIS_PTS_REF CAL_ign_comp_overtemp_coeff_X_coolant_temp /end AXIS_DESCR
/end CHARACTERISTIC
/begin AXIS_PTS CAL_ign_comp_idle_rpm_rate_X_rpm_delta "Calibration: X-axis (rpm delta) for the ignition compensation speed variation table (16-element array)." 0x4000A9F2 NO_INPUT_QUANTITY RL_AXIS_UBYTE 0 NO_COMPU_METHOD 16 0 255 /end AXIS_PTS
/begin CHARACTERISTIC CAL_ign_comp_idle_rpm_rate "Calibration: ignition compensation speed variation (16-element array)." CURVE 0x4000AA02 RL_VALUE_UBYTE 0 NO_COMPU_METHOD 0 255
 /begin AXIS_DESCR COM_AXIS NO_INPUT_QUANTITY NO_COMPU_METHOD 16 0 255 AXIS_PTS_REF CAL_ign_comp_idle_rpm_rate_X_rpm_delta /end AXIS_DESCR
/end CHARACTERISTIC
/begin AXIS_PTS CAL_closedloop_o2_switch_threshold_X_rpm "Calibration: X-axis (rpm) for the closedloop O2 switch threshold table (RPM = val*125/4+500; 8-element array)." 0x4000AA22 NO_INPUT_QUANTITY RL_AXIS_UBYTE 0 CM_u8_rspeed_125_4_500rpm 8 500 8468.75 /end AXIS_PTS
/begin CHARACTERISTIC CAL_closedloop_o2_switch_threshold "Calibration: closedloop O2 switch threshold (8-element array)." CURVE 0x4000AA2A RL_VALUE_UBYTE 0 NO_COMPU_METHOD 0 255
 /begin AXIS_DESCR COM_AXIS NO_INPUT_QUANTITY CM_u8_rspeed_125_4_500rpm 8 500 8468.75 AXIS_PTS_REF CAL_closedloop_o2_switch_threshold_X_rpm /end AXIS_DESCR
/end CHARACTERISTIC
/begin AXIS_PTS CAL_ign_comp_tps_rate_X_tps_rate "Calibration: X-axis (tps rate) for the ignition compensation throttle position rate table (8-element array)." 0x4000AA32 NO_INPUT_QUANTITY RL_AXIS_UBYTE 0 CM_u8_factor_1_255 8 0 100 /end AXIS_PTS
/begin CHARACTERISTIC CAL_ign_comp_tps_rate "ign_comp_tps_rate — timing pulled for fast pedal movement. This is a straight retard applied whenever the throttle is moving quickly, in either direction, and it's subtracted from the timing target in the normal running paths (:16069, :16090). It's a" CURVE 0x4000AA3A RL_VALUE_SBYTE 0 CM_u8_angle_1_4deg -32 31.75
 /begin AXIS_DESCR COM_AXIS NO_INPUT_QUANTITY CM_u8_factor_1_255 8 0 100 AXIS_PTS_REF CAL_ign_comp_tps_rate_X_tps_rate /end AXIS_DESCR
/end CHARACTERISTIC
/begin AXIS_PTS CAL_knock_sampling_window_X_rpm "Calibration: X-axis (rpm) for the knock sampling window table (RPM = val*125/4+500; 16-element array)." 0x4000AA42 NO_INPUT_QUANTITY RL_AXIS_UBYTE 0 CM_u8_rspeed_125_4_500rpm 16 500 8468.75 /end AXIS_PTS
/begin AXIS_PTS CAL_knock_sampling_window_Y_load "Calibration: Y-axis (load) for the knock sampling window table (mg/stroke = val*4; 16-element array)." 0x4000AA52 load_mass_per_stroke RL_AXIS_UBYTE 0 CM_u8_load_4mg_stroke 16 0 1020 /end AXIS_PTS
/begin CHARACTERISTIC CAL_knock_sampling_window "Calibration: knock sampling window (256-element array)." MAP 0x4000AA62 RL_VALUE_UBYTE 0 NO_COMPU_METHOD 0 255
 /begin AXIS_DESCR COM_AXIS NO_INPUT_QUANTITY CM_u8_rspeed_125_4_500rpm 16 500 8468.75 AXIS_PTS_REF CAL_knock_sampling_window_X_rpm /end AXIS_DESCR
 /begin AXIS_DESCR COM_AXIS load_mass_per_stroke CM_u8_load_4mg_stroke 16 0 1020 AXIS_PTS_REF CAL_knock_sampling_window_Y_load /end AXIS_DESCR
/end CHARACTERISTIC
/begin AXIS_PTS CAL_knock_buffer_size_X_engine_speed "Calibration: X-axis (engine speed) for the knock buffer size table (RPM = val*125/4+500; 16-element array)." 0x4000AB62 NO_INPUT_QUANTITY RL_AXIS_UBYTE 0 CM_u8_rspeed_125_4_500rpm 16 500 8468.75 /end AXIS_PTS
/begin AXIS_PTS CAL_knock_buffer_size_Y_load "Calibration: Y-axis (load) for the knock buffer size table (mg/stroke = val*4; 16-element array)." 0x4000AB72 load_mass_per_stroke RL_AXIS_UBYTE 0 CM_u8_load_4mg_stroke 16 0 1020 /end AXIS_PTS
/begin CHARACTERISTIC CAL_knock_buffer_size "Calibration: knock buffer size (256-element array)." MAP 0x4000AB82 RL_VALUE_UBYTE 0 NO_COMPU_METHOD 0 255
 /begin AXIS_DESCR COM_AXIS NO_INPUT_QUANTITY CM_u8_rspeed_125_4_500rpm 16 500 8468.75 AXIS_PTS_REF CAL_knock_buffer_size_X_engine_speed /end AXIS_DESCR
 /begin AXIS_DESCR COM_AXIS load_mass_per_stroke CM_u8_load_4mg_stroke 16 0 1020 AXIS_PTS_REF CAL_knock_buffer_size_Y_load /end AXIS_DESCR
/end CHARACTERISTIC
/begin AXIS_PTS CAL_inj_deadtime_base_X_car_voltage "Calibration: X-axis (car voltage) for the injector time base table (V = val*72/1023; 8-element array)." 0x4000ACD2 NO_INPUT_QUANTITY RL_AXIS_UBYTE 0 CM_u8_voltage_72_1023v 8 0 17.9472140762463 /end AXIS_PTS
/begin AXIS_PTS CAL_inj_deadtime_base_Y_fuel_pressure "Calibration: Y-axis (fuel pressure) for the injector time base table (mbar = val*50; 8-element array)." 0x4000ACDA NO_INPUT_QUANTITY RL_AXIS_UBYTE 0 CM_u8_pressure_50mbar 8 0 12750 /end AXIS_PTS
/begin CHARACTERISTIC CAL_inj_deadtime_base "Calibration: injector time base (µs = val*20; 64-element array)." MAP 0x4000ACE2 RL_VALUE_UBYTE 0 CM_u8_time_20us 0 5100
 /begin AXIS_DESCR COM_AXIS NO_INPUT_QUANTITY CM_u8_voltage_72_1023v 8 0 17.9472140762463 AXIS_PTS_REF CAL_inj_deadtime_base_X_car_voltage /end AXIS_DESCR
 /begin AXIS_DESCR COM_AXIS NO_INPUT_QUANTITY CM_u8_pressure_50mbar 8 0 12750 AXIS_PTS_REF CAL_inj_deadtime_base_Y_fuel_pressure /end AXIS_DESCR
/end CHARACTERISTIC
/begin AXIS_PTS CAL_sensor_ac_evap_temp_scaling_X_voltage "Calibration: X-axis (voltage) for the sensor A/C evaporative temperature scaling table (V = val*5/1023; 16-element array)." 0x4000AD22 ac_evap_temp_voltage RL_AXIS_UWORD 0 CM_u16_voltage_5_1023v 16 0 320.307917888563 /end AXIS_PTS
/begin CHARACTERISTIC CAL_sensor_ac_evap_temp_scaling "Calibration: sensor A/C evaporative temperature scaling (16-element array)." CURVE 0x4000AD42 RL_VALUE_UWORD 0 NO_COMPU_METHOD 0 65535
 /begin AXIS_DESCR COM_AXIS ac_evap_temp_voltage CM_u16_voltage_5_1023v 16 0 320.307917888563 AXIS_PTS_REF CAL_sensor_ac_evap_temp_scaling_X_voltage /end AXIS_DESCR
/end CHARACTERISTIC
/begin AXIS_PTS CAL_inj_accel_enrichment_load_threshold_X_rpm "Calibration: X-axis (rpm) for the injector accelerator enrichment load threshold table (RPM = val*125/4+500; 8-element array)." 0x4000AD62 NO_INPUT_QUANTITY RL_AXIS_UBYTE 0 CM_u8_rspeed_125_4_500rpm 8 500 8468.75 /end AXIS_PTS
/begin CHARACTERISTIC CAL_inj_accel_enrichment_load_threshold "Calibration: injector accelerator enrichment load threshold (val/100; 8-element array)." CURVE 0x4000AD6A RL_VALUE_UBYTE 0 CM_u8_factor_1_100 0 255
 /begin AXIS_DESCR COM_AXIS NO_INPUT_QUANTITY CM_u8_rspeed_125_4_500rpm 8 500 8468.75 AXIS_PTS_REF CAL_inj_accel_enrichment_load_threshold_X_rpm /end AXIS_DESCR
/end CHARACTERISTIC
/begin AXIS_PTS CAL_sensor_fuel_level_X_voltage "Calibration: X-axis (voltage) for the sensor fuel level table (V = val*5/1023; 8-element array)." 0x4000AD72 NO_INPUT_QUANTITY RL_AXIS_UWORD 0 CM_u16_voltage_5_1023v 8 0 320.307917888563 /end AXIS_PTS
/begin CHARACTERISTIC CAL_sensor_fuel_level "Calibration: sensor fuel level (gal = val/10; 8-element array)." CURVE 0x4000AD82 RL_VALUE_UWORD 0 CM_u8_volume_1_10gallon 0 6553.5
 /begin AXIS_DESCR COM_AXIS NO_INPUT_QUANTITY CM_u16_voltage_5_1023v 8 0 320.307917888563 AXIS_PTS_REF CAL_sensor_fuel_level_X_voltage /end AXIS_DESCR
/end CHARACTERISTIC
/begin AXIS_PTS CAL_ign_comp_startup_manual_X_maf_accum "Calibration: X-axis (maf accum) for the ignition compensation startup manual table (mg; 8-element array)." 0x4000ADA2 maf_accumulated_since_start_raw RL_AXIS_UWORD 0 CM_u16_mass_mg 8 0 65535 /end AXIS_PTS
/begin CHARACTERISTIC CAL_ign_comp_startup_manual "Calibration: ignition compensation startup manual (° = val/4; 8-element array)." CURVE 0x4000ADB2 RL_VALUE_SWORD 0 CM_u8_angle_1_4deg -8192 8191.75
 /begin AXIS_DESCR COM_AXIS maf_accumulated_since_start_raw CM_u16_mass_mg 8 0 65535 AXIS_PTS_REF CAL_ign_comp_startup_manual_X_maf_accum /end AXIS_DESCR
/end CHARACTERISTIC
/begin AXIS_PTS CAL_load_alphaN_base_X_engine_speed "Calibration: X-axis (engine speed) for the load alphaN base table (RPM = val*125/4+500; 20-element array)." 0x4000ADF2 NO_INPUT_QUANTITY RL_AXIS_UBYTE 0 CM_u8_rspeed_125_4_500rpm 20 500 8468.75 /end AXIS_PTS
/begin AXIS_PTS CAL_load_alphaN_base_Y_tps "Calibration: Y-axis (tps) for the load alphaN base table (val/255; 20-element array)." 0x4000AE06 NO_INPUT_QUANTITY RL_AXIS_UBYTE 0 CM_u8_factor_1_255 20 0 100 /end AXIS_PTS
/begin CHARACTERISTIC CAL_load_alphaN_base "Calibration: load alphaN base (mg/stroke = val*1173; 400-element array)." MAP 0x4000AE1A RL_VALUE_UBYTE 0 CM_u8_load_1173mg_255stroke 0 1173
 /begin AXIS_DESCR COM_AXIS NO_INPUT_QUANTITY CM_u8_rspeed_125_4_500rpm 20 500 8468.75 AXIS_PTS_REF CAL_load_alphaN_base_X_engine_speed /end AXIS_DESCR
 /begin AXIS_DESCR COM_AXIS NO_INPUT_QUANTITY CM_u8_factor_1_255 20 0 100 AXIS_PTS_REF CAL_load_alphaN_base_Y_tps /end AXIS_DESCR
/end CHARACTERISTIC
/begin AXIS_PTS CAL_tpstarget_tour_ips_X_pps "Calibration: X-axis (pps) for the tpstarget tour IPS table (val/1023; 16-element array)." 0x4000B032 NO_INPUT_QUANTITY RL_AXIS_UWORD 0 CM_u16_factor_1_1023 16 0 6406.15835777126 /end AXIS_PTS
/begin CHARACTERISTIC CAL_tpstarget_tour_ips "Calibration: tpstarget tour IPS (val/1023; 16-element array)." CURVE 0x4000B052 RL_VALUE_UWORD 0 CM_u16_factor_1_1023 0 6406.15835777126
 /begin AXIS_DESCR COM_AXIS NO_INPUT_QUANTITY CM_u16_factor_1_1023 16 0 6406.15835777126 AXIS_PTS_REF CAL_tpstarget_tour_ips_X_pps /end AXIS_DESCR
/end CHARACTERISTIC
/begin AXIS_PTS CAL_tpstarget_sport_ips_X_pps "Calibration: X-axis (pps) for the tpstarget sport IPS table (val/1023; 16-element array)." 0x4000B072 NO_INPUT_QUANTITY RL_AXIS_UWORD 0 CM_u16_factor_1_1023 16 0 6406.15835777126 /end AXIS_PTS
/begin CHARACTERISTIC CAL_tpstarget_sport_ips "Calibration: tpstarget sport IPS (val/1023; 16-element array)." CURVE 0x4000B092 RL_VALUE_UWORD 0 CM_u16_factor_1_1023 0 6406.15835777126
 /begin AXIS_DESCR COM_AXIS NO_INPUT_QUANTITY CM_u16_factor_1_1023 16 0 6406.15835777126 AXIS_PTS_REF CAL_tpstarget_sport_ips_X_pps /end AXIS_DESCR
/end CHARACTERISTIC
/begin AXIS_PTS CAL_knock_sensitivity_X_engine_speed "Calibration: X-axis (engine speed) for the knock sensitivity table (RPM = val*125/4+500; 8-element array)." 0x4000B0B2 NO_INPUT_QUANTITY RL_AXIS_UBYTE 0 CM_u8_rspeed_125_4_500rpm 8 500 8468.75 /end AXIS_PTS
/begin AXIS_PTS CAL_knock_sensitivity_Y_load "Calibration: Y-axis (load) for the knock sensitivity table (mg/stroke = val*4; 8-element array)." 0x4000B0BA load_mass_per_stroke RL_AXIS_UBYTE 0 CM_u8_load_4mg_stroke 8 0 1020 /end AXIS_PTS
/begin CHARACTERISTIC CAL_knock_sensitivity "Calibration: knock sensitivity (val/255; 64-element array)." MAP 0x4000B0C2 RL_VALUE_UBYTE 0 CM_u8_factor_1_255 0 100
 /begin AXIS_DESCR COM_AXIS NO_INPUT_QUANTITY CM_u8_rspeed_125_4_500rpm 8 500 8468.75 AXIS_PTS_REF CAL_knock_sensitivity_X_engine_speed /end AXIS_DESCR
 /begin AXIS_DESCR COM_AXIS load_mass_per_stroke CM_u8_load_4mg_stroke 8 0 1020 AXIS_PTS_REF CAL_knock_sensitivity_Y_load /end AXIS_DESCR
/end CHARACTERISTIC
/begin AXIS_PTS CAL_knock_peak_threshold_X_engine_speed "Calibration: X-axis (engine speed) for the knock peak threshold table (RPM = val*125/4+500; 8-element array)." 0x4000B102 NO_INPUT_QUANTITY RL_AXIS_UBYTE 0 CM_u8_rspeed_125_4_500rpm 8 500 8468.75 /end AXIS_PTS
/begin AXIS_PTS CAL_knock_peak_threshold_Y_load "Calibration: Y-axis (load) for the knock peak threshold table (mg/stroke = val*4; 8-element array)." 0x4000B10A load_mass_per_stroke RL_AXIS_UBYTE 0 CM_u8_load_4mg_stroke 8 0 1020 /end AXIS_PTS
/begin CHARACTERISTIC CAL_knock_peak_threshold "Calibration: knock peak threshold (64-element array)." MAP 0x4000B112 RL_VALUE_UBYTE 0 NO_COMPU_METHOD 0 255
 /begin AXIS_DESCR COM_AXIS NO_INPUT_QUANTITY CM_u8_rspeed_125_4_500rpm 8 500 8468.75 AXIS_PTS_REF CAL_knock_peak_threshold_X_engine_speed /end AXIS_DESCR
 /begin AXIS_DESCR COM_AXIS load_mass_per_stroke CM_u8_load_4mg_stroke 8 0 1020 AXIS_PTS_REF CAL_knock_peak_threshold_Y_load /end AXIS_DESCR
/end CHARACTERISTIC
/begin AXIS_PTS CAL_knock_count_to_retard_X_knock_count "Calibration: X-axis (knock count) for the knock count to retard table (8-element array)." 0x4000B152 NO_INPUT_QUANTITY RL_AXIS_UBYTE 0 NO_COMPU_METHOD 8 0 255 /end AXIS_PTS
/begin CHARACTERISTIC CAL_knock_count_to_retard "Calibration: knock count to retard (° = val/4; 8-element array)." CURVE 0x4000B15A RL_VALUE_UBYTE 0 CM_u8_angle_1_4deg 0 63.75
 /begin AXIS_DESCR COM_AXIS NO_INPUT_QUANTITY NO_COMPU_METHOD 8 0 255 AXIS_PTS_REF CAL_knock_count_to_retard_X_knock_count /end AXIS_DESCR
/end CHARACTERISTIC
/begin AXIS_PTS CAL_knock_detection_load_threshold_X_rpm "Calibration: X-axis (rpm) for the knock detection load threshold table (RPM = val*125/4+500; 8-element array)." 0x4000B162 NO_INPUT_QUANTITY RL_AXIS_UBYTE 0 CM_u8_rspeed_125_4_500rpm 8 500 8468.75 /end AXIS_PTS
/begin CHARACTERISTIC CAL_knock_detection_load_threshold "Calibration: knock detection load threshold (mg/stroke = val*4; 8-element array)." CURVE 0x4000B16A RL_VALUE_UBYTE 0 CM_u8_load_4mg_stroke 0 1020
 /begin AXIS_DESCR COM_AXIS NO_INPUT_QUANTITY CM_u8_rspeed_125_4_500rpm 8 500 8468.75 AXIS_PTS_REF CAL_knock_detection_load_threshold_X_rpm /end AXIS_DESCR
/end CHARACTERISTIC
/begin AXIS_PTS CAL_knock_learning_load_threshold_X_rpm "Calibration: X-axis (rpm) for the knock learning load threshold table (RPM = val*125/4+500; 8-element array)." 0x4000B172 NO_INPUT_QUANTITY RL_AXIS_UBYTE 0 CM_u8_rspeed_125_4_500rpm 8 500 8468.75 /end AXIS_PTS
/begin CHARACTERISTIC CAL_knock_learning_load_threshold "Calibration: knock learning load threshold (mg/stroke = val*4; 8-element array)." CURVE 0x4000B17A RL_VALUE_UBYTE 0 CM_u8_load_4mg_stroke 0 1020
 /begin AXIS_DESCR COM_AXIS NO_INPUT_QUANTITY CM_u8_rspeed_125_4_500rpm 8 500 8468.75 AXIS_PTS_REF CAL_knock_learning_load_threshold_X_rpm /end AXIS_DESCR
/end CHARACTERISTIC
/begin AXIS_PTS CAL_tpstarget_tour_manual_X_pps "Calibration: X-axis (pps) for the tpstarget tour manual table (val/1023; 16-element array)." 0x4000B2B2 NO_INPUT_QUANTITY RL_AXIS_UWORD 0 CM_u16_factor_1_1023 16 0 6406.15835777126 /end AXIS_PTS
/begin CHARACTERISTIC CAL_tpstarget_tour_manual "Calibration: tpstarget tour manual (val/1023; 16-element array)." CURVE 0x4000B2D2 RL_VALUE_UWORD 0 CM_u16_factor_1_1023 0 6406.15835777126
 /begin AXIS_DESCR COM_AXIS NO_INPUT_QUANTITY CM_u16_factor_1_1023 16 0 6406.15835777126 AXIS_PTS_REF CAL_tpstarget_tour_manual_X_pps /end AXIS_DESCR
/end CHARACTERISTIC
/begin AXIS_PTS CAL_tpstarget_sport_manual_X_pps "Calibration: X-axis (pps) for the tpstarget sport manual table (val/1023; 16-element array)." 0x4000B332 NO_INPUT_QUANTITY RL_AXIS_UWORD 0 CM_u16_factor_1_1023 16 0 6406.15835777126 /end AXIS_PTS
/begin CHARACTERISTIC CAL_tpstarget_sport_manual "Calibration: tpstarget sport manual (val/1023; 16-element array)." CURVE 0x4000B352 RL_VALUE_UWORD 0 CM_u16_factor_1_1023 0 6406.15835777126
 /begin AXIS_DESCR COM_AXIS NO_INPUT_QUANTITY CM_u16_factor_1_1023 16 0 6406.15835777126 AXIS_PTS_REF CAL_tpstarget_sport_manual_X_pps /end AXIS_DESCR
/end CHARACTERISTIC
/begin AXIS_PTS CAL_ign_target_step_retard_accel_pedal_X_rpm "Calibration: X-axis (engine speed) for the ignition compensation tps2 table (RPM = val*125/4+500; 8-element array)." 0x4000B372 NO_INPUT_QUANTITY RL_AXIS_UBYTE 0 CM_u8_rspeed_125_4_500rpm 8 500 8468.75 /end AXIS_PTS
/begin AXIS_PTS CAL_ign_target_step_retard_accel_pedal_Y_pps "Calibration: Y-axis (accel pedal) for the ignition compensation tps2 table (val/255; 16-element array)." 0x4000B37A NO_INPUT_QUANTITY RL_AXIS_UBYTE 0 CM_u8_factor_1_255 16 0 100 /end AXIS_PTS
/begin CHARACTERISTIC CAL_ign_target_step_retard_accel_pedal "ign_target_step_retard — how fast timing gets pulled. Same rate limit in the opposite direction: when the timing target drops, this is the largest amount of timing the ECU may remove per step, again one step every 50 ms, again in quarter-degrees, so " MAP 0x4000B38A RL_VALUE_UBYTE 0 CM_u8_angle_1_4deg 0 63.75
 /begin AXIS_DESCR COM_AXIS NO_INPUT_QUANTITY CM_u8_rspeed_125_4_500rpm 8 500 8468.75 AXIS_PTS_REF CAL_ign_target_step_retard_accel_pedal_X_rpm /end AXIS_DESCR
 /begin AXIS_DESCR COM_AXIS NO_INPUT_QUANTITY CM_u8_factor_1_255 16 0 100 AXIS_PTS_REF CAL_ign_target_step_retard_accel_pedal_Y_pps /end AXIS_DESCR
/end CHARACTERISTIC
/begin AXIS_PTS CAL_inj_cranking_enrichment_coolant_ips_X_coolant_engine_stopped "Calibration: X-axis (coolant engine stopped) for the injector cranking enrichment coolant IPS table (°C = val*5/8−40; 12-element array)." 0x4000B40A coolant_temp_engine_stopped RL_AXIS_UWORD 0 CM_u8_temp_5_8_40c 12 -40 40919.375 /end AXIS_PTS
/begin AXIS_PTS CAL_inj_cranking_enrichment_coolant_ips_Y_maf_accumulated "Calibration: Y-axis (maf accumulated) for the injector cranking enrichment coolant IPS table (mg; 14-element array)." 0x4000B422 maf_accumulated_since_start_raw RL_AXIS_UWORD 0 CM_u16_mass_mg 14 0 65535 /end AXIS_PTS
/begin CHARACTERISTIC CAL_inj_cranking_enrichment_coolant_ips "Calibration: injector cranking enrichment coolant IPS (val/32; 168-element array)." MAP 0x4000B43E RL_VALUE_UWORD 0 CM_u16_factor_1_32 0 204796.875
 /begin AXIS_DESCR COM_AXIS coolant_temp_engine_stopped CM_u8_temp_5_8_40c 12 -40 40919.375 AXIS_PTS_REF CAL_inj_cranking_enrichment_coolant_ips_X_coolant_engine_stopped /end AXIS_DESCR
 /begin AXIS_DESCR COM_AXIS maf_accumulated_since_start_raw CM_u16_mass_mg 14 0 65535 AXIS_PTS_REF CAL_inj_cranking_enrichment_coolant_ips_Y_maf_accumulated /end AXIS_DESCR
/end CHARACTERISTIC
/begin AXIS_PTS CAL_ign_min_X_engine_speed "Calibration: X-axis (engine speed) for the ignition minimum table (RPM = val*125/4+500; 16-element array)." 0x4000B9AA NO_INPUT_QUANTITY RL_AXIS_UBYTE 0 CM_u8_rspeed_125_4_500rpm 16 500 8468.75 /end AXIS_PTS
/begin AXIS_PTS CAL_ign_min_Y_load "Calibration: Y-axis (load) for the ignition minimum table (mg/stroke = val*4; 16-element array)." 0x4000B9BA load_mass_per_stroke RL_AXIS_UBYTE 0 CM_u8_load_4mg_stroke 16 0 1020 /end AXIS_PTS
/begin CHARACTERISTIC CAL_ign_min "Calibration: ignition minimum (° = val/4−20; 256-element array)." MAP 0x4000B9CA RL_VALUE_UBYTE 0 CM_u8_angle_1_4_20deg -20 43.75
 /begin AXIS_DESCR COM_AXIS NO_INPUT_QUANTITY CM_u8_rspeed_125_4_500rpm 16 500 8468.75 AXIS_PTS_REF CAL_ign_min_X_engine_speed /end AXIS_DESCR
 /begin AXIS_DESCR COM_AXIS load_mass_per_stroke CM_u8_load_4mg_stroke 16 0 1020 AXIS_PTS_REF CAL_ign_min_Y_load /end AXIS_DESCR
/end CHARACTERISTIC
/begin AXIS_PTS CAL_ign_comp_coolant_ips_noflags_X_coolant_temp "Calibration: X-axis (coolant temp) for the ignition compensation coolant IPS noflags table (°C = val*5/8−40; 16-element array)." 0x4000BFFA coolant_temp RL_AXIS_UBYTE 0 CM_u8_temp_5_8_40c 16 -40 119.375 /end AXIS_PTS
/begin CHARACTERISTIC CAL_ign_comp_coolant_ips_noflags "Calibration: ignition compensation coolant IPS noflags (° = val/4; 16-element array)." CURVE 0x4000C00A RL_VALUE_UBYTE 0 CM_u8_angle_1_4deg 0 63.75
 /begin AXIS_DESCR COM_AXIS coolant_temp CM_u8_temp_5_8_40c 16 -40 119.375 AXIS_PTS_REF CAL_ign_comp_coolant_ips_noflags_X_coolant_temp /end AXIS_DESCR
/end CHARACTERISTIC
/begin AXIS_PTS CAL_ign_min_engine_off_X_engine_speed "Calibration: X-axis (engine speed) for the ignition minimum engine off table (RPM = val*125/4+500; 3-element array)." 0x4000C0CB NO_INPUT_QUANTITY RL_AXIS_UBYTE 0 CM_u8_rspeed_125_4_500rpm 3 500 8468.75 /end AXIS_PTS
/begin AXIS_PTS CAL_ign_min_engine_off_Y_load "Calibration: Y-axis (load) for the ignition minimum engine off table (mg/stroke = val*4; 3-element array)." 0x4000C0CE load_mass_per_stroke RL_AXIS_UBYTE 0 CM_u8_load_4mg_stroke 3 0 1020 /end AXIS_PTS
/begin CHARACTERISTIC CAL_ign_min_engine_off "Calibration: ignition minimum engine off (° = val/4−20; 9-element array)." MAP 0x4000C0D1 RL_VALUE_UBYTE 0 CM_u8_angle_1_4_20deg -20 43.75
 /begin AXIS_DESCR COM_AXIS NO_INPUT_QUANTITY CM_u8_rspeed_125_4_500rpm 3 500 8468.75 AXIS_PTS_REF CAL_ign_min_engine_off_X_engine_speed /end AXIS_DESCR
 /begin AXIS_DESCR COM_AXIS load_mass_per_stroke CM_u8_load_4mg_stroke 3 0 1020 AXIS_PTS_REF CAL_ign_min_engine_off_Y_load /end AXIS_DESCR
/end CHARACTERISTIC
/begin AXIS_PTS CAL_inj_bank_balance_X_engine_speed "Calibration: X-axis (engine speed) for the injector bank balance table (RPM = val*125/4+500; 20-element array)." 0x4000C0DA NO_INPUT_QUANTITY RL_AXIS_UBYTE 0 CM_u8_rspeed_125_4_500rpm 20 500 8468.75 /end AXIS_PTS
/begin AXIS_PTS CAL_inj_bank_balance_Y_load "Calibration: Y-axis (load) for the injector bank balance table (mg/stroke = val*1173; 20-element array)." 0x4000C0EE NO_INPUT_QUANTITY RL_AXIS_UBYTE 0 CM_u8_load_1173mg_255stroke 20 0 1173 /end AXIS_PTS
/begin CHARACTERISTIC CAL_inj_bank_balance "Calibration: injector bank balance (val/200; 400-element array)." MAP 0x4000C102 RL_VALUE_UBYTE 0 CM_u8_factor_1_200 0 127.5
 /begin AXIS_DESCR COM_AXIS NO_INPUT_QUANTITY CM_u8_rspeed_125_4_500rpm 20 500 8468.75 AXIS_PTS_REF CAL_inj_bank_balance_X_engine_speed /end AXIS_DESCR
 /begin AXIS_DESCR COM_AXIS NO_INPUT_QUANTITY CM_u8_load_1173mg_255stroke 20 0 1173 AXIS_PTS_REF CAL_inj_bank_balance_Y_load /end AXIS_DESCR
/end CHARACTERISTIC
/begin AXIS_PTS CAL_ign_mbt_modeled_X_engine_speed "Calibration: X-axis (engine speed) for the ignition MBT modeled table (RPM = val*125/4+500; 20-element array)." 0x4000C292 NO_INPUT_QUANTITY RL_AXIS_UBYTE 0 CM_u8_rspeed_125_4_500rpm 20 500 8468.75 /end AXIS_PTS
/begin AXIS_PTS CAL_ign_mbt_modeled_Y_load "Calibration: Y-axis (load) for the ignition MBT modeled table (mg/stroke = val*1173; 20-element array)." 0x4000C2A6 NO_INPUT_QUANTITY RL_AXIS_UBYTE 0 CM_u8_load_1173mg_255stroke 20 0 1173 /end AXIS_PTS
/begin CHARACTERISTIC CAL_ign_mbt_modeled "Calibration: ignition MBT modeled (° = val/4−10; 400-element array)." MAP 0x4000C2BA RL_VALUE_UBYTE 0 CM_u8_angle_1_4_10deg -10 53.75
 /begin AXIS_DESCR COM_AXIS NO_INPUT_QUANTITY CM_u8_rspeed_125_4_500rpm 20 500 8468.75 AXIS_PTS_REF CAL_ign_mbt_modeled_X_engine_speed /end AXIS_DESCR
 /begin AXIS_DESCR COM_AXIS NO_INPUT_QUANTITY CM_u8_load_1173mg_255stroke 20 0 1173 AXIS_PTS_REF CAL_ign_mbt_modeled_Y_load /end AXIS_DESCR
/end CHARACTERISTIC
/begin AXIS_PTS CAL_inj_post_start_transient_scaler_X_mass_accum "u8_mass_32mg[8]" 0x4000C44A NO_INPUT_QUANTITY RL_AXIS_UBYTE 0 CM_u8_mass_32mg 8 0 8160 /end AXIS_PTS
/begin AXIS_PTS CAL_inj_post_start_transient_scaler_Y_coolant_temp "u8_temp_5/8-40c[8]" 0x4000C452 NO_INPUT_QUANTITY RL_AXIS_UBYTE 0 CM_u8_temp_5_8_40c 8 -40 119.375 /end AXIS_PTS
/begin CHARACTERISTIC CAL_inj_post_start_transient_scaler "u8_factor_1/255[64]" MAP 0x4000C45A RL_VALUE_UBYTE 0 CM_u8_factor_1_255 0 100
 /begin AXIS_DESCR COM_AXIS NO_INPUT_QUANTITY CM_u8_mass_32mg 8 0 8160 AXIS_PTS_REF CAL_inj_post_start_transient_scaler_X_mass_accum /end AXIS_DESCR
 /begin AXIS_DESCR COM_AXIS NO_INPUT_QUANTITY CM_u8_temp_5_8_40c 8 -40 119.375 AXIS_PTS_REF CAL_inj_post_start_transient_scaler_Y_coolant_temp /end AXIS_DESCR
/end CHARACTERISTIC
/begin AXIS_PTS CAL_inj_coldstart_enrichment_X_coolant_temp "Calibration: X-axis (coolant temp) for the injector coldstart enrichment table (°C = val*5/8−40; 8-element array)." 0x4000C49A coolant_temp_engine_stopped RL_AXIS_UBYTE 0 CM_u8_temp_5_8_40c 8 -40 119.375 /end AXIS_PTS
/begin AXIS_PTS CAL_inj_coldstart_enrichment_Y_maf_accum "Calibration: Y-axis (maf accum) for the injector coldstart enrichment table (8-element array)." 0x4000C4A2 V_CAL_inj_coldstart_enrichment_Y_maf_accum RL_AXIS_UBYTE 0 NO_COMPU_METHOD 8 0 255 /end AXIS_PTS
/begin CHARACTERISTIC CAL_inj_coldstart_enrichment "Calibration: injector coldstart enrichment (64-element array)." MAP 0x4000C4AA RL_VALUE_UBYTE 0 NO_COMPU_METHOD 0 255
 /begin AXIS_DESCR COM_AXIS coolant_temp_engine_stopped CM_u8_temp_5_8_40c 8 -40 119.375 AXIS_PTS_REF CAL_inj_coldstart_enrichment_X_coolant_temp /end AXIS_DESCR
 /begin AXIS_DESCR COM_AXIS V_CAL_inj_coldstart_enrichment_Y_maf_accum NO_COMPU_METHOD 8 0 255 AXIS_PTS_REF CAL_inj_coldstart_enrichment_Y_maf_accum /end AXIS_DESCR
/end CHARACTERISTIC
/begin AXIS_PTS CAL_load_baro_gain_X_rpm "Calibration: X-axis (rpm) for the load baro gain table (RPM = val*125/4+500; 16-element array)." 0x4000C51A NO_INPUT_QUANTITY RL_AXIS_UBYTE 0 CM_u8_rspeed_125_4_500rpm 16 500 8468.75 /end AXIS_PTS
/begin AXIS_PTS CAL_load_baro_gain_Y_load "Calibration: Y-axis (load) for the load baro gain table (mg/stroke = val*4; 16-element array)." 0x4000C52A load_mass_per_stroke RL_AXIS_UBYTE 0 CM_u8_load_4mg_stroke 16 0 1020 /end AXIS_PTS
/begin CHARACTERISTIC CAL_load_baro_gain "Calibration: load baro gain (256-element array)." MAP 0x4000C53A RL_VALUE_UBYTE 0 NO_COMPU_METHOD 0 255
 /begin AXIS_DESCR COM_AXIS NO_INPUT_QUANTITY CM_u8_rspeed_125_4_500rpm 16 500 8468.75 AXIS_PTS_REF CAL_load_baro_gain_X_rpm /end AXIS_DESCR
 /begin AXIS_DESCR COM_AXIS load_mass_per_stroke CM_u8_load_4mg_stroke 16 0 1020 AXIS_PTS_REF CAL_load_baro_gain_Y_load /end AXIS_DESCR
/end CHARACTERISTIC
/begin AXIS_PTS CAL_ign_comp_coolant_manual_vvt_alt_X_coolant_temp "Calibration: X-axis (coolant temp) for the ignition compensation coolant manual VVT alt table (°C = val*5/8−40; 16-element array)." 0x4000C6B2 coolant_temp RL_AXIS_UBYTE 0 CM_u8_temp_5_8_40c 16 -40 119.375 /end AXIS_PTS
/begin CHARACTERISTIC CAL_ign_comp_coolant_manual_vvt_alt "Calibration: ignition compensation coolant manual VVT alt (° = val/4; 16-element array)." CURVE 0x4000C6C2 RL_VALUE_UBYTE 0 CM_u8_angle_1_4deg 0 63.75
 /begin AXIS_DESCR COM_AXIS coolant_temp CM_u8_temp_5_8_40c 16 -40 119.375 AXIS_PTS_REF CAL_ign_comp_coolant_manual_vvt_alt_X_coolant_temp /end AXIS_DESCR
/end CHARACTERISTIC
/begin AXIS_PTS CAL_ign_comp_coolant_ips_flags_X_coolant_temp "Calibration: X-axis (coolant temp) for the ignition compensation coolant IPS flags table (°C = val*5/8−40; 16-element array)." 0x4000C6D2 coolant_temp RL_AXIS_UBYTE 0 CM_u8_temp_5_8_40c 16 -40 119.375 /end AXIS_PTS
/begin CHARACTERISTIC CAL_ign_comp_coolant_ips_flags "Calibration: ignition compensation coolant IPS flags (° = val/4; 16-element array)." CURVE 0x4000C6E2 RL_VALUE_UBYTE 0 CM_u8_angle_1_4deg 0 63.75
 /begin AXIS_DESCR COM_AXIS coolant_temp CM_u8_temp_5_8_40c 16 -40 119.375 AXIS_PTS_REF CAL_ign_comp_coolant_ips_flags_X_coolant_temp /end AXIS_DESCR
/end CHARACTERISTIC
/begin AXIS_PTS CAL_injtip_dfco_enable_rpm_ips_firstgear_X_coolant "Calibration: X-axis (coolant) for the injector tip-in decel fuel cut-off enable RPM IPS firstgear table (°C = val*5/8−40; 4-element array)." 0x4000C722 coolant_temp RL_AXIS_UBYTE 0 CM_u8_temp_5_8_40c 4 -40 119.375 /end AXIS_PTS
/begin CHARACTERISTIC CAL_injtip_dfco_enable_rpm_ips_firstgear "Calibration: injector tip-in decel fuel cut-off enable RPM IPS firstgear (RPM = val*50; 4-element array)." CURVE 0x4000C726 RL_VALUE_UBYTE 0 CM_u8_rspeed_50rpm 0 12750
 /begin AXIS_DESCR COM_AXIS coolant_temp CM_u8_temp_5_8_40c 4 -40 119.375 AXIS_PTS_REF CAL_injtip_dfco_enable_rpm_ips_firstgear_X_coolant /end AXIS_DESCR
/end CHARACTERISTIC
/begin AXIS_PTS CAL_ign_comp_startup_ips_X_coolant_temp_engine_stopped "Calibration: X-axis (coolant temp engine stopped) for the ignition compensation startup IPS table (°C = val*5/8−40; 4-element array)." 0x4000C7E2 coolant_temp_engine_stopped RL_AXIS_UWORD 0 CM_u8_temp_5_8_40c 4 -40 40919.375 /end AXIS_PTS
/begin AXIS_PTS CAL_ign_comp_startup_ips_Y_maf_accumulated "Calibration: Y-axis (maf accumulated) for the ignition compensation startup IPS table (10-element array)." 0x4000C7EA maf_accumulated_since_start_raw RL_AXIS_UWORD 0 NO_COMPU_METHOD 10 0 65535 /end AXIS_PTS
/begin CHARACTERISTIC CAL_ign_comp_startup_ips "Calibration: ignition compensation startup IPS (° = val/4; 40-element array)." MAP 0x4000C7FE RL_VALUE_SWORD 0 CM_u8_angle_1_4deg -8192 8191.75
 /begin AXIS_DESCR COM_AXIS coolant_temp_engine_stopped CM_u8_temp_5_8_40c 4 -40 40919.375 AXIS_PTS_REF CAL_ign_comp_startup_ips_X_coolant_temp_engine_stopped /end AXIS_DESCR
 /begin AXIS_DESCR COM_AXIS maf_accumulated_since_start_raw NO_COMPU_METHOD 10 0 65535 AXIS_PTS_REF CAL_ign_comp_startup_ips_Y_maf_accumulated /end AXIS_DESCR
/end CHARACTERISTIC
/begin AXIS_PTS CAL_tpstarget_tour_shifting_X_pps "Calibration: X-axis (pps) for the tpstarget tour shifting table (val/1023; 16-element array)." 0x4000C912 NO_INPUT_QUANTITY RL_AXIS_UWORD 0 CM_u16_factor_1_1023 16 0 6406.15835777126 /end AXIS_PTS
/begin CHARACTERISTIC CAL_tpstarget_tour_shifting "Calibration: tpstarget tour shifting (val/1023; 16-element array)." CURVE 0x4000C932 RL_VALUE_UWORD 0 CM_u16_factor_1_1023 0 6406.15835777126
 /begin AXIS_DESCR COM_AXIS NO_INPUT_QUANTITY CM_u16_factor_1_1023 16 0 6406.15835777126 AXIS_PTS_REF CAL_tpstarget_tour_shifting_X_pps /end AXIS_DESCR
/end CHARACTERISTIC
/begin AXIS_PTS CAL_tpstarget_sport_shifting_X_pps "Calibration: X-axis (pps) for the tpstarget sport shifting table (val/1023; 16-element array)." 0x4000C952 NO_INPUT_QUANTITY RL_AXIS_UWORD 0 CM_u16_factor_1_1023 16 0 6406.15835777126 /end AXIS_PTS
/begin CHARACTERISTIC CAL_tpstarget_sport_shifting "Calibration: tpstarget sport shifting (val/1023; 16-element array)." CURVE 0x4000C972 RL_VALUE_UWORD 0 CM_u16_factor_1_1023 0 6406.15835777126
 /begin AXIS_DESCR COM_AXIS NO_INPUT_QUANTITY CM_u16_factor_1_1023 16 0 6406.15835777126 AXIS_PTS_REF CAL_tpstarget_sport_shifting_X_pps /end AXIS_DESCR
/end CHARACTERISTIC
/begin CHARACTERISTIC CAL_cac_dutycycle_tolerance "Calibration: charge-air-cooler dutycycle tolerance (val/255)." VALUE 0x4000C9D7 RL_VALUE_UBYTE 0 CM_u8_factor_1_255 0 100 /end CHARACTERISTIC
/begin CHARACTERISTIC CAL_sensor_iat_voltage_threshold "Calibration: sensor intake air temp voltage threshold (V = val*5/1023; 2-element array)." VAL_BLK 0x4000C9EE RL_VALUE_UWORD 0 CM_u16_voltage_5_1023v 0 320.307917888563 NUMBER 2 /end CHARACTERISTIC
/begin CHARACTERISTIC CAL_sensor_coolant_voltage_threshold "Calibration: sensor coolant voltage threshold (V = val*5/1023; 2-element array)." VAL_BLK 0x4000CA04 RL_VALUE_UWORD 0 CM_u16_voltage_5_1023v 0 320.307917888563 NUMBER 2 /end CHARACTERISTIC
/begin CHARACTERISTIC CAL_sensor_baro_sensor_failure_fallback "Calibration: sensor baro sensor failure fallback (mbar)." VALUE 0x4000CA14 RL_VALUE_UWORD 0 CM_u16_pressure_mbar 0 65535 /end CHARACTERISTIC
/begin CHARACTERISTIC CAL_sensor_o2_heater_undercurrent_threshold "Calibration: sensor O2 heater undercurrent threshold (mA)." VALUE 0x4000CA6A RL_VALUE_UWORD 0 CM_u16_current_mA 0 65535 /end CHARACTERISTIC
/begin CHARACTERISTIC CAL_sensor_o2_heater_overcurrent_threshold_mA "Calibration: sensor O2 heater overcurrent threshold mA (mA)." VALUE 0x4000CA6C RL_VALUE_UWORD 0 CM_u16_current_mA 0 65535 /end CHARACTERISTIC
/begin CHARACTERISTIC CAL_load_mass_per_stroke_raw_limit_1 "undefined2" VALUE 0x4000CA72 RL_VALUE_UWORD 0 NO_COMPU_METHOD 0 65535 /end CHARACTERISTIC
/begin CHARACTERISTIC CAL_load_mass_per_stroke_raw_limit_2 "undefined2" VALUE 0x4000CA74 RL_VALUE_UWORD 0 NO_COMPU_METHOD 0 65535 /end CHARACTERISTIC
/begin CHARACTERISTIC CAL_sensor_accel_pedal_pos_d_threshold "Calibration: sensor accelerator pedal position d threshold (2-element array)." VAL_BLK 0x4000CA7A RL_VALUE_UWORD 0 NO_COMPU_METHOD 0 65535 NUMBER 2 /end CHARACTERISTIC
/begin CHARACTERISTIC CAL_sensor_accel_pedal_pos_e_threshold "Calibration: sensor accelerator pedal position e threshold (2-element array)." VAL_BLK 0x4000CA7E RL_VALUE_UWORD 0 NO_COMPU_METHOD 0 65535 NUMBER 2 /end CHARACTERISTIC
/begin CHARACTERISTIC CAL_tps_obd_throttle_monitor_error_parity_mask "uint16_t" VALUE 0x4000CA86 RL_VALUE_UWORD 0 NO_COMPU_METHOD 0 65535 /end CHARACTERISTIC
/begin CHARACTERISTIC CAL_tps_commanded_during_fault "Calibration: throttle position commanded during fault (val/255)." VALUE 0x4000CA9B RL_VALUE_UBYTE 0 CM_u8_factor_1_255 0 100 /end CHARACTERISTIC
/begin CHARACTERISTIC CAL_sensor_iat_fallback "Calibration: sensor intake air temp fallback (°C = val*5/8−40)." VALUE 0x4000CA9C RL_VALUE_UBYTE 0 CM_u8_temp_5_8_40c -40 119.375 /end CHARACTERISTIC
/begin CHARACTERISTIC CAL_sensor_coolant_temp_fallback_value "Calibration: sensor coolant temperature fallback value (°C = val*5/8−40)." VALUE 0x4000CA9D RL_VALUE_UBYTE 0 CM_u8_temp_5_8_40c -40 119.375 /end CHARACTERISTIC
/begin CHARACTERISTIC CAL_sensor_manifold_temp_sensor_present "Calibration: sensor manifold temperature sensor present (boolean flag)." VALUE 0x4000CAA2 RL_VALUE_UBYTE 0 NO_COMPU_METHOD 0 255 /end CHARACTERISTIC
/begin CHARACTERISTIC CAL_load_alphaN_use_tmap_density "Calibration: load alphaN use TMAP density (boolean flag)." VALUE 0x4000CAA3 RL_VALUE_UBYTE 0 NO_COMPU_METHOD 0 255 /end CHARACTERISTIC
/begin CHARACTERISTIC CAL_tmap_use_for_load "Calibration: TMAP use for load (boolean flag)." VALUE 0x4000CAAC RL_VALUE_UBYTE 0 NO_COMPU_METHOD 0 255 /end CHARACTERISTIC
/begin CHARACTERISTIC CAL_sensor_intake_air_temp_voltage_threshold "Calibration: sensor intake air temperature voltage threshold (V = val*5/1023; 2-element array)." VAL_BLK 0x4000CAB6 RL_VALUE_UWORD 0 CM_u16_voltage_5_1023v 0 320.307917888563 NUMBER 2 /end CHARACTERISTIC
/begin CHARACTERISTIC CAL_sensor_o2_lean_voltage_threshold "Calibration: sensor O2 lean voltage threshold (V = val*5/1023)." VALUE 0x4000CACC RL_VALUE_UWORD 0 CM_u16_voltage_5_1023v 0 320.307917888563 /end CHARACTERISTIC
/begin CHARACTERISTIC CAL_sensor_o2_rich_voltage_threshold "Calibration: sensor O2 rich voltage threshold (V = val*5/1023)." VALUE 0x4000CACE RL_VALUE_UWORD 0 CM_u16_voltage_5_1023v 0 320.307917888563 /end CHARACTERISTIC
/begin CHARACTERISTIC CAL_sensor_o2_rich_voltage_threshold_4000CAD2 "Calibration: sensor O2 rich voltage threshold (V = val*5/1023)." VALUE 0x4000CAD2 RL_VALUE_UWORD 0 CM_u16_voltage_5_1023v 0 320.307917888563 /end CHARACTERISTIC
/begin CHARACTERISTIC CAL_sensor_o2_lean_voltage_threshold_4000CAD4 "Calibration: sensor O2 lean voltage threshold (V = val*5/1023)." VALUE 0x4000CAD4 RL_VALUE_UWORD 0 CM_u16_voltage_5_1023v 0 320.307917888563 /end CHARACTERISTIC
/begin CHARACTERISTIC CAL_sensor_fuel_level_sensor_voltage_threshold "Calibration: sensor fuel level sensor voltage threshold (V = val*5/1023; 2-element array)." VAL_BLK 0x4000CAEA RL_VALUE_UWORD 0 CM_u16_voltage_5_1023v 0 320.307917888563 NUMBER 2 /end CHARACTERISTIC
/begin CHARACTERISTIC CAL_cac_pwm_mismatch_threshold "Calibration: charge-air-cooler PWM mismatch threshold." VALUE 0x4000CAF2 RL_VALUE_UBYTE 0 NO_COMPU_METHOD 0 255 /end CHARACTERISTIC
/begin CHARACTERISTIC CAL_sensor_coolant_filter_alpha "undefined1" VALUE 0x4000CB03 RL_VALUE_UBYTE 0 NO_COMPU_METHOD 0 255 /end CHARACTERISTIC
/begin CHARACTERISTIC CAL_sensor_knock_voltage_threshold "Calibration: sensor knock voltage threshold (2-element array)." VAL_BLK 0x4000CB24 RL_VALUE_UWORD 0 NO_COMPU_METHOD 0 65535 NUMBER 2 /end CHARACTERISTIC
/begin CHARACTERISTIC CAL_sensor_temp_diagnostic_startup_delay "Calibration: sensor temperature diagnostic startup delay (ms = val*5)." VALUE 0x4000CB4A RL_VALUE_UWORD 0 CM_u8_time_5ms 0 327675 /end CHARACTERISTIC
/begin CHARACTERISTIC CAL_sensor_tps_voltage_theshold1 "Calibration: sensor throttle position voltage theshold1 (V = val*5/1023; 2-element array)." VAL_BLK 0x4000CB50 RL_VALUE_UWORD 0 CM_u16_voltage_5_1023v 0 320.307917888563 NUMBER 2 /end CHARACTERISTIC
/begin CHARACTERISTIC CAL_sensor_tps_voltage_theshold2 "Calibration: sensor throttle position voltage theshold2 (V = val*5/1023; 2-element array)." VAL_BLK 0x4000CB54 RL_VALUE_UWORD 0 CM_u16_voltage_5_1023v 0 320.307917888563 NUMBER 2 /end CHARACTERISTIC
/begin CHARACTERISTIC CAL_closedloop_stft_idle_max_limit "Calibration: closedloop short-term fuel trim idle maximum limit." VALUE 0x4000CB82 RL_VALUE_SWORD 0 NO_COMPU_METHOD -32768 32767 /end CHARACTERISTIC
/begin CHARACTERISTIC CAL_closedloop_o2_switch_threshold_ips "undefined1" VALUE 0x4000CB84 RL_VALUE_UBYTE 0 NO_COMPU_METHOD 0 255 /end CHARACTERISTIC
/begin CHARACTERISTIC CAL_closedloop_max_tipin_enrichment "Calibration: closedloop maximum tipin enrichment (µs = val*10)." VALUE 0x4000CB88 RL_VALUE_UBYTE 0 CM_u8_time_10us 0 2550 /end CHARACTERISTIC
/begin CHARACTERISTIC CAL_closedloop_max_tipout_enleanment "Calibration: closedloop maximum tipout enleanment (µs = val*10)." VALUE 0x4000CB89 RL_VALUE_UBYTE 0 CM_u8_time_10us 0 2550 /end CHARACTERISTIC
/begin CHARACTERISTIC CAL_fuel_usage_to_flow_scaling "Calibration: fuel usage to flow scaling." VALUE 0x4000CB8E RL_VALUE_UWORD 0 NO_COMPU_METHOD 0 65535 /end CHARACTERISTIC
/begin CHARACTERISTIC CAL_closedloop_tipout_holdoff_ticks "undefined1" VALUE 0x4000CB97 RL_VALUE_UBYTE 0 NO_COMPU_METHOD 0 255 /end CHARACTERISTIC
/begin CHARACTERISTIC CAL_closedloop_tipout_rpm_threshold "u16_rspeed_rpm" VALUE 0x4000CB98 RL_VALUE_UWORD 0 CM_u16_rspeed_rpm 0 65535 /end CHARACTERISTIC
/begin CHARACTERISTIC CAL_maf_flow_1_limit_0 "undefined1" VALUE 0x4000CB9D RL_VALUE_UBYTE 0 NO_COMPU_METHOD 0 255 /end CHARACTERISTIC
/begin CHARACTERISTIC CAL_sensor_accel_pedal_midpoint_voltage_range "Calibration: sensor accelerator pedal midpoint voltage range (V = val*5/1023; 2-element array)." VAL_BLK 0x4000CBCC RL_VALUE_UWORD 0 CM_u16_voltage_5_1023v 0 320.307917888563 NUMBER 2 /end CHARACTERISTIC
/begin CHARACTERISTIC CAL_load_mass_per_stroke_raw_limit_3 "undefined2" VALUE 0x4000CBD8 RL_VALUE_UWORD 0 NO_COMPU_METHOD 0 65535 /end CHARACTERISTIC
/begin CHARACTERISTIC CAL_maf_flow_1_limit_2 "undefined2" VALUE 0x4000CBDE RL_VALUE_UWORD 0 NO_COMPU_METHOD 0 65535 /end CHARACTERISTIC
/begin CHARACTERISTIC CAL_maf_flow_1_threshold_4 "undefined2" VALUE 0x4000CBE0 RL_VALUE_UWORD 0 NO_COMPU_METHOD 0 65535 /end CHARACTERISTIC
/begin CHARACTERISTIC CAL_knock_octane_scaler_short_term_limit "undefined2" VALUE 0x4000CBF8 RL_VALUE_UWORD 0 NO_COMPU_METHOD 0 65535 /end CHARACTERISTIC
/begin CHARACTERISTIC CAL_knock_threshold_obd_ii_check_enable_engine_speed "Calibration: knock threshold OBD-II check enable engine speed (RPM)." VALUE 0x4000CBFA RL_VALUE_UWORD 0 CM_u16_rspeed_rpm 0 65535 /end CHARACTERISTIC
/begin CHARACTERISTIC CAL_knock_threshold_obd_ii_check_enable_load "Calibration: knock threshold OBD-II check enable load (val/100)." VALUE 0x4000CBFC RL_VALUE_UBYTE 0 CM_u8_factor_1_100 0 255 /end CHARACTERISTIC
/begin CHARACTERISTIC CAL_sensor_lat_accel_raw_threshold "Calibration: sensor lateral accelerator threshold (g = val/255)." VALUE 0x4000CC01 RL_VALUE_UBYTE 0 CM_u8_accel_1_255g 0 1 /end CHARACTERISTIC
/begin CHARACTERISTIC CAL_sensor_lat_accel_smoothing_factor "Calibration: sensor lateral accelerator smoothing factor (val/255)." VALUE 0x4000CC02 RL_VALUE_UBYTE 0 CM_u8_factor_1_255 0 100 /end CHARACTERISTIC
/begin CHARACTERISTIC CAL_tps_obd_throttle_model_gain_opening "uint8_t" VALUE 0x4000CC4E RL_VALUE_UBYTE 0 NO_COMPU_METHOD 0 255 /end CHARACTERISTIC
/begin CHARACTERISTIC CAL_tps_obd_throttle_model_gain_closing "uint8_t" VALUE 0x4000CC4F RL_VALUE_UBYTE 0 NO_COMPU_METHOD 0 255 /end CHARACTERISTIC
/begin CHARACTERISTIC CAL_tps_obd_throttle_model_step_max_opening "uint16_t" VALUE 0x4000CC50 RL_VALUE_UWORD 0 NO_COMPU_METHOD 0 65535 /end CHARACTERISTIC
/begin CHARACTERISTIC CAL_tps_obd_throttle_model_step_max_closing "uint16_t" VALUE 0x4000CC52 RL_VALUE_UWORD 0 NO_COMPU_METHOD 0 65535 /end CHARACTERISTIC
/begin CHARACTERISTIC CAL_tps_obd_throttle_model_slewrate_accel "uint8_t" VALUE 0x4000CC54 RL_VALUE_UBYTE 0 NO_COMPU_METHOD 0 255 /end CHARACTERISTIC
/begin CHARACTERISTIC CAL_tps_obd_throttle_model_slewrate_rev_closing "uint8_t" VALUE 0x4000CC56 RL_VALUE_UBYTE 0 NO_COMPU_METHOD 0 255 /end CHARACTERISTIC
/begin CHARACTERISTIC CAL_tps_obd_throttle_model_slewrate_rev_opening "uint8_t" VALUE 0x4000CC57 RL_VALUE_UBYTE 0 NO_COMPU_METHOD 0 255 /end CHARACTERISTIC
/begin CHARACTERISTIC CAL_tps_obd_throttle_monitor_error_threshold "uint16_t" VALUE 0x4000CC58 RL_VALUE_UWORD 0 NO_COMPU_METHOD 0 65535 /end CHARACTERISTIC
/begin CHARACTERISTIC CAL_tps_obd_throttle_monitor_fail_threshold "uint16_t" VALUE 0x4000CC5A RL_VALUE_UWORD 0 NO_COMPU_METHOD 0 65535 /end CHARACTERISTIC
/begin CHARACTERISTIC CAL_tps_obd_throttle_monitor_tps_rate_blank_threshold "uint16_t" VALUE 0x4000CC5C RL_VALUE_UWORD 0 NO_COMPU_METHOD 0 65535 /end CHARACTERISTIC
/begin CHARACTERISTIC CAL_tps_obd_throttle_monitor_blank_time "u8_time_5ms" VALUE 0x4000CC5E RL_VALUE_UBYTE 0 CM_u8_time_5ms 0 1275 /end CHARACTERISTIC
/begin CHARACTERISTIC CAL_load_filter_low_pass_coeff "Calibration: load filter low pass coeff (val/255)." VALUE 0x4000CCC3 RL_VALUE_UBYTE 0 CM_u8_factor_1_255 0 100 /end CHARACTERISTIC
/begin AXIS_PTS CAL_ign_base_ips_X_engine_speed "Calibration: X-axis (engine speed) for the ignition base IPS table (RPM = val*125/4+500; 20-element array)." 0x4000CFF4 NO_INPUT_QUANTITY RL_AXIS_UBYTE 0 CM_u8_rspeed_125_4_500rpm 20 500 8468.75 /end AXIS_PTS
/begin AXIS_PTS CAL_ign_base_ips_Y_load "Calibration: Y-axis (load) for the ignition base IPS table (mg/stroke = val*1173; 20-element array)." 0x4000D008 NO_INPUT_QUANTITY RL_AXIS_UBYTE 0 CM_u8_load_1173mg_255stroke 20 0 1173 /end AXIS_PTS
/begin CHARACTERISTIC CAL_ign_base_ips "Calibration: ignition base IPS (° = val/4−10; 400-element array)." MAP 0x4000D01C RL_VALUE_UBYTE 0 CM_u8_angle_1_4_10deg -10 53.75
 /begin AXIS_DESCR COM_AXIS NO_INPUT_QUANTITY CM_u8_rspeed_125_4_500rpm 20 500 8468.75 AXIS_PTS_REF CAL_ign_base_ips_X_engine_speed /end AXIS_DESCR
 /begin AXIS_DESCR COM_AXIS NO_INPUT_QUANTITY CM_u8_load_1173mg_255stroke 20 0 1173 AXIS_PTS_REF CAL_ign_base_ips_Y_load /end AXIS_DESCR
/end CHARACTERISTIC
/begin CHARACTERISTIC CAL_tps_obd_throttle_monitor_pass_threshold "u8_count" VALUE 0x4000D3F1 RL_VALUE_UBYTE 0 NO_COMPU_METHOD 0 255 /end CHARACTERISTIC
/begin AXIS_PTS CAL_fuel_pump_command_X_pressure "Calibration: X-axis (pressure) for the fuel pump command table (mbar; 8-element array)." 0x4000D4F0 V_CAL_fuel_pump_command_X_pressure RL_AXIS_UWORD 0 CM_u16_pressure_mbar 8 0 65535 /end AXIS_PTS
/begin AXIS_PTS CAL_fuel_pump_command_Y_estimated_inj_flow "Calibration: Y-axis (estimated inj flow) for the fuel pump command table (8-element array)." 0x4000D500 NO_INPUT_QUANTITY RL_AXIS_UWORD 0 NO_COMPU_METHOD 8 0 65535 /end AXIS_PTS
/begin CHARACTERISTIC CAL_fuel_pump_command "Calibration: fuel pump command (val/10000; 64-element array)." MAP 0x4000D510 RL_VALUE_UWORD 0 CM_u16_factor_1_10000 0 655.35
 /begin AXIS_DESCR COM_AXIS V_CAL_fuel_pump_command_X_pressure CM_u16_pressure_mbar 8 0 65535 AXIS_PTS_REF CAL_fuel_pump_command_X_pressure /end AXIS_DESCR
 /begin AXIS_DESCR COM_AXIS NO_INPUT_QUANTITY NO_COMPU_METHOD 8 0 65535 AXIS_PTS_REF CAL_fuel_pump_command_Y_estimated_inj_flow /end AXIS_DESCR
/end CHARACTERISTIC
/begin AXIS_PTS CAL_sensor_o2_afr_diag_scaling_X_voltage "Calibration: X-axis (voltage) for the sensor O2 AFR diag scaling table (V = val*5/1023; 16-element array)." 0x4000D664 NO_INPUT_QUANTITY RL_AXIS_UWORD 0 CM_u16_voltage_5_1023v 16 0 320.307917888563 /end AXIS_PTS
/begin CHARACTERISTIC CAL_sensor_o2_afr_diag_scaling "Calibration: sensor O2 AFR diag scaling (val/100; 16-element array)." CURVE 0x4000D684 RL_VALUE_UWORD 0 CM_u16_afr_1_100 0 655.35
 /begin AXIS_DESCR COM_AXIS NO_INPUT_QUANTITY CM_u16_voltage_5_1023v 16 0 320.307917888563 AXIS_PTS_REF CAL_sensor_o2_afr_diag_scaling_X_voltage /end AXIS_DESCR
/end CHARACTERISTIC
/begin AXIS_PTS CAL_cac_pump_dutycycle_X_manifold_temp "Calibration: X-axis (manifold temp) for the charge-air-cooler pump dutycycle table (°C = val*5/8−40; 8-element array)." 0x4000D724 obd_ii_manifold_temp RL_AXIS_UBYTE 0 CM_u8_temp_5_8_40c 8 -40 119.375 /end AXIS_PTS
/begin CHARACTERISTIC CAL_cac_pump_dutycycle "Calibration: charge-air-cooler pump dutycycle (val/255; 8-element array)." CURVE 0x4000D72C RL_VALUE_UBYTE 0 CM_u8_factor_1_255 0 100
 /begin AXIS_DESCR COM_AXIS obd_ii_manifold_temp CM_u8_temp_5_8_40c 8 -40 119.375 AXIS_PTS_REF CAL_cac_pump_dutycycle_X_manifold_temp /end AXIS_DESCR
/end CHARACTERISTIC
/begin AXIS_PTS CAL_ign_retard_recovery_step_X_engine_speed "Calibration: X-axis (engine speed) for the ignition retard recovery step table (RPM = val*125/4+500; 8-element array)." 0x4000D73C NO_INPUT_QUANTITY RL_AXIS_UBYTE 0 CM_u8_rspeed_125_4_500rpm 8 500 8468.75 /end AXIS_PTS
/begin AXIS_PTS CAL_ign_retard_recovery_step_Y_load "Calibration: Y-axis (load) for the ignition retard recovery step table (mg/stroke = val*4; 8-element array)." 0x4000D744 load_mass_per_stroke RL_AXIS_UBYTE 0 CM_u8_load_4mg_stroke 8 0 1020 /end AXIS_PTS
/begin CHARACTERISTIC CAL_ign_retard_recovery_step "Calibration: ignition retard recovery step (° = val/4; 64-element array)." MAP 0x4000D74C RL_VALUE_SBYTE 0 CM_u8_angle_1_4deg -32 31.75
 /begin AXIS_DESCR COM_AXIS NO_INPUT_QUANTITY CM_u8_rspeed_125_4_500rpm 8 500 8468.75 AXIS_PTS_REF CAL_ign_retard_recovery_step_X_engine_speed /end AXIS_DESCR
 /begin AXIS_DESCR COM_AXIS load_mass_per_stroke CM_u8_load_4mg_stroke 8 0 1020 AXIS_PTS_REF CAL_ign_retard_recovery_step_Y_load /end AXIS_DESCR
/end CHARACTERISTIC
/begin AXIS_PTS CAL_cac_pump_dc_drive_output_X_target_dutycycle "Calibration: X-axis (target dutycycle) for the charge-air-cooler pump duty cycle drive output table (val/255; 8-element array)." 0x4000D8DC cac_pump_dutycycle RL_AXIS_UBYTE 0 CM_u8_factor_1_255 8 0 100 /end AXIS_PTS
/begin CHARACTERISTIC CAL_cac_pump_dc_drive_output "Calibration: charge-air-cooler pump duty cycle drive output (val/255; 8-element array)." CURVE 0x4000D8E4 RL_VALUE_UBYTE 0 CM_u8_factor_1_255 0 100
 /begin AXIS_DESCR COM_AXIS cac_pump_dutycycle CM_u8_factor_1_255 8 0 100 AXIS_PTS_REF CAL_cac_pump_dc_drive_output_X_target_dutycycle /end AXIS_DESCR
/end CHARACTERISTIC
/begin AXIS_PTS CAL_sensor_tmap_expected_temp_X_rpm "Calibration: X-axis (rpm) for the sensor TMAP expected temperature table (RPM = val*125/4+500; 8-element array)." 0x4000D90C NO_INPUT_QUANTITY RL_AXIS_UBYTE 0 CM_u8_rspeed_125_4_500rpm 8 500 8468.75 /end AXIS_PTS
/begin AXIS_PTS CAL_sensor_tmap_expected_temp_Y_load "Calibration: Y-axis (load) for the sensor TMAP expected temperature table (mg/stroke = val*4; 8-element array)." 0x4000D914 NO_INPUT_QUANTITY RL_AXIS_UBYTE 0 CM_u8_load_4mg_stroke 8 0 1020 /end AXIS_PTS
/begin CHARACTERISTIC CAL_sensor_tmap_expected_temp "Calibration: sensor TMAP expected temperature (°C = val*5/8−40; 64-element array)." MAP 0x4000D91C RL_VALUE_UBYTE 0 CM_u8_temp_5_8_40c -40 119.375
 /begin AXIS_DESCR COM_AXIS NO_INPUT_QUANTITY CM_u8_rspeed_125_4_500rpm 8 500 8468.75 AXIS_PTS_REF CAL_sensor_tmap_expected_temp_X_rpm /end AXIS_DESCR
 /begin AXIS_DESCR COM_AXIS NO_INPUT_QUANTITY CM_u8_load_4mg_stroke 8 0 1020 AXIS_PTS_REF CAL_sensor_tmap_expected_temp_Y_load /end AXIS_DESCR
/end CHARACTERISTIC
/begin AXIS_PTS CAL_load_plausibility_test_delta_X_rpm "Calibration: X-axis (rpm) for the load plausibility test delta table (RPM = val*125/4+500; 8-element array)." 0x4000D98C NO_INPUT_QUANTITY RL_AXIS_UBYTE 0 CM_u8_rspeed_125_4_500rpm 8 500 8468.75 /end AXIS_PTS
/begin AXIS_PTS CAL_load_plausibility_test_delta_Y_tps "Calibration: Y-axis (tps) for the load plausibility test delta table (val/255; 8-element array)." 0x4000D994 NO_INPUT_QUANTITY RL_AXIS_UBYTE 0 CM_u8_factor_1_255 8 0 100 /end AXIS_PTS
/begin CHARACTERISTIC CAL_load_plausibility_test_delta "Calibration: load plausibility test delta (mg/stroke = val*2; 64-element array)." MAP 0x4000D99C RL_VALUE_UBYTE 0 CM_u8_load_2mg_stroke 0 510
 /begin AXIS_DESCR COM_AXIS NO_INPUT_QUANTITY CM_u8_rspeed_125_4_500rpm 8 500 8468.75 AXIS_PTS_REF CAL_load_plausibility_test_delta_X_rpm /end AXIS_DESCR
 /begin AXIS_DESCR COM_AXIS NO_INPUT_QUANTITY CM_u8_factor_1_255 8 0 100 AXIS_PTS_REF CAL_load_plausibility_test_delta_Y_tps /end AXIS_DESCR
/end CHARACTERISTIC
/begin AXIS_PTS CAL_inj_cranking_enrichment_load_X_load "Calibration: X-axis (load) for the injector cranking enrichment load table (mg/stroke = val*4; 6-element array)." 0x4000E00A load_mass_per_stroke RL_AXIS_UBYTE 0 CM_u8_load_4mg_stroke 6 0 1020 /end AXIS_PTS
/begin CHARACTERISTIC CAL_inj_cranking_enrichment_load "Calibration: injector cranking enrichment load (val/255; 6-element array)." CURVE 0x4000E010 RL_VALUE_UBYTE 0 CM_u8_factor_1_255 0 100
 /begin AXIS_DESCR COM_AXIS load_mass_per_stroke CM_u8_load_4mg_stroke 6 0 1020 AXIS_PTS_REF CAL_inj_cranking_enrichment_load_X_load /end AXIS_DESCR
/end CHARACTERISTIC
/begin AXIS_PTS CAL_sensor_obd_ii_p0106_maf_pressure_correction_X_maf_flow "Calibration: X-axis (maf flow) for the sensor OBD-II P0106 MAF pressure correction table (g/s; 8-element array)." 0x4000E048 V_CAL_sensor_obd_ii_p0106_maf_pressure_correction_X_maf_flow RL_AXIS_UBYTE 0 CM_u8_flow_g_s 8 0 255 /end AXIS_PTS
/begin CHARACTERISTIC CAL_sensor_obd_ii_p0106_maf_pressure_correction "Calibration: sensor OBD-II P0106 MAF pressure correction (mbar; 8-element array)." CURVE 0x4000E050 RL_VALUE_UBYTE 0 CM_u16_pressure_mbar 0 255
 /begin AXIS_DESCR COM_AXIS V_CAL_sensor_obd_ii_p0106_maf_pressure_correction_X_maf_flow CM_u8_flow_g_s 8 0 255 AXIS_PTS_REF CAL_sensor_obd_ii_p0106_maf_pressure_correction_X_maf_flow /end AXIS_DESCR
/end CHARACTERISTIC
/begin AXIS_PTS CAL_inj_flow_rate_X_fuel_pressure "Calibration: X-axis (fuel pressure) for the injector flow rate table (mbar; 8-element array)." 0x4000E168 fuel_pressure_manifold_relative RL_AXIS_UWORD 0 CM_u16_pressure_mbar 8 0 65535 /end AXIS_PTS
/begin CHARACTERISTIC CAL_inj_flow_rate "Calibration: injector flow rate (mg/s; 8-element array)." CURVE 0x4000E178 RL_VALUE_UWORD 0 CM_u16_flow_mg_s 0 65535
 /begin AXIS_DESCR COM_AXIS fuel_pressure_manifold_relative CM_u16_pressure_mbar 8 0 65535 AXIS_PTS_REF CAL_inj_flow_rate_X_fuel_pressure /end AXIS_DESCR
/end CHARACTERISTIC
/begin AXIS_PTS CAL_tpstarget_low_gear_tour_manual_X_pps "Calibration: X-axis (pps) for the tpstarget low gear tour manual table (val/1023; 16-element array)." 0x4000E228 NO_INPUT_QUANTITY RL_AXIS_UWORD 0 CM_u16_factor_1_1023 16 0 6406.15835777126 /end AXIS_PTS
/begin CHARACTERISTIC CAL_tpstarget_low_gear_tour_manual "Calibration: tpstarget low gear tour manual (val/1023; 16-element array)." CURVE 0x4000E248 RL_VALUE_UWORD 0 CM_u16_factor_1_1023 0 6406.15835777126
 /begin AXIS_DESCR COM_AXIS NO_INPUT_QUANTITY CM_u16_factor_1_1023 16 0 6406.15835777126 AXIS_PTS_REF CAL_tpstarget_low_gear_tour_manual_X_pps /end AXIS_DESCR
/end CHARACTERISTIC
/begin AXIS_PTS CAL_tpssmooth_increment_parking_X_tps_diff "Calibration: X-axis (tps diff) for the tpssmooth increment parking table (val/255; 8-element array)." 0x4000E268 NO_INPUT_QUANTITY RL_AXIS_UBYTE 0 CM_u8_factor_1_255 8 0 100 /end AXIS_PTS
/begin CHARACTERISTIC CAL_tpssmooth_increment_parking "Calibration: tpssmooth increment parking (val/255; 8-element array)." CURVE 0x4000E270 RL_VALUE_UBYTE 0 CM_u8_factor_1_255 0 100
 /begin AXIS_DESCR COM_AXIS NO_INPUT_QUANTITY CM_u8_factor_1_255 8 0 100 AXIS_PTS_REF CAL_tpssmooth_increment_parking_X_tps_diff /end AXIS_DESCR
/end CHARACTERISTIC
/begin AXIS_PTS CAL_injtip_fuel_film_alpha_inc_X_mass_per_time "Calibration: X-axis (mass per time) for the injector tip-in fuel film alpha inc table (8-element array)." 0x4000E278 NO_INPUT_QUANTITY RL_AXIS_UBYTE 0 NO_COMPU_METHOD 8 0 255 /end AXIS_PTS
/begin CHARACTERISTIC CAL_injtip_fuel_film_alpha_inc "Calibration: injector tip-in fuel film alpha inc (val/255; 8-element array)." CURVE 0x4000E280 RL_VALUE_UBYTE 0 CM_u8_factor_1_255 0 100
 /begin AXIS_DESCR COM_AXIS NO_INPUT_QUANTITY NO_COMPU_METHOD 8 0 255 AXIS_PTS_REF CAL_injtip_fuel_film_alpha_inc_X_mass_per_time /end AXIS_DESCR
/end CHARACTERISTIC
/begin AXIS_PTS CAL_injtip_fuel_film_alpha_dec_X_mass_per_time "Calibration: X-axis (mass per time) for the injector tip-in fuel film alpha dec table (8-element array)." 0x4000E288 NO_INPUT_QUANTITY RL_AXIS_UBYTE 0 NO_COMPU_METHOD 8 0 255 /end AXIS_PTS
/begin CHARACTERISTIC CAL_injtip_fuel_film_alpha_dec "Calibration: injector tip-in fuel film alpha dec (val/255; 8-element array)." CURVE 0x4000E290 RL_VALUE_UBYTE 0 CM_u8_factor_1_255 0 100
 /begin AXIS_DESCR COM_AXIS NO_INPUT_QUANTITY NO_COMPU_METHOD 8 0 255 AXIS_PTS_REF CAL_injtip_fuel_film_alpha_dec_X_mass_per_time /end AXIS_DESCR
/end CHARACTERISTIC
/begin AXIS_PTS CAL_injtip_fuel_film_X_factor_X_load "Calibration: X-axis (factor X load) for the injector tip-in fuel film table (mg/stroke = val*4; 16-element array)." 0x4000E298 NO_INPUT_QUANTITY RL_AXIS_UBYTE 0 CM_u8_load_4mg_stroke 16 0 1020 /end AXIS_PTS
/begin CHARACTERISTIC CAL_injtip_fuel_film_X_factor "Calibration: X-axis (factor) for the injector tip-in fuel film table (val/255; 16-element array)." CURVE 0x4000E2A8 RL_VALUE_UBYTE 0 CM_u8_factor_1_255 0 100
 /begin AXIS_DESCR COM_AXIS NO_INPUT_QUANTITY CM_u8_load_4mg_stroke 16 0 1020 AXIS_PTS_REF CAL_injtip_fuel_film_X_factor_X_load /end AXIS_DESCR
/end CHARACTERISTIC
/begin AXIS_PTS CAL_inj_angle_X_engine_speed "Calibration: X-axis (engine speed) for the injector angle table (RPM = val*125/4+500; 16-element array)." 0x4000E3B8 NO_INPUT_QUANTITY RL_AXIS_UBYTE 0 CM_u8_rspeed_125_4_500rpm 16 500 8468.75 /end AXIS_PTS
/begin AXIS_PTS CAL_inj_angle_Y_load "Calibration: Y-axis (load) for the injector angle table (mg/stroke = val*4; 16-element array)." 0x4000E3C8 load_mass_per_stroke RL_AXIS_UBYTE 0 CM_u8_load_4mg_stroke 16 0 1020 /end AXIS_PTS
/begin CHARACTERISTIC CAL_inj_angle "Calibration: injector angle (° = val*720/256; 256-element array)." MAP 0x4000E3D8 RL_VALUE_UBYTE 0 CM_u8_angle_720_256deg 0 717.1875
 /begin AXIS_DESCR COM_AXIS NO_INPUT_QUANTITY CM_u8_rspeed_125_4_500rpm 16 500 8468.75 AXIS_PTS_REF CAL_inj_angle_X_engine_speed /end AXIS_DESCR
 /begin AXIS_DESCR COM_AXIS load_mass_per_stroke CM_u8_load_4mg_stroke 16 0 1020 AXIS_PTS_REF CAL_inj_angle_Y_load /end AXIS_DESCR
/end CHARACTERISTIC
/begin AXIS_PTS CAL_ign_comp_manifold_temp_X_engine_speed "Calibration: X-axis (engine speed) for the ignition compensation manifold temperature table (RPM = val*125/4+500; 16-element array)." 0x4000E608 NO_INPUT_QUANTITY RL_AXIS_UBYTE 0 CM_u8_rspeed_125_4_500rpm 16 500 8468.75 /end AXIS_PTS
/begin AXIS_PTS CAL_ign_comp_manifold_temp_Y_manifold_temp "Calibration: Y-axis (manifold temp) for the ignition compensation manifold temperature table (°C = val*5/8−40; 12-element array)." 0x4000E618 NO_INPUT_QUANTITY RL_AXIS_UBYTE 0 CM_u8_temp_5_8_40c 12 -40 119.375 /end AXIS_PTS
/begin CHARACTERISTIC CAL_ign_comp_manifold_temp "Calibration: ignition compensation manifold temperature (° = val/4−32; 192-element array)." MAP 0x4000E624 RL_VALUE_UBYTE 0 CM_u8_angle_1_4_32deg -32 31.75
 /begin AXIS_DESCR COM_AXIS NO_INPUT_QUANTITY CM_u8_rspeed_125_4_500rpm 16 500 8468.75 AXIS_PTS_REF CAL_ign_comp_manifold_temp_X_engine_speed /end AXIS_DESCR
 /begin AXIS_DESCR COM_AXIS NO_INPUT_QUANTITY CM_u8_temp_5_8_40c 12 -40 119.375 AXIS_PTS_REF CAL_ign_comp_manifold_temp_Y_manifold_temp /end AXIS_DESCR
/end CHARACTERISTIC
/begin AXIS_PTS CAL_sensor_oil_pressure_expected_X_engine_speed "Calibration: X-axis (engine speed) for the sensor oil pressure expected table (RPM = val*125/4+500; 8-element array)." 0x4000E6F4 NO_INPUT_QUANTITY RL_AXIS_UBYTE 0 CM_u8_rspeed_125_4_500rpm 8 500 8468.75 /end AXIS_PTS
/begin CHARACTERISTIC CAL_sensor_oil_pressure_expected "Calibration: sensor oil pressure expected (8-element array)." CURVE 0x4000E6FC RL_VALUE_UBYTE 0 NO_COMPU_METHOD 0 255
 /begin AXIS_DESCR COM_AXIS NO_INPUT_QUANTITY CM_u8_rspeed_125_4_500rpm 8 500 8468.75 AXIS_PTS_REF CAL_sensor_oil_pressure_expected_X_engine_speed /end AXIS_DESCR
/end CHARACTERISTIC
/begin AXIS_PTS CAL_inj_cranking_enrichment_air_temp_X_iat "Calibration: X-axis (iat) for the injector cranking enrichment air temperature table (°C = val*5/8−40; 8-element array)." 0x4000E704 NO_INPUT_QUANTITY RL_AXIS_UBYTE 0 CM_u8_temp_5_8_40c 8 -40 119.375 /end AXIS_PTS
/begin AXIS_PTS CAL_inj_cranking_enrichment_air_temp_Y_coolant_temp_engine_stopped "Calibration: Y-axis (coolant temp engine stopped) for the injector cranking enrichment air temperature table (°C = val*5/8−40; 8-element array)." 0x4000E70C coolant_temp_engine_stopped RL_AXIS_UBYTE 0 CM_u8_temp_5_8_40c 8 -40 119.375 /end AXIS_PTS
/begin CHARACTERISTIC CAL_inj_cranking_enrichment_air_temp "Calibration: injector cranking enrichment air temperature (val/255; 64-element array)." MAP 0x4000E714 RL_VALUE_UBYTE 0 CM_u8_factor_1_255 0 100
 /begin AXIS_DESCR COM_AXIS NO_INPUT_QUANTITY CM_u8_temp_5_8_40c 8 -40 119.375 AXIS_PTS_REF CAL_inj_cranking_enrichment_air_temp_X_iat /end AXIS_DESCR
 /begin AXIS_DESCR COM_AXIS coolant_temp_engine_stopped CM_u8_temp_5_8_40c 8 -40 119.375 AXIS_PTS_REF CAL_inj_cranking_enrichment_air_temp_Y_coolant_temp_engine_stopped /end AXIS_DESCR
/end CHARACTERISTIC
/begin AXIS_PTS CAL_inj_cranking_enrichment_mass_accum_X_maf_accum "Calibration: X-axis (maf accum) for the injector cranking enrichment mass accum table (g = val*8; 10-element array)." 0x4000E754 V_CAL_inj_cranking_enrichment_mass_accum_X_maf_accum RL_AXIS_UBYTE 0 CM_u8_mass_8g 10 0 2040 /end AXIS_PTS
/begin CHARACTERISTIC CAL_inj_cranking_enrichment_mass_accum "Calibration: injector cranking enrichment mass accum (10-element array)." CURVE 0x4000E75E RL_VALUE_UBYTE 0 NO_COMPU_METHOD 0 255
 /begin AXIS_DESCR COM_AXIS V_CAL_inj_cranking_enrichment_mass_accum_X_maf_accum CM_u8_mass_8g 10 0 2040 AXIS_PTS_REF CAL_inj_cranking_enrichment_mass_accum_X_maf_accum /end AXIS_DESCR
/end CHARACTERISTIC
/begin AXIS_PTS CAL_inj_cranking_enrichment_soak_time_X_engine_off_time "Calibration: X-axis (engine off time) for the injector cranking enrichment soak time table (10-element array)." 0x4000E768 V_CAL_inj_cranking_enrichment_soak_time_X_engine_off_time RL_AXIS_UBYTE 0 NO_COMPU_METHOD 10 0 255 /end AXIS_PTS
/begin CHARACTERISTIC CAL_inj_cranking_enrichment_soak_time "Calibration: injector cranking enrichment soak time (val/255; 10-element array)." CURVE 0x4000E772 RL_VALUE_UBYTE 0 CM_u8_factor_1_255 0 100
 /begin AXIS_DESCR COM_AXIS V_CAL_inj_cranking_enrichment_soak_time_X_engine_off_time NO_COMPU_METHOD 10 0 255 AXIS_PTS_REF CAL_inj_cranking_enrichment_soak_time_X_engine_off_time /end AXIS_DESCR
/end CHARACTERISTIC
/begin AXIS_PTS CAL_fuel_pressure_target_X_engine_speed "Calibration: X-axis (engine speed) for the fuel pressure target table (RPM = val*125/4+500; 8-element array)." 0x4000E77C NO_INPUT_QUANTITY RL_AXIS_UBYTE 0 CM_u8_rspeed_125_4_500rpm 8 500 8468.75 /end AXIS_PTS
/begin AXIS_PTS CAL_fuel_pressure_target_Y_load "Calibration: Y-axis (load) for the fuel pressure target table (mg/stroke = val*4; 8-element array)." 0x4000E784 load_mass_per_stroke RL_AXIS_UBYTE 0 CM_u8_load_4mg_stroke 8 0 1020 /end AXIS_PTS
/begin CHARACTERISTIC CAL_fuel_pressure_target "Calibration: fuel pressure target (mbar = val*50; 64-element array)." MAP 0x4000E78C RL_VALUE_UBYTE 0 CM_u8_pressure_50mbar 0 12750
 /begin AXIS_DESCR COM_AXIS NO_INPUT_QUANTITY CM_u8_rspeed_125_4_500rpm 8 500 8468.75 AXIS_PTS_REF CAL_fuel_pressure_target_X_engine_speed /end AXIS_DESCR
 /begin AXIS_DESCR COM_AXIS load_mass_per_stroke CM_u8_load_4mg_stroke 8 0 1020 AXIS_PTS_REF CAL_fuel_pressure_target_Y_load /end AXIS_DESCR
/end CHARACTERISTIC
/begin AXIS_PTS CAL_load_ve_for_speed_density_X_rpm "Calibration: X-axis (rpm) for the load VE for speed density table (RPM = val/4; 16-element array)." 0x4000E81C obd_ii_engine_speed RL_AXIS_UWORD 0 CM_u16_rspeed_1_4rpm 16 0 16383.75 /end AXIS_PTS
/begin AXIS_PTS CAL_load_ve_for_speed_density_Y_map "Calibration: Y-axis (map) for the load VE for speed density table (mbar; 16-element array)." 0x4000E83C map RL_AXIS_UWORD 0 CM_u16_pressure_mbar 16 0 65535 /end AXIS_PTS
/begin CHARACTERISTIC CAL_load_ve_for_speed_density "There is a speed density calculation for exhaust flow estimation. It does not effect fueling targets" MAP 0x4000E85C RL_VALUE_UWORD 0 CM_u16_factor_1_10000 0 655.35
 /begin AXIS_DESCR COM_AXIS obd_ii_engine_speed CM_u16_rspeed_1_4rpm 16 0 16383.75 AXIS_PTS_REF CAL_load_ve_for_speed_density_X_rpm /end AXIS_DESCR
 /begin AXIS_DESCR COM_AXIS map CM_u16_pressure_mbar 16 0 65535 AXIS_PTS_REF CAL_load_ve_for_speed_density_Y_map /end AXIS_DESCR
/end CHARACTERISTIC
/begin AXIS_PTS CAL_tpstarget_low_gear_sport_ips_X_pps "Calibration: X-axis (pps) for the tpstarget low gear sport IPS table (val/1023; 16-element array)." 0x4000EA5C NO_INPUT_QUANTITY RL_AXIS_UWORD 0 CM_u16_factor_1_1023 16 0 6406.15835777126 /end AXIS_PTS
/begin CHARACTERISTIC CAL_tpstarget_low_gear_sport_ips "Calibration: tpstarget low gear sport IPS (val/1023; 16-element array)." CURVE 0x4000EA7C RL_VALUE_UWORD 0 CM_u16_factor_1_1023 0 6406.15835777126
 /begin AXIS_DESCR COM_AXIS NO_INPUT_QUANTITY CM_u16_factor_1_1023 16 0 6406.15835777126 AXIS_PTS_REF CAL_tpstarget_low_gear_sport_ips_X_pps /end AXIS_DESCR
/end CHARACTERISTIC
/begin AXIS_PTS CAL_tpstarget_low_gear_sport_manual_X_pps "Calibration: X-axis (pps) for the tpstarget low gear sport manual table (val/1023; 16-element array)." 0x4000EA9C NO_INPUT_QUANTITY RL_AXIS_UWORD 0 CM_u16_factor_1_1023 16 0 6406.15835777126 /end AXIS_PTS
/begin CHARACTERISTIC CAL_tpstarget_low_gear_sport_manual "Calibration: tpstarget low gear sport manual (val/1023; 16-element array)." CURVE 0x4000EABC RL_VALUE_UWORD 0 CM_u16_factor_1_1023 0 6406.15835777126
 /begin AXIS_DESCR COM_AXIS NO_INPUT_QUANTITY CM_u16_factor_1_1023 16 0 6406.15835777126 AXIS_PTS_REF CAL_tpstarget_low_gear_sport_manual_X_pps /end AXIS_DESCR
/end CHARACTERISTIC
/begin AXIS_PTS CAL_tpstarget_low_gear_tour_ips_X_pps "Calibration: X-axis (pps) for the tpstarget low gear tour IPS table (val/1023; 16-element array)." 0x4000EADC NO_INPUT_QUANTITY RL_AXIS_UWORD 0 CM_u16_factor_1_1023 16 0 6406.15835777126 /end AXIS_PTS
/begin CHARACTERISTIC CAL_tpstarget_low_gear_tour_ips "Calibration: tpstarget low gear tour IPS (val/1023; 16-element array)." CURVE 0x4000EAFC RL_VALUE_UWORD 0 CM_u16_factor_1_1023 0 6406.15835777126
 /begin AXIS_DESCR COM_AXIS NO_INPUT_QUANTITY CM_u16_factor_1_1023 16 0 6406.15835777126 AXIS_PTS_REF CAL_tpstarget_low_gear_tour_ips_X_pps /end AXIS_DESCR
/end CHARACTERISTIC
/begin AXIS_PTS CAL_ign_comp_manifold_temp_load_multiplier_X_engine_speed "Calibration: X-axis (engine speed) for the ignition compensation manifold temperature load multiplier table (RPM = val*125/4+500; 16-element array)." 0x4000EB4C NO_INPUT_QUANTITY RL_AXIS_UBYTE 0 CM_u8_rspeed_125_4_500rpm 16 500 8468.75 /end AXIS_PTS
/begin AXIS_PTS CAL_ign_comp_manifold_temp_load_multiplier_Y_load "Calibration: Y-axis (load) for the ignition compensation manifold temperature load multiplier table (mg/stroke = val*4; 12-element array)." 0x4000EB5C load_mass_per_stroke RL_AXIS_UBYTE 0 CM_u8_load_4mg_stroke 12 0 1020 /end AXIS_PTS
/begin CHARACTERISTIC CAL_ign_comp_manifold_temp_load_multiplier "Calibration: ignition compensation manifold temperature load multiplier (val/128; 192-element array)." MAP 0x4000EB68 RL_VALUE_UBYTE 0 CM_u8_factor_1_128 0 199.21875
 /begin AXIS_DESCR COM_AXIS NO_INPUT_QUANTITY CM_u8_rspeed_125_4_500rpm 16 500 8468.75 AXIS_PTS_REF CAL_ign_comp_manifold_temp_load_multiplier_X_engine_speed /end AXIS_DESCR
 /begin AXIS_DESCR COM_AXIS load_mass_per_stroke CM_u8_load_4mg_stroke 12 0 1020 AXIS_PTS_REF CAL_ign_comp_manifold_temp_load_multiplier_Y_load /end AXIS_DESCR
/end CHARACTERISTIC
/begin AXIS_PTS CAL_load_ve_for_map_synthesis_X_rpm "Calibration: X-axis (rpm) for the load VE for MAP synthesis table (RPM = val*125/4+500; 16-element array)." 0x4000EC28 NO_INPUT_QUANTITY RL_AXIS_UBYTE 0 CM_u8_rspeed_125_4_500rpm 16 500 8468.75 /end AXIS_PTS
/begin AXIS_PTS CAL_load_ve_for_map_synthesis_Y_load "Calibration: Y-axis (load) for the load VE for MAP synthesis table (mg/stroke = val*4; 16-element array)." 0x4000EC38 load_mass_per_stroke RL_AXIS_UBYTE 0 CM_u8_load_4mg_stroke 16 0 1020 /end AXIS_PTS
/begin CHARACTERISTIC CAL_load_ve_for_map_synthesis "When CAL_ecu_load_use_tmap is false, the ECU uses the synthesized MAP (manifold_pressure_calculated) rather than the measured MAP sensor — confirming this is a MAF-primary system that models MAP as a secondary value." MAP 0x4000EC48 RL_VALUE_UBYTE 0 CM_u8_factor_1_100 0 255
 /begin AXIS_DESCR COM_AXIS NO_INPUT_QUANTITY CM_u8_rspeed_125_4_500rpm 16 500 8468.75 AXIS_PTS_REF CAL_load_ve_for_map_synthesis_X_rpm /end AXIS_DESCR
 /begin AXIS_DESCR COM_AXIS load_mass_per_stroke CM_u8_load_4mg_stroke 16 0 1020 AXIS_PTS_REF CAL_load_ve_for_map_synthesis_Y_load /end AXIS_DESCR
/end CHARACTERISTIC
/begin CHARACTERISTIC CAL_sensor_trans_temp_scaling "Calibration: sensor transmission temperature scaling (°C = val*5/8−40; 33-element array)." VAL_BLK 0x4000ED48 RL_VALUE_UBYTE 0 CM_u8_temp_5_8_40c -40 119.375 NUMBER 33 /end CHARACTERISTIC
/begin GROUP G_Fuel "Fuel and injection" ROOT
 /begin SUB_GROUP G_Fuel_closedloop G_Fuel_dfco G_Fuel_fuel G_Fuel_inj G_Fuel_injtip G_Fuel_lfb /end SUB_GROUP
/end GROUP
/begin GROUP G_Fuel_closedloop "closedloop"
 /begin REF_CHARACTERISTIC CAL_closedloop_activate_engine_timer CAL_closedloop_activate_timer_o2_check CAL_closedloop_afr CAL_closedloop_bank_sync_max_hold CAL_closedloop_cross_bank_check_enable CAL_closedloop_derivative_gain_ips CAL_closedloop_derivative_gain_table CAL_closedloop_derivative_gain_table_X_rpm CAL_closedloop_derivative_gain_table_Y_load CAL_closedloop_engine_run_learn_timer_unknown CAL_closedloop_entry_delay_power_enrich CAL_closedloop_entry_delay_time_cruise CAL_closedloop_fuel_learn_baro_min CAL_closedloop_fuel_learn_coolant_min CAL_closedloop_fuel_learn_iat_max CAL_closedloop_integral_gain_ips CAL_closedloop_integral_gain_scale_manual CAL_closedloop_integral_gain_table CAL_closedloop_integral_gain_table_X_rpm CAL_closedloop_integral_gain_table_Y_load CAL_closedloop_lean_protect_max_rpm CAL_closedloop_max_tipin_enrichment CAL_closedloop_max_tipout_enleanment CAL_closedloop_o2_sensor_threshold_lean CAL_closedloop_o2_sensor_threshold_rich CAL_closedloop_o2_sensor_voltage_switch_rich CAL_closedloop_o2_sensor_voltage_switching_lean CAL_closedloop_o2_switch_threshold CAL_closedloop_o2_switch_threshold_X_rpm CAL_closedloop_o2_switch_threshold_ips CAL_closedloop_o2_switch_timeout_engine_cycles_ips CAL_closedloop_prop_gain_lean_slow_switch_scale CAL_closedloop_proportional_gain_lean_ips CAL_closedloop_proportional_gain_lean_table CAL_closedloop_proportional_gain_lean_table_X_rpm CAL_closedloop_proportional_gain_lean_table_Y_load CAL_closedloop_proportional_gain_rich_ips CAL_closedloop_proportional_gain_rich_table CAL_closedloop_proportional_gain_rich_table_X_rpm CAL_closedloop_proportional_gain_rich_table_Y_load CAL_closedloop_proportional_gain_scale CAL_closedloop_stft_filter_unknown CAL_closedloop_stft_idle_max_limit CAL_closedloop_stft_increment_period CAL_closedloop_stft_ramp_interval_manual CAL_closedloop_tipout_holdoff_ticks CAL_closedloop_tipout_rpm_threshold /end REF_CHARACTERISTIC
/end GROUP
/begin GROUP G_Fuel_dfco "dfco" /begin REF_CHARACTERISTIC CAL_dfco_cyl_ramp_length /end REF_CHARACTERISTIC /end GROUP
/begin GROUP G_Fuel_fuel "fuel"
 /begin REF_CHARACTERISTIC CAL_fuel_level_change_threshold CAL_fuel_level_debounce_window_high_ CAL_fuel_level_debounce_window_low CAL_fuel_level_filter_coeff_fall CAL_fuel_level_filter_coeff_rise CAL_fuel_level_holdoff_count CAL_fuel_level_stable_count CAL_fuel_pressure_max CAL_fuel_pressure_target CAL_fuel_pressure_target_X_engine_speed CAL_fuel_pressure_target_Y_load CAL_fuel_pressure_target_max CAL_fuel_pressure_target_min CAL_fuel_pump_command CAL_fuel_pump_command_X_pressure CAL_fuel_pump_command_Y_estimated_inj_flow CAL_fuel_pump_integral_enable CAL_fuel_pump_integral_fuel_level_min CAL_fuel_pump_integral_gain CAL_fuel_pump_integral_hold_on_dfco CAL_fuel_pump_integral_pressure_deadband CAL_fuel_pump_integral_update_period CAL_fuel_pump_proportional_gain CAL_fuel_pump_proportional_gain_X_error CAL_fuel_pump_proportional_limit CAL_fuel_pump_reference_voltage CAL_fuel_trim_integral_max CAL_fuel_usage_to_flow_scaling /end REF_CHARACTERISTIC
/end GROUP
/begin GROUP G_Fuel_inj "inj"
 /begin REF_CHARACTERISTIC CAL_inj_accel_enrichment_load_threshold CAL_inj_accel_enrichment_load_threshold_X_rpm CAL_inj_afr_base CAL_inj_afr_base_X_engine_speed CAL_inj_afr_base_Y_engine_load CAL_inj_angle CAL_inj_angle_X_engine_speed CAL_inj_angle_Y_load CAL_inj_bank_balance CAL_inj_bank_balance_X_engine_speed CAL_inj_bank_balance_Y_load CAL_inj_coldstart_enrichment CAL_inj_coldstart_enrichment_X_coolant_temp CAL_inj_coldstart_enrichment_Y_maf_accum CAL_inj_comp_power_enrich_from_ign_retard CAL_inj_cranking_comp_air_temp CAL_inj_cranking_comp_air_temp_X_iat CAL_inj_cranking_comp_air_temp_Y_maf_accum CAL_inj_cranking_enrichment_air_temp CAL_inj_cranking_enrichment_air_temp_X_iat CAL_inj_cranking_enrichment_air_temp_Y_coolant_temp_engine_stopped CAL_inj_cranking_enrichment_coolant_ips CAL_inj_cranking_enrichment_coolant_ips_X_coolant_engine_stopped CAL_inj_cranking_enrichment_coolant_ips_Y_maf_accumulated CAL_inj_cranking_enrichment_coolant_manual CAL_inj_cranking_enrichment_coolant_manual_X_coolant_engine_stopped CAL_inj_cranking_enrichment_coolant_manual_Y_maf_accumulated CAL_inj_cranking_enrichment_load CAL_inj_cranking_enrichment_load_X_load CAL_inj_cranking_enrichment_mass_accum CAL_inj_cranking_enrichment_mass_accum_X_maf_accum CAL_inj_cranking_enrichment_soak_time CAL_inj_cranking_enrichment_soak_time_X_engine_off_time CAL_inj_deadtime_base CAL_inj_deadtime_base_X_car_voltage CAL_inj_deadtime_base_Y_fuel_pressure CAL_inj_deadtime_comp_iat CAL_inj_efficiency CAL_inj_efficiency_X_engine_speed CAL_inj_efficiency_Y_engine_load CAL_inj_enrichment_charge_air_temp CAL_inj_enrichment_charge_air_temp_X_load CAL_inj_enrichment_charge_air_temp_Y_charge_temp CAL_inj_flow_rate CAL_inj_flow_rate_X_fuel_pressure CAL_inj_fuel_learn_lean_time_limit CAL_inj_fuel_learn_offset_maf_max CAL_inj_fuel_learn_rich_time_limit CAL_inj_fuel_learn_step_period CAL_inj_fuel_learn_stft_rich_limit CAL_inj_fuel_learn_time_step CAL_inj_fuel_learn_zone_2_load_max CAL_inj_fuel_learn_zone_2_load_min CAL_inj_fuel_learn_zone_2_maf_max CAL_inj_fuel_learn_zone_2_maf_min CAL_inj_fuel_learn_zone_2_max CAL_inj_fuel_learn_zone_2_min CAL_inj_fuel_learn_zone_3_load_min CAL_inj_fuel_learn_zone_3_maf_min CAL_inj_fuel_learn_zone_3_max CAL_inj_fuel_learn_zone_3_min CAL_inj_max_duty_cycle_limit CAL_inj_post_start_tipin_factor CAL_inj_post_start_tipin_factor_X_rise_rate CAL_inj_post_start_tipout_factor CAL_inj_post_start_tipout_factor_X_drop_rate CAL_inj_post_start_transient_scaler CAL_inj_post_start_transient_scaler_X_mass_accum CAL_inj_post_start_transient_scaler_Y_coolant_temp CAL_inj_post_start_trim_decay_lean CAL_inj_post_start_trim_decay_lean_X_maf_accum CAL_inj_post_start_trim_decay_lean_Y_coolant_temp CAL_inj_post_start_trim_decay_rich CAL_inj_post_start_trim_decay_rich_X_mass_accum CAL_inj_post_start_trim_decay_rich_Y_coolant_temp CAL_inj_soak_time_max CAL_inj_startup_enrichment_offset CAL_inj_startup_enrichment_offset_X_coolant_temp_engine_stopped CAL_inj_stft_limit CAL_inj_warmup_factor_ips CAL_inj_warmup_factor_ips_X_load CAL_inj_warmup_factor_ips_Y_coolant CAL_inj_warmup_factor_manual CAL_inj_warmup_factor_manual_X_load CAL_inj_warmup_factor_manual_Y_cooland /end REF_CHARACTERISTIC
/end GROUP
/begin GROUP G_Fuel_injtip "injtip"
 /begin REF_CHARACTERISTIC CAL_injtip_comp_base CAL_injtip_comp_load1 CAL_injtip_comp_load1_X_load CAL_injtip_comp_negative_load CAL_injtip_comp_negative_load_X_load CAL_injtip_dfco_accel_pedal_max_manual_clutch_disengage CAL_injtip_dfco_disable_accel_pedal CAL_injtip_dfco_disable_temp CAL_injtip_dfco_disasble_ingear_ips CAL_injtip_dfco_disasble_ingear_ips_X_coolant_temp CAL_injtip_dfco_disasble_ingear_manual CAL_injtip_dfco_disasble_ingear_manual_X_coolant_temp CAL_injtip_dfco_disasble_neutral CAL_injtip_dfco_disasble_neutral_X_coolant_temp CAL_injtip_dfco_enable_accel_pedal CAL_injtip_dfco_enable_rpm_ips_alt CAL_injtip_dfco_enable_rpm_ips_alt_X_coolant_temp CAL_injtip_dfco_enable_rpm_ips_firstgear CAL_injtip_dfco_enable_rpm_ips_firstgear_X_coolant CAL_injtip_dfco_enable_rpm_manual_alt CAL_injtip_dfco_enable_rpm_manual_alt_X_coolant_temp CAL_injtip_dfco_enable_rpm_manual_clutch_disengage CAL_injtip_dfco_enable_speed CAL_injtip_dfco_enable_temp CAL_injtip_dfco_ips_default CAL_injtip_dfco_ips_default_X_coolant_temp CAL_injtip_dfco_low_speed_threshold CAL_injtip_dfco_manual_default CAL_injtip_dfco_manual_default_X_coolant_temp CAL_injtip_dfco_min_runtime CAL_injtip_dfco_pedal_ramp_target CAL_injtip_dfco_pedal_ramp_target_X_pps CAL_injtip_dfco_recovery_enrich_by_duration CAL_injtip_dfco_recovery_enrichment_max_rpm CAL_injtip_fuel_film_X_factor CAL_injtip_fuel_film_X_factor_X_load CAL_injtip_fuel_film_alpha_dec CAL_injtip_fuel_film_alpha_dec_X_mass_per_time CAL_injtip_fuel_film_alpha_inc CAL_injtip_fuel_film_alpha_inc_X_mass_per_time CAL_injtip_fuel_film_disable_default_coeff CAL_injtip_fuel_film_xtau_enable CAL_injtip_in_adj_gears CAL_injtip_in_adj_gears_6 CAL_injtip_in_coolant_scale CAL_injtip_in_coolant_scale_X_coolant_temp CAL_injtip_in_rpm_decay CAL_injtip_in_rpm_decay_X_rpm CAL_injtip_in_rpm_scale CAL_injtip_in_rpm_scale_X_rpm CAL_injtip_in_threshold CAL_injtip_out_coolant_scale CAL_injtip_out_coolant_scale_X_rpm CAL_injtip_out_rpm_decay CAL_injtip_out_rpm_decay_X_rpm CAL_injtip_out_rpm_scale CAL_injtip_out_rpm_scale_X_rpm CAL_injtip_out_threshold CAL_injtip_overrun_hysteresis_timer CAL_injtip_overrun_inhibit_timer CAL_injtip_tipin_decay_rate_divider CAL_injtip_tipout_decay_rate_divider CAL_injtip_transient_throttle_response_time CAL_injtip_transient_throttle_response_time_X_coolant_tmp CAL_injtip_transient_throttle_response_time_Y_rpm /end REF_CHARACTERISTIC
/end GROUP
/begin GROUP G_Fuel_lfb "lfb"
 /begin REF_CHARACTERISTIC CAL_lfb_brake_off_hold_ticks CAL_lfb_clutch_threshold CAL_lfb_detect_carspeed_min CAL_lfb_pedal_override_rate CAL_lfb_pulse_enable CAL_lfb_pulse_toggle_period CAL_lfb_timer_entry CAL_lfb_timer_hold CAL_lfb_tps_max /end REF_CHARACTERISTIC
/end GROUP
/begin GROUP G_Ignition "Ignition and knock" ROOT /begin SUB_GROUP G_Ignition_ign G_Ignition_knock G_Ignition_roughness /end SUB_GROUP /end GROUP
/begin GROUP G_Ignition_ign "ign"
 /begin REF_CHARACTERISTIC CAL_ign_base_ips CAL_ign_base_ips_X_engine_speed CAL_ign_base_ips_Y_load CAL_ign_base_manual CAL_ign_base_manual_X_engine_speed CAL_ign_base_manual_Y_load CAL_ign_comp_ac_compressor_active CAL_ign_comp_coldstart CAL_ign_comp_coldstart_X_coolant_temp CAL_ign_comp_coolant_engine_stopped_max CAL_ign_comp_coolant_engine_stopped_min CAL_ign_comp_coolant_engine_stopped_min_400086A2 CAL_ign_comp_coolant_ips_flags CAL_ign_comp_coolant_ips_flags_X_coolant_temp CAL_ign_comp_coolant_ips_noflags CAL_ign_comp_coolant_ips_noflags_X_coolant_temp CAL_ign_comp_coolant_manual1 CAL_ign_comp_coolant_manual1_X_coolant_temp CAL_ign_comp_coolant_manual_vvt_alt CAL_ign_comp_coolant_manual_vvt_alt_X_coolant_temp CAL_ign_comp_engine_air CAL_ign_comp_engine_air_X_air_temp CAL_ign_comp_idle_error CAL_ign_comp_idle_error_X_rpm CAL_ign_comp_idle_error_driveaway CAL_ign_comp_idle_error_driveaway_X_rpm CAL_ign_comp_idle_error_driveaway_rpm_max CAL_ign_comp_idle_error_driveaway_speed_max CAL_ign_comp_idle_error_moving CAL_ign_comp_idle_error_moving_X_rpm CAL_ign_comp_idle_rpm_rate CAL_ign_comp_idle_rpm_rate_X_rpm_delta CAL_ign_comp_idle_transient_advance_max CAL_ign_comp_manifold_temp CAL_ign_comp_manifold_temp_X_engine_speed CAL_ign_comp_manifold_temp_Y_manifold_temp CAL_ign_comp_manifold_temp_load_multiplier CAL_ign_comp_manifold_temp_load_multiplier_X_engine_speed CAL_ign_comp_manifold_temp_load_multiplier_Y_load CAL_ign_comp_overtemp CAL_ign_comp_overtemp_X_rpm CAL_ign_comp_overtemp_coeff CAL_ign_comp_overtemp_coeff_X_coolant_temp CAL_ign_comp_recovery_timer CAL_ign_comp_startup_ips CAL_ign_comp_startup_ips_X_coolant_temp_engine_stopped CAL_ign_comp_startup_ips_Y_maf_accumulated CAL_ign_comp_startup_manual CAL_ign_comp_startup_manual_X_maf_accum CAL_ign_comp_startup_tps CAL_ign_comp_startup_tps_X_maf_accum CAL_ign_comp_startup_tps_Y_tps CAL_ign_comp_tps_rate CAL_ign_comp_tps_rate_X_tps_rate CAL_ign_dwell_time CAL_ign_dwell_time_X_rpm CAL_ign_dwell_time_Y_ecu_voltage CAL_ign_enable_lea_knock_retard CAL_ign_fixed_timing_ips CAL_ign_fixed_timing_manual CAL_ign_idle_mode_holdover_time CAL_ign_knock_safe CAL_ign_knock_safe_X_engine_speed CAL_ign_knock_safe_Y_load CAL_ign_limit_first_gear_manual CAL_ign_limit_first_gear_manual_X_engine_speed CAL_ign_low_gear_number CAL_ign_mbt_modeled CAL_ign_mbt_modeled_X_engine_speed CAL_ign_mbt_modeled_Y_load CAL_ign_min CAL_ign_min_X_engine_speed CAL_ign_min_Y_load CAL_ign_min_engine_off CAL_ign_min_engine_off_X_engine_speed CAL_ign_min_engine_off_Y_load CAL_ign_retard_recovery_step CAL_ign_retard_recovery_step_X_engine_speed CAL_ign_retard_recovery_step_Y_load CAL_ign_target_step_advance_accel_pedal_ips CAL_ign_target_step_advance_accel_pedal_ips_X_rpm CAL_ign_target_step_advance_accel_pedal_ips_Y_pps CAL_ign_target_step_advance_accel_pedal_manual CAL_ign_target_step_advance_accel_pedal_manual_X_rpm CAL_ign_target_step_advance_accel_pedal_manual_Y_pps CAL_ign_target_step_retard_accel_pedal CAL_ign_target_step_retard_accel_pedal_X_rpm CAL_ign_target_step_retard_accel_pedal_Y_pps CAL_ign_tps_rate_decay_period_closing CAL_ign_tps_rate_decay_period_opening CAL_ign_trim_per_cyl CAL_ign_zero_gear CAL_ign_zero_load_threshold CAL_ign_zero_rpm_threshold /end REF_CHARACTERISTIC
/end GROUP
/begin GROUP G_Ignition_knock "knock"
 /begin REF_CHARACTERISTIC CAL_knock_agc_hysteresis_band CAL_knock_agc_scaling_threshold CAL_knock_agc_threshold CAL_knock_baseline_filter_alpha CAL_knock_baseline_min_clamp CAL_knock_buffer_size CAL_knock_buffer_size_X_engine_speed CAL_knock_buffer_size_Y_load CAL_knock_corr_limit CAL_knock_corr_octane_base CAL_knock_corr_temp_threshold CAL_knock_count_to_retard CAL_knock_count_to_retard_X_knock_count CAL_knock_detection_engine_speed_margin CAL_knock_detection_engine_speed_max CAL_knock_detection_engine_speed_min CAL_knock_detection_load_margin_debounce CAL_knock_detection_load_threshold CAL_knock_detection_load_threshold_X_rpm CAL_knock_freq_band_centers CAL_knock_ign_retard_decay_rate CAL_knock_inhibit_timer_tps_rate CAL_knock_inhibit_tps_max CAL_knock_inhibit_tps_max_X_rpm CAL_knock_inhibit_tps_rate1 CAL_knock_learning_load_threshold CAL_knock_learning_load_threshold_X_rpm CAL_knock_mode CAL_knock_octane_scaler_decrement CAL_knock_octane_scaler_increment CAL_knock_octane_scaler_short_term_limit CAL_knock_octane_scaler_shortterm_decrement CAL_knock_octane_scaler_shortterm_multiplier CAL_knock_peak_threshold CAL_knock_peak_threshold_X_engine_speed CAL_knock_peak_threshold_Y_load CAL_knock_retard_hold_time CAL_knock_sampling_window CAL_knock_sampling_window_X_rpm CAL_knock_sampling_window_Y_load CAL_knock_sensitivity CAL_knock_sensitivity_X_engine_speed CAL_knock_sensitivity_Y_load CAL_knock_threshold_obd_ii_check_enable_engine_speed CAL_knock_threshold_obd_ii_check_enable_load /end REF_CHARACTERISTIC
/end GROUP
/begin GROUP G_Ignition_roughness "roughness"
 /begin REF_CHARACTERISTIC CAL_roughness_cycle_count_threshold CAL_roughness_delta_rpm_smoothing_factor CAL_roughness_enable_load CAL_roughness_enable_rpm CAL_roughness_ign_adv_max CAL_roughness_ign_adv_min_sign_flipped CAL_roughness_min_edge_count CAL_roughness_peak_valley_imblance_threshold /end REF_CHARACTERISTIC
/end GROUP
/begin GROUP G_Airflow "Airflow and load" ROOT
 /begin SUB_GROUP G_Airflow_cac G_Airflow_load G_Airflow_maf G_Airflow_sensor G_Airflow_tmap /end SUB_GROUP
/end GROUP
/begin GROUP G_Airflow_cac "cac"
 /begin REF_CHARACTERISTIC CAL_cac_dutycycle_tolerance CAL_cac_pump_dc_drive_output CAL_cac_pump_dc_drive_output_X_target_dutycycle CAL_cac_pump_diag_dutycycle_min CAL_cac_pump_dutycycle CAL_cac_pump_dutycycle_X_manifold_temp CAL_cac_pwm_mismatch_threshold /end REF_CHARACTERISTIC
/end GROUP
/begin GROUP G_Airflow_load "load"
 /begin REF_CHARACTERISTIC CAL_load_alphaN_base CAL_load_alphaN_base_X_engine_speed CAL_load_alphaN_base_Y_tps CAL_load_alphaN_hold_time CAL_load_alphaN_learning_mass_accum_threshold CAL_load_alphaN_learning_rpm_rate_max CAL_load_alphaN_learning_temp_threshold CAL_load_alphaN_max_rpm CAL_load_alphaN_seed CAL_load_alphaN_seed_X_tps CAL_load_alphaN_tps_rate_closing_threshold CAL_load_alphaN_tps_rate_opening_threshold CAL_load_alphaN_use_tmap_density CAL_load_baro_gain CAL_load_baro_gain_X_rpm CAL_load_baro_gain_Y_load CAL_load_cylinder_volume CAL_load_filter_low_pass_coeff CAL_load_learning_holdoff_delay CAL_load_learning_stabilization_delay CAL_load_mass_per_stroke_raw_limit_1 CAL_load_mass_per_stroke_raw_limit_2 CAL_load_mass_per_stroke_raw_limit_3 CAL_load_plausibility_test_delta CAL_load_plausibility_test_delta_X_rpm CAL_load_plausibility_test_delta_Y_tps CAL_load_reference_charge CAL_load_reference_charge_X_rpm CAL_load_source_selection_threshold_by_tps CAL_load_source_selection_threshold_by_tps_X_rpm CAL_load_to_tps_mapping CAL_load_to_tps_mapping_X_rpm CAL_load_to_tps_mapping_Y_load CAL_load_unused1 CAL_load_unused1_X_rpm CAL_load_ve_for_map_synthesis CAL_load_ve_for_map_synthesis_X_rpm CAL_load_ve_for_map_synthesis_Y_load CAL_load_ve_for_speed_density CAL_load_ve_for_speed_density_X_rpm CAL_load_ve_for_speed_density_Y_map /end REF_CHARACTERISTIC
/end GROUP
/begin GROUP G_Airflow_maf "maf"
 /begin REF_CHARACTERISTIC CAL_maf_flow_1_limit_0 CAL_maf_flow_1_limit_2 CAL_maf_flow_1_threshold_4 /end REF_CHARACTERISTIC
/end GROUP
/begin GROUP G_Airflow_sensor "sensor"
 /begin REF_CHARACTERISTIC CAL_sensor_ac_evap_temp_filter_alpha CAL_sensor_ac_evap_temp_scaling CAL_sensor_ac_evap_temp_scaling_X_voltage CAL_sensor_accel_pedal_midpoint_voltage_range CAL_sensor_accel_pedal_pos_d_threshold CAL_sensor_accel_pedal_pos_e_threshold CAL_sensor_airtemp_tmaf_filter_alpha CAL_sensor_baro_sensor_failure_fallback CAL_sensor_clutch_disengaged_threshold CAL_sensor_clutch_engaged_threshold CAL_sensor_coolant_filter_alpha CAL_sensor_coolant_temp_derived1_scaling CAL_sensor_coolant_temp_fallback_value CAL_sensor_coolant_temp_sensor_engine_off_scaling CAL_sensor_coolant_voltage_threshold CAL_sensor_engine_air_scaling CAL_sensor_evap_purge_pressure_scaling CAL_sensor_fuel_level CAL_sensor_fuel_level_X_voltage CAL_sensor_fuel_level_sensor_voltage_threshold CAL_sensor_fuel_pressure_offset CAL_sensor_fuel_pressure_scaling CAL_sensor_iat_fallback CAL_sensor_iat_voltage_threshold CAL_sensor_intake_air_scaling CAL_sensor_intake_air_temp_filter_scaling CAL_sensor_intake_air_temp_voltage_threshold CAL_sensor_knock_voltage_threshold CAL_sensor_lat_accel_raw_threshold CAL_sensor_lat_accel_smoothing_factor CAL_sensor_maf_buffer_size CAL_sensor_maf_scaling CAL_sensor_maf_scaling_X_signal CAL_sensor_manifold_pressure_sensor_offset CAL_sensor_manifold_pressure_sensor_scaling CAL_sensor_manifold_temp_sensor_present CAL_sensor_map_avg_window_size CAL_sensor_o2_afr_diag_scaling CAL_sensor_o2_afr_diag_scaling_X_voltage CAL_sensor_o2_heater_overcurrent_threshold_mA CAL_sensor_o2_heater_undercurrent_threshold CAL_sensor_o2_heater_warmup_duration CAL_sensor_o2_heater_warmup_pwm_period CAL_sensor_o2_lean_voltage_threshold CAL_sensor_o2_lean_voltage_threshold_4000CAD4 CAL_sensor_o2_rich_voltage_threshold CAL_sensor_o2_rich_voltage_threshold_4000CAD2 CAL_sensor_obd_ii_p0106_maf_pressure_correction CAL_sensor_obd_ii_p0106_maf_pressure_correction_X_maf_flow CAL_sensor_oil_pressure_expected CAL_sensor_oil_pressure_expected_X_engine_speed CAL_sensor_pps_unknown1 CAL_sensor_temp_diagnostic_startup_delay CAL_sensor_tmap_expected_temp CAL_sensor_tmap_expected_temp_X_rpm CAL_sensor_tmap_expected_temp_Y_load CAL_sensor_tps_voltage_theshold1 CAL_sensor_tps_voltage_theshold2 CAL_sensor_trans_temp_scaling /end REF_CHARACTERISTIC
/end GROUP
/begin GROUP G_Airflow_tmap "tmap" /begin REF_CHARACTERISTIC CAL_tmap_use_for_inj CAL_tmap_use_for_load /end REF_CHARACTERISTIC /end GROUP
/begin GROUP G_Throttle "Throttle" ROOT
 /begin SUB_GROUP G_Throttle_etb G_Throttle_tps G_Throttle_tpssmooth G_Throttle_tpstarget /end SUB_GROUP
/end GROUP
/begin GROUP G_Throttle_etb "etb"
 /begin REF_CHARACTERISTIC CAL_etb_pid_integral_limit CAL_etb_pid_kd CAL_etb_pid_ki CAL_etb_pid_kp CAL_etb_pwm_period CAL_etb_tps1_max_count CAL_etb_tps2_max_count /end REF_CHARACTERISTIC
/end GROUP
/begin GROUP G_Throttle_tps "tps"
 /begin REF_CHARACTERISTIC CAL_tps_accel_pedal_zero_calibrate_timer CAL_tps_brake_safety_floor CAL_tps_brake_wheeldecel_tps_cut_threshold CAL_tps_commanded_during_fault CAL_tps_delta_rate_window_size CAL_tps_idle_request_max CAL_tps_idle_to_current_ratio_threshold CAL_tps_limit_severe_misfire_1_cut CAL_tps_limit_severe_misfire_1_cut_40008868 CAL_tps_limit_severe_misfire_multi_cut CAL_tps_limit_severe_misfire_no_cut CAL_tps_limit_warmup_stepsize CAL_tps_min CAL_tps_obd_throttle_model_gain_closing CAL_tps_obd_throttle_model_gain_opening CAL_tps_obd_throttle_model_slewrate_accel CAL_tps_obd_throttle_model_slewrate_rev_closing CAL_tps_obd_throttle_model_slewrate_rev_opening CAL_tps_obd_throttle_model_step_max_closing CAL_tps_obd_throttle_model_step_max_opening CAL_tps_obd_throttle_monitor_blank_time CAL_tps_obd_throttle_monitor_error_parity_mask CAL_tps_obd_throttle_monitor_error_threshold CAL_tps_obd_throttle_monitor_fail_threshold CAL_tps_obd_throttle_monitor_pass_threshold CAL_tps_obd_throttle_monitor_tps_rate_blank_threshold CAL_tps_rate_steadystate_threshold CAL_tps_rate_steadystate_threshold_X_rpm CAL_tps_rate_steadystate_threshold_Y_tps CAL_tps_rate_steadystate_window_size CAL_tps_scaling_factor_rpm CAL_tps_scaling_factor_rpm_X_rpm CAL_tps_warmup_max /end REF_CHARACTERISTIC
/end GROUP
/begin GROUP G_Throttle_tpssmooth "tpssmooth"
 /begin REF_CHARACTERISTIC CAL_tpssmooth_accel_pedal_modes_enable CAL_tpssmooth_decrement_by_delta CAL_tpssmooth_decrement_by_delta_X_tps_delta CAL_tpssmooth_decrement_by_rpm CAL_tpssmooth_decrement_by_rpm_X_rpm CAL_tpssmooth_decrement_comp_gears_ips CAL_tpssmooth_decrement_comp_gears_manual CAL_tpssmooth_increment_b_neutral_sport CAL_tpssmooth_increment_b_neutral_tour CAL_tpssmooth_increment_parking CAL_tpssmooth_increment_parking_X_tps_diff CAL_tpssmooth_increment_rpm CAL_tpssmooth_increment_rpm_X_rpm CAL_tpssmooth_increment_sport CAL_tpssmooth_increment_sport_X_tps_diff CAL_tpssmooth_increment_tour CAL_tpssmooth_increment_tour_X_tps_diff CAL_tpssmooth_parking_clutch_threshold CAL_tpssmooth_parking_threshold_carspeed CAL_tpssmooth_parking_threshold_gear CAL_tpssmooth_parking_threshold_tps CAL_tpssmooth_rate_closing_clamp_thresholds CAL_tpssmooth_rate_decay_closing CAL_tpssmooth_rate_decay_closing_X_rpm CAL_tpssmooth_rate_decay_opening CAL_tpssmooth_rate_decay_opening_X_rpm CAL_tpssmooth_rate_opening_clamp_thresholds CAL_tpssmooth_step_timer /end REF_CHARACTERISTIC
/end GROUP
/begin GROUP G_Throttle_tpstarget "tpstarget"
 /begin REF_CHARACTERISTIC CAL_tpstarget_low_gear_sport_ips CAL_tpstarget_low_gear_sport_ips_X_pps CAL_tpstarget_low_gear_sport_manual CAL_tpstarget_low_gear_sport_manual_X_pps CAL_tpstarget_low_gear_tour_ips CAL_tpstarget_low_gear_tour_ips_X_pps CAL_tpstarget_low_gear_tour_manual CAL_tpstarget_low_gear_tour_manual_X_pps CAL_tpstarget_pedalmap_low_gear_threshold CAL_tpstarget_sport_ips CAL_tpstarget_sport_ips_X_pps CAL_tpstarget_sport_manual CAL_tpstarget_sport_manual_X_pps CAL_tpstarget_sport_shifting CAL_tpstarget_sport_shifting_X_pps CAL_tpstarget_tour_ips CAL_tpstarget_tour_ips_X_pps CAL_tpstarget_tour_manual CAL_tpstarget_tour_manual_X_pps CAL_tpstarget_tour_shifting CAL_tpstarget_tour_shifting_X_pps /end REF_CHARACTERISTIC
/end GROUP
/end MODULE
/end PROJECT
