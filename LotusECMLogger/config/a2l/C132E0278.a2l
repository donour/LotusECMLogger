ASAP2_VERSION 1 61
/begin PROJECT C132E0278 "Lotus T6 C132E0278"
/begin HEADER "" VERSION "generated v1" /end HEADER
/begin MODULE C132E0278 ""
/begin MOD_COMMON "" BYTE_ORDER MSB_FIRST ALIGNMENT_BYTE 1 ALIGNMENT_WORD 2 ALIGNMENT_LONG 4 /end MOD_COMMON
/begin RECORD_LAYOUT RL_VALUE_ULONG FNC_VALUES 1 ULONG ROW_DIR DIRECT /end RECORD_LAYOUT
/begin RECORD_LAYOUT RL_AXIS_ULONG AXIS_PTS_X 1 ULONG INDEX_INCR DIRECT /end RECORD_LAYOUT
/begin COMPU_METHOD CM_i16_dutycycle_1_2000 "i16_dutycycle_1/2000" RAT_FUNC "%12.4" "%" COEFFS 0 1 0 0 0 0.0005 /end COMPU_METHOD
/begin COMPU_METHOD CM_i16_flow_100_1024mg_s "i16_flow_100/1024mg/s" RAT_FUNC "%12.4" "mg/s" COEFFS 0 1 0 0 0 0.09765625 /end COMPU_METHOD
/begin COMPU_METHOD CM_i16_pressure_mbar "i16_pressure_mbar" RAT_FUNC "%8.0" "mbar" COEFFS 0 1 0 0 0 1 /end COMPU_METHOD
/begin COMPU_METHOD CM_u16_angle_1_10deg "u16_angle_1/10deg" RAT_FUNC "%9.1" "deg" COEFFS 0 1 0 0 0 0.1 /end COMPU_METHOD
/begin COMPU_METHOD CM_u16_factor_1_10000 "u16_factor_1/10000" RAT_FUNC "%10.2" "%" COEFFS 0 1 0 0 0 0.01 /end COMPU_METHOD
/begin COMPU_METHOD CM_u16_factor_1_1023 "u16_factor_1/1023" RAT_FUNC "%12.4" "%" COEFFS 0 1 0 0 0 0.0977517106549365 /end COMPU_METHOD
/begin COMPU_METHOD CM_u16_factor_1_4095 "u16_factor_1/4095" RAT_FUNC "%12.4" "%" COEFFS 0 1 0 0 0 0.0244200244200244 /end COMPU_METHOD
/begin COMPU_METHOD CM_u16_flow_10mg_s "u16_flow_10mg/s" RAT_FUNC "%8.0" "mg/s" COEFFS 0 1 0 0 0 10 /end COMPU_METHOD
/begin COMPU_METHOD CM_u16_flow_mg_s "u16_flow_mg/s" RAT_FUNC "%8.0" "mg/s" COEFFS 0 1 0 0 0 1 /end COMPU_METHOD
/begin COMPU_METHOD CM_u16_mass_mg "u16_mass_mg" RAT_FUNC "%8.0" "mg" COEFFS 0 1 0 0 0 1 /end COMPU_METHOD
/begin COMPU_METHOD CM_u16_power_1_100kw "u16_power_1/100kw" RAT_FUNC "%10.2" "kW" COEFFS 0 1 0 0 0 0.01 /end COMPU_METHOD
/begin COMPU_METHOD CM_u16_slip_1_8pct "u16_slip_1/8pct" RAT_FUNC "%11.3" "%" COEFFS 0 1 0 0 0 0.125 /end COMPU_METHOD
/begin COMPU_METHOD CM_u16_voltage_18_1023v "u16_voltage_18/1023v" RAT_FUNC "%12.4" "V" COEFFS 0 1 0 0 0 0.0175953079178886 /end COMPU_METHOD
/begin COMPU_METHOD CM_u16_voltage_5_1023v "u16_voltage_5/1023v" RAT_FUNC "%12.4" "V" COEFFS 0 1 0 0 0 0.00488758553274682 /end COMPU_METHOD
/begin COMPU_METHOD CM_u16_voltage_5_4095v "u16_voltage_5/4095v" RAT_FUNC "%12.4" "V" COEFFS 0 1 0 0 0 0.00122100122100122 /end COMPU_METHOD
/begin COMPU_METHOD CM_u32_time_100ns "u32_time_100ns" RAT_FUNC "%8.0" "ns" COEFFS 0 1 0 0 0 100 /end COMPU_METHOD
/begin COMPU_METHOD CM_u8_accel_1_100g "u8_accel_1/100g" RAT_FUNC "%10.2" "g" COEFFS 0 1 0 0 0 0.01 /end COMPU_METHOD
/begin COMPU_METHOD CM_u8_angle_1_4deg "u8_angle_1/4deg" RAT_FUNC "%10.2" "deg" COEFFS 0 1 0 0 0 0.25 /end COMPU_METHOD
/begin COMPU_METHOD CM_u8_factor_1_100 "u8_factor_1/100" RAT_FUNC "%8.0" "%" COEFFS 0 1 0 0 0 1 /end COMPU_METHOD
/begin COMPU_METHOD CM_u8_factor_1_255 "u8_factor_1/255" RAT_FUNC "%12.4" "%" COEFFS 0 1 0 0 0 0.392156862745098 /end COMPU_METHOD
/begin COMPU_METHOD CM_u8_flow_2g_s "u8_flow_2g/s" RAT_FUNC "%8.0" "g/s" COEFFS 0 1 0 0 0 2 /end COMPU_METHOD
/begin COMPU_METHOD CM_u8_load_1173mg_255stroke "u8_load_1173mg/255stroke" RAT_FUNC "%9.1" "mg/stroke" COEFFS 0 1 0 0 0 4.6 /end COMPU_METHOD
/begin COMPU_METHOD CM_u8_load_mg_stroke "u8_load_mg/stroke" RAT_FUNC "%8.0" "mg/stroke" COEFFS 0 1 0 0 0 1 /end COMPU_METHOD
/begin COMPU_METHOD CM_u8_percent_100_256_50 "u8_percent_100/256-50" RAT_FUNC "%12.4" "%" COEFFS 0 1 50 0 0 0.390625 /end COMPU_METHOD
/begin COMPU_METHOD CM_u8_pressure_4mbar "u8_pressure_4mbar" RAT_FUNC "%8.0" "mbar" COEFFS 0 1 0 0 0 4 /end COMPU_METHOD
/begin COMPU_METHOD CM_u8_pressure_50mbar "u8_pressure_50mbar" RAT_FUNC "%8.0" "mbar" COEFFS 0 1 0 0 0 50 /end COMPU_METHOD
/begin COMPU_METHOD CM_u8_rspeed_2rpm "u8_rspeed_2rpm" RAT_FUNC "%8.0" "rpm" COEFFS 0 1 0 0 0 2 /end COMPU_METHOD
/begin COMPU_METHOD CM_u8_rspeed_rpm "u8_rspeed_rpm" RAT_FUNC "%8.0" "rpm" COEFFS 0 1 0 0 0 1 /end COMPU_METHOD
/begin COMPU_METHOD CM_u8_speed_1_100kph "u8_speed_1/100kph" RAT_FUNC "%10.2" "km/h" COEFFS 0 1 0 0 0 0.01 /end COMPU_METHOD
/begin COMPU_METHOD CM_u8_speed_kph "u8_speed_kph" RAT_FUNC "%8.0" "km/h" COEFFS 0 1 0 0 0 1 /end COMPU_METHOD
/begin COMPU_METHOD CM_u8_temp_1_10C "u8_temp_1/10C" RAT_FUNC "%9.1" "°C" COEFFS 0 1 0 0 0 0.1 /end COMPU_METHOD
/begin COMPU_METHOD CM_u8_temp_5_8_40c "u8_temp_5/8-40c" RAT_FUNC "%11.3" "°C" COEFFS 0 1 40 0 0 0.625 /end COMPU_METHOD
/begin COMPU_METHOD CM_u8_tempdelta_5_8c "u8_tempdelta_5/8c" RAT_FUNC "%11.3" "°C" COEFFS 0 1 0 0 0 0.625 /end COMPU_METHOD
/begin COMPU_METHOD CM_u8_time_100ms "u8_time_100ms" RAT_FUNC "%8.0" "ms" COEFFS 0 1 0 0 0 100 /end COMPU_METHOD
/begin COMPU_METHOD CM_u8_time_10ms "u8_time_10ms" RAT_FUNC "%8.0" "ms" COEFFS 0 1 0 0 0 10 /end COMPU_METHOD
/begin COMPU_METHOD CM_u8_time_25ms "u8_time_25ms" RAT_FUNC "%8.0" "ms" COEFFS 0 1 0 0 0 25 /end COMPU_METHOD
/begin COMPU_METHOD CM_u8_time_5ms "u8_time_5ms" RAT_FUNC "%8.0" "ms" COEFFS 0 1 0 0 0 5 /end COMPU_METHOD
/begin COMPU_METHOD CM_u8_time_ms "u8_time_ms" RAT_FUNC "%8.0" "ms" COEFFS 0 1 0 0 0 1 /end COMPU_METHOD
/begin COMPU_METHOD CM_u8_time_us "u8_time_us" RAT_FUNC "%8.0" "us" COEFFS 0 1 0 0 0 1 /end COMPU_METHOD
/begin COMPU_METHOD CM_u8_torque_nm "u8_torque_nm" RAT_FUNC "%8.0" "Nm" COEFFS 0 1 0 0 0 1 /end COMPU_METHOD
/begin COMPU_METHOD CM_u8_volume_1_10gallon "u8_volume_1/10gallon" RAT_FUNC "%9.1" "gallon" COEFFS 0 1 0 0 0 0.1 /end COMPU_METHOD
/begin MEASUREMENT obd_ii_mode2f_evap_purge_val "Mode $2F evap purge test value." UBYTE NO_COMPU_METHOD 0 0 0 255 ECU_ADDRESS 0x400021F2 /end MEASUREMENT
/begin MEASUREMENT obd_ii_dyno_mode_active "OBD-II: diag override (boolean flag)." UBYTE NO_COMPU_METHOD 0 0 0 255 ECU_ADDRESS 0x400021F3 /end MEASUREMENT
/begin MEASUREMENT obd_ii_mode2f_cooling_fan_dutycycle "Mode $2F cooling fan test duty." UBYTE NO_COMPU_METHOD 0 0 0 255 ECU_ADDRESS 0x400021F4 /end MEASUREMENT
/begin MEASUREMENT cac_pump_test_2F_dutycycle "Charge-air-cooler pump test 2F dutycycle (val/255)." UBYTE CM_u8_factor_1_255 0 0 0 100 ECU_ADDRESS 0x400021F5 /end MEASUREMENT
/begin MEASUREMENT obd_ii_mode2f_coil_pulse_timer "u8_time_5ms" UBYTE CM_u8_time_5ms 0 0 0 1275 ECU_ADDRESS 0x40002217 /end MEASUREMENT
/begin MEASUREMENT obd_ii_mode2f_184_timer_unknown "OBD-II: mode2f 184 timer (ms = val*5)." UBYTE CM_u8_time_5ms 0 0 0 1275 ECU_ADDRESS 0x40002218 /end MEASUREMENT
/begin MEASUREMENT obd_ii_mode2f_timeout "Mode $2F inactivity timeout (CAL_obd_ii_mode2f_timeout)." UWORD CM_u8_time_5ms 0 0 0 327675 ECU_ADDRESS 0x4000221A /end MEASUREMENT
/begin MEASUREMENT obd_ii_readiness_flags "OBD readiness / monitor completion bits (bit3 init, bit4 O2 response done)." UBYTE NO_COMPU_METHOD 0 0 0 255 ECU_ADDRESS 0x40002220 /end MEASUREMENT
/begin MEASUREMENT obd_ii_monitor_status_this_drive_cycle "OBD-II: monitor status this drive cycle." UWORD NO_COMPU_METHOD 0 0 0 65535 ECU_ADDRESS 0x40002222 /end MEASUREMENT
/begin MEASUREMENT obd_ii_cat_stable_timer "Catalyst monitor stability countdown (CAL_obd_ii_cat_monitor_stable_time)." UWORD NO_COMPU_METHOD 0 0 0 65535 ECU_ADDRESS 0x40002224 /end MEASUREMENT
/begin MEASUREMENT obd_ii_cat_init_counter "Catalyst monitor init countdown (CAL_obd_ii_cat_monitor_init_counter_2)." UWORD NO_COMPU_METHOD 0 0 0 65535 ECU_ADDRESS 0x40002226 /end MEASUREMENT
/begin MEASUREMENT obd_ii_cat_run_timer "Catalyst monitor minimum run countdown (CAL_obd_ii_cat_monitor_run_time_min)." UWORD NO_COMPU_METHOD 0 0 0 65535 ECU_ADDRESS 0x40002228 /end MEASUREMENT
/begin MEASUREMENT obd_ii_cat_window_timer "Catalyst monitor window countdown (CAL_obd_ii_cat_monitor_window_time)." UWORD NO_COMPU_METHOD 0 0 0 65535 ECU_ADDRESS 0x4000222A /end MEASUREMENT
/begin MEASUREMENT obd_ii_p101_config "OBD-II: P101 config (OBD-II monitor enable level)." UBYTE NO_COMPU_METHOD 0 0 0 255 ECU_ADDRESS 0x40002230 /end MEASUREMENT
/begin MEASUREMENT obd_ii_p0102_health "Debounce health for P0102: reset to CAL_obd_ii_P0102_debounce_count; +1 per passing sample (to the CAL), -1 per obd_ii_monitor_debounce_ticks failing samples; the DTC fails when it reaches 0." UBYTE NO_COMPU_METHOD 0 0 0 255 ECU_ADDRESS 0x40002231 /end MEASUREMENT
/begin MEASUREMENT obd_ii_p0103_health "Debounce health for P0103: reset to CAL_obd_ii_P0103_debounce_count; +1 per passing sample (to the CAL), -1 per obd_ii_monitor_debounce_ticks failing samples; the DTC fails when it reaches 0." UBYTE NO_COMPU_METHOD 0 0 0 255 ECU_ADDRESS 0x40002232 /end MEASUREMENT
/begin MEASUREMENT obd_ii_p0111_health "Debounce health for P0111: reset to CAL_obd_ii_P0111_debounce_count; +1 per passing sample (to the CAL), -1 per obd_ii_monitor_debounce_ticks failing samples; the DTC fails when it reaches 0." UBYTE NO_COMPU_METHOD 0 0 0 255 ECU_ADDRESS 0x40002233 /end MEASUREMENT
/begin MEASUREMENT obd_ii_p0112_health "Debounce health for P0112: reset to CAL_obd_ii_P0112_debounce_count; +1 per passing sample (to the CAL), -1 per obd_ii_monitor_debounce_ticks failing samples; the DTC fails when it reaches 0." UBYTE NO_COMPU_METHOD 0 0 0 255 ECU_ADDRESS 0x40002234 /end MEASUREMENT
/begin MEASUREMENT obd_ii_p0113_health "Debounce health for P0113: reset to CAL_obd_ii_P0113_debounce_count; +1 per passing sample (to the CAL), -1 per obd_ii_monitor_debounce_ticks failing samples; the DTC fails when it reaches 0." UBYTE NO_COMPU_METHOD 0 0 0 255 ECU_ADDRESS 0x40002235 /end MEASUREMENT
/begin MEASUREMENT obd_ii_p0071_health "Debounce health for P0071: reset to CAL_obd_ii_P0071_maturing_limit; +1 per passing sample (to the CAL), -1 per obd_ii_monitor_debounce_ticks failing samples; the DTC fails when it reaches 0." UBYTE NO_COMPU_METHOD 0 0 0 255 ECU_ADDRESS 0x40002236 /end MEASUREMENT
/begin MEASUREMENT obd_ii_p0116_health "Debounce health for P0116: reset to CAL_obd_ii_P0116_debounce_count; +1 per passing sample (to the CAL), -1 per obd_ii_monitor_debounce_ticks failing samples; the DTC fails when it reaches 0." UBYTE NO_COMPU_METHOD 0 0 0 255 ECU_ADDRESS 0x40002237 /end MEASUREMENT
/begin MEASUREMENT obd_ii_p0117_health "Debounce health for P0117: reset to CAL_obd_ii_P0117_debounce_count; +1 per passing sample (to the CAL), -1 per obd_ii_monitor_debounce_ticks failing samples; the DTC fails when it reaches 0." UBYTE NO_COMPU_METHOD 0 0 0 255 ECU_ADDRESS 0x40002238 /end MEASUREMENT
/begin MEASUREMENT obd_ii_p0118_health "Debounce health for P0118: reset to CAL_obd_ii_P0118_debounce_count; +1 per passing sample (to the CAL), -1 per obd_ii_monitor_debounce_ticks failing samples; the DTC fails when it reaches 0." UBYTE NO_COMPU_METHOD 0 0 0 255 ECU_ADDRESS 0x40002239 /end MEASUREMENT
/begin MEASUREMENT obd_ii_p0131_health "Debounce health for P0131: reset to CAL_obd_ii_P0131_debounce_count; +1 per passing sample (to the CAL), -1 per obd_ii_monitor_debounce_ticks failing samples; the DTC fails when it reaches 0." UBYTE NO_COMPU_METHOD 0 0 0 255 ECU_ADDRESS 0x4000223A /end MEASUREMENT
/begin MEASUREMENT obd_ii_p0132_health "Debounce health for P0132: reset to CAL_obd_ii_P0132_fail_count; +1 per passing sample (to the CAL), -1 per obd_ii_monitor_debounce_ticks failing samples; the DTC fails when it reaches 0." UBYTE NO_COMPU_METHOD 0 0 0 255 ECU_ADDRESS 0x4000223B /end MEASUREMENT
/begin MEASUREMENT obd_ii_p0151_health "Debounce health for P0151: reset to CAL_obd_ii_P0151_fail_count; +1 per passing sample (to the CAL), -1 per obd_ii_monitor_debounce_ticks failing samples; the DTC fails when it reaches 0." UBYTE NO_COMPU_METHOD 0 0 0 255 ECU_ADDRESS 0x4000223C /end MEASUREMENT
/begin MEASUREMENT obd_ii_p0152_health "Debounce health for P0152: reset to CAL_obd_ii_P0152_fail_count; +1 per passing sample (to the CAL), -1 per obd_ii_monitor_debounce_ticks failing samples; the DTC fails when it reaches 0." UBYTE NO_COMPU_METHOD 0 0 0 255 ECU_ADDRESS 0x4000223D /end MEASUREMENT
/begin MEASUREMENT obd_ii_p0564_health "Debounce health for P0564: reset to CAL_obd_ii_P0564_debounce_count; +1 per passing sample (to the CAL), -1 per obd_ii_monitor_debounce_ticks failing samples; the DTC fails when it reaches 0." UBYTE NO_COMPU_METHOD 0 0 0 255 ECU_ADDRESS 0x4000223E /end MEASUREMENT
/begin MEASUREMENT obd_ii_p0522_health "Debounce health for P0522: reset to CAL_obd_ii_P0522_debounce_count; +1 per passing sample (to the CAL), -1 per obd_ii_monitor_debounce_ticks failing samples; the DTC fails when it reaches 0." UBYTE NO_COMPU_METHOD 0 0 0 255 ECU_ADDRESS 0x4000223F /end MEASUREMENT
/begin MEASUREMENT obd_ii_p0523_health "Debounce health for P0523: reset to CAL_obd_ii_P0523_debounce_count; +1 per passing sample (to the CAL), -1 per obd_ii_monitor_debounce_ticks failing samples; the DTC fails when it reaches 0." UBYTE NO_COMPU_METHOD 0 0 0 255 ECU_ADDRESS 0x40002240 /end MEASUREMENT
/begin MEASUREMENT obd_ii_p0806_health "Debounce health for P0806: reset to CAL_obd_ii_P0806_debounce_count; +1 per passing sample (to the CAL), -1 per obd_ii_monitor_debounce_ticks failing samples; the DTC fails when it reaches 0." UBYTE NO_COMPU_METHOD 0 0 0 255 ECU_ADDRESS 0x40002241 /end MEASUREMENT
/begin MEASUREMENT obd_ii_p0807_health "Debounce health for P0807: reset to CAL_obd_ii_P0807_debounce_count; +1 per passing sample (to the CAL), -1 per obd_ii_monitor_debounce_ticks failing samples; the DTC fails when it reaches 0." UBYTE NO_COMPU_METHOD 0 0 0 255 ECU_ADDRESS 0x40002242 /end MEASUREMENT
/begin MEASUREMENT obd_ii_p0808_health "Debounce health for P0808: reset to CAL_obd_ii_P0808_debounce_count; +1 per passing sample (to the CAL), -1 per obd_ii_monitor_debounce_ticks failing samples; the DTC fails when it reaches 0." UBYTE NO_COMPU_METHOD 0 0 0 255 ECU_ADDRESS 0x40002243 /end MEASUREMENT
/begin MEASUREMENT obd_ii_p1107_health "Debounce health for P1107: reset to CAL_obd_ii_P1107_debounce_count; +1 per passing sample (to the CAL), -1 per obd_ii_monitor_debounce_ticks failing samples; the DTC fails when it reaches 0." UBYTE NO_COMPU_METHOD 0 0 0 255 ECU_ADDRESS 0x40002244 /end MEASUREMENT
/begin MEASUREMENT obd_ii_p1108_health "Debounce health for P1108: reset to CAL_obd_ii_P1108_debounce_count; +1 per passing sample (to the CAL), -1 per obd_ii_monitor_debounce_ticks failing samples; the DTC fails when it reaches 0." UBYTE NO_COMPU_METHOD 0 0 0 255 ECU_ADDRESS 0x40002245 /end MEASUREMENT
/begin MEASUREMENT obd_ii_monitor_debounce_ticks "Copy of CAL_obd_ii_monitor_debounce_cycles: failing samples per health decrement for all monitors in obd_ii_monitor_completion_update." UWORD NO_COMPU_METHOD 0 0 0 65535 ECU_ADDRESS 0x40002246 /end MEASUREMENT
/begin MEASUREMENT engine_state_failure_flags "Engine sensor fault bits: 0 IAT, 1 coolant, 3 baro, 4 MAF, 5 inlet cam (P0341/P0346/P0016/P0018), 6 exhaust cam (P0366/P0391/P0017/P0019), 9 knock sensors, 10 VSS/TC input, 12 O2 sensors, 24 TMAP, 26 fuel pressure, 30 ambient temp." ULONG NO_COMPU_METHOD 0 0 0 4294967295 ECU_ADDRESS 0x40002248 /end MEASUREMENT
/begin MEASUREMENT oil_pressure_low_event "Oil pressure low event (boolean flag)." UBYTE NO_COMPU_METHOD 0 0 0 255 ECU_ADDRESS 0x4000224C /end MEASUREMENT
/begin MEASUREMENT obd_ii_temp_sensor_diag_flags "Temp-sensor diag bits: 16/17 IAT volts low/high, 18/19 IAT2 volts low/high, 20/21 coolant volts low/high, 22/23 ambient (CAN 0x407) temp low/high; low bits 3-6 used by obd_ii_thermostat_monitor_logic." ULONG NO_COMPU_METHOD 0 0 0 4294967295 ECU_ADDRESS 0x40002250 /end MEASUREMENT
/begin MEASUREMENT load_residual_maf_vs_speed_density "i16_load_mg/stroke" SWORD CM_u8_load_mg_stroke 0 0 -32768 32767 ECU_ADDRESS 0x40002254 /end MEASUREMENT
/begin MEASUREMENT load_residual_maf_vs_alphaN_expected "i16_load_mg/stroke" SWORD CM_u8_load_mg_stroke 0 0 -32768 32767 ECU_ADDRESS 0x40002256 /end MEASUREMENT
/begin MEASUREMENT obd_ii_p0096_cac_agree_health "Debounce health for P0096 charge-cooler temp vs TMAP temp agreement (reset/limit = CAL_obd_ii_P1113_debounce_count); +1 per pass, -1 per obd_ii_monitor_debounce_ticks failing samples, fails at 0." UBYTE NO_COMPU_METHOD 0 0 0 255 ECU_ADDRESS 0x40002258 /end MEASUREMENT
/begin MEASUREMENT obd_ii_p0096_cac_agree_ticks "Up/down debounce ticks for P0096 cac agreement: +1 per failing sample (at obd_ii_monitor_debounce_ticks -> health-1), -1 per passing sample (at 0 -> health+1, reload)." UWORD NO_COMPU_METHOD 0 0 0 65535 ECU_ADDRESS 0x4000225A /end MEASUREMENT
/begin MEASUREMENT obd_ii_p0097_health "Debounce health for P0097: reset to CAL_obd_ii_P0097_debounce_count; +1 per passing sample (to the CAL), -1 per obd_ii_monitor_debounce_ticks failing samples; the DTC fails when it reaches 0." UBYTE NO_COMPU_METHOD 0 0 0 255 ECU_ADDRESS 0x4000225C /end MEASUREMENT
/begin MEASUREMENT obd_ii_p0097_fail_ticks "Consecutive failing samples for P0097; at obd_ii_monitor_debounce_ticks it resets and decrements obd_ii_p0097_health." UWORD NO_COMPU_METHOD 0 0 0 65535 ECU_ADDRESS 0x4000225E /end MEASUREMENT
/begin MEASUREMENT obd_ii_p0098_health "Debounce health for P0098: reset to CAL_obd_ii_P0098_debounce_count; +1 per passing sample (to the CAL), -1 per obd_ii_monitor_debounce_ticks failing samples; the DTC fails when it reaches 0." UBYTE NO_COMPU_METHOD 0 0 0 255 ECU_ADDRESS 0x40002260 /end MEASUREMENT
/begin MEASUREMENT obd_ii_p0098_fail_ticks "Consecutive failing samples for P0098; at obd_ii_monitor_debounce_ticks it resets and decrements obd_ii_p0098_health." UWORD NO_COMPU_METHOD 0 0 0 65535 ECU_ADDRESS 0x40002262 /end MEASUREMENT
/begin MEASUREMENT obd_ii_p0101_idle_health "Debounce health for P0101 MAF vs alpha-N load plausibility at idle (CAL_obd_ii_P0101_maturing_limit); +1 per pass, -1 per obd_ii_monitor_debounce_ticks failing samples, fails at 0." UBYTE NO_COMPU_METHOD 0 0 0 255 ECU_ADDRESS 0x40002264 /end MEASUREMENT
/begin MEASUREMENT obd_ii_p0101_partload_health "Debounce health for P0101 MAF vs alpha-N load plausibility at part load (CAL_obd_ii_P0101_maturing_limit); +1 per pass, -1 per obd_ii_monitor_debounce_ticks failing samples, fails at 0." UBYTE NO_COMPU_METHOD 0 0 0 255 ECU_ADDRESS 0x40002265 /end MEASUREMENT
/begin MEASUREMENT obd_ii_p0101_idle_fail_ticks "Consecutive implausible idle samples for P0101; at obd_ii_monitor_debounce_ticks decrements obd_ii_p0101_idle_health." UWORD NO_COMPU_METHOD 0 0 0 65535 ECU_ADDRESS 0x40002266 /end MEASUREMENT
/begin MEASUREMENT obd_ii_p0101_partload_fail_ticks "Consecutive implausible part-load samples for P0101; at obd_ii_monitor_debounce_ticks decrements obd_ii_p0101_partload_health." UWORD NO_COMPU_METHOD 0 0 0 65535 ECU_ADDRESS 0x40002268 /end MEASUREMENT
/begin MEASUREMENT obd_ii_p0102_fail_ticks "Consecutive failing samples for P0102; at obd_ii_monitor_debounce_ticks it resets and decrements obd_ii_p0102_health." UWORD NO_COMPU_METHOD 0 0 0 65535 ECU_ADDRESS 0x4000226A /end MEASUREMENT
/begin MEASUREMENT obd_ii_p0103_fail_ticks "Consecutive failing samples for P0103; at obd_ii_monitor_debounce_ticks it resets and decrements obd_ii_p0103_health." UWORD NO_COMPU_METHOD 0 0 0 65535 ECU_ADDRESS 0x4000226C /end MEASUREMENT
/begin MEASUREMENT obd_ii_p0107_health "Debounce health for P0107: reset to CAL_obd_ii_P0107_debounce_count; +1 per passing sample (to the CAL), -1 per obd_ii_monitor_debounce_ticks failing samples; the DTC fails when it reaches 0." UBYTE NO_COMPU_METHOD 0 0 0 255 ECU_ADDRESS 0x4000226E /end MEASUREMENT
/begin MEASUREMENT obd_ii_p0107_fail_ticks "Consecutive failing samples for P0107; at obd_ii_monitor_debounce_ticks it resets and decrements obd_ii_p0107_health." UWORD NO_COMPU_METHOD 0 0 0 65535 ECU_ADDRESS 0x40002270 /end MEASUREMENT
/begin MEASUREMENT obd_ii_p0108_health "Debounce health for P0108: reset to CAL_obd_ii_P0108_debounce_count; +1 per passing sample (to the CAL), -1 per obd_ii_monitor_debounce_ticks failing samples; the DTC fails when it reaches 0." UBYTE NO_COMPU_METHOD 0 0 0 255 ECU_ADDRESS 0x40002272 /end MEASUREMENT
/begin MEASUREMENT obd_ii_p0108_fail_ticks "Consecutive failing samples for P0108; at obd_ii_monitor_debounce_ticks it resets and decrements obd_ii_p0108_health." UWORD NO_COMPU_METHOD 0 0 0 65535 ECU_ADDRESS 0x40002274 /end MEASUREMENT
/begin MEASUREMENT obd_ii_p0111_debounce_ticks "Up/down debounce ticks for P0111: +1 per failing sample (at obd_ii_monitor_debounce_ticks -> health-1), -1 per passing sample (at 0 -> health+1, reload)." UWORD NO_COMPU_METHOD 0 0 0 65535 ECU_ADDRESS 0x40002276 /end MEASUREMENT
/begin MEASUREMENT obd_ii_p0112_fail_ticks "Consecutive failing samples for P0112; at obd_ii_monitor_debounce_ticks it resets and decrements obd_ii_p0112_health." UWORD NO_COMPU_METHOD 0 0 0 65535 ECU_ADDRESS 0x40002278 /end MEASUREMENT
/begin MEASUREMENT obd_ii_p0113_fail_ticks "Consecutive failing samples for P0113; at obd_ii_monitor_debounce_ticks it resets and decrements obd_ii_p0113_health." UWORD NO_COMPU_METHOD 0 0 0 65535 ECU_ADDRESS 0x4000227A /end MEASUREMENT
/begin MEASUREMENT obd_ii_p0116_debounce_ticks "Up/down debounce ticks for P0116: +1 per failing sample (at obd_ii_monitor_debounce_ticks -> health-1), -1 per passing sample (at 0 -> health+1, reload)." UWORD NO_COMPU_METHOD 0 0 0 65535 ECU_ADDRESS 0x4000227C /end MEASUREMENT
/begin MEASUREMENT obd_ii_p0117_fail_ticks "Consecutive failing samples for P0117; at obd_ii_monitor_debounce_ticks it resets and decrements obd_ii_p0117_health." UWORD NO_COMPU_METHOD 0 0 0 65535 ECU_ADDRESS 0x4000227E /end MEASUREMENT
/begin MEASUREMENT obd_ii_p0118_fail_ticks "Consecutive failing samples for P0118; at obd_ii_monitor_debounce_ticks it resets and decrements obd_ii_p0118_health." UWORD NO_COMPU_METHOD 0 0 0 65535 ECU_ADDRESS 0x40002280 /end MEASUREMENT
/begin MEASUREMENT obd_ii_p0131_fail_ticks "Consecutive failing samples for P0131; at obd_ii_monitor_debounce_ticks it resets and decrements obd_ii_p0131_health." UWORD NO_COMPU_METHOD 0 0 0 65535 ECU_ADDRESS 0x40002282 /end MEASUREMENT
/begin MEASUREMENT obd_ii_p0132_fail_ticks "Consecutive failing samples for P0132; at obd_ii_monitor_debounce_ticks it resets and decrements obd_ii_p0132_health." UWORD NO_COMPU_METHOD 0 0 0 65535 ECU_ADDRESS 0x40002284 /end MEASUREMENT
/begin MEASUREMENT obd_ii_p0137_health "Debounce health for P0137: reset to CAL_obd_ii_P0137_fail_count; +1 per passing sample (to the CAL), -1 per obd_ii_monitor_debounce_ticks failing samples; the DTC fails when it reaches 0." UBYTE NO_COMPU_METHOD 0 0 0 255 ECU_ADDRESS 0x40002286 /end MEASUREMENT
/begin MEASUREMENT obd_ii_p0137_fail_ticks "Consecutive failing samples for P0137; at obd_ii_monitor_debounce_ticks it resets and decrements obd_ii_p0137_health." UWORD NO_COMPU_METHOD 0 0 0 65535 ECU_ADDRESS 0x40002288 /end MEASUREMENT
/begin MEASUREMENT obd_ii_p0151_fail_ticks "Consecutive failing samples for P0151; at obd_ii_monitor_debounce_ticks it resets and decrements obd_ii_p0151_health." UWORD NO_COMPU_METHOD 0 0 0 65535 ECU_ADDRESS 0x4000228A /end MEASUREMENT
/begin MEASUREMENT obd_ii_p0152_fail_ticks "Consecutive failing samples for P0152; at obd_ii_monitor_debounce_ticks it resets and decrements obd_ii_p0152_health." UWORD NO_COMPU_METHOD 0 0 0 65535 ECU_ADDRESS 0x4000228C /end MEASUREMENT
/begin MEASUREMENT obd_ii_p0157_health "Debounce health for P0157: reset to CAL_obd_ii_P0157_fail_count; +1 per passing sample (to the CAL), -1 per obd_ii_monitor_debounce_ticks failing samples; the DTC fails when it reaches 0." UBYTE NO_COMPU_METHOD 0 0 0 255 ECU_ADDRESS 0x4000228E /end MEASUREMENT
/begin MEASUREMENT obd_ii_p0157_fail_ticks "Consecutive failing samples for P0157; at obd_ii_monitor_debounce_ticks it resets and decrements obd_ii_p0157_health." UWORD NO_COMPU_METHOD 0 0 0 65535 ECU_ADDRESS 0x40002290 /end MEASUREMENT
/begin MEASUREMENT obd_ii_p0327_health "Debounce health for P0327: reset to CAL_obd_ii_P0327_debounce_count; +1 per passing sample (to the CAL), -1 per obd_ii_monitor_debounce_ticks failing samples; the DTC fails when it reaches 0." UBYTE NO_COMPU_METHOD 0 0 0 255 ECU_ADDRESS 0x40002292 /end MEASUREMENT
/begin MEASUREMENT obd_ii_p0327_fail_ticks "Consecutive failing samples for P0327; at obd_ii_monitor_debounce_ticks it resets and decrements obd_ii_p0327_health." UWORD NO_COMPU_METHOD 0 0 0 65535 ECU_ADDRESS 0x40002294 /end MEASUREMENT
/begin MEASUREMENT obd_ii_p0328_health "Debounce health for P0328: reset to CAL_obd_ii_P0328_debounce_count; +1 per passing sample (to the CAL), -1 per obd_ii_monitor_debounce_ticks failing samples; the DTC fails when it reaches 0." UBYTE NO_COMPU_METHOD 0 0 0 255 ECU_ADDRESS 0x40002296 /end MEASUREMENT
/begin MEASUREMENT obd_ii_p0328_fail_ticks "Consecutive failing samples for P0328; at obd_ii_monitor_debounce_ticks it resets and decrements obd_ii_p0328_health." UWORD NO_COMPU_METHOD 0 0 0 65535 ECU_ADDRESS 0x40002298 /end MEASUREMENT
/begin MEASUREMENT obd_ii_p0332_health "Debounce health for P0332: reset to CAL_obd_ii_P0332_debounce_count; +1 per passing sample (to the CAL), -1 per obd_ii_monitor_debounce_ticks failing samples; the DTC fails when it reaches 0." UBYTE NO_COMPU_METHOD 0 0 0 255 ECU_ADDRESS 0x4000229A /end MEASUREMENT
/begin MEASUREMENT obd_ii_p0332_fail_ticks "Consecutive failing samples for P0332; at obd_ii_monitor_debounce_ticks it resets and decrements obd_ii_p0332_health." UWORD NO_COMPU_METHOD 0 0 0 65535 ECU_ADDRESS 0x4000229C /end MEASUREMENT
/begin MEASUREMENT obd_ii_p0333_health "Debounce health for P0333: reset to CAL_obd_ii_P0333_debounce_count; +1 per passing sample (to the CAL), -1 per obd_ii_monitor_debounce_ticks failing samples; the DTC fails when it reaches 0." UBYTE NO_COMPU_METHOD 0 0 0 255 ECU_ADDRESS 0x4000229E /end MEASUREMENT
/begin MEASUREMENT obd_ii_p0333_fail_ticks "Consecutive failing samples for P0333; at obd_ii_monitor_debounce_ticks it resets and decrements obd_ii_p0333_health." UWORD NO_COMPU_METHOD 0 0 0 65535 ECU_ADDRESS 0x400022A0 /end MEASUREMENT
/begin MEASUREMENT obd_ii_p0138_health "Debounce health for P0138: reset to CAL_obd_ii_P0138_fail_count; +1 per passing sample (to the CAL), -1 per obd_ii_monitor_debounce_ticks failing samples; the DTC fails when it reaches 0." UBYTE NO_COMPU_METHOD 0 0 0 255 ECU_ADDRESS 0x400022A2 /end MEASUREMENT
/begin MEASUREMENT obd_ii_p0138_fail_ticks "Consecutive failing samples for P0138; at obd_ii_monitor_debounce_ticks it resets and decrements obd_ii_p0138_health." UWORD NO_COMPU_METHOD 0 0 0 65535 ECU_ADDRESS 0x400022A4 /end MEASUREMENT
/begin MEASUREMENT obd_ii_p0158_health "Debounce health for P0158: reset to CAL_obd_ii_P0158_fail_count; +1 per passing sample (to the CAL), -1 per obd_ii_monitor_debounce_ticks failing samples; the DTC fails when it reaches 0." UBYTE NO_COMPU_METHOD 0 0 0 255 ECU_ADDRESS 0x400022A6 /end MEASUREMENT
/begin MEASUREMENT obd_ii_p0158_fail_ticks "Consecutive failing samples for P0158; at obd_ii_monitor_debounce_ticks it resets and decrements obd_ii_p0158_health." UWORD NO_COMPU_METHOD 0 0 0 65535 ECU_ADDRESS 0x400022A8 /end MEASUREMENT
/begin MEASUREMENT obd_ii_p0192_health "Debounce health for P0192: reset to CAL_obd_ii_P0192_debounce_count; +1 per passing sample (to the CAL), -1 per obd_ii_monitor_debounce_ticks failing samples; the DTC fails when it reaches 0." UBYTE NO_COMPU_METHOD 0 0 0 255 ECU_ADDRESS 0x400022AA /end MEASUREMENT
/begin MEASUREMENT obd_ii_p0192_fail_ticks "Consecutive failing samples for P0192; at obd_ii_monitor_debounce_ticks it resets and decrements obd_ii_p0192_health." UWORD NO_COMPU_METHOD 0 0 0 65535 ECU_ADDRESS 0x400022AC /end MEASUREMENT
/begin MEASUREMENT obd_ii_p0193_health "Debounce health for P0193: reset to CAL_obd_ii_P0193_debounce_count; +1 per passing sample (to the CAL), -1 per obd_ii_monitor_debounce_ticks failing samples; the DTC fails when it reaches 0." UBYTE NO_COMPU_METHOD 0 0 0 255 ECU_ADDRESS 0x400022AE /end MEASUREMENT
/begin MEASUREMENT obd_ii_p0193_fail_ticks "Consecutive failing samples for P0193; at obd_ii_monitor_debounce_ticks it resets and decrements obd_ii_p0193_health." UWORD NO_COMPU_METHOD 0 0 0 65535 ECU_ADDRESS 0x400022B0 /end MEASUREMENT
/begin MEASUREMENT obd_ii_p1107_fail_ticks "Consecutive failing samples for P1107; at obd_ii_monitor_debounce_ticks it resets and decrements obd_ii_p1107_health." UWORD NO_COMPU_METHOD 0 0 0 65535 ECU_ADDRESS 0x400022B2 /end MEASUREMENT
/begin MEASUREMENT obd_ii_p1108_fail_ticks "Consecutive failing samples for P1108; at obd_ii_monitor_debounce_ticks it resets and decrements obd_ii_p1108_health." UWORD NO_COMPU_METHOD 0 0 0 65535 ECU_ADDRESS 0x400022B4 /end MEASUREMENT
/begin MEASUREMENT obd_ii_p0452_health "Debounce health for P0452: reset to CAL_obd_ii_P0452_debounce_count; +1 per passing sample (to the CAL), -1 per obd_ii_monitor_debounce_ticks failing samples; the DTC fails when it reaches 0." UBYTE NO_COMPU_METHOD 0 0 0 255 ECU_ADDRESS 0x400022B6 /end MEASUREMENT
/begin MEASUREMENT obd_ii_p0452_fail_ticks "Consecutive failing samples for P0452; at obd_ii_monitor_debounce_ticks it resets and decrements obd_ii_p0452_health." UWORD NO_COMPU_METHOD 0 0 0 65535 ECU_ADDRESS 0x400022B8 /end MEASUREMENT
/begin MEASUREMENT obd_ii_p0453_health "Debounce health for P0453: reset to CAL_obd_ii_P0453_debounce_count; +1 per passing sample (to the CAL), -1 per obd_ii_monitor_debounce_ticks failing samples; the DTC fails when it reaches 0." UBYTE NO_COMPU_METHOD 0 0 0 255 ECU_ADDRESS 0x400022BA /end MEASUREMENT
/begin MEASUREMENT obd_ii_p0453_fail_ticks "Consecutive failing samples for P0453; at obd_ii_monitor_debounce_ticks it resets and decrements obd_ii_p0453_health." UWORD NO_COMPU_METHOD 0 0 0 65535 ECU_ADDRESS 0x400022BC /end MEASUREMENT
/begin MEASUREMENT obd_ii_p0462_health "Debounce health for P0462: reset to CAL_obd_ii_P0462_debounce_count; +1 per passing sample (to the CAL), -1 per obd_ii_monitor_debounce_ticks failing samples; the DTC fails when it reaches 0." UBYTE NO_COMPU_METHOD 0 0 0 255 ECU_ADDRESS 0x400022BE /end MEASUREMENT
/begin MEASUREMENT obd_ii_p0462_fail_ticks "Consecutive failing samples for P0462; at obd_ii_monitor_debounce_ticks it resets and decrements obd_ii_p0462_health." UWORD NO_COMPU_METHOD 0 0 0 65535 ECU_ADDRESS 0x400022C0 /end MEASUREMENT
/begin MEASUREMENT obd_ii_p0463_health "Debounce health for P0463: reset to CAL_obd_ii_P0463_debounce_count; +1 per passing sample (to the CAL), -1 per obd_ii_monitor_debounce_ticks failing samples; the DTC fails when it reaches 0." UBYTE NO_COMPU_METHOD 0 0 0 255 ECU_ADDRESS 0x400022C2 /end MEASUREMENT
/begin MEASUREMENT obd_ii_p0463_fail_ticks "Consecutive failing samples for P0463; at obd_ii_monitor_debounce_ticks it resets and decrements obd_ii_p0463_health." UWORD NO_COMPU_METHOD 0 0 0 65535 ECU_ADDRESS 0x400022C4 /end MEASUREMENT
/begin MEASUREMENT obd_ii_p0522_fail_ticks "Consecutive failing samples for P0522; at obd_ii_monitor_debounce_ticks it resets and decrements obd_ii_p0522_health." UWORD NO_COMPU_METHOD 0 0 0 65535 ECU_ADDRESS 0x400022C6 /end MEASUREMENT
/begin MEASUREMENT obd_ii_p0523_fail_ticks "Consecutive failing samples for P0523; at obd_ii_monitor_debounce_ticks it resets and decrements obd_ii_p0523_health." UWORD NO_COMPU_METHOD 0 0 0 65535 ECU_ADDRESS 0x400022C8 /end MEASUREMENT
/begin MEASUREMENT oil_pressure_low_timer "Low oil pressure duration (100 Hz, vs CAL_oil_pressure_low_timer_threshold)." UWORD CM_u8_time_10ms 0 0 0 655350 ECU_ADDRESS 0x400022CA /end MEASUREMENT
/begin MEASUREMENT oil_pressure_low_detected "Oil pressure low detected (boolean flag)." UBYTE NO_COMPU_METHOD 0 0 0 255 ECU_ADDRESS 0x400022CC /end MEASUREMENT
/begin MEASUREMENT obd_ii_p0563_health "Debounce health for P0563: reset to CAL_obd_ii_P0563_debounce_count; +1 per passing sample (to the CAL), -1 per obd_ii_monitor_debounce_ticks failing samples; the DTC fails when it reaches 0." UBYTE NO_COMPU_METHOD 0 0 0 255 ECU_ADDRESS 0x400022CD /end MEASUREMENT
/begin MEASUREMENT obd_ii_p0563_fail_ticks "Consecutive high-voltage samples for P0563; at CAL_obd_ii_P0563_sample_count decrements obd_ii_p0563_health." UWORD NO_COMPU_METHOD 0 0 0 65535 ECU_ADDRESS 0x400022CE /end MEASUREMENT
/begin MEASUREMENT obd_ii_p0562_health "Debounce health for P0562: reset to CAL_obd_ii_P0562_debounce_count; +1 per passing sample (to the CAL), -1 per obd_ii_monitor_debounce_ticks failing samples; the DTC fails when it reaches 0." UBYTE NO_COMPU_METHOD 0 0 0 255 ECU_ADDRESS 0x400022D0 /end MEASUREMENT
/begin MEASUREMENT obd_ii_p0562_fail_ticks "Consecutive low-voltage samples for P0562; at CAL_obd_ii_P0562_sample_count decrements obd_ii_p0562_health." UWORD NO_COMPU_METHOD 0 0 0 65535 ECU_ADDRESS 0x400022D2 /end MEASUREMENT
/begin MEASUREMENT obd_ii_p0564_fail_ticks "Consecutive failing samples for P0564; at obd_ii_monitor_debounce_ticks it resets and decrements obd_ii_p0564_health." UBYTE NO_COMPU_METHOD 0 0 0 255 ECU_ADDRESS 0x400022D4 /end MEASUREMENT
/begin MEASUREMENT obd_ii_p0685_health "Debounce health for P0685: reset to CAL_obd_ii_P0685_debounce_count; +1 per passing sample (to the CAL), -1 per obd_ii_monitor_debounce_ticks failing samples; the DTC fails when it reaches 0." UBYTE NO_COMPU_METHOD 0 0 0 255 ECU_ADDRESS 0x400022D5 /end MEASUREMENT
/begin MEASUREMENT obd_ii_p0685_fail_ticks "Consecutive failing samples for P0685; at obd_ii_monitor_debounce_ticks it resets and decrements obd_ii_p0685_health." UWORD NO_COMPU_METHOD 0 0 0 65535 ECU_ADDRESS 0x400022D6 /end MEASUREMENT
/begin MEASUREMENT obd_ii_p0826_health "Debounce health for P0826: reset to CAL_obd_ii_P0826_debounce_count; +1 per passing sample (to the CAL), -1 per obd_ii_monitor_debounce_ticks failing samples; the DTC fails when it reaches 0." UBYTE NO_COMPU_METHOD 0 0 0 255 ECU_ADDRESS 0x400022D8 /end MEASUREMENT
/begin MEASUREMENT obd_ii_p0827_health "Debounce health for P0827: reset to CAL_obd_ii_P0827_debounce_count; +1 per passing sample (to the CAL), -1 per obd_ii_monitor_debounce_ticks failing samples; the DTC fails when it reaches 0." UBYTE NO_COMPU_METHOD 0 0 0 255 ECU_ADDRESS 0x400022D9 /end MEASUREMENT
/begin MEASUREMENT obd_ii_p0827_fail_ticks "Consecutive failing samples for P0827; at obd_ii_monitor_debounce_ticks it resets and decrements obd_ii_p0827_health." UWORD NO_COMPU_METHOD 0 0 0 65535 ECU_ADDRESS 0x400022DA /end MEASUREMENT
/begin MEASUREMENT obd_ii_p0828_health "Debounce health for P0828: reset to CAL_obd_ii_P0828_debounce_count; +1 per passing sample (to the CAL), -1 per obd_ii_monitor_debounce_ticks failing samples; the DTC fails when it reaches 0." UBYTE NO_COMPU_METHOD 0 0 0 255 ECU_ADDRESS 0x400022DC /end MEASUREMENT
/begin MEASUREMENT obd_ii_p0828_fail_ticks "Consecutive failing samples for P0828; at obd_ii_monitor_debounce_ticks it resets and decrements obd_ii_p0828_health." UWORD NO_COMPU_METHOD 0 0 0 65535 ECU_ADDRESS 0x400022DE /end MEASUREMENT
/begin MEASUREMENT obd_ii_p1809_health "Debounce health for P1809: reset to CAL_obd_ii_P1809_debounce_count; +1 per passing sample (to the CAL), -1 per obd_ii_monitor_debounce_ticks failing samples; the DTC fails when it reaches 0." UBYTE NO_COMPU_METHOD 0 0 0 255 ECU_ADDRESS 0x400022E0 /end MEASUREMENT
/begin MEASUREMENT obd_ii_p1562_health "Debounce health for P1562: reset to CAL_obd_ii_P1562_debounce_count; +1 per passing sample (to the CAL), -1 per obd_ii_monitor_debounce_ticks failing samples; the DTC fails when it reaches 0." UBYTE NO_COMPU_METHOD 0 0 0 255 ECU_ADDRESS 0x400022E1 /end MEASUREMENT
/begin MEASUREMENT obd_ii_p0111_iat_voltage_max "Max IAT sensor voltage seen this test; pass when max-min > CAL_obd_ii_P0111_iat_span_min." UWORD CM_u16_voltage_5_1023v 0 0 0 320.307917888563 ECU_ADDRESS 0x400022E2 /end MEASUREMENT
/begin MEASUREMENT obd_ii_P0111_stage "P0111 airflow sequence: 0 idle, 1 in high band, 2 high band done (waiting for low), 3 low-flow soak." UBYTE NO_COMPU_METHOD 0 0 0 255 ECU_ADDRESS 0x400022E4 /end MEASUREMENT
/begin MEASUREMENT obd_ii_p0111_band_timer_5ms "P0111 airflow-band dwell/debounce timer (CAL_obd_ii_P0111_maf_debounce_time*20)." UWORD CM_u8_time_5ms 0 0 0 327675 ECU_ADDRESS 0x400022E6 /end MEASUREMENT
/begin MEASUREMENT obd_ii_p0111_status "P0111 IAT rationality: bit0 fail, bit1 test complete (IAT voltage span seen, or airflow sequence done), bit3/4/5 pass/fail/debounce state." UBYTE NO_COMPU_METHOD 0 0 0 255 ECU_ADDRESS 0x400022E8 /end MEASUREMENT
/begin MEASUREMENT obd_ii_p0111_low_flow_timer_5ms "P0111 low-airflow soak timer (CAL_obd_ii_P0111_airflow_stage_time*20); expiry = test complete without IAT change -> fail." UWORD CM_u8_time_5ms 0 0 0 327675 ECU_ADDRESS 0x400022EA /end MEASUREMENT
/begin MEASUREMENT obd_ii_p0111_high_flow_timer_5ms "P0111 high-airflow dwell (CAL_obd_ii_P0111_high_airflow_time*200)." UWORD CM_u8_time_5ms 0 0 0 327675 ECU_ADDRESS 0x400022EC /end MEASUREMENT
/begin MEASUREMENT obd_ii_p0096_iat2_voltage_max "Max intake-air (IAT2) sensor voltage this test." UWORD CM_u16_voltage_5_1023v 0 0 0 320.307917888563 ECU_ADDRESS 0x400022EE /end MEASUREMENT
/begin MEASUREMENT obd_ii_p0096_status "P0096 IAT2/TMAP-temp rationality: bit0 fail, bit1 complete, bit3/4/5 cac-agreement pass/fail/debounce." UBYTE NO_COMPU_METHOD 0 0 0 255 ECU_ADDRESS 0x400022F0 /end MEASUREMENT
/begin MEASUREMENT obd_ii_p0096_idle_phase_timer "Countdown per idle phase (reload CAL_obd_ii_P0096_idle_phase_dwell)." UBYTE NO_COMPU_METHOD 0 0 0 255 ECU_ADDRESS 0x400022F1 /end MEASUREMENT
/begin MEASUREMENT obd_ii_p0096_high_flow_phase_timer "Countdown per high-flow phase (reload CAL_obd_ii_P0096_high_flow_phase_dwell)." UBYTE NO_COMPU_METHOD 0 0 0 255 ECU_ADDRESS 0x400022F2 /end MEASUREMENT
/begin MEASUREMENT obd_ii_p0096_high_flow_phase_count "Completed high-flow phases (to CAL_obd_ii_P0096_high_flow_phase_count)." UBYTE NO_COMPU_METHOD 0 0 0 255 ECU_ADDRESS 0x400022F3 /end MEASUREMENT
/begin MEASUREMENT obd_ii_p0096_idle_phase_count "Completed idle phases (to CAL_obd_ii_P0096_idle_phase_count)." UBYTE NO_COMPU_METHOD 0 0 0 255 ECU_ADDRESS 0x400022F4 /end MEASUREMENT
/begin MEASUREMENT obd_ii_p0116_status "P0116 coolant rationality: bit0 fail, bit1 complete, bit5 debounce, bit6/7 thermostat-window state." UBYTE NO_COMPU_METHOD 0 0 0 255 ECU_ADDRESS 0x400022F5 /end MEASUREMENT
/begin MEASUREMENT obd_ii_p0116_warmup_deadline_5ms "CAL_obd_ii_thermostat_monitor_time[start coolant]*2000 (10 s units); coolant must warm before runtime passes this." ULONG CM_u8_time_5ms 0 0 0 21474836475 ECU_ADDRESS 0x400022F8 /end MEASUREMENT
/begin MEASUREMENT obd_ii_p0116_coolant_drop_limit "Max seen - CAL_coolant_temp_threshold_1_hysteresis (or CAL_coolant_temp_threshold_1): coolant below this flags a drop." UBYTE CM_u8_temp_5_8_40c 0 0 -40 119.375 ECU_ADDRESS 0x400022FC /end MEASUREMENT
/begin MEASUREMENT obd_ii_p0116_coolant_max "Max coolant_temp seen this drive." UBYTE CM_u8_temp_5_8_40c 0 0 -40 119.375 ECU_ADDRESS 0x400022FD /end MEASUREMENT
/begin MEASUREMENT obd_ii_p0116_deviation_max "CAL_obd_ii_P0116_coolant_deviation_max (or _coldstart)." UBYTE CM_u8_tempdelta_5_8c 0 0 0 159.375 ECU_ADDRESS 0x400022FE /end MEASUREMENT
/begin MEASUREMENT obd_ii_p0071_status "P0071 ambient temp rationality: bit0 fail, bit1 complete, bit3/4/5 pass/fail/debounce state." UBYTE NO_COMPU_METHOD 0 0 0 255 ECU_ADDRESS 0x400022FF /end MEASUREMENT
/begin MEASUREMENT obd_ii_thermostat_cold_start_low_flow_ticks "Cold-start low-airflow counter (to CAL_obd_ii_cold_start_low_flow_count*8)." UWORD NO_COMPU_METHOD 0 0 0 65535 ECU_ADDRESS 0x40002300 /end MEASUREMENT
/begin MEASUREMENT obd_ii_p0071_debounce_ticks "Up/down debounce ticks for P0071: +1 per failing sample (at obd_ii_monitor_debounce_ticks -> health-1), -1 per passing sample (at 0 -> health+1, reload)." UWORD NO_COMPU_METHOD 0 0 0 65535 ECU_ADDRESS 0x40002302 /end MEASUREMENT
/begin MEASUREMENT obd_ii_p0072_health "Debounce health for P0072: reset to CAL_obd_ii_P0072_debounce_count; +1 per passing sample (to the CAL), -1 per obd_ii_monitor_debounce_ticks failing samples; the DTC fails when it reaches 0." UBYTE NO_COMPU_METHOD 0 0 0 255 ECU_ADDRESS 0x40002304 /end MEASUREMENT
/begin MEASUREMENT obd_ii_p0072_fail_ticks "Consecutive failing samples for P0072; at obd_ii_monitor_debounce_ticks it resets and decrements obd_ii_p0072_health." UWORD NO_COMPU_METHOD 0 0 0 65535 ECU_ADDRESS 0x40002306 /end MEASUREMENT
/begin MEASUREMENT obd_ii_p0073_health "Debounce health for P0073: reset to CAL_obd_ii_P0073_debounce_count; +1 per passing sample (to the CAL), -1 per obd_ii_monitor_debounce_ticks failing samples; the DTC fails when it reaches 0." UBYTE NO_COMPU_METHOD 0 0 0 255 ECU_ADDRESS 0x40002308 /end MEASUREMENT
/begin MEASUREMENT obd_ii_p0073_fail_ticks "Consecutive failing samples for P0073; at obd_ii_monitor_debounce_ticks it resets and decrements obd_ii_p0073_health." UWORD NO_COMPU_METHOD 0 0 0 65535 ECU_ADDRESS 0x4000230A /end MEASUREMENT
/begin MEASUREMENT obd_ii_thermostat_monitor_flags "Thermostat monitor state bits (obd_ii_thermostat_monitor_logic)." ULONG NO_COMPU_METHOD 0 0 0 4294967295 ECU_ADDRESS 0x4000230C /end MEASUREMENT
/begin MEASUREMENT obd_ii_p0101_partload_tolerance_pct "CAL_obd_ii_P0101_load_tolerance_pct[rpm], max 100 (%)." UBYTE NO_COMPU_METHOD 0 0 0 255 ECU_ADDRESS 0x40002310 /end MEASUREMENT
/begin MEASUREMENT oil_pressure_expected "Expected oil pressure <<4." UWORD NO_COMPU_METHOD 0 0 0 65535 ECU_ADDRESS 0x40002312 /end MEASUREMENT
/begin MEASUREMENT obd_ii_p1109_map_voltage_max "Max MAP sensor voltage this test." UWORD CM_u16_voltage_5_1023v 0 0 0 320.307917888563 ECU_ADDRESS 0x40002314 /end MEASUREMENT
/begin MEASUREMENT obd_ii_p1109_status "P1109 TMAP rationality: bit0 fail, bit1 voltage span complete, bit2/3 model fail/pass, bit4/5 map-vs-baro fail/pass." UBYTE NO_COMPU_METHOD 0 0 0 255 ECU_ADDRESS 0x40002316 /end MEASUREMENT
/begin MEASUREMENT obd_ii_p1109_idle_phase_timer "Countdown per idle phase (CAL_obd_ii_P1109_idle_phase_dwell)." UBYTE NO_COMPU_METHOD 0 0 0 255 ECU_ADDRESS 0x40002317 /end MEASUREMENT
/begin MEASUREMENT obd_ii_p1109_high_load_phase_timer "Countdown per high-load phase (CAL_obd_ii_P1109_high_load_phase_dwell)." UBYTE NO_COMPU_METHOD 0 0 0 255 ECU_ADDRESS 0x40002318 /end MEASUREMENT
/begin MEASUREMENT obd_ii_p1109_idle_phase_count "Completed idle phases." UBYTE NO_COMPU_METHOD 0 0 0 255 ECU_ADDRESS 0x40002319 /end MEASUREMENT
/begin MEASUREMENT obd_ii_p1109_high_load_phase_count "Completed high-load phases." UBYTE NO_COMPU_METHOD 0 0 0 255 ECU_ADDRESS 0x4000231A /end MEASUREMENT
/begin MEASUREMENT obd_ii_p1109_map_agree_health "Health for |manifold pressure - map_filtered| agreement (CAL_obd_ii_P1109_map_agree_count)." UBYTE NO_COMPU_METHOD 0 0 0 255 ECU_ADDRESS 0x4000231B /end MEASUREMENT
/begin MEASUREMENT obd_ii_p1109_load_model_error "|load_from_speed_density - load_measured_maf| (mg/stroke)." SLONG NO_COMPU_METHOD 0 0 -2147483648 2147483647 ECU_ADDRESS 0x4000231C /end MEASUREMENT
/begin MEASUREMENT obd_ii_p1109_map_model_error "|map - manifold_pressure_calculated| (mbar)." UWORD CM_i16_pressure_mbar 0 0 0 65535 ECU_ADDRESS 0x40002320 /end MEASUREMENT
/begin MEASUREMENT obd_ii_p1109_steady_settle_timer "Countdown (CAL_obd_ii_P1109_steady_settle) after a throttle transient." UBYTE NO_COMPU_METHOD 0 0 0 255 ECU_ADDRESS 0x40002322 /end MEASUREMENT
/begin MEASUREMENT obd_ii_p1109_model_agree_health "Health for the load/MAP model agreement (CAL_obd_ii_P1109_model_agree_count)." UBYTE NO_COMPU_METHOD 0 0 0 255 ECU_ADDRESS 0x40002323 /end MEASUREMENT
/begin MEASUREMENT obd_ii_p1109_pass_period_timer "Countdown (CAL_obd_ii_P1109_pass_period) of agreeing samples before the model pass bit." UBYTE NO_COMPU_METHOD 0 0 0 255 ECU_ADDRESS 0x40002324 /end MEASUREMENT
/begin MEASUREMENT obd_ii_p0571_health "Debounce health for P0571: reset to CAL_obd_ii_P0571_debounce_count; +1 per passing sample (to the CAL), -1 per obd_ii_monitor_debounce_ticks failing samples; the DTC fails when it reaches 0." UBYTE NO_COMPU_METHOD 0 0 0 255 ECU_ADDRESS 0x40002325 /end MEASUREMENT
/begin MEASUREMENT obd_ii_p0571_switch_mismatch_timer "Samples with the two brake switches disagreeing (vs CAL_obd_ii_P0571_switch_mismatch_time)." UWORD NO_COMPU_METHOD 0 0 0 65535 ECU_ADDRESS 0x40002326 /end MEASUREMENT
/begin MEASUREMENT obd_ii_p0571_pedal_conflict_timer "Samples with brake on and pedal pressed (vs CAL_obd_ii_brake_pedal_conflict_count)." UWORD NO_COMPU_METHOD 0 0 0 65535 ECU_ADDRESS 0x40002328 /end MEASUREMENT
/begin MEASUREMENT obd_ii_p0571_status "P0571 brake switch: bit0 switch-pair mismatch timeout, bit1 brake/pedal conflict." UBYTE NO_COMPU_METHOD 0 0 0 255 ECU_ADDRESS 0x4000232A /end MEASUREMENT
/begin MEASUREMENT obd_ii_p0807_fail_ticks "Consecutive failing samples for P0807; at obd_ii_monitor_debounce_ticks it resets and decrements obd_ii_p0807_health." UWORD NO_COMPU_METHOD 0 0 0 65535 ECU_ADDRESS 0x4000232C /end MEASUREMENT
/begin MEASUREMENT obd_ii_p0808_fail_ticks "Consecutive failing samples for P0808; at obd_ii_monitor_debounce_ticks it resets and decrements obd_ii_p0808_health." UWORD NO_COMPU_METHOD 0 0 0 65535 ECU_ADDRESS 0x4000232E /end MEASUREMENT
/begin MEASUREMENT obd_ii_p0806_clutch_voltage_max "Max clutch position voltage this drive." UWORD CM_u16_voltage_5_1023v 0 0 0 320.307917888563 ECU_ADDRESS 0x40002330 /end MEASUREMENT
/begin MEASUREMENT obd_ii_p0806_clutch_voltage_span "Max - min clutch voltage; < CAL_obd_ii_P0806_clutch_span_min after enough gear changes = fail." UWORD CM_u16_voltage_5_1023v 0 0 0 320.307917888563 ECU_ADDRESS 0x40002332 /end MEASUREMENT
/begin MEASUREMENT clutch_sensor_confidence "u16_count" UWORD NO_COMPU_METHOD 0 0 0 65535 ECU_ADDRESS 0x40002334 /end MEASUREMENT
/begin MEASUREMENT obd_ii_p0806_gear_change_count "Gear changes seen (saturates 0xff)." UBYTE NO_COMPU_METHOD 0 0 0 255 ECU_ADDRESS 0x40002336 /end MEASUREMENT
/begin MEASUREMENT obd_ii_p0806_last_gear "Previous gear for change counting." UBYTE NO_COMPU_METHOD 0 0 0 255 ECU_ADDRESS 0x40002337 /end MEASUREMENT
/begin MEASUREMENT obd_ii_p0806_max_gear "Highest gear seen." UBYTE NO_COMPU_METHOD 0 0 0 255 ECU_ADDRESS 0x40002338 /end MEASUREMENT
/begin MEASUREMENT obd_ii_p0106_health "Debounce health for P0106: reset to CAL_obd_ii_P0106_debounce_count; +1 per passing sample (to the CAL), -1 per obd_ii_monitor_debounce_ticks failing samples; the DTC fails when it reaches 0." UBYTE NO_COMPU_METHOD 0 0 0 255 ECU_ADDRESS 0x40002339 /end MEASUREMENT
/begin MEASUREMENT obd_ii_p0106_fail_ticks "Consecutive failing samples for P0106; at obd_ii_monitor_debounce_ticks it resets and decrements obd_ii_p0106_health." UWORD NO_COMPU_METHOD 0 0 0 65535 ECU_ADDRESS 0x4000233A /end MEASUREMENT
/begin MEASUREMENT obd_ii_p0106_pass_ticks "Consecutive in-tolerance part-load baro samples for P0106; at obd_ii_monitor_debounce_ticks increments obd_ii_p0106_health (at max sets pass bit)." UWORD NO_COMPU_METHOD 0 0 0 65535 ECU_ADDRESS 0x4000233C /end MEASUREMENT
/begin MEASUREMENT obd_ii_p0106_engine_off_baro_map_delta "Engine off: |baro - map_filtered| (mbar), tested against CAL_obd_ii_map_baro_engine_off_tol." UWORD CM_i16_pressure_mbar 0 0 0 65535 ECU_ADDRESS 0x4000233E /end MEASUREMENT
/begin MEASUREMENT obd_ii_p0106_engine_off_fail_count "Engine-off baro/MAP disagreement countdown (reload CAL_obd_ii_map_baro_engine_off_fail_count); 0 sets status bit0." UBYTE NO_COMPU_METHOD 0 0 0 255 ECU_ADDRESS 0x40002340 /end MEASUREMENT
/begin MEASUREMENT obd_ii_p0106_engine_off_pass_count "Engine-off agreement countdown (reload CAL_obd_ii_map_baro_engine_off_pass_count); 0 sets status bit1." UBYTE NO_COMPU_METHOD 0 0 0 255 ECU_ADDRESS 0x40002341 /end MEASUREMENT
/begin MEASUREMENT obd_ii_p0106_status "P0106: bit0 engine-off fail, bit1 engine-off pass, bit2 part-load fail, bit3 part-load pass." UBYTE NO_COMPU_METHOD 0 0 0 255 ECU_ADDRESS 0x40002342 /end MEASUREMENT
/begin MEASUREMENT obd_ii_p0826_paddle_voltage_ref "Paddle-shift raw reading latched as the stability reference (+-10 counts)." UWORD NO_COMPU_METHOD 0 0 0 65535 ECU_ADDRESS 0x40002344 /end MEASUREMENT
/begin MEASUREMENT obd_ii_p0826_stable_timer "Countdown (CAL_obd_ii_paddle_shift_voltage_stable_time*10) while the paddle reading is stable." UWORD NO_COMPU_METHOD 0 0 0 65535 ECU_ADDRESS 0x40002346 /end MEASUREMENT
/begin MEASUREMENT obd_ii_p0826_fail_ticks "Consecutive failing samples for P0826; at obd_ii_monitor_debounce_ticks it resets and decrements obd_ii_p0826_health." UBYTE NO_COMPU_METHOD 0 0 0 255 ECU_ADDRESS 0x40002348 /end MEASUREMENT
/begin MEASUREMENT obd_ii_p0101_status "P0101: low nibble idle test (0xA pass, 0x5 fail), high nibble part-load test (0xA0 pass, 0x50 fail); bit3+bit7 = both passed." UBYTE NO_COMPU_METHOD 0 0 0 255 ECU_ADDRESS 0x40002349 /end MEASUREMENT
/begin MEASUREMENT obd_ii_p0191_status "P0191 rail pressure rationality: bit0/1 trim test fail/pass, bit2-5 stuck test, bit6 test armed, bit7 dfco/fueling phase, bit8 hold, bit9/10 dual-sensor fail/pass." UWORD NO_COMPU_METHOD 0 0 0 65535 ECU_ADDRESS 0x4000234A /end MEASUREMENT
/begin MEASUREMENT obd_ii_p0191_stuck_check_count "Countdown (CAL_obd_ii_P0191_stuck_check_count_dfco/_fueling) of samples before a stuck verdict." UBYTE NO_COMPU_METHOD 0 0 0 255 ECU_ADDRESS 0x4000234C /end MEASUREMENT
/begin MEASUREMENT obd_ii_p0191_pressure_min "Min fuel_pressure_abs this phase." UWORD CM_i16_pressure_mbar 0 0 0 65535 ECU_ADDRESS 0x4000234E /end MEASUREMENT
/begin MEASUREMENT obd_ii_p0191_pressure_max "Max fuel_pressure_abs this phase." UWORD CM_i16_pressure_mbar 0 0 0 65535 ECU_ADDRESS 0x40002350 /end MEASUREMENT
/begin MEASUREMENT obd_ii_p0191_pid_correction_min "Min fuel_pressure_pid_correction this phase." SWORD NO_COMPU_METHOD 0 0 -32768 32767 ECU_ADDRESS 0x40002352 /end MEASUREMENT
/begin MEASUREMENT obd_ii_p0191_pid_correction_max "Max fuel_pressure_pid_correction this phase." SWORD NO_COMPU_METHOD 0 0 -32768 32767 ECU_ADDRESS 0x40002354 /end MEASUREMENT
/begin MEASUREMENT obd_ii_p0191_pressure_prev "fuel_pressure_abs at the previous pass." UWORD CM_i16_pressure_mbar 0 0 0 65535 ECU_ADDRESS 0x40002356 /end MEASUREMENT
/begin MEASUREMENT obd_ii_p0191_fueling_ticks_prev "fuel_on_continuous_ticks at the previous pass; > CAL_obd_ii_P0191_flow_min enables the fueling phase." UWORD NO_COMPU_METHOD 0 0 0 65535 ECU_ADDRESS 0x40002358 /end MEASUREMENT
/begin MEASUREMENT obd_ii_p0191_trim_check_count "Countdown (CAL_obd_ii_P0191_trim_check_count) for the fuel-trim vs pressure-PID check." UBYTE NO_COMPU_METHOD 0 0 0 255 ECU_ADDRESS 0x4000235A /end MEASUREMENT
/begin MEASUREMENT obd_ii_p0191_dual_sensor_health "Health for rail sensor 1 vs 2 agreement (CAL_obd_ii_P0191_dual_sensor_agree_count)." UBYTE NO_COMPU_METHOD 0 0 0 255 ECU_ADDRESS 0x4000235B /end MEASUREMENT
/begin MEASUREMENT obd_ii_p0191_cyl_cut_settle_count "Settle countdown after cylinder cut before the dual-sensor compare." UBYTE NO_COMPU_METHOD 0 0 0 255 ECU_ADDRESS 0x4000235C /end MEASUREMENT
/begin MEASUREMENT obd_ii_p0106_maf_pressure_drop "Intake pressure drop correction from CAL_sensor_obd_ii_p0106_maf_pressure_correction[maf] (mbar)." UBYTE CM_i16_pressure_mbar 0 0 0 255 ECU_ADDRESS 0x4000235D /end MEASUREMENT
/begin MEASUREMENT load_residual_maf_vs_speed_density_filt "IIR (CAL_obd_ii_load_model_diff_filter_alpha/256) of (load_maf_diag + load_comp_idle - load_from_speed_density), <<8; >>8 gives load_residual_maf_vs_speed_density." SLONG NO_COMPU_METHOD 0 0 -2147483648 2147483647 ECU_ADDRESS 0x40002360 /end MEASUREMENT
/begin MEASUREMENT load_residual_maf_vs_alphaN_filt "IIR of (load_maf_diag - load_alphaN_expected), <<8; >>8 gives load_residual_maf_vs_alphaN_expected." SLONG NO_COMPU_METHOD 0 0 -2147483648 2147483647 ECU_ADDRESS 0x40002364 /end MEASUREMENT
/begin MEASUREMENT obd_ii_p0116_coolant_raw_max "Max 10-bit engine-off-scaled coolant reading in the current window." UWORD NO_COMPU_METHOD 0 0 0 65535 ECU_ADDRESS 0x40002368 /end MEASUREMENT
/begin MEASUREMENT obd_ii_p0116_coolant_raw_min "Min 10-bit engine-off-scaled coolant reading in the current window; spread < CAL delta = no change." UWORD NO_COMPU_METHOD 0 0 0 65535 ECU_ADDRESS 0x4000236A /end MEASUREMENT
/begin MEASUREMENT obd_ii_p0116_stuck_holdoff_timer "Countdown (reload CAL_obd_ii_coolant_rationality_holdoff_time) before an idle window counts." UBYTE NO_COMPU_METHOD 0 0 0 255 ECU_ADDRESS 0x4000236C /end MEASUREMENT
/begin MEASUREMENT obd_ii_p0116_stuck_sample_count "Samples in the current window (to CAL_obd_ii_coolant_rationality_sample_count)." UBYTE NO_COMPU_METHOD 0 0 0 255 ECU_ADDRESS 0x4000236D /end MEASUREMENT
/begin MEASUREMENT obd_ii_p0116_stuck_window_count "Windows with no coolant change (to CAL_obd_ii_coolant_rationality_count -> fail)." UBYTE NO_COMPU_METHOD 0 0 0 255 ECU_ADDRESS 0x4000236E /end MEASUREMENT
/begin MEASUREMENT cp_upper "Cp upper (V = val*5/1023)." UWORD CM_u16_voltage_5_1023v 0 0 0 320.307917888563 ECU_ADDRESS 0x40002370 /end MEASUREMENT
/begin MEASUREMENT cp_lower "Cp lower (V = val*5/1023)." UWORD CM_u16_voltage_5_1023v 0 0 0 320.307917888563 ECU_ADDRESS 0x40002372 /end MEASUREMENT
/begin MEASUREMENT clutch_sample_below_count "Clutch samples below the window." UBYTE NO_COMPU_METHOD 0 0 0 255 ECU_ADDRESS 0x40002374 /end MEASUREMENT
/begin MEASUREMENT clutch_sample_above_count "Clutch samples above the window." UBYTE NO_COMPU_METHOD 0 0 0 255 ECU_ADDRESS 0x40002375 /end MEASUREMENT
/begin MEASUREMENT cp_sample_count "Cp sample count." UBYTE NO_COMPU_METHOD 0 0 0 255 ECU_ADDRESS 0x40002376 /end MEASUREMENT
/begin MEASUREMENT clutch_confidence_min_init_flag "Clutch confidence minimum init flag (boolean flag)." UBYTE NO_COMPU_METHOD 0 0 0 255 ECU_ADDRESS 0x40002377 /end MEASUREMENT
/begin MEASUREMENT obd_ii_tstat_start_engine_air_temp "temp_engine_air latched at the start of the thermostat monitor." UBYTE CM_u8_temp_5_8_40c 0 0 -40 119.375 ECU_ADDRESS 0x40002378 /end MEASUREMENT
/begin MEASUREMENT obd_ii_tstat_start_manifold_temp "obd_ii_manifold_temp latched at the start of the thermostat monitor." UBYTE CM_u8_temp_5_8_40c 0 0 -40 119.375 ECU_ADDRESS 0x40002379 /end MEASUREMENT
/begin MEASUREMENT obd_ii_tstat_start_coolant_temp "coolant_temp latched at the start of the thermostat monitor." UBYTE CM_u8_temp_5_8_40c 0 0 -40 119.375 ECU_ADDRESS 0x4000237A /end MEASUREMENT
/begin MEASUREMENT obd_ii_tstat_start_ambient_temp "air_temp_ambient latched at the start of the thermostat monitor." UBYTE CM_u8_temp_5_8_40c 0 0 -40 119.375 ECU_ADDRESS 0x4000237B /end MEASUREMENT
/begin MEASUREMENT obd_ii_p0106_throttle_vacuum_model "P0106 throttle vacuum model interpolated between the low/high-rpm tables (mbar = val*4)." UBYTE CM_u8_pressure_4mbar 0 0 0 1020 ECU_ADDRESS 0x4000237C /end MEASUREMENT
/begin MEASUREMENT obd_ii_p0106_throttle_vacuum_rpm_hi "CAL_obd_ii_P0106_throttle_vacuum_rpm_hi[tps, load] (mbar = val*4)." UBYTE CM_u8_pressure_4mbar 0 0 0 1020 ECU_ADDRESS 0x4000237D /end MEASUREMENT
/begin MEASUREMENT obd_ii_p0106_throttle_vacuum_rpm_lo "CAL_obd_ii_P0106_throttle_vacuum_rpm_lo[tps, load] (mbar = val*4)." UBYTE CM_u8_pressure_4mbar 0 0 0 1020 ECU_ADDRESS 0x4000237E /end MEASUREMENT
/begin MEASUREMENT obd_ii_p0106_baro_error "Baro sensor - obd_ii_p0106_baro_estimate (mbar, signed), limited by CAL_obd_ii_P0106_baro_error_limits." SWORD CM_i16_pressure_mbar 0 0 -32768 32767 ECU_ADDRESS 0x40002380 /end MEASUREMENT
/begin MEASUREMENT obd_ii_p0116_stuck_result "Return of obd_ii_coolant_temp_rationality_check: 0 pass, 1 fail (sensor stuck), 3 running." UBYTE NO_COMPU_METHOD 0 0 0 255 ECU_ADDRESS 0x40002382 /end MEASUREMENT
/begin MEASUREMENT obd_ii_p0116_deviation_fault "0xff when |coolant model deviation| > obd_ii_p0116_deviation_max." UBYTE NO_COMPU_METHOD 0 0 0 255 ECU_ADDRESS 0x40002383 /end MEASUREMENT
/begin MEASUREMENT coolant_temp_derived3 "Coolant temperature derived3 (°C = val*5/8−40)." UBYTE CM_u8_temp_5_8_40c 0 0 -40 119.375 ECU_ADDRESS 0x40002384 /end MEASUREMENT
/begin MEASUREMENT obd_ii_p0106_baro_estimate "Part-load baro estimate = map + throttle vacuum model*4 + MAF pressure drop (mbar)." UWORD CM_i16_pressure_mbar 0 0 0 65535 ECU_ADDRESS 0x40002386 /end MEASUREMENT
/begin MEASUREMENT thermostat_diag_maf_threshold_ips "Thermostat diagnostic air-mass threshold (compared with thermostat_warmup_air_mass >> 16)." UBYTE NO_COMPU_METHOD 0 0 0 255 ECU_ADDRESS 0x40002388 /end MEASUREMENT
/begin MEASUREMENT thermostat_warmup_air_mass "sum of maf*thermostat_warmup_load_weight/5100 per tick = mg x weight/255; >>16 compared with thermostat_diag_maf_threshold_ips." ULONG CM_u16_mass_mg 0 0 0 4294967295 ECU_ADDRESS 0x4000238C /end MEASUREMENT
/begin MEASUREMENT thermostat_warmup_load_weight "CAL_cooling_thermostat_warmup_load_factor[load] while moving/off idle, 255 at idle." UBYTE CM_u8_factor_1_255 0 0 0 100 ECU_ADDRESS 0x40002390 /end MEASUREMENT
/begin MEASUREMENT obd_ii_p0128_health "Debounce health for P0128: reset to its CAL debounce count, decremented on failing samples; DTC fails at 0." UBYTE NO_COMPU_METHOD 0 0 0 255 ECU_ADDRESS 0x40002391 /end MEASUREMENT
/begin MEASUREMENT obd_ii_P0128_lowspeed_seconds "P0128 low-speed time counter." ULONG NO_COMPU_METHOD 0 0 0 4294967295 ECU_ADDRESS 0x40002394 /end MEASUREMENT
/begin MEASUREMENT obd_ii_P0128_iat_too_cold_latch "P0128: IAT too cold latch." UBYTE NO_COMPU_METHOD 0 0 0 255 ECU_ADDRESS 0x40002398 /end MEASUREMENT
/begin MEASUREMENT evap_tank_vacuum "Evap tank vacuum (negative = vacuum) used by the purge-flow test." SWORD NO_COMPU_METHOD 0 0 -32768 32767 ECU_ADDRESS 0x400023A0 /end MEASUREMENT
/begin MEASUREMENT obd_ii_p0451_status "P0451 (evap pressure sensor range/performance) monitor state bits." UWORD NO_COMPU_METHOD 0 0 0 65535 ECU_ADDRESS 0x400023A2 /end MEASUREMENT
/begin MEASUREMENT obd_ii_evap_entry_settle "Entry settle countdown (CAL_obd_ii_evap_entry_settle_delay)." UBYTE NO_COMPU_METHOD 0 0 0 255 ECU_ADDRESS 0x400023A4 /end MEASUREMENT
/begin MEASUREMENT obd_ii_evap_fuel_level_noise_count "Fuel-level noise events (vs CAL_obd_ii_evap_fuel_level_noise_count_limit)." UBYTE NO_COMPU_METHOD 0 0 0 255 ECU_ADDRESS 0x400023A5 /end MEASUREMENT
/begin MEASUREMENT obd_ii_evap_pressure_noise_count "Evap pressure noise events (vs CAL_obd_ii_evap_pressure_noise_count_limit)." UBYTE NO_COMPU_METHOD 0 0 0 255 ECU_ADDRESS 0x400023A6 /end MEASUREMENT
/begin MEASUREMENT obd_ii_p0461_health "Debounce health for P0461: reset to its CAL debounce count, decremented on failing samples; DTC fails at 0." UBYTE NO_COMPU_METHOD 0 0 0 255 ECU_ADDRESS 0x400023A7 /end MEASUREMENT
/begin MEASUREMENT obd_ii_p0451_fail_health "P0451 failure debounce (CAL_obd_ii_P0451_fail_debounce_count)." UBYTE NO_COMPU_METHOD 0 0 0 255 ECU_ADDRESS 0x400023A8 /end MEASUREMENT
/begin MEASUREMENT obd_ii_evap_fuel_level_start "fuel_level at the start of the stability window." UBYTE CM_u8_volume_1_10gallon 0 0 0 25.5 ECU_ADDRESS 0x400023A9 /end MEASUREMENT
/begin MEASUREMENT obd_ii_evap_fuel_level_delta "Fuel level change over the window." SWORD NO_COMPU_METHOD 0 0 -32768 32767 ECU_ADDRESS 0x400023AA /end MEASUREMENT
/begin MEASUREMENT obd_ii_evap_stability_samples "Stable samples (to CAL_obd_ii_evap_stability_window_samples)." UWORD NO_COMPU_METHOD 0 0 0 65535 ECU_ADDRESS 0x400023AC /end MEASUREMENT
/begin MEASUREMENT obd_ii_p0451_pressure_min "Minimum evap pressure (+offset) seen by P0451." SWORD NO_COMPU_METHOD 0 0 -32768 32767 ECU_ADDRESS 0x400023AE /end MEASUREMENT
/begin MEASUREMENT obd_ii_p0451_pressure_max "Maximum evap pressure (+offset); max-min > CAL_obd_ii_P0451_pressure_swing_min passes." SWORD NO_COMPU_METHOD 0 0 -32768 32767 ECU_ADDRESS 0x400023B0 /end MEASUREMENT
/begin MEASUREMENT obd_ii_evap_fuel_level_noise "|fuel_level_raw delta| this sample." UBYTE NO_COMPU_METHOD 0 0 0 255 ECU_ADDRESS 0x400023B2 /end MEASUREMENT
/begin MEASUREMENT obd_ii_evap_pressure_noise "|pressure delta| this sample." SWORD NO_COMPU_METHOD 0 0 -32768 32767 ECU_ADDRESS 0x400023B4 /end MEASUREMENT
/begin MEASUREMENT obd_ii_evap_fuel_level_raw_prev "Previous fuel_level_raw." UWORD NO_COMPU_METHOD 0 0 0 65535 ECU_ADDRESS 0x400023B6 /end MEASUREMENT
/begin MEASUREMENT obd_ii_p0451_pressure "obd_ii_evap_purge_pressure + zero offset." SWORD NO_COMPU_METHOD 0 0 -32768 32767 ECU_ADDRESS 0x400023B8 /end MEASUREMENT
/begin MEASUREMENT obd_ii_p0451_health_a "P0451 sub-test debounce (CAL_obd_ii_P0451_debounce_count)." UBYTE NO_COMPU_METHOD 0 0 0 255 ECU_ADDRESS 0x400023BA /end MEASUREMENT
/begin MEASUREMENT obd_ii_p0451_health_b "P0451 sub-test debounce (CAL_obd_ii_P0451_debounce_count)." UBYTE NO_COMPU_METHOD 0 0 0 255 ECU_ADDRESS 0x400023BB /end MEASUREMENT
/begin MEASUREMENT obd_ii_p0451_health_c "P0451 sub-test debounce." UBYTE NO_COMPU_METHOD 0 0 0 255 ECU_ADDRESS 0x400023BC /end MEASUREMENT
/begin MEASUREMENT obd_ii_p0451_health_d "P0451 sub-test debounce (CAL_obd_ii_P0451_debounce_count)." UBYTE NO_COMPU_METHOD 0 0 0 255 ECU_ADDRESS 0x400023BD /end MEASUREMENT
/begin MEASUREMENT obd_ii_evap_purge_settle "Purge settle countdown (CAL_obd_ii_evap_purge_settle_debounce)." UBYTE NO_COMPU_METHOD 0 0 0 255 ECU_ADDRESS 0x400023BE /end MEASUREMENT
/begin MEASUREMENT obd_ii_evap_monitor_settle "Monitor settle countdown (CAL_obd_ii_evap_monitor_settle_count)." UBYTE NO_COMPU_METHOD 0 0 0 255 ECU_ADDRESS 0x400023BF /end MEASUREMENT
/begin MEASUREMENT vvt_task_rate_divider "vvt_200hz divider, reload 10: cam targets ramp 1 count (0.25 deg) per 50 ms." UBYTE NO_COMPU_METHOD 0 0 0 255 ECU_ADDRESS 0x400023C0 /end MEASUREMENT
/begin MEASUREMENT vvt_inlet_target_requested "Inlet base map (normal or low-load) - coolant offset, clamped 0..43 deg (deg = val/4). Was vvt_inlet_taget_calc_bank1." UWORD CM_u8_angle_1_4deg 0 0 0 16383.75 ECU_ADDRESS 0x400023C2 /end MEASUREMENT
/begin MEASUREMENT vvt_exhaust_target_requested "Exhaust base map - coolant comp, clamped 0..35 deg (deg = val/4). Was vvt_exhaust_taget_calc_bank1." UWORD CM_u8_angle_1_4deg 0 0 0 16383.75 ECU_ADDRESS 0x400023C4 /end MEASUREMENT
/begin MEASUREMENT vvt_pi_p_term_inlet_b1 "Inlet b1 PI proportional term = error*CAL_vvt_error_gain_startup>>8." SWORD CM_i16_dutycycle_1_2000 0 0 -16.384 16.3835 ECU_ADDRESS 0x400023C6 /end MEASUREMENT
/begin MEASUREMENT vvt_pi_integral_inlet_b1 "Inlet b1 PI integrator (<<8), += error*CAL_vvt_integral_gain every 50 ms, clamped +-0x19000 (= +-400 after >>8)." SLONG CM_i16_dutycycle_1_2000 0 0 -1073741.824 1073741.8235 ECU_ADDRESS 0x400023C8 /end MEASUREMENT
/begin MEASUREMENT vvt_pi_output_inlet_b1 "Inlet b1 PI output = P + I>>8, clamped +-400; -400 forced after target==0 timeout (park). duty = val/2 + 400." SLONG CM_i16_dutycycle_1_2000 0 0 -1073741.824 1073741.8235 ECU_ADDRESS 0x400023CC /end MEASUREMENT
/begin MEASUREMENT vvt_pi_p_term_inlet_b2 "Inlet b2 PI proportional term." SWORD CM_i16_dutycycle_1_2000 0 0 -16.384 16.3835 ECU_ADDRESS 0x400023D0 /end MEASUREMENT
/begin MEASUREMENT vvt_pi_integral_inlet_b2 "Inlet b2 PI integrator (<<8), clamped +-0x19000." SLONG CM_i16_dutycycle_1_2000 0 0 -1073741.824 1073741.8235 ECU_ADDRESS 0x400023D4 /end MEASUREMENT
/begin MEASUREMENT vvt_pi_output_inlet_b2 "Inlet b2 PI output, clamped +-400." SLONG CM_i16_dutycycle_1_2000 0 0 -1073741.824 1073741.8235 ECU_ADDRESS 0x400023D8 /end MEASUREMENT
/begin MEASUREMENT vvt_pi_p_term_exhaust_b1 "Exhaust b1 PI proportional term." SWORD CM_i16_dutycycle_1_2000 0 0 -16.384 16.3835 ECU_ADDRESS 0x400023DC /end MEASUREMENT
/begin MEASUREMENT vvt_pi_integral_exhaust_b1 "Exhaust b1 PI integrator (<<8), clamped +-0x19000." SLONG CM_i16_dutycycle_1_2000 0 0 -1073741.824 1073741.8235 ECU_ADDRESS 0x400023E0 /end MEASUREMENT
/begin MEASUREMENT vvt_pi_output_exhaust_b1 "Exhaust b1 PI output, clamped +-400." SLONG CM_i16_dutycycle_1_2000 0 0 -1073741.824 1073741.8235 ECU_ADDRESS 0x400023E4 /end MEASUREMENT
/begin MEASUREMENT vvt_pi_p_term_exhaust_b2 "Exhaust b2 PI proportional term." SWORD CM_i16_dutycycle_1_2000 0 0 -16.384 16.3835 ECU_ADDRESS 0x400023E8 /end MEASUREMENT
/begin MEASUREMENT vvt_pi_integral_exhaust_b2 "Exhaust b2 PI integrator (<<8), clamped +-0x19000." SLONG CM_i16_dutycycle_1_2000 0 0 -1073741.824 1073741.8235 ECU_ADDRESS 0x400023EC /end MEASUREMENT
/begin MEASUREMENT vvt_pi_output_exhaust_b2 "Exhaust b2 PI output, clamped +-400." SLONG CM_i16_dutycycle_1_2000 0 0 -1073741.824 1073741.8235 ECU_ADDRESS 0x400023F0 /end MEASUREMENT
/begin MEASUREMENT vvt_intake_transition_complete "VVT intake transition complete (boolean flag)." UBYTE NO_COMPU_METHOD 0 0 0 255 ECU_ADDRESS 0x400023F4 /end MEASUREMENT
/begin MEASUREMENT vvt_exhaust_transition_complete "VVT exhaust transition complete (boolean flag)." UBYTE NO_COMPU_METHOD 0 0 0 255 ECU_ADDRESS 0x400023F5 /end MEASUREMENT
/begin MEASUREMENT cam_park_position_sum_inlet_b1 "Sum of inlet b1 cam positions during the park check (1/4 deg units). Was typed u16 (it is a 32-bit sum)." SLONG NO_COMPU_METHOD 0 0 -2147483648 2147483647 ECU_ADDRESS 0x400023F8 /end MEASUREMENT
/begin MEASUREMENT cam_park_position_sum_inlet_b2 "Sum of inlet b2 cam positions during the park check." SLONG NO_COMPU_METHOD 0 0 -2147483648 2147483647 ECU_ADDRESS 0x400023FC /end MEASUREMENT
/begin MEASUREMENT cam_park_position_sum_exhaust_b1 "Sum of exhaust b1 cam positions during the park check." SLONG NO_COMPU_METHOD 0 0 -2147483648 2147483647 ECU_ADDRESS 0x40002400 /end MEASUREMENT
/begin MEASUREMENT cam_park_position_sum_exhaust_b2 "Sum of exhaust b2 cam positions during the park check." SLONG NO_COMPU_METHOD 0 0 -2147483648 2147483647 ECU_ADDRESS 0x40002404 /end MEASUREMENT
/begin MEASUREMENT cam_park_sample_count_inlet_b1 "Park-check sample count, inlet b1." ULONG NO_COMPU_METHOD 0 0 0 4294967295 ECU_ADDRESS 0x40002408 /end MEASUREMENT
/begin MEASUREMENT cam_park_sample_count_inlet_b2 "Park-check sample count, inlet b2." ULONG NO_COMPU_METHOD 0 0 0 4294967295 ECU_ADDRESS 0x4000240C /end MEASUREMENT
/begin MEASUREMENT cam_park_sample_count_exhaust_b1 "Park-check sample count, exhaust b1." ULONG NO_COMPU_METHOD 0 0 0 4294967295 ECU_ADDRESS 0x40002410 /end MEASUREMENT
/begin MEASUREMENT cam_park_sample_count_exhaust_b2 "Park-check sample count, exhaust b2." ULONG NO_COMPU_METHOD 0 0 0 4294967295 ECU_ADDRESS 0x40002414 /end MEASUREMENT
/begin MEASUREMENT vvt_park_integral_reset_flags "Per-controller flag (bit0 in-b1, bit1 in-b2, bit2 ex-b1, bit3 ex-b2): integrator to be cleared when target leaves 0." UBYTE NO_COMPU_METHOD 0 0 0 255 ECU_ADDRESS 0x40002418 /end MEASUREMENT
/begin MEASUREMENT vvt_intake_target_zero_timer "Counts down while the inlet target is 0 (reload CAL_vvt_zero_target_timeout); at 0 the PI output is forced to -400 (park)." UBYTE CM_u8_time_100ms 0 0 0 25500 ECU_ADDRESS 0x40002419 /end MEASUREMENT
/begin MEASUREMENT vvt_exhaust_target_zero_timer "Counts down while the exhaust target is 0; at 0 the PI output is forced to -400." UBYTE CM_u8_time_100ms 0 0 0 25500 ECU_ADDRESS 0x4000241A /end MEASUREMENT
/begin MEASUREMENT vvt_low_load_active "VVT low load active (boolean flag)." UBYTE NO_COMPU_METHOD 0 0 0 255 ECU_ADDRESS 0x4000241B /end MEASUREMENT
/begin MEASUREMENT vvt_low_load_target_offset "Mean (intake+exhaust) of active target - normal-map target while both cams are on the low-load map, 0..255 (deg = val/4); non-zero selects idle LEA offsets / alt spark tables. Was vvt_error_scale." UBYTE CM_u8_angle_1_4deg 0 0 0 63.75 ECU_ADDRESS 0x4000241C /end MEASUREMENT
/begin MEASUREMENT vvt_exhaust_mode_flags "bit0 low-load map active, bit1 normal map, bit2 ramping to low-load, bit3 ramping to normal." UBYTE NO_COMPU_METHOD 0 0 0 255 ECU_ADDRESS 0x4000241D /end MEASUREMENT
/begin MEASUREMENT vvt_intake_mode_flags "bit0 low-load map active, bit1 normal map, bit2 ramping to low-load, bit3 ramping to normal." UBYTE NO_COMPU_METHOD 0 0 0 255 ECU_ADDRESS 0x4000241E /end MEASUREMENT
/begin MEASUREMENT cam_edge_watchdog_exhaust_b2 "Cam edge watchdog exhaust b2: reloaded to CAL_obd_ii_crank_cam_error_count_max by the cam ISR, -1 per crank rev; also a new-sample flag for the park check." UBYTE NO_COMPU_METHOD 0 0 0 255 ECU_ADDRESS 0x4000241F /end MEASUREMENT
/begin MEASUREMENT cam_edge_watchdog_exhaust_b1 "Cam edge watchdog exhaust b1." UBYTE NO_COMPU_METHOD 0 0 0 255 ECU_ADDRESS 0x40002420 /end MEASUREMENT
/begin MEASUREMENT cam_edge_watchdog_inlet_b2 "Cam edge watchdog inlet b2." UBYTE NO_COMPU_METHOD 0 0 0 255 ECU_ADDRESS 0x40002421 /end MEASUREMENT
/begin MEASUREMENT cam_edge_watchdog_inlet_b1 "Cam edge watchdog inlet b1 (see exhaust b2). Was cam_edge_watchdog." UBYTE NO_COMPU_METHOD 0 0 0 255 ECU_ADDRESS 0x40002422 /end MEASUREMENT
/begin MEASUREMENT cam_park_position_mean_exhaust_b2 "Mean park position exhaust b2; |mean| > CAL_vvt_cam_park_offset_max sets the offset fault." SLONG CM_u8_angle_1_4deg 0 0 -536870912 536870911.75 ECU_ADDRESS 0x40002424 /end MEASUREMENT
/begin MEASUREMENT cam_park_position_mean_exhaust_b1 "Mean park position exhaust b1." SLONG CM_u8_angle_1_4deg 0 0 -536870912 536870911.75 ECU_ADDRESS 0x40002428 /end MEASUREMENT
/begin MEASUREMENT cam_park_position_mean_inlet_b2 "Mean park position inlet b2." SLONG CM_u8_angle_1_4deg 0 0 -536870912 536870911.75 ECU_ADDRESS 0x4000242C /end MEASUREMENT
/begin MEASUREMENT cam_park_position_mean_inlet_b1 "Mean park position inlet b1." SLONG CM_u8_angle_1_4deg 0 0 -536870912 536870911.75 ECU_ADDRESS 0x40002430 /end MEASUREMENT
/begin MEASUREMENT cam_park_offset_fault_exhaust_b2 "Park offset fault exhaust b2 (0 ok, 0xff = |mean| > CAL_vvt_cam_park_offset_max); blocks closed-loop VVT." UBYTE NO_COMPU_METHOD 0 0 0 255 ECU_ADDRESS 0x40002434 /end MEASUREMENT
/begin MEASUREMENT cam_park_offset_fault_exhaust_b1 "Park offset fault exhaust b1." UBYTE NO_COMPU_METHOD 0 0 0 255 ECU_ADDRESS 0x40002435 /end MEASUREMENT
/begin MEASUREMENT cam_park_offset_fault_inlet_b2 "Park offset fault inlet b2." UBYTE NO_COMPU_METHOD 0 0 0 255 ECU_ADDRESS 0x40002436 /end MEASUREMENT
/begin MEASUREMENT cam_park_offset_fault_inlet_b1 "Park offset fault inlet b1." UBYTE NO_COMPU_METHOD 0 0 0 255 ECU_ADDRESS 0x40002437 /end MEASUREMENT
/begin MEASUREMENT cam_park_check_done_exhaust_b2 "Park check done exhaust b2 (1 = done)." UBYTE NO_COMPU_METHOD 0 0 0 255 ECU_ADDRESS 0x40002438 /end MEASUREMENT
/begin MEASUREMENT cam_park_check_done_exhaust_b1 "Park check done exhaust b1." UBYTE NO_COMPU_METHOD 0 0 0 255 ECU_ADDRESS 0x40002439 /end MEASUREMENT
/begin MEASUREMENT cam_park_check_done_inlet_b2 "Park check done inlet b2 (1 = done)." UBYTE NO_COMPU_METHOD 0 0 0 255 ECU_ADDRESS 0x4000243A /end MEASUREMENT
/begin MEASUREMENT cam_park_check_done_inlet_b1 "Park check done inlet b1." UBYTE NO_COMPU_METHOD 0 0 0 255 ECU_ADDRESS 0x4000243B /end MEASUREMENT
/begin MEASUREMENT vvt_enable_delay_5ms "CAL_vvt_start_timer[stopped coolant]*20: before this runtime the cams are held parked and sampled; after it closed-loop VVT runs. Was vvt_start_time." UWORD CM_u8_time_5ms 0 0 0 327675 ECU_ADDRESS 0x4000243C /end MEASUREMENT
/begin MEASUREMENT obd_ii_vvt_exhaust_error_bank2 "Exhaust cam error bank 2 = target + position (exhaust position is negative-going) (deg = val/4)." SWORD CM_u8_angle_1_4deg 0 0 -8192 8191.75 ECU_ADDRESS 0x4000243E /end MEASUREMENT
/begin MEASUREMENT obd_ii_vvt_exhaust_error_bank1 "Exhaust cam error bank 1 = target + position (deg = val/4)." SWORD CM_u8_angle_1_4deg 0 0 -8192 8191.75 ECU_ADDRESS 0x40002440 /end MEASUREMENT
/begin MEASUREMENT obd_ii_vvt_inlet_error_bank2 "obd_ii_vvt_inlet_target - inlet position bank 2 (deg = val/4). Was obd_ii_vvt_inlet_angle_error_bank2." SWORD CM_u8_angle_1_4deg 0 0 -8192 8191.75 ECU_ADDRESS 0x40002442 /end MEASUREMENT
/begin MEASUREMENT obd_ii_vvt_inlet_error_bank1 "obd_ii_vvt_inlet_target - inlet position bank 1 (deg = val/4). Was obd_ii_vvt_inlet_angle_error_bank1." SWORD CM_u8_angle_1_4deg 0 0 -8192 8191.75 ECU_ADDRESS 0x40002444 /end MEASUREMENT
/begin MEASUREMENT obd_ii_vvt_exhaust_target "Exhaust cam target used by BOTH banks, ramped 0.25 deg / 50 ms (deg = val/4). Was obd_ii_vvt_exhaust_target_bank1." UWORD CM_u8_angle_1_4deg 0 0 0 16383.75 ECU_ADDRESS 0x40002446 /end MEASUREMENT
/begin MEASUREMENT obd_ii_vvt_inlet_target "Inlet cam target used by BOTH banks, ramped 0.25 deg / 50 ms toward vvt_inlet_target_requested in vvt_200hz (deg = val/4). Was vvt_inlet_target_bank1." UWORD CM_u8_angle_1_4deg 0 0 0 16383.75 ECU_ADDRESS 0x40002448 /end MEASUREMENT
/begin MEASUREMENT obd_ii_throttle_body_range_perf "Set by tps_control_1000hz on throttle body range/performance failure -> P2119." UBYTE NO_COMPU_METHOD 0 0 0 255 ECU_ADDRESS 0x40002450 /end MEASUREMENT
/begin MEASUREMENT tps_track_a_raw "TPS track A 12-bit ADC (get_tps_a_12bit) before smoothing. Was tps_absolute_." UWORD CM_u16_voltage_5_4095v 0 0 0 80.018315018315 ECU_ADDRESS 0x40002452 /end MEASUREMENT
/begin MEASUREMENT tps_absolute_b "u16_voltage_5/1023v" UWORD CM_u16_voltage_5_1023v 0 0 0 320.307917888563 ECU_ADDRESS 0x40002454 /end MEASUREMENT
/begin MEASUREMENT tps_absolute_a "u16_voltage_5/1023v" UWORD CM_u16_voltage_5_1023v 0 0 0 320.307917888563 ECU_ADDRESS 0x40002456 /end MEASUREMENT
/begin MEASUREMENT tps_absolte_b_u8 "u16_voltage_5/1023v" UWORD CM_u16_voltage_5_1023v 0 0 0 320.307917888563 ECU_ADDRESS 0x40002458 /end MEASUREMENT
/begin MEASUREMENT etb_pwm_duty_percent "ETB PWM duty (%) last commanded." UBYTE NO_COMPU_METHOD 0 0 0 255 ECU_ADDRESS 0x4000245A /end MEASUREMENT
/begin MEASUREMENT obd_ii_commanded_throttle_actuator "Final, commanded throttle position" UWORD CM_u16_factor_1_4095 0 0 0 1600.3663003663 ECU_ADDRESS 0x4000245C /end MEASUREMENT
/begin MEASUREMENT tps_limited_clamped "TPS target after warmup/min clamps" UWORD CM_u16_factor_1_1023 0 0 0 6406.15835777126 ECU_ADDRESS 0x4000245E /end MEASUREMENT
/begin MEASUREMENT etb_dbg_error "ETB PID debug: position error." SWORD NO_COMPU_METHOD 0 0 -32768 32767 ECU_ADDRESS 0x40002460 /end MEASUREMENT
/begin MEASUREMENT etb_dbg_derivative_filtered "ETB PID debug: filtered derivative." SWORD NO_COMPU_METHOD 0 0 -32768 32767 ECU_ADDRESS 0x40002462 /end MEASUREMENT
/begin MEASUREMENT etb_dbg_p_term "ETB PID debug: P term." SLONG NO_COMPU_METHOD 0 0 -2147483648 2147483647 ECU_ADDRESS 0x40002464 /end MEASUREMENT
/begin MEASUREMENT etb_dbg_integral "ETB PID debug: integral." SLONG NO_COMPU_METHOD 0 0 -2147483648 2147483647 ECU_ADDRESS 0x40002468 /end MEASUREMENT
/begin MEASUREMENT etb_dbg_i_term "ETB PID debug: I term." SLONG NO_COMPU_METHOD 0 0 -2147483648 2147483647 ECU_ADDRESS 0x4000246C /end MEASUREMENT
/begin MEASUREMENT etb_dbg_pid_sum "ETB PID debug: PID sum." SLONG NO_COMPU_METHOD 0 0 -2147483648 2147483647 ECU_ADDRESS 0x40002470 /end MEASUREMENT
/begin MEASUREMENT etb_dbg_d_term "ETB PID debug: D term." SLONG NO_COMPU_METHOD 0 0 -2147483648 2147483647 ECU_ADDRESS 0x40002474 /end MEASUREMENT
/begin MEASUREMENT etb_dbg_feedforward_term "ETB PID debug: feed-forward term." SLONG NO_COMPU_METHOD 0 0 -2147483648 2147483647 ECU_ADDRESS 0x40002478 /end MEASUREMENT
/begin MEASUREMENT tps_target_post_limits_s32 "uint32_t" ULONG NO_COMPU_METHOD 0 0 0 4294967295 ECU_ADDRESS 0x4000247C /end MEASUREMENT
/begin MEASUREMENT tps_target_post_limits_u16 "u16_factor_1/1023" UWORD CM_u16_factor_1_1023 0 0 0 6406.15835777126 ECU_ADDRESS 0x40002480 /end MEASUREMENT
/begin MEASUREMENT tps1_cal_offset "Learned TPS1 0% count (CAL_tps_etb_tps1_scale_0pct_frac of the closed..max span)." UWORD CM_u16_voltage_5_4095v 0 0 0 80.018315018315 ECU_ADDRESS 0x40002482 /end MEASUREMENT
/begin MEASUREMENT tps2_cal_offset "Learned TPS2 0% count." UWORD CM_u16_voltage_5_4095v 0 0 0 80.018315018315 ECU_ADDRESS 0x40002484 /end MEASUREMENT
/begin MEASUREMENT tps1_cal_full "Learned TPS1 100% count." UWORD CM_u16_voltage_5_4095v 0 0 0 80.018315018315 ECU_ADDRESS 0x40002486 /end MEASUREMENT
/begin MEASUREMENT tps2_cal_full "Learned TPS2 100% count." UWORD CM_u16_voltage_5_4095v 0 0 0 80.018315018315 ECU_ADDRESS 0x40002488 /end MEASUREMENT
/begin MEASUREMENT tps1_cal_gain "TPS1 gain = 0x3ffff / (full - offset)." UWORD NO_COMPU_METHOD 0 0 0 65535 ECU_ADDRESS 0x4000248A /end MEASUREMENT
/begin MEASUREMENT tps2_cal_gain "TPS2 gain = 0x3ffff / (full - offset)." UWORD NO_COMPU_METHOD 0 0 0 65535 ECU_ADDRESS 0x4000248C /end MEASUREMENT
/begin MEASUREMENT tps1_abs_gain "TPS1 absolute gain = 0x3ffff / (CAL_tps_etb_tps1_max_count - 0x235)." UWORD NO_COMPU_METHOD 0 0 0 65535 ECU_ADDRESS 0x4000248E /end MEASUREMENT
/begin MEASUREMENT tps2_abs_gain "TPS2 absolute gain = 0x3ffff / (CAL_tps_etb_tps2_max_count - 0x732)." UWORD NO_COMPU_METHOD 0 0 0 65535 ECU_ADDRESS 0x40002490 /end MEASUREMENT
/begin MEASUREMENT cruise_cancel_request_flags "Cruise cancel request bits (bit0 set by throttle control)." UWORD NO_COMPU_METHOD 0 0 0 65535 ECU_ADDRESS 0x40002492 /end MEASUREMENT
/begin MEASUREMENT tps_smoothing_step_flags "Throttle position smoothing step flags (enumerated state)." UBYTE NO_COMPU_METHOD 0 0 0 255 ECU_ADDRESS 0x40002494 /end MEASUREMENT
/begin MEASUREMENT throttle_error_flags "Throttle error flags." UBYTE NO_COMPU_METHOD 0 0 0 255 ECU_ADDRESS 0x40002496 /end MEASUREMENT
/begin MEASUREMENT etb_hc08_state_mismatch "bool" UBYTE NO_COMPU_METHOD 0 0 0 255 ECU_ADDRESS 0x40002497 /end MEASUREMENT
/begin MEASUREMENT throttle_calibrate_fail "Throttle calibrate fail (boolean flag)." UBYTE NO_COMPU_METHOD 0 0 0 255 ECU_ADDRESS 0x40002498 /end MEASUREMENT
/begin MEASUREMENT lfb_pulse_toggle_timer "Lfb pulse toggle timer (ms = val*100)." UWORD CM_u8_time_100ms 0 0 0 6553500 ECU_ADDRESS 0x4000249A /end MEASUREMENT
/begin MEASUREMENT lfb_state_flags "Left-foot-braking state bits (bit3 = LFB fault -> P1106)." UBYTE NO_COMPU_METHOD 0 0 0 255 ECU_ADDRESS 0x4000249C /end MEASUREMENT
/begin MEASUREMENT torque_limit "Torque limit (Nm)." UWORD CM_u8_torque_nm 0 0 0 65535 ECU_ADDRESS 0x4000249E /end MEASUREMENT
/begin MEASUREMENT etb_initialization_state "Throttle body initialization state (enumerated state)." UBYTE NO_COMPU_METHOD 0 0 0 255 ECU_ADDRESS 0x400024A0 /end MEASUREMENT
/begin MEASUREMENT throttle_disable_step_count "Step counter in throttle_disable (> 49)." UWORD NO_COMPU_METHOD 0 0 0 65535 ECU_ADDRESS 0x400024A2 /end MEASUREMENT
/begin MEASUREMENT tps_max_during_warmup "Throttle position maximum during warmup (val/1023)." UWORD CM_u16_factor_1_1023 0 0 0 6406.15835777126 ECU_ADDRESS 0x400024A4 /end MEASUREMENT
/begin MEASUREMENT throttle_disable_trace_len "Number of TPS trace samples captured in throttle_disable." UWORD NO_COMPU_METHOD 0 0 0 65535 ECU_ADDRESS 0x400024A6 /end MEASUREMENT
/begin MEASUREMENT throttle_fault_capture_count "Throttle fault capture count (0, 1, 2)." UBYTE NO_COMPU_METHOD 0 0 0 255 ECU_ADDRESS 0x400024A8 /end MEASUREMENT
/begin MEASUREMENT throttle_disable_duty "Duty ramp in throttle_disable (0xaa0 -> 0x780)." SLONG NO_COMPU_METHOD 0 0 -2147483648 2147483647 ECU_ADDRESS 0x400024AC /end MEASUREMENT
/begin MEASUREMENT throttle_disable_tps_a_last "tps_track_a_smoothed at the end of throttle_disable." UWORD NO_COMPU_METHOD 0 0 0 65535 ECU_ADDRESS 0x400024B0 /end MEASUREMENT
/begin MEASUREMENT throttle_disable_ms "Time in throttle_disable (to 1000)." UWORD CM_u8_time_ms 0 0 0 65535 ECU_ADDRESS 0x400024B2 /end MEASUREMENT
/begin MEASUREMENT throttle_disable_trace_index "Write index into the TPS trace buffer at 0x40006170 (32 samples)." UBYTE NO_COMPU_METHOD 0 0 0 255 ECU_ADDRESS 0x400024B4 /end MEASUREMENT
/begin MEASUREMENT throttle_disable_trace_ptr "Pointer to LEA_tps_fault_trace_track_a." ULONG NO_COMPU_METHOD 0 0 0 4294967295 ECU_ADDRESS 0x400024B8 /end MEASUREMENT
/begin MEASUREMENT tps_smooth_step_timer "u16_time_10ms" UWORD CM_u8_time_10ms 0 0 0 655350 ECU_ADDRESS 0x400024BC /end MEASUREMENT
/begin MEASUREMENT tps_request_before_limits "Throttle position request before limits (val/1023)." UWORD CM_u16_factor_1_1023 0 0 0 6406.15835777126 ECU_ADDRESS 0x400024BE /end MEASUREMENT
/begin MEASUREMENT tps_smooth_error "u16_factor_1/255" UWORD CM_u8_factor_1_255 0 0 0 25700 ECU_ADDRESS 0x400024C0 /end MEASUREMENT
/begin MEASUREMENT tpssmooth_decrement "u16_factor_1/4095" UWORD CM_u16_factor_1_4095 0 0 0 1600.3663003663 ECU_ADDRESS 0x400024C2 /end MEASUREMENT
/begin MEASUREMENT tps_smooth_incr_step "u16_factor_1/4095" UWORD CM_u16_factor_1_4095 0 0 0 1600.3663003663 ECU_ADDRESS 0x400024C4 /end MEASUREMENT
/begin MEASUREMENT tpssmooth_parking_mode_active "bool" UBYTE NO_COMPU_METHOD 0 0 0 255 ECU_ADDRESS 0x400024C6 /end MEASUREMENT
/begin MEASUREMENT revlimit_throttle_clamp_active "Rev-limit throttle clamp active (boolean flag)." UBYTE NO_COMPU_METHOD 0 0 0 255 ECU_ADDRESS 0x400024C7 /end MEASUREMENT
/begin MEASUREMENT tps_smooth_decr_by_rpm "Throttle position smooth decrement2 (val/255)." UBYTE CM_u8_factor_1_255 0 0 0 100 ECU_ADDRESS 0x400024C8 /end MEASUREMENT
/begin MEASUREMENT tps_smooth_incr_by_rpm "u8_factor_1/255" UBYTE CM_u8_factor_1_255 0 0 0 100 ECU_ADDRESS 0x400024C9 /end MEASUREMENT
/begin MEASUREMENT tps_smooth_incr_by_delta "Tpssmooth increment2 (val/255)." UBYTE CM_u8_factor_1_255 0 0 0 100 ECU_ADDRESS 0x400024CA /end MEASUREMENT
/begin MEASUREMENT tpssmooth_decrement_a "TPS smoothing decrement after gear scaling." UBYTE NO_COMPU_METHOD 0 0 0 255 ECU_ADDRESS 0x400024CB /end MEASUREMENT
/begin MEASUREMENT tps_torque_limit_applied "Throttle position torque limit applied (boolean flag)." UBYTE NO_COMPU_METHOD 0 0 0 255 ECU_ADDRESS 0x400024CC /end MEASUREMENT
/begin MEASUREMENT torque_limit_cooldown_timer "Torque-limit cooldown countdown (CAL_torque_limit_cooldown_timer)." UWORD NO_COMPU_METHOD 0 0 0 65535 ECU_ADDRESS 0x400024CE /end MEASUREMENT
/begin MEASUREMENT tps_commanded_filtered "Throttle position smooth (val/4095)." UWORD CM_u16_factor_1_4095 0 0 0 1600.3663003663 ECU_ADDRESS 0x400024D0 /end MEASUREMENT
/begin MEASUREMENT torque_limit_by_rpm "Torque limit by RPM (Nm)." UWORD CM_u8_torque_nm 0 0 0 65535 ECU_ADDRESS 0x400024D2 /end MEASUREMENT
/begin MEASUREMENT torque_limit_engine_speed "Torque limit engine speed (Nm)." UWORD CM_u8_torque_nm 0 0 0 65535 ECU_ADDRESS 0x400024D4 /end MEASUREMENT
/begin MEASUREMENT etb_pos_history_z0 "ETB position history z0." SWORD NO_COMPU_METHOD 0 0 -32768 32767 ECU_ADDRESS 0x400024D8 /end MEASUREMENT
/begin MEASUREMENT etb_pos_history_z1 "ETB position history z-1." SWORD NO_COMPU_METHOD 0 0 -32768 32767 ECU_ADDRESS 0x400024DA /end MEASUREMENT
/begin MEASUREMENT etb_pos_history_z2 "ETB position history z-2." SWORD NO_COMPU_METHOD 0 0 -32768 32767 ECU_ADDRESS 0x400024DC /end MEASUREMENT
/begin MEASUREMENT etb_pos_history_z3 "ETB position history z-3." SWORD NO_COMPU_METHOD 0 0 -32768 32767 ECU_ADDRESS 0x400024DE /end MEASUREMENT
/begin MEASUREMENT etb_pid_integral "ETB PID integral." SLONG NO_COMPU_METHOD 0 0 -2147483648 2147483647 ECU_ADDRESS 0x400024E0 /end MEASUREMENT
/begin MEASUREMENT etb_init_delay_timer "ETB init delay (1000 = 1 s at 1 kHz)." UWORD CM_u8_time_ms 0 0 0 65535 ECU_ADDRESS 0x400024E4 /end MEASUREMENT
/begin MEASUREMENT tps_init_and_stability_state "TPS init/stability state (1, 2)." UBYTE NO_COMPU_METHOD 0 0 0 255 ECU_ADDRESS 0x400024E6 /end MEASUREMENT
/begin MEASUREMENT hc08_cruise_mode_ack_timer "HC08 cruise-mode acknowledge timer (500 ms)." UWORD CM_u8_time_ms 0 0 0 65535 ECU_ADDRESS 0x400024E8 /end MEASUREMENT
/begin MEASUREMENT throttle_uptime_ticks "Throttle uptime (1 kHz, saturating)." UWORD CM_u8_time_ms 0 0 0 65535 ECU_ADDRESS 0x400024EA /end MEASUREMENT
/begin MEASUREMENT throttle_monitor5_ticks "Time in throttle monitor state 5 (1 kHz, saturating)." UWORD CM_u8_time_ms 0 0 0 65535 ECU_ADDRESS 0x400024EC /end MEASUREMENT
/begin MEASUREMENT lfb_tps_cap_x4 "Left-foot-brake TPS cap x4 (0x3ffc = none)." SWORD NO_COMPU_METHOD 0 0 -32768 32767 ECU_ADDRESS 0x400024EE /end MEASUREMENT
/begin MEASUREMENT lfb_tps_target_x4 "Left-foot-brake TPS target x4." SWORD NO_COMPU_METHOD 0 0 -32768 32767 ECU_ADDRESS 0x400024F0 /end MEASUREMENT
/begin MEASUREMENT lfb_hold_timer "LFB hold countdown (CAL_lfb_timer_hold<<5)." UWORD NO_COMPU_METHOD 0 0 0 65535 ECU_ADDRESS 0x400024F2 /end MEASUREMENT
/begin MEASUREMENT lfb_entry_countdown_timer "LFB entry countdown (CAL_lfb_timer_entry<<5). Was lbf_entry_countdown_timer." UWORD NO_COMPU_METHOD 0 0 0 65535 ECU_ADDRESS 0x400024F4 /end MEASUREMENT
/begin MEASUREMENT lfb_brake_off_hold_ticks "LFB brake-off hold (CAL_lfb_brake_off_hold_ticks)." UWORD NO_COMPU_METHOD 0 0 0 65535 ECU_ADDRESS 0x400024F6 /end MEASUREMENT
/begin MEASUREMENT lfb_tps_rate "LFB TPS slew rate (CAL_lfb_pedal_override_rate or CAL_lfb_release_rate)." UWORD NO_COMPU_METHOD 0 0 0 65535 ECU_ADDRESS 0x400024F8 /end MEASUREMENT
/begin MEASUREMENT lfb_pedal_filtered_x16 "Accel pedal x16 filtered for the LFB override." UWORD NO_COMPU_METHOD 0 0 0 65535 ECU_ADDRESS 0x400024FA /end MEASUREMENT
/begin MEASUREMENT tps_track_b_closed_value "TPS track B closed-throttle count (default 1829)." UWORD CM_u16_voltage_5_4095v 0 0 0 80.018315018315 ECU_ADDRESS 0x400024FC /end MEASUREMENT
/begin MEASUREMENT tps_track_a_closed_value "TPS track A closed-throttle count (default 572)." UWORD CM_u16_voltage_5_4095v 0 0 0 80.018315018315 ECU_ADDRESS 0x400024FE /end MEASUREMENT
/begin MEASUREMENT ips_state_flags "IPS state byte from CAN (0 / 9 = neutral-like states)." UBYTE NO_COMPU_METHOD 0 0 0 255 ECU_ADDRESS 0x40002500 /end MEASUREMENT
/begin MEASUREMENT tcu_0xc7_engine_speed_request "u16_rspeed_rpm" UWORD CM_u8_rspeed_rpm 0 0 0 65535 ECU_ADDRESS 0x40002502 /end MEASUREMENT
/begin MEASUREMENT ips_can_199_word "CAN 0x199 bytes 2-3 (big-endian)." UWORD NO_COMPU_METHOD 0 0 0 65535 ECU_ADDRESS 0x40002504 /end MEASUREMENT
/begin MEASUREMENT tps_state_degraded "Throttle position state degraded (boolean flag)." UBYTE NO_COMPU_METHOD 0 0 0 255 ECU_ADDRESS 0x40002508 /end MEASUREMENT
/begin MEASUREMENT tps_16bit "Throttle position (val/1023)." UWORD CM_u16_factor_1_4095 0 0 0 1600.3663003663 ECU_ADDRESS 0x4000250A /end MEASUREMENT
/begin MEASUREMENT accel_pedal_state_degraded "Accelerator pedal state degraded (boolean flag)." UBYTE NO_COMPU_METHOD 0 0 0 255 ECU_ADDRESS 0x4000250C /end MEASUREMENT
/begin MEASUREMENT lfb_pedal_raw "Accel pedal value passed to get_accel_pedal_lfb_brake_override." UWORD NO_COMPU_METHOD 0 0 0 65535 ECU_ADDRESS 0x4000250E /end MEASUREMENT
/begin MEASUREMENT accel_pedal_pos_16bit "Accelerator pedal position (val/1023)." UWORD CM_u16_factor_1_1023 0 0 0 6406.15835777126 ECU_ADDRESS 0x40002510 /end MEASUREMENT
/begin MEASUREMENT tps_fault_active "Throttle position fault active (boolean flag)." UBYTE NO_COMPU_METHOD 0 0 0 255 ECU_ADDRESS 0x40002512 /end MEASUREMENT
/begin MEASUREMENT accel_pedal_fault_active "Accelerator pedal fault active (boolean flag)." UBYTE NO_COMPU_METHOD 0 0 0 255 ECU_ADDRESS 0x40002513 /end MEASUREMENT
/begin MEASUREMENT obd_ii_app_fault_flags "Accel pedal monitor fault bits (P2122.. family)." UBYTE NO_COMPU_METHOD 0 0 0 255 ECU_ADDRESS 0x40002514 /end MEASUREMENT
/begin MEASUREMENT tps_fault_flags "TPS circuit faults: bit0 TPS1 high (P0123), bit1 TPS1 low (P0122), bit2 TPS2 high (P0223), bit3 TPS2 low (P0222), bit4/5 TPS1-TPS2 correlation (P2135)." UBYTE NO_COMPU_METHOD 0 0 0 255 ECU_ADDRESS 0x40002515 /end MEASUREMENT
/begin MEASUREMENT knock_buffer_last_index "Knock ADC buffer index at the end of the window." UBYTE NO_COMPU_METHOD 0 0 0 255 ECU_ADDRESS 0x40002518 /end MEASUREMENT
/begin MEASUREMENT knock_dsp_window_select "Knock DSP mode-2 window selector." UBYTE NO_COMPU_METHOD 0 0 0 255 ECU_ADDRESS 0x40002519 /end MEASUREMENT
/begin MEASUREMENT knock_sensor_new_data_available "Knock sensor new data available (boolean flag)." UBYTE NO_COMPU_METHOD 0 0 0 255 ECU_ADDRESS 0x4000251A /end MEASUREMENT
/begin MEASUREMENT knock_curr_cylinder "Cylinder (0..5) whose knock window is being processed." UBYTE NO_COMPU_METHOD 0 0 0 255 ECU_ADDRESS 0x4000251B /end MEASUREMENT
/begin MEASUREMENT knock_agc_stage_current "Knock AGC stage in use (1/2)." UBYTE NO_COMPU_METHOD 0 0 0 255 ECU_ADDRESS 0x4000251C /end MEASUREMENT
/begin MEASUREMENT knock_buffer_index "Knock buffer index." UBYTE NO_COMPU_METHOD 0 0 0 255 ECU_ADDRESS 0x4000251D /end MEASUREMENT
/begin MEASUREMENT knock_fft_bin_index "FFT bin loop index (0..6)." UBYTE NO_COMPU_METHOD 0 0 0 255 ECU_ADDRESS 0x4000251E /end MEASUREMENT
/begin MEASUREMENT knock_dsp_reset_request "Set to request knock DSP state reset." UBYTE NO_COMPU_METHOD 0 0 0 255 ECU_ADDRESS 0x40002528 /end MEASUREMENT
/begin MEASUREMENT knock_agc_stage_override_enable "bool" UBYTE NO_COMPU_METHOD 0 0 0 255 ECU_ADDRESS 0x40002529 /end MEASUREMENT
/begin MEASUREMENT knock_freq_bin_count "Number of knock frequency bins." UBYTE NO_COMPU_METHOD 0 0 0 255 ECU_ADDRESS 0x4000252A /end MEASUREMENT
/begin MEASUREMENT flexcan_ccp_tx_timeout_count "CCP (0x351) transmit timeouts." UBYTE NO_COMPU_METHOD 0 0 0 255 ECU_ADDRESS 0x40002530 /end MEASUREMENT
/begin MEASUREMENT flexcan_diag_tx_count "flexcan_diagnostics_tx call counter." ULONG NO_COMPU_METHOD 0 0 0 4294967295 ECU_ADDRESS 0x40002538 /end MEASUREMENT
/begin MEASUREMENT obd_ii_defer_send "OBD-II: defer send (boolean flag)." UBYTE NO_COMPU_METHOD 0 0 0 255 ECU_ADDRESS 0x40002540 /end MEASUREMENT
/begin MEASUREMENT obd_ii_tx_messages_pending "OBD-II: tx messages pending (boolean flag)." UBYTE NO_COMPU_METHOD 0 0 0 255 ECU_ADDRESS 0x40002541 /end MEASUREMENT
/begin MEASUREMENT isotp_flow_status "ISO-TP flow-control status (0 CTS, 1 wait, ...)." UBYTE NO_COMPU_METHOD 0 0 0 255 ECU_ADDRESS 0x40002542 /end MEASUREMENT
/begin MEASUREMENT isotp_fc_received "ISO-TP flow-control received (boolean flag)." UBYTE NO_COMPU_METHOD 0 0 0 255 ECU_ADDRESS 0x40002543 /end MEASUREMENT
/begin MEASUREMENT isotp_block_size "ISO-TP block size from the tester." UBYTE NO_COMPU_METHOD 0 0 0 255 ECU_ADDRESS 0x40002544 /end MEASUREMENT
/begin MEASUREMENT isotp_stmin "ISO-TP STmin." UBYTE NO_COMPU_METHOD 0 0 0 255 ECU_ADDRESS 0x40002545 /end MEASUREMENT
/begin MEASUREMENT obd_ii_response_length "Length of the pending OBD response." UWORD NO_COMPU_METHOD 0 0 0 65535 ECU_ADDRESS 0x40002546 /end MEASUREMENT
/begin MEASUREMENT isotp_block_counter "ISO-TP consecutive frames left in the block." UBYTE NO_COMPU_METHOD 0 0 0 255 ECU_ADDRESS 0x40002548 /end MEASUREMENT
/begin MEASUREMENT isotp_stmin_counter "ISO-TP STmin countdown (5 ms ticks)." UBYTE NO_COMPU_METHOD 0 0 0 255 ECU_ADDRESS 0x40002549 /end MEASUREMENT
/begin MEASUREMENT gear_index_auto "Gear index auto (enumerated state)." UBYTE NO_COMPU_METHOD 0 0 0 255 ECU_ADDRESS 0x40002550 /end MEASUREMENT
/begin MEASUREMENT ips_shift_active "bool" UBYTE NO_COMPU_METHOD 0 0 0 255 ECU_ADDRESS 0x40002551 /end MEASUREMENT
/begin MEASUREMENT ips_flags_faults_ "IPS fault bits from CAN 0x202 (bits 5-6)." UBYTE NO_COMPU_METHOD 0 0 0 255 ECU_ADDRESS 0x40002552 /end MEASUREMENT
/begin MEASUREMENT abs_a8_flag2 "ABS/ESP status from CAN 0xA8 (0, 1, 4, 5)." UBYTE NO_COMPU_METHOD 0 0 0 255 ECU_ADDRESS 0x40002553 /end MEASUREMENT
/begin MEASUREMENT obd_ii_oil_temp_ips "IPS oil temperature from CAN 0x250 byte 5 (mode 22)." UBYTE CM_u8_temp_5_8_40c 0 0 -40 119.375 ECU_ADDRESS 0x40002554 /end MEASUREMENT
/begin MEASUREMENT abs_a4_status_bit3 "CAN 0xA4 status bit 3 (wheel-speed message)." UBYTE NO_COMPU_METHOD 0 0 0 255 ECU_ADDRESS 0x40002555 /end MEASUREMENT
/begin MEASUREMENT abs_a4_status_bit5 "CAN 0xA4 status bit 5 (wheel-speed message)." UBYTE NO_COMPU_METHOD 0 0 0 255 ECU_ADDRESS 0x40002556 /end MEASUREMENT
/begin MEASUREMENT dm_data_buffer "Dev-mode CAN memory peek/poke address (CAN 0x50-0x53)." ULONG NO_COMPU_METHOD 0 0 0 4294967295 ECU_ADDRESS 0x40002558 /end MEASUREMENT
/begin MEASUREMENT dm_write_ptr "Dev-mode CAN memory write pointer (multi-frame poke)." ULONG NO_COMPU_METHOD 0 0 0 4294967295 ECU_ADDRESS 0x4000255C /end MEASUREMENT
/begin MEASUREMENT dm_write_remaining "Dev-mode CAN bytes left to write." UWORD NO_COMPU_METHOD 0 0 0 65535 ECU_ADDRESS 0x40002560 /end MEASUREMENT
/begin MEASUREMENT dm_read_length "Dev-mode CAN read length (<= 8)." UWORD NO_COMPU_METHOD 0 0 0 65535 ECU_ADDRESS 0x40002562 /end MEASUREMENT
/begin MEASUREMENT can_rx_msg_timestamp "Timestamp of the last received CAN message." UWORD NO_COMPU_METHOD 0 0 0 65535 ECU_ADDRESS 0x40002564 /end MEASUREMENT
/begin MEASUREMENT can_502_rx_count "CAN 0x502 receive counter." UBYTE NO_COMPU_METHOD 0 0 0 255 ECU_ADDRESS 0x40002566 /end MEASUREMENT
/begin MEASUREMENT can_a4_dlc "DLC of the last CAN 0xA4 frame (8 = extended data)." UBYTE NO_COMPU_METHOD 0 0 0 255 ECU_ADDRESS 0x4000256C /end MEASUREMENT
/begin MEASUREMENT can_b7_rolling_counter "CAN 0xB7 rolling counter (4-bit)." UBYTE NO_COMPU_METHOD 0 0 0 255 ECU_ADDRESS 0x4000256D /end MEASUREMENT
/begin MEASUREMENT can_a4_ext_byte2 "CAN 0xA4 extended data byte (DLC 8)." UBYTE NO_COMPU_METHOD 0 0 0 255 ECU_ADDRESS 0x4000256E /end MEASUREMENT
/begin MEASUREMENT can_a4_ext_byte0 "CAN 0xA4 extended data byte (DLC 8)." UBYTE NO_COMPU_METHOD 0 0 0 255 ECU_ADDRESS 0x4000256F /end MEASUREMENT
/begin MEASUREMENT can_a2_rolling_counter "CAN 0xA2 rolling counter (4-bit)." UBYTE NO_COMPU_METHOD 0 0 0 255 ECU_ADDRESS 0x40002570 /end MEASUREMENT
/begin MEASUREMENT can_a4_rolling_counter "CAN 0xA4 rolling counter (4-bit)." UBYTE NO_COMPU_METHOD 0 0 0 255 ECU_ADDRESS 0x40002571 /end MEASUREMENT
/begin MEASUREMENT dm_tx_ptr "Dev-mode CAN response data pointer." ULONG NO_COMPU_METHOD 0 0 0 4294967295 ECU_ADDRESS 0x40002580 /end MEASUREMENT
/begin MEASUREMENT dm_rx_ptr "Dev-mode CAN request data pointer." ULONG NO_COMPU_METHOD 0 0 0 4294967295 ECU_ADDRESS 0x40002584 /end MEASUREMENT
/begin MEASUREMENT ips_can_199_flags "CAN 0x199 status bits (bit0, bit1 used by the IPS shift state machine)." UBYTE NO_COMPU_METHOD 0 0 0 255 ECU_ADDRESS 0x40002588 /end MEASUREMENT
/begin MEASUREMENT imu_gyro "Yaw rate from CAN 0x303 ((12-bit - 0x800) x8)." SWORD NO_COMPU_METHOD 0 0 -32768 32767 ECU_ADDRESS 0x4000258A /end MEASUREMENT
/begin MEASUREMENT imu_lat_accel_raw "Lateral acceleration from CAN 0x303 (scaled /100000)." SWORD NO_COMPU_METHOD 0 0 -32768 32767 ECU_ADDRESS 0x4000258C /end MEASUREMENT
/begin MEASUREMENT imu_accel_lat "Lateral acceleration from yaw sensor CAN 0x303 (g = val/100; (raw12-0x801)*0.20385)." SWORD CM_u8_accel_1_100g 0 0 -327.68 327.67 ECU_ADDRESS 0x4000258E /end MEASUREMENT
/begin MEASUREMENT imu_status_byte "CAN 0x303 status byte." UBYTE NO_COMPU_METHOD 0 0 0 255 ECU_ADDRESS 0x40002590 /end MEASUREMENT
/begin MEASUREMENT steering_angle_sensor_status "Steering angle sensor status (bit0 valid)." UBYTE NO_COMPU_METHOD 0 0 0 255 ECU_ADDRESS 0x40002591 /end MEASUREMENT
/begin MEASUREMENT steering_angle_rate "Steering angle rate from CAN 0x85 byte 2. Was steering_angle_rate___." UBYTE NO_COMPU_METHOD 0 0 0 255 ECU_ADDRESS 0x40002592 /end MEASUREMENT
/begin MEASUREMENT steering_angle "Steering angle (° = val/10)." UWORD CM_u16_angle_1_10deg 0 0 0 6553.5 ECU_ADDRESS 0x40002594 /end MEASUREMENT
/begin MEASUREMENT can_310_value_3 "CAN 0x310 value 3 scaled x10/4 (or CAN 0x311 raw when that frame is used)." UWORD NO_COMPU_METHOD 0 0 0 65535 ECU_ADDRESS 0x40002596 /end MEASUREMENT
/begin MEASUREMENT can_310_value_2 "CAN 0x310 value 2 scaled x10/4 (or CAN 0x311 raw when that frame is used)." UWORD NO_COMPU_METHOD 0 0 0 65535 ECU_ADDRESS 0x40002598 /end MEASUREMENT
/begin MEASUREMENT can_310_value_1 "CAN 0x310 value 1 scaled x10/4 (or CAN 0x311 raw when that frame is used)." UWORD NO_COMPU_METHOD 0 0 0 65535 ECU_ADDRESS 0x4000259A /end MEASUREMENT
/begin MEASUREMENT can_310_value_0 "CAN 0x310 value 0 scaled x10/4 (or CAN 0x311 raw when that frame is used)." UWORD NO_COMPU_METHOD 0 0 0 65535 ECU_ADDRESS 0x4000259C /end MEASUREMENT
/begin MEASUREMENT can_311_raw_3 "CAN 0x311 value 3 (big-endian raw)." UWORD NO_COMPU_METHOD 0 0 0 65535 ECU_ADDRESS 0x4000259E /end MEASUREMENT
/begin MEASUREMENT can_311_raw_2 "CAN 0x311 value 2 (big-endian raw)." UWORD NO_COMPU_METHOD 0 0 0 65535 ECU_ADDRESS 0x400025A0 /end MEASUREMENT
/begin MEASUREMENT can_311_raw_1 "CAN 0x311 value 1 (big-endian raw)." UWORD NO_COMPU_METHOD 0 0 0 65535 ECU_ADDRESS 0x400025A2 /end MEASUREMENT
/begin MEASUREMENT can_311_raw_0 "CAN 0x311 value 0 (big-endian raw)." UWORD NO_COMPU_METHOD 0 0 0 65535 ECU_ADDRESS 0x400025A4 /end MEASUREMENT
/begin MEASUREMENT can_310_value_3_copy "Copy of can_310_value_3." UWORD NO_COMPU_METHOD 0 0 0 65535 ECU_ADDRESS 0x400025A6 /end MEASUREMENT
/begin MEASUREMENT can_310_value_2_copy "Copy of can_310_value_2." UWORD NO_COMPU_METHOD 0 0 0 65535 ECU_ADDRESS 0x400025A8 /end MEASUREMENT
/begin MEASUREMENT can_310_value_1_copy "Copy of can_310_value_1." UWORD NO_COMPU_METHOD 0 0 0 65535 ECU_ADDRESS 0x400025AA /end MEASUREMENT
/begin MEASUREMENT can_310_value_0_copy "Copy of can_310_value_0." UWORD NO_COMPU_METHOD 0 0 0 65535 ECU_ADDRESS 0x400025AC /end MEASUREMENT
/begin MEASUREMENT can_310_raw_3 "CAN 0x310 value 3 (big-endian raw)." UWORD NO_COMPU_METHOD 0 0 0 65535 ECU_ADDRESS 0x400025AE /end MEASUREMENT
/begin MEASUREMENT can_310_raw_2 "CAN 0x310 value 2 (big-endian raw)." UWORD NO_COMPU_METHOD 0 0 0 65535 ECU_ADDRESS 0x400025B0 /end MEASUREMENT
/begin MEASUREMENT can_310_raw_1 "CAN 0x310 value 1 (big-endian raw)." UWORD NO_COMPU_METHOD 0 0 0 65535 ECU_ADDRESS 0x400025B2 /end MEASUREMENT
/begin MEASUREMENT can_310_raw_0 "CAN 0x310 value 0 (big-endian raw)." UWORD NO_COMPU_METHOD 0 0 0 65535 ECU_ADDRESS 0x400025B4 /end MEASUREMENT
/begin MEASUREMENT ccp_rx_word "CAN-C 0x350 (CCP CRO) first word." UWORD NO_COMPU_METHOD 0 0 0 65535 ECU_ADDRESS 0x400025B8 /end MEASUREMENT
/begin MEASUREMENT obd_ii_MIL_and_DTC "Mode 01 PID 01 byte A: DTC count | 0x80 when the MIL is on." UBYTE NO_COMPU_METHOD 0 0 0 255 ECU_ADDRESS 0x400025E8 /end MEASUREMENT
/begin MEASUREMENT obd_ii_DTC_count "Number of current DTCs (mode 03)." UBYTE NO_COMPU_METHOD 0 0 0 255 ECU_ADDRESS 0x400025E9 /end MEASUREMENT
/begin MEASUREMENT esci_rx_checksum "Running checksum of the HC08 frame being received (complement byte must match)." UBYTE NO_COMPU_METHOD 0 0 0 255 ECU_ADDRESS 0x400025F0 /end MEASUREMENT
/begin MEASUREMENT esci_rx_byte_index "Byte index in the HC08 frame being received (< 23)." UBYTE NO_COMPU_METHOD 0 0 0 255 ECU_ADDRESS 0x400025F1 /end MEASUREMENT
/begin MEASUREMENT esci_seq_number "HC08 frame sequence number (incremented per transmitted frame)." UBYTE NO_COMPU_METHOD 0 0 0 255 ECU_ADDRESS 0x400025F2 /end MEASUREMENT
/begin MEASUREMENT esci_tx_length "Length of the eSCI frame being transmitted." UBYTE NO_COMPU_METHOD 0 0 0 255 ECU_ADDRESS 0x400025F3 /end MEASUREMENT
/begin MEASUREMENT esci_tx_index "Next byte index transmitted from the eSCI TX buffer (0x40007f58)." UBYTE NO_COMPU_METHOD 0 0 0 255 ECU_ADDRESS 0x400025F4 /end MEASUREMENT
/begin MEASUREMENT esci_rx_count "Bytes waiting in the eSCI RX ring buffer (max 32)." UBYTE NO_COMPU_METHOD 0 0 0 255 ECU_ADDRESS 0x400025F5 /end MEASUREMENT
/begin MEASUREMENT esci_rx_tail "eSCI RX ring read index (0..31)." UBYTE NO_COMPU_METHOD 0 0 0 255 ECU_ADDRESS 0x400025F6 /end MEASUREMENT
/begin MEASUREMENT esci_rx_head "eSCI RX ring write index (0..31) into 0x40007f78." UBYTE NO_COMPU_METHOD 0 0 0 255 ECU_ADDRESS 0x400025F7 /end MEASUREMENT
/begin MEASUREMENT hc08_tx_rx_delta "throttle_tx_counter - hc08_rx_frame_count (frames sent without reply)." SWORD NO_COMPU_METHOD 0 0 -32768 32767 ECU_ADDRESS 0x400025F8 /end MEASUREMENT
/begin MEASUREMENT hc08_rx_frame_count "Valid HC08 frames received." ULONG NO_COMPU_METHOD 0 0 0 4294967295 ECU_ADDRESS 0x400025FC /end MEASUREMENT
/begin MEASUREMENT throttle_tx_counter "Throttle tx counter." ULONG NO_COMPU_METHOD 0 0 0 4294967295 ECU_ADDRESS 0x40002600 /end MEASUREMENT
/begin MEASUREMENT cruise_switch_voltage "Cruise stalk resistor-ladder voltage (ADC ch 0x10). Was cruise_switch_unknown_voltage." UWORD CM_u16_voltage_5_1023v 0 0 0 320.307917888563 ECU_ADDRESS 0x40002608 /end MEASUREMENT
/begin MEASUREMENT cruise_status_flags "Cruise control state bitfield (bit1 = cruise engaged; also reported in mode 22). Was obd_ii_cruise_status." ULONG NO_COMPU_METHOD 0 0 0 4294967295 ECU_ADDRESS 0x4000260C /end MEASUREMENT
/begin MEASUREMENT cruise_speed_target "Cruise speed target (km/h = val/100)." UWORD CM_u8_speed_1_100kph 0 0 0 655.35 ECU_ADDRESS 0x40002610 /end MEASUREMENT
/begin MEASUREMENT cruise_proportional_term "Cruise proportional term (km/h = val/100)." UWORD CM_u8_speed_1_100kph 0 0 0 655.35 ECU_ADDRESS 0x40002612 /end MEASUREMENT
/begin MEASUREMENT cruise_integral_term "Cruise PI integral term (+-CAL_cruise_integral_term_limit*100)." SWORD NO_COMPU_METHOD 0 0 -32768 32767 ECU_ADDRESS 0x40002614 /end MEASUREMENT
/begin MEASUREMENT cruise_deriv_term "Cruise derivative term (+-CAL_cruise_derivative_term_limit*100)." SWORD NO_COMPU_METHOD 0 0 -32768 32767 ECU_ADDRESS 0x40002616 /end MEASUREMENT
/begin MEASUREMENT cruise_maf_flow_ref "MAF flow latched when cruise engages (feed-forward reference)." UWORD CM_u16_flow_10mg_s 0 0 0 655350 ECU_ADDRESS 0x40002618 /end MEASUREMENT
/begin MEASUREMENT cruise_load_axis "Cruise load axis (load*255/1173)." UBYTE NO_COMPU_METHOD 0 0 0 255 ECU_ADDRESS 0x4000261A /end MEASUREMENT
/begin MEASUREMENT cruise_virtual_pps_request "Cruise virtual pps request (val/1023)." UWORD CM_u16_factor_1_1023 0 0 0 6406.15835777126 ECU_ADDRESS 0x4000261C /end MEASUREMENT
/begin MEASUREMENT tps_commanded_cruise "Cruise-commanded pedal (val/1023; >>2 gives the 8-bit pps axis)." UWORD CM_u16_factor_1_1023 0 0 0 6406.15835777126 ECU_ADDRESS 0x4000261E /end MEASUREMENT
/begin MEASUREMENT cruise_speed_error "Cruise speed error (km/h = val/100)." UWORD CM_u8_speed_1_100kph 0 0 0 655.35 ECU_ADDRESS 0x40002620 /end MEASUREMENT
/begin MEASUREMENT cruise_control_flags "Cruise control internal state bits. Was cruise_flags_unknown." UWORD NO_COMPU_METHOD 0 0 0 65535 ECU_ADDRESS 0x40002622 /end MEASUREMENT
/begin MEASUREMENT obd_ii_p0578_health "Debounce health for P0578: reset to CAL_obd_ii_P0578_fail_count; +1 per passing sample (to the CAL), -1 per obd_ii_monitor_debounce_ticks failing samples; the DTC fails when it reaches 0." UBYTE NO_COMPU_METHOD 0 0 0 255 ECU_ADDRESS 0x40002624 /end MEASUREMENT
/begin MEASUREMENT obd_ii_p0579_health "Debounce health for P0579: reset to CAL_obd_ii_P0579_fail_count; +1 per passing sample (to the CAL), -1 per obd_ii_monitor_debounce_ticks failing samples; the DTC fails when it reaches 0." UBYTE NO_COMPU_METHOD 0 0 0 255 ECU_ADDRESS 0x40002625 /end MEASUREMENT
/begin MEASUREMENT obd_ii_p0579_stuck_timer_5ms "Cruise switch stuck timeout (CAL_obd_ii_P0579_stuck_timeout*20), decremented in cruise2_200hz." UWORD CM_u8_time_5ms 0 0 0 327675 ECU_ADDRESS 0x40002626 /end MEASUREMENT
/begin MEASUREMENT cruise_cancel_button_hold_count "Cancel button hold count (> 3 = pressed)." UBYTE NO_COMPU_METHOD 0 0 0 255 ECU_ADDRESS 0x40002628 /end MEASUREMENT
/begin MEASUREMENT cruise_resume_button_hold_count "Resume button hold count." UBYTE NO_COMPU_METHOD 0 0 0 255 ECU_ADDRESS 0x40002629 /end MEASUREMENT
/begin MEASUREMENT cruise_set_button_hold_count "Set button hold count." UBYTE NO_COMPU_METHOD 0 0 0 255 ECU_ADDRESS 0x4000262A /end MEASUREMENT
/begin MEASUREMENT cruise_speed_error_prev "cruise_speed_error at the previous update (derivative)." SWORD NO_COMPU_METHOD 0 0 -32768 32767 ECU_ADDRESS 0x4000262C /end MEASUREMENT
/begin MEASUREMENT cruise_integral_accum "int16_t" SWORD NO_COMPU_METHOD 0 0 -32768 32767 ECU_ADDRESS 0x4000262E /end MEASUREMENT
/begin MEASUREMENT cruise_speed_error_rate "Cruise speed error rate (derivative input)." SWORD NO_COMPU_METHOD 0 0 -32768 32767 ECU_ADDRESS 0x40002630 /end MEASUREMENT
/begin MEASUREMENT cruise_override_timer "Accelerator override countdown (CAL_cruise_override_timeout*4)." UWORD CM_u8_time_5ms 0 0 0 327675 ECU_ADDRESS 0x40002632 /end MEASUREMENT
/begin MEASUREMENT cruise_coast_switch_override_timer "Coast switch override cancel countdown (CAL_cruise_override_coast_cancel_time)." UBYTE NO_COMPU_METHOD 0 0 0 255 ECU_ADDRESS 0x40002634 /end MEASUREMENT
/begin MEASUREMENT cruise_speed_smoothed "Cruise speed smoothed (km/h = val/100)." UWORD CM_u8_speed_1_100kph 0 0 0 655.35 ECU_ADDRESS 0x40002636 /end MEASUREMENT
/begin MEASUREMENT cruise_switch_voltage_ref "Cruise switch voltage latched for the P0578 stuck check (+-10). Was cruise_switch_unknown_voltage2." UWORD CM_u16_voltage_5_1023v 0 0 0 320.307917888563 ECU_ADDRESS 0x40002638 /end MEASUREMENT
/begin MEASUREMENT obd_ii_p0578_stable_timer "P0578 switch-stable countdown (CAL_obd_ii_switch_voltage_debounce*10)." UWORD NO_COMPU_METHOD 0 0 0 65535 ECU_ADDRESS 0x4000263A /end MEASUREMENT
/begin MEASUREMENT cruise_engage_settle "Cruise engage settle countdown (reset 20)." UBYTE NO_COMPU_METHOD 0 0 0 255 ECU_ADDRESS 0x4000263C /end MEASUREMENT
/begin MEASUREMENT cruise_speed_target_prev "cruise_speed_target at the previous update." UWORD CM_u8_speed_1_100kph 0 0 0 655.35 ECU_ADDRESS 0x4000263E /end MEASUREMENT
/begin MEASUREMENT cruise_transition_lockout_timer "Cruise state-transition lockout countdown." UWORD NO_COMPU_METHOD 0 0 0 65535 ECU_ADDRESS 0x40002640 /end MEASUREMENT
/begin MEASUREMENT cruise_unused_2642 "Cleared in cruise2_200hz, never read." UWORD NO_COMPU_METHOD 0 0 0 65535 ECU_ADDRESS 0x40002642 /end MEASUREMENT
/begin MEASUREMENT cruise_resume_timer "Resume countdown (CAL_cruise_resume_timer*2)." UWORD CM_u8_time_5ms 0 0 0 327675 ECU_ADDRESS 0x40002644 /end MEASUREMENT
/begin MEASUREMENT cruise_gear_prev "Gear at the previous update (IPS integral gain lookup)." UBYTE NO_COMPU_METHOD 0 0 0 255 ECU_ADDRESS 0x40002646 /end MEASUREMENT
/begin MEASUREMENT cruise_switch_state "Cruise switch state bits (3 = both)." UBYTE NO_COMPU_METHOD 0 0 0 255 ECU_ADDRESS 0x40002647 /end MEASUREMENT
/begin MEASUREMENT cruise_switch_change_count "Cruise switch transitions (P0579)." UBYTE NO_COMPU_METHOD 0 0 0 255 ECU_ADDRESS 0x40002648 /end MEASUREMENT
/begin MEASUREMENT obd_ii_p0579_switch_changes "Switch changes counted for P0579 (vs CAL_obd_ii_P0579_switch_changes_max)." UBYTE NO_COMPU_METHOD 0 0 0 255 ECU_ADDRESS 0x40002649 /end MEASUREMENT
/begin MEASUREMENT cruise_integral_gain "Cruise integral gain in use." UBYTE NO_COMPU_METHOD 0 0 0 255 ECU_ADDRESS 0x4000264A /end MEASUREMENT
/begin MEASUREMENT cruise_stalk_idle_debounce_timer "Cruise stalk idle debounce (reload 100)." UBYTE CM_u8_time_5ms 0 0 0 1275 ECU_ADDRESS 0x4000264B /end MEASUREMENT
/begin MEASUREMENT cruise_switch_pos "Cruise switch position (enumerated state)." UBYTE NO_COMPU_METHOD 0 0 0 255 ECU_ADDRESS 0x4000264C /end MEASUREMENT
/begin MEASUREMENT cruise_speed_error_normalized "Normalised cruise speed error (feed-forward blend axis)." UBYTE NO_COMPU_METHOD 0 0 0 255 ECU_ADDRESS 0x4000264D /end MEASUREMENT
/begin MEASUREMENT obd_ii_engine_torque "OBD-II: engine torque (Nm)." UWORD CM_u8_torque_nm 0 0 0 65535 ECU_ADDRESS 0x40002650 /end MEASUREMENT
/begin MEASUREMENT torque_estimated_actual_load "Estimated actual engine torque from load." SWORD NO_COMPU_METHOD 0 0 -32768 32767 ECU_ADDRESS 0x40002652 /end MEASUREMENT
/begin MEASUREMENT engine_friction_torque "Engine friction torque (Nm)." UWORD CM_u8_torque_nm 0 0 0 65535 ECU_ADDRESS 0x40002654 /end MEASUREMENT
/begin MEASUREMENT torque_estimated_alphaN "Torque estimated alphaN (Nm)." UWORD CM_u8_torque_nm 0 0 0 65535 ECU_ADDRESS 0x40002656 /end MEASUREMENT
/begin MEASUREMENT torque_engine_friction_base "Torque engine friction base (Nm)." UWORD CM_u8_torque_nm 0 0 0 65535 ECU_ADDRESS 0x40002658 /end MEASUREMENT
/begin MEASUREMENT load_estimated_alphaN "Load estimated alphaN (mg/stroke)." UWORD CM_u8_load_mg_stroke 0 0 0 65535 ECU_ADDRESS 0x4000265A /end MEASUREMENT
/begin MEASUREMENT load_learned_alphaN "Load learned alphaN (mg/stroke)." UWORD CM_u8_load_mg_stroke 0 0 0 65535 ECU_ADDRESS 0x4000265C /end MEASUREMENT
/begin MEASUREMENT load_target_with_torque_limit "Load target with torque limit (mg/stroke = val*1173)." UWORD CM_u8_load_1173mg_255stroke 0 0 0 301461 ECU_ADDRESS 0x4000265E /end MEASUREMENT
/begin MEASUREMENT torque_limit_tps_target "Torque limit throttle position target (val/4095)." UWORD CM_u16_factor_1_4095 0 0 0 1600.3663003663 ECU_ADDRESS 0x40002660 /end MEASUREMENT
/begin MEASUREMENT ign_comp_torque_reduction "Torque-model spark reduction request (<=0) (deg = val/4)." SWORD CM_u8_angle_1_4deg 0 0 -8192 8191.75 ECU_ADDRESS 0x40002662 /end MEASUREMENT
/begin MEASUREMENT torque_allowed_factor "Torque allowed factor (val/255)." UBYTE CM_u8_factor_1_255 0 0 0 100 ECU_ADDRESS 0x40002664 /end MEASUREMENT
/begin MEASUREMENT torque_limit_external_net "Torque limit external net (Nm)." UWORD CM_u8_torque_nm 0 0 0 65535 ECU_ADDRESS 0x40002666 /end MEASUREMENT
/begin MEASUREMENT torque_limit_external_factor "Torque limit external factor (val/255)." UBYTE CM_u8_factor_1_255 0 0 0 100 ECU_ADDRESS 0x40002668 /end MEASUREMENT
/begin MEASUREMENT torque_margin_above_limit "Torque margin above limit (Nm)." UWORD CM_u8_torque_nm 0 0 0 65535 ECU_ADDRESS 0x4000266A /end MEASUREMENT
/begin MEASUREMENT torque_net_engine_combustion "Torque net engine combustion (Nm)." UWORD CM_u8_torque_nm 0 0 0 65535 ECU_ADDRESS 0x4000266C /end MEASUREMENT
/begin MEASUREMENT torque_alphaN_net "Torque alphaN net (Nm)." UWORD CM_u8_torque_nm 0 0 0 65535 ECU_ADDRESS 0x4000266E /end MEASUREMENT
/begin MEASUREMENT torque_limit_base_factor "Torque limit base factor (val/255)." UBYTE CM_u8_factor_1_255 0 0 0 100 ECU_ADDRESS 0x40002670 /end MEASUREMENT
/begin MEASUREMENT torque_efficiency_factor "Torque efficiency factor." UBYTE CM_u8_factor_1_255 0 0 0 100 ECU_ADDRESS 0x40002671 /end MEASUREMENT
/begin MEASUREMENT torque_engine_friction_temp_component "Torque engine friction temperature component (Nm)." UWORD CM_u8_torque_nm 0 0 0 65535 ECU_ADDRESS 0x40002672 /end MEASUREMENT
/begin MEASUREMENT torque_engine_friction_ac_load "Torque engine friction A/C load (Nm)." UWORD CM_u8_torque_nm 0 0 0 65535 ECU_ADDRESS 0x40002674 /end MEASUREMENT
/begin MEASUREMENT torque_cut_demand_factor "Torque cut demand factor (val/255)." UWORD CM_u8_factor_1_255 0 0 0 25700 ECU_ADDRESS 0x40002676 /end MEASUREMENT
/begin MEASUREMENT torque_factor_per_cyl_step "Torque fraction per cut cylinder (42 = 1/6 of 255)." UBYTE NO_COMPU_METHOD 0 0 0 255 ECU_ADDRESS 0x40002678 /end MEASUREMENT
/begin MEASUREMENT torque_cut_level "Torque cut level." UBYTE NO_COMPU_METHOD 0 0 0 255 ECU_ADDRESS 0x40002679 /end MEASUREMENT
/begin MEASUREMENT spark_retard_from_mbt "Spark retard from MBT (avg of firing cylinders), clamped 0..255." SWORD NO_COMPU_METHOD 0 0 -32768 32767 ECU_ADDRESS 0x4000267A /end MEASUREMENT
/begin MEASUREMENT message_102_complete "Message 102 complete (boolean flag)." UBYTE NO_COMPU_METHOD 0 0 0 255 ECU_ADDRESS 0x4000267C /end MEASUREMENT
/begin MEASUREMENT torque_limit_source_flags "uint8_t" UBYTE NO_COMPU_METHOD 0 0 0 255 ECU_ADDRESS 0x4000267D /end MEASUREMENT
/begin MEASUREMENT torque_req_0xb7_abs_esp_active "Torque req 0xb7 ABS ESP active (boolean flag)." UBYTE NO_COMPU_METHOD 0 0 0 255 ECU_ADDRESS 0x4000267E /end MEASUREMENT
/begin MEASUREMENT torque_req_0xb7_cruise_control_active "Torque req 0xb7 cruise control active (boolean flag)." UBYTE NO_COMPU_METHOD 0 0 0 255 ECU_ADDRESS 0x4000267F /end MEASUREMENT
/begin MEASUREMENT tcu_0xc7_torque_request_active "bool" UBYTE NO_COMPU_METHOD 0 0 0 255 ECU_ADDRESS 0x40002680 /end MEASUREMENT
/begin MEASUREMENT abs_wheelspeed_valid "Set when a valid wheel-speed frame is received." UBYTE NO_COMPU_METHOD 0 0 0 255 ECU_ADDRESS 0x40002681 /end MEASUREMENT
/begin MEASUREMENT trqlimit_ign_base_delta_from_mbt "Trqlimit ignition base delta from MBT (° = val/4)." SWORD CM_u8_angle_1_4deg 0 0 -8192 8191.75 ECU_ADDRESS 0x40002682 /end MEASUREMENT
/begin MEASUREMENT ign_retard_knock_avg "Ignition retard knock avg (° = val/4)." UWORD CM_u8_angle_1_4deg 0 0 0 16383.75 ECU_ADDRESS 0x40002684 /end MEASUREMENT
/begin MEASUREMENT abs_esp_flags "uint8_t" UBYTE NO_COMPU_METHOD 0 0 0 255 ECU_ADDRESS 0x40002686 /end MEASUREMENT
/begin MEASUREMENT ips_shift_torque_request_active "bit0 = IPS shift torque request active." UBYTE NO_COMPU_METHOD 0 0 0 255 ECU_ADDRESS 0x40002687 /end MEASUREMENT
/begin MEASUREMENT torque_limit_hysteresis_timer "Torque-limit hysteresis countdown." UBYTE CM_u8_time_10ms 0 0 0 2550 ECU_ADDRESS 0x40002688 /end MEASUREMENT
/begin MEASUREMENT torque_limit_tcu_hold_timer "u8_time_10ms" UBYTE CM_u8_time_10ms 0 0 0 2550 ECU_ADDRESS 0x40002689 /end MEASUREMENT
/begin MEASUREMENT tc_torque_limit_use_slow_path "Flexcan mesg 0xb7 is 7byte (boolean flag)." UBYTE NO_COMPU_METHOD 0 0 0 255 ECU_ADDRESS 0x4000268A /end MEASUREMENT
/begin MEASUREMENT tcu_slow_channel_active_never_set "bool" UBYTE NO_COMPU_METHOD 0 0 0 255 ECU_ADDRESS 0x4000268B /end MEASUREMENT
/begin MEASUREMENT torque_limit_ips_shift_latched "Set while an IPS shift torque limit is applied." UBYTE NO_COMPU_METHOD 0 0 0 255 ECU_ADDRESS 0x4000268C /end MEASUREMENT
/begin MEASUREMENT dpm_torque_split_active "bool" UBYTE NO_COMPU_METHOD 0 0 0 255 ECU_ADDRESS 0x4000268D /end MEASUREMENT
/begin MEASUREMENT torque_limit_slow_path_active "Set when the slow (TC) torque-limit path is active." UBYTE NO_COMPU_METHOD 0 0 0 255 ECU_ADDRESS 0x4000268E /end MEASUREMENT
/begin MEASUREMENT torque_driver_net_clamped "Torque driver net clamped (Nm)." UWORD CM_u8_torque_nm 0 0 0 65535 ECU_ADDRESS 0x40002690 /end MEASUREMENT
/begin MEASUREMENT cruise_brake_cancel_timer "Cruise brake cancel countdown (CAL_cruise_brake_cancel_time)." UWORD CM_u8_time_5ms 0 0 0 327675 ECU_ADDRESS 0x40002692 /end MEASUREMENT
/begin MEASUREMENT torque_external_request_margin "Torque external request margin (Nm)." UWORD CM_u8_torque_nm 0 0 0 65535 ECU_ADDRESS 0x40002694 /end MEASUREMENT
/begin MEASUREMENT load_limit_from_torque_limit "Load limit from torque limit (mg/stroke)." UWORD CM_u8_load_mg_stroke 0 0 0 65535 ECU_ADDRESS 0x40002696 /end MEASUREMENT
/begin MEASUREMENT torque_loss_from_ign_retard "Torque loss from ignition retard (Nm)." UWORD CM_u8_torque_nm 0 0 0 65535 ECU_ADDRESS 0x40002698 /end MEASUREMENT
/begin MEASUREMENT ign_retard_torque_limit "Ignition retard requested by the torque limiter (>= 0)." SWORD NO_COMPU_METHOD 0 0 -32768 32767 ECU_ADDRESS 0x4000269A /end MEASUREMENT
/begin MEASUREMENT ign_comp_torque_reduction_unclipped "Ignition compensation torque reduction unclipped (° = val/4)." UWORD CM_u8_angle_1_4deg 0 0 0 16383.75 ECU_ADDRESS 0x4000269C /end MEASUREMENT
/begin MEASUREMENT torque_reduction_ign_unclamped "Torque reduction ignition unclamped (val/255)." UWORD CM_u8_factor_1_255 0 0 0 25700 ECU_ADDRESS 0x4000269E /end MEASUREMENT
/begin MEASUREMENT torque_limit_engine_protection "Torque limit engine protection (Nm)." UWORD CM_u8_torque_nm 0 0 0 65535 ECU_ADDRESS 0x400026A0 /end MEASUREMENT
/begin MEASUREMENT torque_limit_external_and_internal "Torque limit external and internal (Nm)." UWORD CM_u8_torque_nm 0 0 0 65535 ECU_ADDRESS 0x400026A2 /end MEASUREMENT
/begin MEASUREMENT nonfiring_cyl_count "Number of non-firing cylinders." UBYTE NO_COMPU_METHOD 0 0 0 255 ECU_ADDRESS 0x400026A4 /end MEASUREMENT
/begin MEASUREMENT torque_limit_output_clamp_flags "Torque-limit output clamp bits." UBYTE NO_COMPU_METHOD 0 0 0 255 ECU_ADDRESS 0x400026A5 /end MEASUREMENT
/begin MEASUREMENT torque_tps_limit_delay_timer "Torque TPS-limit delay (50 = 250 ms)." UBYTE CM_u8_time_5ms 0 0 0 1275 ECU_ADDRESS 0x400026A6 /end MEASUREMENT
/begin MEASUREMENT tcu_torque_limit_onset_latch "TCU torque-limit onset latch." UBYTE NO_COMPU_METHOD 0 0 0 255 ECU_ADDRESS 0x400026A7 /end MEASUREMENT
/begin MEASUREMENT torque_request_cruise_active "bool" UBYTE NO_COMPU_METHOD 0 0 0 255 ECU_ADDRESS 0x400026A8 /end MEASUREMENT
/begin MEASUREMENT cruise_brake_release_timer "Brake release countdown (20). Was brake_timer2." UBYTE CM_u8_time_5ms 0 0 0 1275 ECU_ADDRESS 0x400026A9 /end MEASUREMENT
/begin MEASUREMENT runaway_protection_timeout_unknown "u8_time_10ms" UBYTE CM_u8_time_10ms 0 0 0 2550 ECU_ADDRESS 0x400026AA /end MEASUREMENT
/begin MEASUREMENT ign_adv_sum_firing_cyl "Ignition adv sum firing cyl (° = val/4)." SWORD CM_u8_angle_1_4deg 0 0 -8192 8191.75 ECU_ADDRESS 0x400026AC /end MEASUREMENT
/begin MEASUREMENT torque_external_request_final "Torque external request final (Nm)." UWORD CM_u8_torque_nm 0 0 0 65535 ECU_ADDRESS 0x400026AE /end MEASUREMENT
/begin MEASUREMENT torque_engine_ac_load_base "A/C load torque base (negative Nm)." SWORD NO_COMPU_METHOD 0 0 -32768 32767 ECU_ADDRESS 0x400026B0 /end MEASUREMENT
/begin MEASUREMENT torque_engine_ac_load_scaler "Torque engine A/C load scaler (val/255)." UBYTE CM_u8_factor_1_255 0 0 0 100 ECU_ADDRESS 0x400026B2 /end MEASUREMENT
/begin MEASUREMENT torque_engine_friction_speed_component "Torque engine friction speed component (Nm)." UWORD CM_u8_torque_nm 0 0 0 65535 ECU_ADDRESS 0x400026B4 /end MEASUREMENT
/begin MEASUREMENT load_density_compensated "Load density compensated (mg/stroke)." UWORD CM_u8_load_mg_stroke 0 0 0 65535 ECU_ADDRESS 0x400026B6 /end MEASUREMENT
/begin MEASUREMENT tps_from_load_lea "TPS from the learned load-to-TPS mapping." UWORD CM_u16_factor_1_1023 0 0 0 6406.15835777126 ECU_ADDRESS 0x400026B8 /end MEASUREMENT
/begin MEASUREMENT torque_limit_net_friction_and_ign_retard "Torque limit net friction and ignition retard (Nm)." UWORD CM_u8_torque_nm 0 0 0 65535 ECU_ADDRESS 0x400026BA /end MEASUREMENT
/begin MEASUREMENT torque_limit_pi_flags "Load-to-TPS PI state bits. Was torque_limit_flags_pi." UBYTE NO_COMPU_METHOD 0 0 0 255 ECU_ADDRESS 0x400026BC /end MEASUREMENT
/begin MEASUREMENT torque_limit_load_error "Torque limit load error (mg/stroke)." UWORD CM_u8_load_mg_stroke 0 0 0 65535 ECU_ADDRESS 0x400026BE /end MEASUREMENT
/begin MEASUREMENT tps_correction_proportional "Load-to-TPS proportional correction." SWORD NO_COMPU_METHOD 0 0 -32768 32767 ECU_ADDRESS 0x400026C0 /end MEASUREMENT
/begin MEASUREMENT tps_correction_integral "Load-to-TPS integral correction." SWORD NO_COMPU_METHOD 0 0 -32768 32767 ECU_ADDRESS 0x400026C2 /end MEASUREMENT
/begin MEASUREMENT load_to_tps_integral_timer "Countdown between integral updates. Was integral_update_timer." UBYTE NO_COMPU_METHOD 0 0 0 255 ECU_ADDRESS 0x400026C4 /end MEASUREMENT
/begin MEASUREMENT tps_torque_filtered_scaled_x1024 "Filtered TPS feed-forward x1024." ULONG NO_COMPU_METHOD 0 0 0 4294967295 ECU_ADDRESS 0x400026C8 /end MEASUREMENT
/begin MEASUREMENT tps_torque_limit_pi_target "Throttle position torque limit pi target (val/4095)." UWORD CM_u16_factor_1_4095 0 0 0 1600.3663003663 ECU_ADDRESS 0x400026CC /end MEASUREMENT
/begin MEASUREMENT tps_torque_limit_filter_q8 "Torque-limit TPS target IIR accumulator (<<8). Was tps_accumulator_torque_limit." SLONG NO_COMPU_METHOD 0 0 -2147483648 2147483647 ECU_ADDRESS 0x400026D0 /end MEASUREMENT
/begin MEASUREMENT ac_compressor_request "A/C compressor requested (from the HVAC input)." UBYTE NO_COMPU_METHOD 0 0 0 255 ECU_ADDRESS 0x400026D8 /end MEASUREMENT
/begin MEASUREMENT ac_compressor_state "A/C compressor state (enumerated state)." UBYTE NO_COMPU_METHOD 0 0 0 255 ECU_ADDRESS 0x400026D9 /end MEASUREMENT
/begin MEASUREMENT obd_ii_ac_clutch_relay "A/C clutch relay on (obd_ii_relay_status bit5), mode 22." UBYTE NO_COMPU_METHOD 0 0 0 255 ECU_ADDRESS 0x400026DA /end MEASUREMENT
/begin MEASUREMENT ac_load "A/C compressor load (copy of the A/C power term); axis for idle/torque A/C comp (/40). Was ac_load2____." UWORD NO_COMPU_METHOD 0 0 0 65535 ECU_ADDRESS 0x400026DC /end MEASUREMENT
/begin MEASUREMENT ac_inhibit_flags "A/C inhibit reason bits." UWORD NO_COMPU_METHOD 0 0 0 65535 ECU_ADDRESS 0x400026DE /end MEASUREMENT
/begin MEASUREMENT ac_on_time_count "A/C on-time counter (saturating)." UBYTE NO_COMPU_METHOD 0 0 0 255 ECU_ADDRESS 0x400026E0 /end MEASUREMENT
/begin MEASUREMENT ac_ign_comp_delay "Delay before the A/C ignition compensation (CAL_ac_ign_comp_delay)." UBYTE CM_u8_time_5ms 0 0 0 1275 ECU_ADDRESS 0x400026E1 /end MEASUREMENT
/begin MEASUREMENT ac_shutdown_delay "A/C shutdown countdown (CAL_ac_shutdown_delay)." UBYTE CM_u8_time_5ms 0 0 0 1275 ECU_ADDRESS 0x400026E2 /end MEASUREMENT
/begin MEASUREMENT ac_tps_inhibit_timer "A/C TPS inhibit countdown (CAL_ac_tps_inhibit_timer)." UBYTE CM_u8_time_5ms 0 0 0 1275 ECU_ADDRESS 0x400026E3 /end MEASUREMENT
/begin MEASUREMENT ac_clutch_input "A/C clutch input (boolean flag)." UBYTE NO_COMPU_METHOD 0 0 0 255 ECU_ADDRESS 0x400026E4 /end MEASUREMENT
/begin MEASUREMENT ac_cooling_fan_required "A/C cooling fan required (boolean flag)." UBYTE NO_COMPU_METHOD 0 0 0 255 ECU_ADDRESS 0x400026E5 /end MEASUREMENT
/begin MEASUREMENT ac_compressor_ign_compensation_active "A/C compressor ignition compensation active (boolean flag)." UBYTE NO_COMPU_METHOD 0 0 0 255 ECU_ADDRESS 0x400026E6 /end MEASUREMENT
/begin MEASUREMENT ac_compressor_speed_rpm "Filtered A/C compressor speed (rpm)." UWORD CM_u8_rspeed_rpm 0 0 0 65535 ECU_ADDRESS 0x400026E8 /end MEASUREMENT
/begin MEASUREMENT ac_pid_p_term "A/C evaporator PID P term." SWORD NO_COMPU_METHOD 0 0 -32768 32767 ECU_ADDRESS 0x400026EA /end MEASUREMENT
/begin MEASUREMENT ac_pid_error "A/C load error term (power - offset - target)." SWORD NO_COMPU_METHOD 0 0 -32768 32767 ECU_ADDRESS 0x400026EC /end MEASUREMENT
/begin MEASUREMENT ac_pid_d_term "A/C evaporator PID D term (filtered)." SWORD NO_COMPU_METHOD 0 0 -32768 32767 ECU_ADDRESS 0x400026EE /end MEASUREMENT
/begin MEASUREMENT ac_pid_out_accum "A/C evaporator PID integral (output accumulator)." SWORD NO_COMPU_METHOD 0 0 -32768 32767 ECU_ADDRESS 0x400026F0 /end MEASUREMENT
/begin MEASUREMENT ac_pid_target_accum "A/C target accumulator." SWORD NO_COMPU_METHOD 0 0 -32768 32767 ECU_ADDRESS 0x400026F2 /end MEASUREMENT
/begin MEASUREMENT ac_load_step "A/C load ramp step per tick." SWORD NO_COMPU_METHOD 0 0 -32768 32767 ECU_ADDRESS 0x400026F4 /end MEASUREMENT
/begin MEASUREMENT ac_power_limit "A/C power limit (lookup x40)." UWORD NO_COMPU_METHOD 0 0 0 65535 ECU_ADDRESS 0x400026F6 /end MEASUREMENT
/begin MEASUREMENT ac_evap_temp_delta "A/C evaporative temperature delta (°C = val/10)." UWORD CM_u8_temp_1_10C 0 0 0 6553.5 ECU_ADDRESS 0x400026F8 /end MEASUREMENT
/begin MEASUREMENT ac_clutch_reengage_timer "A/C clutch re-engage hold-off (reload 50)." UBYTE CM_u8_time_5ms 0 0 0 1275 ECU_ADDRESS 0x400026FA /end MEASUREMENT
/begin MEASUREMENT ac_compressor_dc "A/C compressor PWM duty." UWORD NO_COMPU_METHOD 0 0 0 65535 ECU_ADDRESS 0x400026FC /end MEASUREMENT
/begin MEASUREMENT ac_fan_startup_hold_timer "Fan hold time after A/C start (CAL_ac_fan_startup_hold_time*10)." UWORD CM_u8_time_5ms 0 0 0 327675 ECU_ADDRESS 0x400026FE /end MEASUREMENT
/begin MEASUREMENT obd_ii_p0537_health "Debounce health for P0537: reset to its CAL debounce count, decremented on failing samples; DTC fails at 0." UBYTE NO_COMPU_METHOD 0 0 0 255 ECU_ADDRESS 0x40002700 /end MEASUREMENT
/begin MEASUREMENT obd_ii_p0537_fail_ticks "Consecutive failing samples for P0537; at obd_ii_monitor_debounce_ticks decrements obd_ii_p0537_health." UWORD NO_COMPU_METHOD 0 0 0 65535 ECU_ADDRESS 0x40002702 /end MEASUREMENT
/begin MEASUREMENT obd_ii_p0538_health "Debounce health for P0538: reset to its CAL debounce count, decremented on failing samples; DTC fails at 0." UBYTE NO_COMPU_METHOD 0 0 0 255 ECU_ADDRESS 0x40002704 /end MEASUREMENT
/begin MEASUREMENT obd_ii_p0538_fail_ticks "Consecutive failing samples for P0538; at obd_ii_monitor_debounce_ticks decrements obd_ii_p0538_health." UWORD NO_COMPU_METHOD 0 0 0 65535 ECU_ADDRESS 0x40002706 /end MEASUREMENT
/begin MEASUREMENT ac_fault_check_timer "A/C fault check countdown." UWORD NO_COMPU_METHOD 0 0 0 65535 ECU_ADDRESS 0x40002708 /end MEASUREMENT
/begin MEASUREMENT ac_load_slew_up_timer "A/C load slew-up period countdown." UWORD CM_u8_time_5ms 0 0 0 327675 ECU_ADDRESS 0x4000270A /end MEASUREMENT
/begin MEASUREMENT ac_load_slew_down_timer "A/C load slew-down period countdown." UWORD CM_u8_time_5ms 0 0 0 327675 ECU_ADDRESS 0x4000270C /end MEASUREMENT
/begin MEASUREMENT ac_clutch_engage_request "A/C clutch engage request." UBYTE NO_COMPU_METHOD 0 0 0 255 ECU_ADDRESS 0x4000270E /end MEASUREMENT
/begin MEASUREMENT ac_evap_pid_update_period "A/C evaporator PID update countdown." UBYTE NO_COMPU_METHOD 0 0 0 255 ECU_ADDRESS 0x4000270F /end MEASUREMENT
/begin MEASUREMENT ac_pid_d_period "A/C PID derivative update countdown (CAL_ac_evap_pid_d_period)." UBYTE NO_COMPU_METHOD 0 0 0 255 ECU_ADDRESS 0x40002710 /end MEASUREMENT
/begin MEASUREMENT ac_compressor_power "A/C compressor power demand (clipped to 2000..ac_power_limit). Was ac_load_mw___." SWORD NO_COMPU_METHOD 0 0 -32768 32767 ECU_ADDRESS 0x40002712 /end MEASUREMENT
/begin MEASUREMENT ac_pid_d_raw "A/C PID derivative before filtering (CAL_ac_evap_pid_kd * d(error) * 4)." SWORD NO_COMPU_METHOD 0 0 -32768 32767 ECU_ADDRESS 0x40002714 /end MEASUREMENT
/begin MEASUREMENT ac_rpm_inhibit_delay_timer "A/C low-rpm inhibit hold (CAL_ac_inhibit_rpm_min_hold)." UBYTE CM_u8_time_5ms 0 0 0 1275 ECU_ADDRESS 0x40002716 /end MEASUREMENT
/begin MEASUREMENT ac_evap_freeze_inhibit_timer "A/C evaporator freeze inhibit (CAL_ac_evap_freeze_inhibit_delay*4)." UWORD CM_u8_time_5ms 0 0 0 327675 ECU_ADDRESS 0x40002718 /end MEASUREMENT
/begin MEASUREMENT ac_evap_temp_falling "0xff when the evaporator temperature is falling." UBYTE NO_COMPU_METHOD 0 0 0 255 ECU_ADDRESS 0x4000271A /end MEASUREMENT
/begin MEASUREMENT ac_evap_temp_prev "Previous obd_ii_ac_evap_temp for the trend." SWORD NO_COMPU_METHOD 0 0 -32768 32767 ECU_ADDRESS 0x4000271C /end MEASUREMENT
/begin MEASUREMENT ac_evap_trend_timer "Evaporator trend sample countdown (CAL_ac_evap_temp_trend_period2)." UBYTE NO_COMPU_METHOD 0 0 0 255 ECU_ADDRESS 0x4000271E /end MEASUREMENT
/begin MEASUREMENT ac_load_slew_up_active "1 while the A/C load is slewing up." UBYTE NO_COMPU_METHOD 0 0 0 255 ECU_ADDRESS 0x4000271F /end MEASUREMENT
/begin MEASUREMENT ac_rpm_cutoff_on_delay "A/C high-rpm cutoff on delay (CAL x10)." UWORD CM_u8_time_5ms 0 0 0 327675 ECU_ADDRESS 0x40002720 /end MEASUREMENT
/begin MEASUREMENT ac_rpm_cutoff_min_hold_timer "A/C rpm cutoff minimum hold (CAL x10)." UWORD CM_u8_time_5ms 0 0 0 327675 ECU_ADDRESS 0x40002722 /end MEASUREMENT
/begin MEASUREMENT ac_evap_temp_delta_rate "Change in the evaporator temperature error." SWORD NO_COMPU_METHOD 0 0 -32768 32767 ECU_ADDRESS 0x40002724 /end MEASUREMENT
/begin MEASUREMENT ac_evap_temp_delta_prev "Previous evaporator temperature error." SWORD NO_COMPU_METHOD 0 0 -32768 32767 ECU_ADDRESS 0x40002726 /end MEASUREMENT
/begin MEASUREMENT ac_power_target "A/C power target before the step limit." SWORD NO_COMPU_METHOD 0 0 -32768 32767 ECU_ADDRESS 0x40002728 /end MEASUREMENT
/begin MEASUREMENT ac_compressor_speed_filter_q8 "A/C compressor speed IIR accumulator (<<8)." SLONG NO_COMPU_METHOD 0 0 -2147483648 2147483647 ECU_ADDRESS 0x4000272C /end MEASUREMENT
/begin MEASUREMENT ac_compressor_speed_raw "A/C compressor speed 60e6/period (rpm)." UWORD CM_u8_rspeed_rpm 0 0 0 65535 ECU_ADDRESS 0x40002730 /end MEASUREMENT
/begin MEASUREMENT ac_fault_metric_a "A/C fault check metric." UWORD NO_COMPU_METHOD 0 0 0 65535 ECU_ADDRESS 0x40002732 /end MEASUREMENT
/begin MEASUREMENT ac_fault_metric_b "A/C fault check metric." UWORD NO_COMPU_METHOD 0 0 0 65535 ECU_ADDRESS 0x40002734 /end MEASUREMENT
/begin MEASUREMENT ac_compressor_speed_ratio "A/C compressor speed / engine speed ratio (x10000/127)." UWORD NO_COMPU_METHOD 0 0 0 65535 ECU_ADDRESS 0x40002736 /end MEASUREMENT
/begin MEASUREMENT etb_driver_diag_latched "Latched ETB H-bridge driver diagnostics: bit0 P2108, bit2 P2103 (circuit high), bit3 P2102 (circuit low), bit4 P2100 (open); used once etb_driver_fault_debounce is TS_CONFIRMED_FAULT." UBYTE NO_COMPU_METHOD 0 0 0 255 ECU_ADDRESS 0x40002738 /end MEASUREMENT
/begin MEASUREMENT tps_sensor_fault_active "Throttle position sensor fault active (boolean flag)." UBYTE NO_COMPU_METHOD 0 0 0 255 ECU_ADDRESS 0x40002739 /end MEASUREMENT
/begin MEASUREMENT tps_feedback_position "Throttle position feedback position (val/1023)." UWORD CM_u16_factor_1_1023 0 0 0 6406.15835777126 ECU_ADDRESS 0x4000273A /end MEASUREMENT
/begin MEASUREMENT tps1_scaled_hist0 "TPS1 scaled history (newest)." UWORD NO_COMPU_METHOD 0 0 0 65535 ECU_ADDRESS 0x4000273C /end MEASUREMENT
/begin MEASUREMENT tps1_scaled_hist1 "TPS1 scaled history (-1)." UWORD NO_COMPU_METHOD 0 0 0 65535 ECU_ADDRESS 0x4000273E /end MEASUREMENT
/begin MEASUREMENT tps1_scaled_hist2 "TPS1 scaled history (-2)." UWORD NO_COMPU_METHOD 0 0 0 65535 ECU_ADDRESS 0x40002740 /end MEASUREMENT
/begin MEASUREMENT tps2_scaled_hist0 "TPS2 scaled history (newest)." UWORD NO_COMPU_METHOD 0 0 0 65535 ECU_ADDRESS 0x40002744 /end MEASUREMENT
/begin MEASUREMENT tps2_scaled_hist1 "TPS2 scaled history (-1)." UWORD NO_COMPU_METHOD 0 0 0 65535 ECU_ADDRESS 0x40002746 /end MEASUREMENT
/begin MEASUREMENT tps2_scaled_hist2 "TPS2 scaled history (-2)." UWORD NO_COMPU_METHOD 0 0 0 65535 ECU_ADDRESS 0x40002748 /end MEASUREMENT
/begin MEASUREMENT tps_track_diff "TPS1 - TPS2 scaled difference (correlation check)." SWORD NO_COMPU_METHOD 0 0 -32768 32767 ECU_ADDRESS 0x4000274A /end MEASUREMENT
/begin MEASUREMENT tps1_scaled_12bit "TPS1 scaled to 0..0xfff." UWORD NO_COMPU_METHOD 0 0 0 65535 ECU_ADDRESS 0x4000274C /end MEASUREMENT
/begin MEASUREMENT tps2_scaled_12bit "TPS2 scaled to 0..0xfff." UWORD NO_COMPU_METHOD 0 0 0 65535 ECU_ADDRESS 0x4000274E /end MEASUREMENT
/begin MEASUREMENT tps_scaled_diff "tps1_scaled_12bit - tps2_scaled_12bit." SWORD NO_COMPU_METHOD 0 0 -32768 32767 ECU_ADDRESS 0x40002750 /end MEASUREMENT
/begin MEASUREMENT tps1_fault_timer "TPS1 fault countdown (1000); non-zero = tps_sensor_fault_active." UWORD CM_u8_time_ms 0 0 0 65535 ECU_ADDRESS 0x40002752 /end MEASUREMENT
/begin MEASUREMENT tps2_fault_timer "TPS2 fault countdown (1000)." UWORD CM_u8_time_ms 0 0 0 65535 ECU_ADDRESS 0x40002754 /end MEASUREMENT
/begin MEASUREMENT app_track_c_hist0 "Pedal track history (newest)." UWORD NO_COMPU_METHOD 0 0 0 65535 ECU_ADDRESS 0x40002758 /end MEASUREMENT
/begin MEASUREMENT app_track_c_hist1 "Pedal track history (-1)." UWORD NO_COMPU_METHOD 0 0 0 65535 ECU_ADDRESS 0x4000275A /end MEASUREMENT
/begin MEASUREMENT app_track_c_hist2 "Pedal track history (-2)." UWORD NO_COMPU_METHOD 0 0 0 65535 ECU_ADDRESS 0x4000275C /end MEASUREMENT
/begin MEASUREMENT app_track_d_hist0 "Pedal track history (newest)." UWORD NO_COMPU_METHOD 0 0 0 65535 ECU_ADDRESS 0x40002760 /end MEASUREMENT
/begin MEASUREMENT app_track_d_hist1 "Pedal track history (-1)." UWORD NO_COMPU_METHOD 0 0 0 65535 ECU_ADDRESS 0x40002762 /end MEASUREMENT
/begin MEASUREMENT app_track_d_hist2 "Pedal track history (-2)." UWORD NO_COMPU_METHOD 0 0 0 65535 ECU_ADDRESS 0x40002764 /end MEASUREMENT
/begin MEASUREMENT tps_system_state "Throttle position system state (enumerated state)." UBYTE NO_COMPU_METHOD 0 0 0 255 ECU_ADDRESS 0x40002768 /end MEASUREMENT
/begin MEASUREMENT accel_pedal_system_state "Accel pedal system state (0 ok, 1, 2 fault)." UBYTE NO_COMPU_METHOD 0 0 0 255 ECU_ADDRESS 0x40002769 /end MEASUREMENT
/begin MEASUREMENT tps_track_d_preferred "Returned by get_tps_sensor_track_d_preferred." UBYTE NO_COMPU_METHOD 0 0 0 255 ECU_ADDRESS 0x4000276A /end MEASUREMENT
/begin MEASUREMENT accel_pedal_track_d_selected "Accelerator pedal track d selected (boolean flag)." UBYTE NO_COMPU_METHOD 0 0 0 255 ECU_ADDRESS 0x4000276B /end MEASUREMENT
/begin MEASUREMENT coding_cmd "Service coding command (1, 2, 7, ...)." UBYTE NO_COMPU_METHOD 0 0 0 255 ECU_ADDRESS 0x40002770 /end MEASUREMENT
/begin MEASUREMENT coding_vin_buf "undefined1" UBYTE NO_COMPU_METHOD 0 0 0 255 ECU_ADDRESS 0x40002780 /end MEASUREMENT
/begin MEASUREMENT eeprom_update_flags "Pending EEPROM/coding update bits." UBYTE NO_COMPU_METHOD 0 0 0 255 ECU_ADDRESS 0x4000278E /end MEASUREMENT
/begin MEASUREMENT prog_version_mismatch "Prog version mismatch (boolean flag)." UBYTE NO_COMPU_METHOD 0 0 0 255 ECU_ADDRESS 0x4000278F /end MEASUREMENT
/begin MEASUREMENT vin_type "VIN type (enumerated state)." UBYTE NO_COMPU_METHOD 0 0 0 255 ECU_ADDRESS 0x40002790 /end MEASUREMENT
/begin MEASUREMENT vin_byte_arrival_mask "Bitmask of VIN bytes received (bits 3..16)." ULONG NO_COMPU_METHOD 0 0 0 4294967295 ECU_ADDRESS 0x40002794 /end MEASUREMENT
/begin MEASUREMENT cod_oil_sump_system "uint8_t" UBYTE NO_COMPU_METHOD 0 0 0 255 ECU_ADDRESS 0x40002798 /end MEASUREMENT
/begin MEASUREMENT central_door_locking_present "uint8_t" UBYTE NO_COMPU_METHOD 0 0 0 255 ECU_ADDRESS 0x40002799 /end MEASUREMENT
/begin MEASUREMENT tps_config_unknown "uint8_t" UBYTE NO_COMPU_METHOD 0 0 0 255 ECU_ADDRESS 0x4000279A /end MEASUREMENT
/begin MEASUREMENT power_fold_mirrors_installed "uint8_t" UBYTE NO_COMPU_METHOD 0 0 0 255 ECU_ADDRESS 0x4000279B /end MEASUREMENT
/begin MEASUREMENT reverse_camera "uint8_t" UBYTE NO_COMPU_METHOD 0 0 0 255 ECU_ADDRESS 0x4000279C /end MEASUREMENT
/begin MEASUREMENT speed_limiter "uint8_t" UBYTE NO_COMPU_METHOD 0 0 0 255 ECU_ADDRESS 0x4000279D /end MEASUREMENT
/begin MEASUREMENT race_mode_present "uint8_t" UBYTE NO_COMPU_METHOD 0 0 0 255 ECU_ADDRESS 0x4000279E /end MEASUREMENT
/begin MEASUREMENT launch_mode_present "uint8_t" UBYTE NO_COMPU_METHOD 0 0 0 255 ECU_ADDRESS 0x4000279F /end MEASUREMENT
/begin MEASUREMENT abs_present "uint8_t" UBYTE NO_COMPU_METHOD 0 0 0 255 ECU_ADDRESS 0x400027A0 /end MEASUREMENT
/begin MEASUREMENT instrument_cluster_is_2011plus "uint8_t" UBYTE NO_COMPU_METHOD 0 0 0 255 ECU_ADDRESS 0x400027A1 /end MEASUREMENT
/begin MEASUREMENT yaw_sensor_present "uint8_t" UBYTE NO_COMPU_METHOD 0 0 0 255 ECU_ADDRESS 0x400027A2 /end MEASUREMENT
/begin MEASUREMENT sas_present "uint8_t" UBYTE NO_COMPU_METHOD 0 0 0 255 ECU_ADDRESS 0x400027A3 /end MEASUREMENT
/begin MEASUREMENT tpms_present "uint8_t" UBYTE NO_COMPU_METHOD 0 0 0 255 ECU_ADDRESS 0x400027A4 /end MEASUREMENT
/begin MEASUREMENT tcu_installed "uint8_t" UBYTE NO_COMPU_METHOD 0 0 0 255 ECU_ADDRESS 0x400027A5 /end MEASUREMENT
/begin MEASUREMENT bcm_installed "uint8_t" UBYTE NO_COMPU_METHOD 0 0 0 255 ECU_ADDRESS 0x400027A6 /end MEASUREMENT
/begin MEASUREMENT cod_option_bits_16_17 "Variant coding COD[1] bits 16-17." UBYTE NO_COMPU_METHOD 0 0 0 255 ECU_ADDRESS 0x400027A7 /end MEASUREMENT
/begin MEASUREMENT fuel_pump_is_pwm "uint8_t" UBYTE NO_COMPU_METHOD 0 0 0 255 ECU_ADDRESS 0x400027A8 /end MEASUREMENT
/begin MEASUREMENT trans_fluid_pump "uint8_t" UBYTE NO_COMPU_METHOD 0 0 0 255 ECU_ADDRESS 0x400027A9 /end MEASUREMENT
/begin MEASUREMENT recirc_valve_installed "uint8_t" UBYTE NO_COMPU_METHOD 0 0 0 255 ECU_ADDRESS 0x400027AA /end MEASUREMENT
/begin MEASUREMENT clutch_type "uint8_t" UBYTE NO_COMPU_METHOD 0 0 0 255 ECU_ADDRESS 0x400027AB /end MEASUREMENT
/begin MEASUREMENT sport_button_installed "uint8_t" UBYTE NO_COMPU_METHOD 0 0 0 255 ECU_ADDRESS 0x400027AC /end MEASUREMENT
/begin MEASUREMENT tcp_esp_button_installed "uint8_t" UBYTE NO_COMPU_METHOD 0 0 0 255 ECU_ADDRESS 0x400027AD /end MEASUREMENT
/begin MEASUREMENT speed_alert_buzzer "uint8_t" UBYTE NO_COMPU_METHOD 0 0 0 255 ECU_ADDRESS 0x400027AE /end MEASUREMENT
/begin MEASUREMENT aux_cooling_fan_installed "uint8_t" UBYTE NO_COMPU_METHOD 0 0 0 255 ECU_ADDRESS 0x400027AF /end MEASUREMENT
/begin MEASUREMENT silencer_bypass_valve_installed "uint8_t" UBYTE NO_COMPU_METHOD 0 0 0 255 ECU_ADDRESS 0x400027B0 /end MEASUREMENT
/begin MEASUREMENT seat_heaters_installed "uint8_t" UBYTE NO_COMPU_METHOD 0 0 0 255 ECU_ADDRESS 0x400027B1 /end MEASUREMENT
/begin MEASUREMENT dpm_switch_installed "uint8_t" UBYTE NO_COMPU_METHOD 0 0 0 255 ECU_ADDRESS 0x400027B2 /end MEASUREMENT
/begin MEASUREMENT exhaust_bypass_override_button_installed "uint8_t" UBYTE NO_COMPU_METHOD 0 0 0 255 ECU_ADDRESS 0x400027B3 /end MEASUREMENT
/begin MEASUREMENT race_button_installed "uint8_t" UBYTE NO_COMPU_METHOD 0 0 0 255 ECU_ADDRESS 0x400027B4 /end MEASUREMENT
/begin MEASUREMENT cod_drive_pos "uint8_t" UBYTE NO_COMPU_METHOD 0 0 0 255 ECU_ADDRESS 0x400027B5 /end MEASUREMENT
/begin MEASUREMENT cod_symbol_display "uint8_t" UBYTE NO_COMPU_METHOD 0 0 0 255 ECU_ADDRESS 0x400027B6 /end MEASUREMENT
/begin MEASUREMENT cod_japan_seatbelt_warning "uint8_t" UBYTE NO_COMPU_METHOD 0 0 0 255 ECU_ADDRESS 0x400027B7 /end MEASUREMENT
/begin MEASUREMENT cod_rear_fog_fitted "uint8_t" UBYTE NO_COMPU_METHOD 0 0 0 255 ECU_ADDRESS 0x400027B8 /end MEASUREMENT
/begin MEASUREMENT cod_fuel_tank_capacity "uint8_t" UBYTE NO_COMPU_METHOD 0 0 0 255 ECU_ADDRESS 0x400027B9 /end MEASUREMENT
/begin MEASUREMENT speed_units "uint8_t" UBYTE NO_COMPU_METHOD 0 0 0 255 ECU_ADDRESS 0x400027BA /end MEASUREMENT
/begin MEASUREMENT srs_present "uint8_t" UBYTE NO_COMPU_METHOD 0 0 0 255 ECU_ADDRESS 0x400027BB /end MEASUREMENT
/begin MEASUREMENT cod_trans_type "uint8_t" UBYTE NO_COMPU_METHOD 0 0 0 255 ECU_ADDRESS 0x400027BC /end MEASUREMENT
/begin MEASUREMENT close_ratio_gears "uint8_t" UBYTE NO_COMPU_METHOD 0 0 0 255 ECU_ADDRESS 0x400027BD /end MEASUREMENT
/begin MEASUREMENT gear_count "uint8_t" UBYTE NO_COMPU_METHOD 0 0 0 255 ECU_ADDRESS 0x400027BE /end MEASUREMENT
/begin MEASUREMENT large_wheel_profile_set "uint8_t" UBYTE NO_COMPU_METHOD 0 0 0 255 ECU_ADDRESS 0x400027BF /end MEASUREMENT
/begin MEASUREMENT mechanical_lsd_installed "Mechanical lsd installed (boolean flag)." UBYTE NO_COMPU_METHOD 0 0 0 255 ECU_ADDRESS 0x400027C0 /end MEASUREMENT
/begin MEASUREMENT traction_control_level "uint8_t" UBYTE NO_COMPU_METHOD 0 0 0 255 ECU_ADDRESS 0x400027C1 /end MEASUREMENT
/begin MEASUREMENT cruise_type "uint8_t" UBYTE NO_COMPU_METHOD 0 0 0 255 ECU_ADDRESS 0x400027C2 /end MEASUREMENT
/begin MEASUREMENT hvac_type "uint8_t" UBYTE NO_COMPU_METHOD 0 0 0 255 ECU_ADDRESS 0x400027C3 /end MEASUREMENT
/begin MEASUREMENT coding_oil_cooling_additional "Coding oil cooling additional (boolean flag)." UBYTE NO_COMPU_METHOD 0 0 0 255 ECU_ADDRESS 0x400027C4 /end MEASUREMENT
/begin MEASUREMENT revlimit_state_flags "bit0 airflow limiter active, bit1/2 flow setpoint stepping up/down, bit3 tps cap valid, bit4 escalated, bit6 fuel cut hit, bit7 speed-limit rpm active, bit8 capped by speed-limit max, bit9 speed-limit rpm valid, bit10 speed target ramping, bit11 over" UWORD NO_COMPU_METHOD 0 0 0 65535 ECU_ADDRESS 0x400027C8 /end MEASUREMENT
/begin MEASUREMENT revlimit_rpm_error "revlimit_soft_target - engine_speed_16bit (RPM, signed)." SWORD CM_u8_rspeed_rpm 0 0 -32768 32767 ECU_ADDRESS 0x400027CA /end MEASUREMENT
/begin MEASUREMENT revlimit_tps_max "Throttle cap from the airflow limiter: CAL_load_to_tps_mapping[revlimit_load_setpoint] - idle tps (val/1023)." UWORD CM_u16_factor_1_1023 0 0 0 6406.15835777126 ECU_ADDRESS 0x400027CC /end MEASUREMENT
/begin MEASUREMENT revlimit_tps_max_remapped_unused "revlimit_tps_max converted to pedal scale and passed through CAL_tpstarget_* (pedal->throttle) at the end of revlimit(). Write-only: nothing reads it." UWORD CM_u16_factor_1_1023 0 0 0 6406.15835777126 ECU_ADDRESS 0x400027CE /end MEASUREMENT
/begin MEASUREMENT revlimit_flow_setpoint "Airflow setpoint stepped toward base + P + I by CAL_revlimit_maf_error_max_10g (mg/s = val*10)." UWORD CM_u16_flow_10mg_s 0 0 0 655350 ECU_ADDRESS 0x400027D0 /end MEASUREMENT
/begin MEASUREMENT revlimit_load_setpoint "revlimit_flow_setpoint converted to load minus idle load, max 1173 (mg/stroke)." UWORD CM_u8_load_mg_stroke 0 0 0 65535 ECU_ADDRESS 0x400027D2 /end MEASUREMENT
/begin MEASUREMENT revlimit_hard_exit_rpm "Latched copy of revlimit_hard: fuel cut ends when rpm <= this (RPM). Also sent on CAN." UWORD CM_u8_rspeed_rpm 0 0 0 65535 ECU_ADDRESS 0x400027D4 /end MEASUREMENT
/begin MEASUREMENT revlimit_hard "Rev-limit hard (RPM)." UWORD CM_u8_rspeed_rpm 0 0 0 65535 ECU_ADDRESS 0x400027D6 /end MEASUREMENT
/begin MEASUREMENT ips_enforce_speed_limit "IPS enforce speed limit (boolean flag)." UBYTE NO_COMPU_METHOD 0 0 0 255 ECU_ADDRESS 0x400027D8 /end MEASUREMENT
/begin MEASUREMENT ips_tcu_data_invalid "Set when CAN 0x250 data is invalid/timed out." UBYTE NO_COMPU_METHOD 0 0 0 255 ECU_ADDRESS 0x400027D9 /end MEASUREMENT
/begin MEASUREMENT ips_throttle_restrict "IPS throttle restriction request (CAN 0x250 byte 0 bit 2)." UBYTE NO_COMPU_METHOD 0 0 0 255 ECU_ADDRESS 0x400027DA /end MEASUREMENT
/begin MEASUREMENT revlimit_soft_target "revlimit_soft - 2*trim_per_gear, lowered to the speed-limit rpm when active (RPM). Airflow limiter target. Was revlimit_current." UWORD CM_u8_rspeed_rpm 0 0 0 65535 ECU_ADDRESS 0x400027DC /end MEASUREMENT
/begin MEASUREMENT revlimit_soft "Rev-limit soft (RPM)." UWORD CM_u8_rspeed_rpm 0 0 0 65535 ECU_ADDRESS 0x400027DE /end MEASUREMENT
/begin MEASUREMENT revlimit_limp_mode_active "Rev-limit limp mode active (boolean flag)." UBYTE NO_COMPU_METHOD 0 0 0 255 ECU_ADDRESS 0x400027E0 /end MEASUREMENT
/begin MEASUREMENT revlimit_rpm_error_integral "Limiter integrator: += error/10 per tick, clamped +-CAL_revlimit_integrator_limit*250." SWORD NO_COMPU_METHOD 0 0 -32768 32767 ECU_ADDRESS 0x400027E2 /end MEASUREMENT
/begin MEASUREMENT revlimit_rpm_approach_rate "Rpm approach rate = d(error)*10/max(error,50) every 15 ms, clipped to [-CAL_revlimit_rpm_rate_limit*25, 0]." SWORD NO_COMPU_METHOD 0 0 -32768 32767 ECU_ADDRESS 0x400027E4 /end MEASUREMENT
/begin MEASUREMENT revlimit_flow_proportional_term "Limiter P term = gain*error/5, clipped +-CAL_revlimit_flow_proportional_limit*100 (mg/s = val*10)." SWORD CM_u16_flow_10mg_s 0 0 -327680 327670 ECU_ADDRESS 0x400027E6 /end MEASUREMENT
/begin MEASUREMENT revlimit_flow_integral_term "Limiter I term = gain*integral/100, clipped +-CAL_revlimit_flow_integral_limit*100 (mg/s = val*10)." SWORD CM_u16_flow_10mg_s 0 0 -327680 327670 ECU_ADDRESS 0x400027E8 /end MEASUREMENT
/begin MEASUREMENT revlimit_airflow_rpm_term "Limiter rate term = gain*approach_rate/10 (mg/s = val*10). NB the +clip writes CAL*10 while testing CAL*100." SWORD CM_u16_flow_10mg_s 0 0 -327680 327670 ECU_ADDRESS 0x400027EA /end MEASUREMENT
/begin MEASUREMENT revlimit_flow_update_divider "Vehicle speed limit enforce timer (ms = val*5)." UBYTE CM_u8_time_5ms 0 0 0 1275 ECU_ADDRESS 0x400027EC /end MEASUREMENT
/begin MEASUREMENT revlimit_approach_rate_divider "Rev-limit RPM rate update timer." UBYTE NO_COMPU_METHOD 0 0 0 255 ECU_ADDRESS 0x400027ED /end MEASUREMENT
/begin MEASUREMENT revlimit_flow_base "Airflow at limiter entry: min(maf, CAL_revlimit_airflow_threshold*2 g/s) (mg/s = val*10)." UWORD CM_u16_flow_10mg_s 0 0 0 655350 ECU_ADDRESS 0x400027EE /end MEASUREMENT
/begin MEASUREMENT revlimit_rpm_error_prev "u16_rspeed_rpm" UWORD CM_u8_rspeed_rpm 0 0 0 65535 ECU_ADDRESS 0x400027F0 /end MEASUREMENT
/begin MEASUREMENT revlimit_i_term_step "Escalation step = CAL_revlimit_escalation_integrator_step[gear]*25 (integrator units)." SWORD NO_COMPU_METHOD 0 0 -32768 32767 ECU_ADDRESS 0x400027F2 /end MEASUREMENT
/begin MEASUREMENT revlimit_speed_limit_rpm "revlimit_rpm_at_speed_limit capped at revlimit_speed_limit_rpm_cap (RPM). Was rpm_speed_estimated_clipped_tomax." UWORD CM_u8_rspeed_rpm 0 0 0 65535 ECU_ADDRESS 0x400027F4 /end MEASUREMENT
/begin MEASUREMENT revlimit_trim_per_gear "Rev-limit trim per gear (RPM = val*2)." UBYTE CM_u8_rspeed_2rpm 0 0 0 510 ECU_ADDRESS 0x400027F6 /end MEASUREMENT
/begin MEASUREMENT revlimit_timer_ticks_past_limit "Rev-limit timer ticks past limit (ms = val*5)." UWORD CM_u8_time_5ms 0 0 0 327675 ECU_ADDRESS 0x400027F8 /end MEASUREMENT
/begin MEASUREMENT revlimit_airflow_threshold "Rev-limit airflow threshold (g/s = val*2)." UBYTE CM_u8_flow_2g_s 0 0 0 510 ECU_ADDRESS 0x400027FA /end MEASUREMENT
/begin MEASUREMENT revlimit_speed_limit_rpm_cap "CAL_revlimit_max_with_speedlimit when a speed limit is enforced, else 0 (RPM). Also caps revlimit_hard. Was revlimit_max." UWORD CM_u8_rspeed_rpm 0 0 0 65535 ECU_ADDRESS 0x400027FC /end MEASUREMENT
/begin MEASUREMENT revlimit_rpm_at_speed_limit "Engine rpm that gives speed_limit_target_ramped in the current gear = target*rpm/car_speed (RPM). Was rpm_speed_estimated." UWORD CM_u8_rspeed_rpm 0 0 0 65535 ECU_ADDRESS 0x400027FE /end MEASUREMENT
/begin MEASUREMENT revlimit_hard_coldstart_offset "Cold-start reduction of the hard limit, decays by CAL_revlimit_startup_offset_decrement at 200 Hz (RPM). Was revlimit_startup_offset." UWORD CM_u8_rspeed_rpm 0 0 0 65535 ECU_ADDRESS 0x40002800 /end MEASUREMENT
/begin MEASUREMENT revlimit_soft_coldstart_offset "Cold-start reduction of the soft limit, decays like the hard one (RPM). Was revlimit_startup_max_offset." UWORD CM_u8_rspeed_rpm 0 0 0 65535 ECU_ADDRESS 0x40002802 /end MEASUREMENT
/begin MEASUREMENT revlimit_active_gear_ips "IPS gear latched when the limiter escalates; NO_GEAR = none." UBYTE NO_COMPU_METHOD 0 0 0 255 ECU_ADDRESS 0x40002804 /end MEASUREMENT
/begin MEASUREMENT revlimit_coldstart_hard "Cold-start hard limit (CAL_revlimit_coldstart_rpm_envelope row 0) or the normal one when warm (RPM). Was revlimit_coldstart_rpm_envelope_min." UWORD CM_u8_rspeed_rpm 0 0 0 65535 ECU_ADDRESS 0x40002806 /end MEASUREMENT
/begin MEASUREMENT revlimit_coldstart_soft "Cold-start soft limit (envelope row 0xffff) or the normal one when warm (RPM). Was revlimit_coldstart_rpm_envelope_max." UWORD CM_u8_rspeed_rpm 0 0 0 65535 ECU_ADDRESS 0x40002808 /end MEASUREMENT
/begin MEASUREMENT revlimit_escalated_timer "Set to 40 (1 s) on escalation/overspeed, -1 every 25 ms. Was revlimit_esclated_timer." UBYTE CM_u8_time_25ms 0 0 0 6375 ECU_ADDRESS 0x4000280A /end MEASUREMENT
/begin MEASUREMENT vin_check_flags_a "VIN check state bits (vin_flags)." UBYTE NO_COMPU_METHOD 0 0 0 255 ECU_ADDRESS 0x40002810 /end MEASUREMENT
/begin MEASUREMENT vin_check_flags_b "VIN check state bits (vin_flags; high nibble state, low nibble result)." UBYTE NO_COMPU_METHOD 0 0 0 255 ECU_ADDRESS 0x40002811 /end MEASUREMENT
/begin MEASUREMENT can_a4_ext_byte0_copy "CAN 0xA4 extended data byte (copy)." UBYTE NO_COMPU_METHOD 0 0 0 255 ECU_ADDRESS 0x40002814 /end MEASUREMENT
/begin MEASUREMENT can_a4_ext_byte2_copy "CAN 0xA4 extended data byte (copy)." UBYTE NO_COMPU_METHOD 0 0 0 255 ECU_ADDRESS 0x40002815 /end MEASUREMENT
/begin MEASUREMENT tcu_can_status_flags "TCU CAN status bits (0x199 / 0x250 reception state)." UWORD NO_COMPU_METHOD 0 0 0 65535 ECU_ADDRESS 0x40002816 /end MEASUREMENT
/begin MEASUREMENT abs_esp_can_torque_request_flags "uint16_t" UWORD NO_COMPU_METHOD 0 0 0 65535 ECU_ADDRESS 0x40002818 /end MEASUREMENT
/begin MEASUREMENT sas_can_status "CAN 0x85 (steering angle) reception bits." UWORD NO_COMPU_METHOD 0 0 0 65535 ECU_ADDRESS 0x4000281A /end MEASUREMENT
/begin MEASUREMENT tc_enable_condition_1 "Traction control enable condition 1 (boolean flag)." UBYTE NO_COMPU_METHOD 0 0 0 255 ECU_ADDRESS 0x4000281C /end MEASUREMENT
/begin MEASUREMENT tc_enable_condition_2 "Traction control enable condition 2 (boolean flag)." UBYTE NO_COMPU_METHOD 0 0 0 255 ECU_ADDRESS 0x4000281D /end MEASUREMENT
/begin MEASUREMENT ips_cal_version_received "IPS calibration version received on CAN 0x250 byte 4 (checked against CAL_ecu_ips_calibration_version)." UBYTE NO_COMPU_METHOD 0 0 0 255 ECU_ADDRESS 0x4000281E /end MEASUREMENT
/begin MEASUREMENT ips_cal_version_valid "Set when CAN 0x250 has been received." UBYTE NO_COMPU_METHOD 0 0 0 255 ECU_ADDRESS 0x4000281F /end MEASUREMENT
/begin MEASUREMENT can_b7_failure_counter "Consecutive CAN 0xB7 rolling-counter failures (saturating); >= 6 sets the CAN fault." UBYTE NO_COMPU_METHOD 0 0 0 255 ECU_ADDRESS 0x40002820 /end MEASUREMENT
/begin MEASUREMENT can_b7_crc_failure_counter "Consecutive CAN 0xB7 second-check failures." UBYTE NO_COMPU_METHOD 0 0 0 255 ECU_ADDRESS 0x40002821 /end MEASUREMENT
/begin MEASUREMENT can_a2_failure_counter "Consecutive CAN 0xA2 check failures." UBYTE NO_COMPU_METHOD 0 0 0 255 ECU_ADDRESS 0x40002822 /end MEASUREMENT
/begin MEASUREMENT can_a2_rolling_failure_counter "Consecutive CAN 0xA2 rolling-counter failures." UBYTE NO_COMPU_METHOD 0 0 0 255 ECU_ADDRESS 0x40002823 /end MEASUREMENT
/begin MEASUREMENT can_a4_failure_counter "Consecutive CAN 0xA4 check failures." UBYTE NO_COMPU_METHOD 0 0 0 255 ECU_ADDRESS 0x40002824 /end MEASUREMENT
/begin MEASUREMENT can_a4_rolling_failure_counter "Consecutive CAN 0xA4 rolling-counter failures." UBYTE NO_COMPU_METHOD 0 0 0 255 ECU_ADDRESS 0x40002825 /end MEASUREMENT
/begin MEASUREMENT obd_ii_u0101_health "U0101 (lost communication with TCM) health (CAL_obd_ii_U0101_pass_counter_max)." UBYTE NO_COMPU_METHOD 0 0 0 255 ECU_ADDRESS 0x40002826 /end MEASUREMENT
/begin MEASUREMENT can_abs_missing_ticks "Time without ABS messages (saturating); > 600 (3 s) flags the fault." UWORD CM_u8_time_5ms 0 0 0 327675 ECU_ADDRESS 0x40002828 /end MEASUREMENT
/begin MEASUREMENT obd_ii_can_check_divider "Divider (0..16) in obd_ii_monitors_misc1." UBYTE NO_COMPU_METHOD 0 0 0 255 ECU_ADDRESS 0x4000282A /end MEASUREMENT
/begin MEASUREMENT obd_ii_u0302_health "Debounce health for U0302: reset to its CAL debounce count, decremented on failing samples; DTC fails at 0." UBYTE NO_COMPU_METHOD 0 0 0 255 ECU_ADDRESS 0x4000282B /end MEASUREMENT
/begin MEASUREMENT obd_ii_u0316_health "Debounce health for U0316: reset to its CAL debounce count, decremented on failing samples; DTC fails at 0." UBYTE NO_COMPU_METHOD 0 0 0 255 ECU_ADDRESS 0x4000282C /end MEASUREMENT
/begin MEASUREMENT obd_ii_u0123_health "Debounce health for U0123: reset to its CAL debounce count, decremented on failing samples; DTC fails at 0." UBYTE NO_COMPU_METHOD 0 0 0 255 ECU_ADDRESS 0x4000282D /end MEASUREMENT
/begin MEASUREMENT obd_ii_u0513_health "Debounce health for U0513: reset to its CAL debounce count, decremented on failing samples; DTC fails at 0." UBYTE NO_COMPU_METHOD 0 0 0 255 ECU_ADDRESS 0x4000282E /end MEASUREMENT
/begin MEASUREMENT obd_ii_u0127_health "Debounce health for U0127: reset to its CAL debounce count, decremented on failing samples; DTC fails at 0." UBYTE NO_COMPU_METHOD 0 0 0 255 ECU_ADDRESS 0x4000282F /end MEASUREMENT
/begin MEASUREMENT can_sensor_timeout "CAN sensor timeout countdown (CAL_can_sensor_timeout_reload)." UBYTE NO_COMPU_METHOD 0 0 0 255 ECU_ADDRESS 0x40002830 /end MEASUREMENT
/begin MEASUREMENT can_yaw_timeout "CAN yaw message timeout countdown (CAL_can_yaw_timeout)." UBYTE NO_COMPU_METHOD 0 0 0 255 ECU_ADDRESS 0x40002831 /end MEASUREMENT
/begin MEASUREMENT can_yaw_data_timeout "CAN yaw data timeout countdown (CAL_can_yaw_data_timeout)." UBYTE NO_COMPU_METHOD 0 0 0 255 ECU_ADDRESS 0x40002832 /end MEASUREMENT
/begin MEASUREMENT can_lat_accel_standstill_timer "Lateral-accel standstill timeout (CAL x20)." UWORD CM_u8_time_5ms 0 0 0 327675 ECU_ADDRESS 0x40002834 /end MEASUREMENT
/begin MEASUREMENT can_sensor_check_count "CAN sensor check counter (20..30 window)." UBYTE NO_COMPU_METHOD 0 0 0 255 ECU_ADDRESS 0x40002836 /end MEASUREMENT
/begin MEASUREMENT can_sensor_fail_count "CAN sensor failure count (> 2)." UBYTE NO_COMPU_METHOD 0 0 0 255 ECU_ADDRESS 0x40002837 /end MEASUREMENT
/begin MEASUREMENT ips_speedmatch_param_d "IPS speed-matching config byte (param_1[0x16])." UBYTE NO_COMPU_METHOD 0 0 0 255 ECU_ADDRESS 0x40002838 /end MEASUREMENT
/begin MEASUREMENT ips_shift_sm_state "IPS shift-management state (0..4)." UBYTE NO_COMPU_METHOD 0 0 0 255 ECU_ADDRESS 0x40002839 /end MEASUREMENT
/begin MEASUREMENT ips_shift_speed_filter "IPS speed-match filter (x0xa00)." SLONG NO_COMPU_METHOD 0 0 -2147483648 2147483647 ECU_ADDRESS 0x4000283C /end MEASUREMENT
/begin MEASUREMENT ips_shift_sm_timer "IPS shift state countdown (3000 = 3 s at 1 kHz)." UWORD CM_u8_time_ms 0 0 0 65535 ECU_ADDRESS 0x40002840 /end MEASUREMENT
/begin MEASUREMENT ips_revmatch_p_gain "Lookup result of CAL_ips_revmatch_p_gain." UWORD NO_COMPU_METHOD 0 0 0 65535 ECU_ADDRESS 0x40002842 /end MEASUREMENT
/begin MEASUREMENT ips_revmatch_rpm_tolerance "Lookup result of CAL_ips_revmatch_rpm_tolerance." UWORD CM_u8_rspeed_rpm 0 0 0 65535 ECU_ADDRESS 0x40002844 /end MEASUREMENT
/begin MEASUREMENT engine_power_corrected "Engine power corrected (kW = val/100)." UWORD CM_u16_power_1_100kw 0 0 0 655.35 ECU_ADDRESS 0x40002848 /end MEASUREMENT
/begin MEASUREMENT tc_cornering_intensity_ "Traction control cornering intensity (val/255)." UBYTE CM_u8_factor_1_255 0 0 0 100 ECU_ADDRESS 0x4000284A /end MEASUREMENT
/begin MEASUREMENT traction_power_based_rpm_threshold "Traction power based RPM threshold (RPM)." UWORD CM_u8_rspeed_rpm 0 0 0 65535 ECU_ADDRESS 0x4000284C /end MEASUREMENT
/begin MEASUREMENT traction_relax_factor_starting "Traction relax factor starting." UWORD NO_COMPU_METHOD 0 0 0 65535 ECU_ADDRESS 0x4000284E /end MEASUREMENT
/begin MEASUREMENT traction_slip_detected_gear "Gear in which traction slip was detected (NO_GEAR = none)." UBYTE NO_COMPU_METHOD 0 0 0 255 ECU_ADDRESS 0x40002850 /end MEASUREMENT
/begin MEASUREMENT traction_power_limit_gear "Gear at which the traction power limit applies." UBYTE NO_COMPU_METHOD 0 0 0 255 ECU_ADDRESS 0x40002851 /end MEASUREMENT
/begin MEASUREMENT tc_is_moving "Traction control is moving (boolean flag)." UBYTE NO_COMPU_METHOD 0 0 0 255 ECU_ADDRESS 0x40002852 /end MEASUREMENT
/begin MEASUREMENT steering_angle_abs_last "Steering angle ABS last (° = val/10)." UWORD CM_u16_angle_1_10deg 0 0 0 6553.5 ECU_ADDRESS 0x40002854 /end MEASUREMENT
/begin MEASUREMENT steering_angle_smoothed "Smoothed steering angle x256." ULONG NO_COMPU_METHOD 0 0 0 4294967295 ECU_ADDRESS 0x40002858 /end MEASUREMENT
/begin MEASUREMENT steering_angle_delta "Steering angle delta (° = val/10)." UWORD CM_u16_angle_1_10deg 0 0 0 6553.5 ECU_ADDRESS 0x4000285C /end MEASUREMENT
/begin MEASUREMENT traction_steering_increase_factor "Traction steering increase factor (val/255)." UBYTE CM_u8_factor_1_255 0 0 0 100 ECU_ADDRESS 0x4000285E /end MEASUREMENT
/begin MEASUREMENT slip_gear_change_holdoff_timer "u8_time_100ms" UBYTE CM_u8_time_100ms 0 0 0 25500 ECU_ADDRESS 0x4000285F /end MEASUREMENT
/begin MEASUREMENT traction_inhibit_accel_pedal_timer "Traction inhibit accelerator pedal timer (ms = val*100)." UBYTE CM_u8_time_100ms 0 0 0 25500 ECU_ADDRESS 0x40002860 /end MEASUREMENT
/begin MEASUREMENT gsi_downshift_advisory_timer "u8_time_100ms" UBYTE CM_u8_time_100ms 0 0 0 25500 ECU_ADDRESS 0x40002861 /end MEASUREMENT
/begin MEASUREMENT traction_timer_per_gear_intervention "Traction timer per gear intervention (ms = val*100)." UBYTE CM_u8_time_100ms 0 0 0 25500 ECU_ADDRESS 0x40002862 /end MEASUREMENT
/begin MEASUREMENT tc_gear_tracker "Gear tracked by TC (0xf = reset)." UBYTE NO_COMPU_METHOD 0 0 0 255 ECU_ADDRESS 0x4000286A /end MEASUREMENT
/begin MEASUREMENT traction_control_gear_recommended_ "Traction control gear recommended??." UBYTE NO_COMPU_METHOD 0 0 0 255 ECU_ADDRESS 0x4000286B /end MEASUREMENT
/begin MEASUREMENT traction_flags "Traction control state bits (bit2, bit6 cluster lamp). Was traction_flags_unknown." UBYTE NO_COMPU_METHOD 0 0 0 255 ECU_ADDRESS 0x4000286C /end MEASUREMENT
/begin MEASUREMENT fuel_pump_crank_activity_timer "Fuel pump run-on after crank activity (CAL_fuel_pump_prime_time)." UWORD NO_COMPU_METHOD 0 0 0 65535 ECU_ADDRESS 0x40002870 /end MEASUREMENT
/begin MEASUREMENT fuel_pressure_target_clamped "Fuel pressure target clamped (mbar = val*50)." UBYTE CM_u8_pressure_50mbar 0 0 0 12750 ECU_ADDRESS 0x40002872 /end MEASUREMENT
/begin MEASUREMENT inj_flow_required_or_estimated "Required injector flow estimate (fuel pump feed-forward)." UWORD CM_u16_flow_mg_s 0 0 0 65535 ECU_ADDRESS 0x40002874 /end MEASUREMENT
/begin MEASUREMENT fuel_pressure_state_flags "uint8_t" UBYTE NO_COMPU_METHOD 0 0 0 255 ECU_ADDRESS 0x40002876 /end MEASUREMENT
/begin MEASUREMENT fuel_pump_dutycycle_commanded "Fuel pump dutycycle commanded (val/10000)." UWORD CM_u16_factor_1_10000 0 0 0 655.35 ECU_ADDRESS 0x40002878 /end MEASUREMENT
/begin MEASUREMENT fuel_pressure_lookup_relative "Fuel pressure lookup relative (mbar)." UWORD CM_i16_pressure_mbar 0 0 0 65535 ECU_ADDRESS 0x4000287A /end MEASUREMENT
/begin MEASUREMENT fuel_pump_state "Fuel pump state (mode 22)." UBYTE NO_COMPU_METHOD 0 0 0 255 ECU_ADDRESS 0x4000287C /end MEASUREMENT
/begin MEASUREMENT fuel_pressure_pid_correction "Fuel pressure PID correction (signed)." SWORD NO_COMPU_METHOD 0 0 -32768 32767 ECU_ADDRESS 0x4000287E /end MEASUREMENT
/begin MEASUREMENT fuel_pump_integral_update_countdown "Fuel pump integral update countdown (CAL_fuel_pump_integral_update_period)." UBYTE NO_COMPU_METHOD 0 0 0 255 ECU_ADDRESS 0x40002880 /end MEASUREMENT
/begin MEASUREMENT fuel_pump_commanded_scaled "Fuel pump commanded scaled (val/10000)." UWORD CM_u16_factor_1_10000 0 0 0 655.35 ECU_ADDRESS 0x40002882 /end MEASUREMENT
/begin MEASUREMENT fuel_pump_p_term "Fuel pump PI proportional term (+-CAL_fuel_pump_proportional_limit*100, 1/10000 duty)." SWORD NO_COMPU_METHOD 0 0 -32768 32767 ECU_ADDRESS 0x40002884 /end MEASUREMENT
/begin MEASUREMENT fuel_pump_i_term "Fuel pump PI integral term (max CAL_fuel_pump_integral_max*100, 1/10000 duty)." SWORD NO_COMPU_METHOD 0 0 -32768 32767 ECU_ADDRESS 0x40002886 /end MEASUREMENT
/begin MEASUREMENT fuel_pump_adapt_settle_timer "Fuel pump adaptation settle countdown (CAL_fuel_pump_adapt_settle_delay*10)." UWORD NO_COMPU_METHOD 0 0 0 65535 ECU_ADDRESS 0x40002888 /end MEASUREMENT
/begin MEASUREMENT fuel_pump_adapt_step_timer "Fuel pump adaptation step countdown (CAL_fuel_pump_adapt_step_period)." UBYTE NO_COMPU_METHOD 0 0 0 255 ECU_ADDRESS 0x4000288A /end MEASUREMENT
/begin MEASUREMENT fuel_pump_prime_timer "Fuel pump prime countdown (CAL_fuel_pump_prime_time)." UWORD NO_COMPU_METHOD 0 0 0 65535 ECU_ADDRESS 0x4000288C /end MEASUREMENT
/begin MEASUREMENT fuel_pump_state_reported "Fuel pump state passed to the OBD monitors (5, 6, 0)." UBYTE NO_COMPU_METHOD 0 0 0 255 ECU_ADDRESS 0x4000288E /end MEASUREMENT
/begin MEASUREMENT fuel_pump_state_counter_a "Fuel pump state machine counter (saturating)." UBYTE NO_COMPU_METHOD 0 0 0 255 ECU_ADDRESS 0x4000288F /end MEASUREMENT
/begin MEASUREMENT fuel_pump_state_counter_b "Fuel pump state machine counter (saturating)." UBYTE NO_COMPU_METHOD 0 0 0 255 ECU_ADDRESS 0x40002890 /end MEASUREMENT
/begin MEASUREMENT fuel_pump_state_debounce "Fuel pump state change debounce (reload 3)." UBYTE NO_COMPU_METHOD 0 0 0 255 ECU_ADDRESS 0x40002891 /end MEASUREMENT
/begin MEASUREMENT fuel_pump_state_hold "Fuel pump state hold countdown (reload 10)." UBYTE NO_COMPU_METHOD 0 0 0 255 ECU_ADDRESS 0x40002892 /end MEASUREMENT
/begin MEASUREMENT obd_ii_p0087_fail_ticks "P0087 (fuel rail pressure) failing samples (vs CAL_obd_ii_fuel_pressure_high_debounce; SAE P0087 = pressure too low, CAL name says high)." UBYTE NO_COMPU_METHOD 0 0 0 255 ECU_ADDRESS 0x40002893 /end MEASUREMENT
/begin MEASUREMENT obd_ii_p0088_fail_ticks "P0088 failing samples (vs CAL_obd_ii_fuel_pressure_low_debounce)." UBYTE NO_COMPU_METHOD 0 0 0 255 ECU_ADDRESS 0x40002894 /end MEASUREMENT
/begin MEASUREMENT obd_ii_p0087_health "Debounce health for P0087: reset to its CAL debounce count, decremented on failing samples; DTC fails at 0." UBYTE NO_COMPU_METHOD 0 0 0 255 ECU_ADDRESS 0x40002895 /end MEASUREMENT
/begin MEASUREMENT obd_ii_p0088_health "Debounce health for P0088: reset to its CAL debounce count, decremented on failing samples; DTC fails at 0." UBYTE NO_COMPU_METHOD 0 0 0 255 ECU_ADDRESS 0x40002896 /end MEASUREMENT
/begin MEASUREMENT fuel_pump_pwm_duty "Fuel pump PWM duty after scaling (500..7000, 1/10000)." SWORD NO_COMPU_METHOD 0 0 -32768 32767 ECU_ADDRESS 0x40002898 /end MEASUREMENT
/begin MEASUREMENT fuel_pressure_target "Fuel pressure target (mbar = val*50)." UBYTE CM_u8_pressure_50mbar 0 0 0 12750 ECU_ADDRESS 0x4000289A /end MEASUREMENT
/begin MEASUREMENT fuel_pump_pwm_output "Fuel pump PWM output." UWORD NO_COMPU_METHOD 0 0 0 65535 ECU_ADDRESS 0x4000289C /end MEASUREMENT
/begin MEASUREMENT fuel_pump_correction_filter_q8 "Fuel pump correction IIR accumulator (<<8)." SLONG NO_COMPU_METHOD 0 0 -2147483648 2147483647 ECU_ADDRESS 0x400028A0 /end MEASUREMENT
/begin MEASUREMENT fuel_pump_correction_filtered "Filtered fuel pump correction (adaptation input)." SWORD NO_COMPU_METHOD 0 0 -32768 32767 ECU_ADDRESS 0x400028A4 /end MEASUREMENT
/begin MEASUREMENT fuel_pump_i_term_max "Upper integral limit (10000 - commanded - P)." SWORD NO_COMPU_METHOD 0 0 -32768 32767 ECU_ADDRESS 0x400028A6 /end MEASUREMENT
/begin MEASUREMENT fuel_pump_i_term_min "Lower integral limit (1000 - (P + commanded))." SWORD NO_COMPU_METHOD 0 0 -32768 32767 ECU_ADDRESS 0x400028A8 /end MEASUREMENT
/begin MEASUREMENT fuel_pump_state_prev "fuel_pump_state at the previous update." UBYTE NO_COMPU_METHOD 0 0 0 255 ECU_ADDRESS 0x400028AA /end MEASUREMENT
/begin MEASUREMENT obd_ii_p0712_fail_ticks "P0712 (trans fluid temp low) failing samples. Was obd_ii_P0713_failure_count." UWORD NO_COMPU_METHOD 0 0 0 65535 ECU_ADDRESS 0x400028B0 /end MEASUREMENT
/begin MEASUREMENT obd_ii_p0712_health "Debounce health for P0712: reset to its CAL debounce count, decremented on failing samples; DTC fails at 0." UBYTE NO_COMPU_METHOD 0 0 0 255 ECU_ADDRESS 0x400028B2 /end MEASUREMENT
/begin MEASUREMENT obd_ii_p0713_fail_ticks "P0713 (trans fluid temp high) failing samples." UWORD NO_COMPU_METHOD 0 0 0 65535 ECU_ADDRESS 0x400028B4 /end MEASUREMENT
/begin MEASUREMENT obd_ii_p0713_health "Debounce health for P0713: reset to its CAL debounce count, decremented on failing samples; DTC fails at 0." UBYTE NO_COMPU_METHOD 0 0 0 255 ECU_ADDRESS 0x400028B6 /end MEASUREMENT
/begin MEASUREMENT obd_ii_p0897_fail_ticks "P0897 (trans fluid deteriorated) failing samples (vs CAL_obd_ii_P0897_debounce)." UWORD NO_COMPU_METHOD 0 0 0 65535 ECU_ADDRESS 0x400028B8 /end MEASUREMENT
/begin MEASUREMENT obd_ii_p0897_health "Debounce health for P0897: reset to its CAL debounce count, decremented on failing samples; DTC fails at 0." UBYTE NO_COMPU_METHOD 0 0 0 255 ECU_ADDRESS 0x400028BA /end MEASUREMENT
/begin MEASUREMENT trans_fluid_pump_setup "Cleared in obd_ii_setup_trans_fluid_pump." ULONG NO_COMPU_METHOD 0 0 0 4294967295 ECU_ADDRESS 0x400028BC /end MEASUREMENT
/begin MEASUREMENT obd_ii_p2797_health "Debounce health for P2797: reset to its CAL debounce count, decremented on failing samples; DTC fails at 0." UBYTE NO_COMPU_METHOD 0 0 0 255 ECU_ADDRESS 0x400028BE /end MEASUREMENT
/begin MEASUREMENT trans_fluid_pump_mode "Trans fluid pump mode (0, 1)." UBYTE NO_COMPU_METHOD 0 0 0 255 ECU_ADDRESS 0x400028BF /end MEASUREMENT
/begin MEASUREMENT trans_fluid_last "Transmission fluid last (°C = val*5/8−40)." UBYTE CM_u8_temp_5_8_40c 0 0 -40 119.375 ECU_ADDRESS 0x400028C0 /end MEASUREMENT
/begin MEASUREMENT trans_pump_condition_flags "Trans pump condition bits (bit0 enabled)." UBYTE NO_COMPU_METHOD 0 0 0 255 ECU_ADDRESS 0x400028C1 /end MEASUREMENT
/begin MEASUREMENT dpm_slip "Driver performance mode slip (% = val/8)." UWORD CM_u16_slip_1_8pct 0 0 0 8191.875 ECU_ADDRESS 0x400028C8 /end MEASUREMENT
/begin MEASUREMENT dpm_slip_target "Driver performance mode slip target (% = val/8)." UWORD CM_u16_slip_1_8pct 0 0 0 8191.875 ECU_ADDRESS 0x400028CA /end MEASUREMENT
/begin MEASUREMENT tc_slip_target_mode_state "TC slip target mode state." UBYTE NO_COMPU_METHOD 0 0 0 255 ECU_ADDRESS 0x400028CC /end MEASUREMENT
/begin MEASUREMENT dpm_slip_target_base "Driver performance mode clip target base (% = val/8)." UBYTE CM_u16_slip_1_8pct 0 0 0 31.875 ECU_ADDRESS 0x400028CD /end MEASUREMENT
/begin MEASUREMENT dpm_max_lr_speed_diff "Driver performance mode maximum lr speed diff (km/h = val/100)." UWORD CM_u8_speed_1_100kph 0 0 0 655.35 ECU_ADDRESS 0x400028CE /end MEASUREMENT
/begin MEASUREMENT dpm_slip_error_filtered "Driver performance mode slip error filtered (% = val/8)." UWORD CM_u16_slip_1_8pct 0 0 0 8191.875 ECU_ADDRESS 0x400028D0 /end MEASUREMENT
/begin MEASUREMENT dpm_min_activation_speed "Driver performance mode minimum activation speed (km/h)." UBYTE CM_u8_speed_kph 0 0 0 255 ECU_ADDRESS 0x400028D2 /end MEASUREMENT
/begin MEASUREMENT dpm_vehicle_speed_kph "Driver performance mode vehicle speed kph (km/h)." UBYTE CM_u8_speed_kph 0 0 0 255 ECU_ADDRESS 0x400028D3 /end MEASUREMENT
/begin MEASUREMENT dpm_cornering_detect_timer "Driver performance mode direct mode on delay (ms = val*5)." UWORD CM_u8_time_5ms 0 0 0 327675 ECU_ADDRESS 0x400028D4 /end MEASUREMENT
/begin MEASUREMENT dpm_cornering_release_timer "Driver performance mode direct mode off delay (ms = val*5)." UWORD CM_u8_time_5ms 0 0 0 327675 ECU_ADDRESS 0x400028D6 /end MEASUREMENT
/begin MEASUREMENT dpm_slip_error_raw "Driver performance mode slip error (% = val/8)." UWORD CM_u16_slip_1_8pct 0 0 0 8191.875 ECU_ADDRESS 0x400028D8 /end MEASUREMENT
/begin MEASUREMENT tc_inhibit_flags "TC inhibit bits (bit4-6 from wheel-speed messages)." UBYTE NO_COMPU_METHOD 0 0 0 255 ECU_ADDRESS 0x400028DA /end MEASUREMENT
/begin MEASUREMENT dpm_front_axle_speed_max "Driver performance mode front axle speed maximum (km/h = val/100)." UWORD CM_u8_speed_1_100kph 0 0 0 655.35 ECU_ADDRESS 0x400028DC /end MEASUREMENT
/begin MEASUREMENT dpm_rear_axle_speed_max "Driver performance mode rear axle speed maximum (km/h = val/100)." UWORD CM_u8_speed_1_100kph 0 0 0 655.35 ECU_ADDRESS 0x400028DE /end MEASUREMENT
/begin MEASUREMENT dpm_front_lr_speed_diff "Driver performance mode front lr speed diff (km/h = val/100)." UWORD CM_u8_speed_1_100kph 0 0 0 655.35 ECU_ADDRESS 0x400028E0 /end MEASUREMENT
/begin MEASUREMENT dpm_rear_lr_speed_diff "Driver performance mode rear lr speed diff (km/h = val/100)." UWORD CM_u8_speed_1_100kph 0 0 0 655.35 ECU_ADDRESS 0x400028E2 /end MEASUREMENT
/begin MEASUREMENT dpm_slip_filter_q8 "DPM slip IIR accumulator (<<8). Was dpm_slip_filter_accumulator." SLONG NO_COMPU_METHOD 0 0 -2147483648 2147483647 ECU_ADDRESS 0x400028E4 /end MEASUREMENT
/begin MEASUREMENT dpm_integral_update_timer "Driver performance mode integral update timer (ms = val*5)." UWORD CM_u8_time_5ms 0 0 0 327675 ECU_ADDRESS 0x400028E8 /end MEASUREMENT
/begin MEASUREMENT dpm_torque_cut_fraction "Driver performance mode torque cut total (val/255)." UBYTE CM_u8_factor_1_255 0 0 0 100 ECU_ADDRESS 0x400028EA /end MEASUREMENT
/begin MEASUREMENT dpm_torque_cut_i_term "Driver performance mode torque cut accumulated (val/255)." UBYTE CM_u8_factor_1_255 0 0 0 100 ECU_ADDRESS 0x400028EB /end MEASUREMENT
/begin MEASUREMENT dpm_slip_integral_accumulator "DPM slip integral (+-CAL_dpm_torque_cut_i_limit*128)." SWORD NO_COMPU_METHOD 0 0 -32768 32767 ECU_ADDRESS 0x400028EC /end MEASUREMENT
/begin MEASUREMENT dpm_torque_cut_p_term "u8_factor_1/255" UBYTE CM_u8_factor_1_255 0 0 0 100 ECU_ADDRESS 0x400028EE /end MEASUREMENT
/begin MEASUREMENT dpm_slip_target_from_pedal "Driver performance mode slip target base (% = val/8)." UWORD CM_u16_slip_1_8pct 0 0 0 8191.875 ECU_ADDRESS 0x400028F0 /end MEASUREMENT
/begin MEASUREMENT dpm_both_buttons_pressed "Driver performance mode both buttons pressed (boolean flag)." UBYTE NO_COMPU_METHOD 0 0 0 255 ECU_ADDRESS 0x400028F2 /end MEASUREMENT
/begin MEASUREMENT dpm_decrease_hold_time "Driver performance mode decrease hold time." UBYTE NO_COMPU_METHOD 0 0 0 255 ECU_ADDRESS 0x400028F3 /end MEASUREMENT
/begin MEASUREMENT dpm_increase_hold_time "Driver performance mode increase hold time." UBYTE NO_COMPU_METHOD 0 0 0 255 ECU_ADDRESS 0x400028F4 /end MEASUREMENT
/begin MEASUREMENT flash_ssd_flash_init "C90FL SSD FlashInit(pSSDConfig). Was flash_driver_init." ULONG NO_COMPU_METHOD 0 0 0 4294967295 ECU_ADDRESS 0x40002910 /end MEASUREMENT
/begin MEASUREMENT flash_ssd_flash_erase "C90FL SSD FlashErase(pSSDConfig, shadowFlag, lowEnabledBlocks, midEnabledBlocks, highEnabledBlocks, CallBack)." ULONG NO_COMPU_METHOD 0 0 0 4294967295 ECU_ADDRESS 0x40002914 /end MEASUREMENT
/begin MEASUREMENT flash_ssd_blank_check "C90FL SSD BlankCheck(pSSDConfig, dest, size, &failAddress, &failData, CallBack)." ULONG NO_COMPU_METHOD 0 0 0 4294967295 ECU_ADDRESS 0x40002918 /end MEASUREMENT
/begin MEASUREMENT flash_ssd_flash_program "C90FL SSD FlashProgram(pSSDConfig, dest, size, source, CallBack). Points at flash_program_driver_c90fl." ULONG NO_COMPU_METHOD 0 0 0 4294967295 ECU_ADDRESS 0x4000291C /end MEASUREMENT
/begin MEASUREMENT flash_ssd_program_verify "C90FL SSD ProgramVerify(pSSDConfig, dest, size, source, &failAddress, &failData, &failSource, CallBack)." ULONG NO_COMPU_METHOD 0 0 0 4294967295 ECU_ADDRESS 0x40002920 /end MEASUREMENT
/begin MEASUREMENT flash_ssd_get_lock "C90FL SSD GetLock(pSSDConfig, blkLockIndicator, &blkLockEnabled, &blkLockState)." ULONG NO_COMPU_METHOD 0 0 0 4294967295 ECU_ADDRESS 0x40002924 /end MEASUREMENT
/begin MEASUREMENT flash_ssd_set_lock "C90FL SSD SetLock(pSSDConfig, blkLockIndicator, blkLockState, password)." ULONG NO_COMPU_METHOD 0 0 0 4294967295 ECU_ADDRESS 0x40002928 /end MEASUREMENT
/begin MEASUREMENT eqadc_cal_extreme_4 "eQADC calibration result 4 running extreme (from CFIFO result register)." ULONG NO_COMPU_METHOD 0 0 0 4294967295 ECU_ADDRESS 0x40002948 /end MEASUREMENT
/begin MEASUREMENT eqadc_cal_read_4 "eQADC calibration result 4 latest read." ULONG NO_COMPU_METHOD 0 0 0 4294967295 ECU_ADDRESS 0x4000294C /end MEASUREMENT
/begin MEASUREMENT eqadc_cal_extreme_2 "eQADC calibration result 2 running extreme (from CFIFO result register)." ULONG NO_COMPU_METHOD 0 0 0 4294967295 ECU_ADDRESS 0x4000295C /end MEASUREMENT
/begin MEASUREMENT eqadc_cal_read_2 "eQADC calibration result 2 latest read." ULONG NO_COMPU_METHOD 0 0 0 4294967295 ECU_ADDRESS 0x40002960 /end MEASUREMENT
/begin MEASUREMENT eqadc_cal_extreme_3 "eQADC calibration result 3 running extreme (from CFIFO result register)." ULONG NO_COMPU_METHOD 0 0 0 4294967295 ECU_ADDRESS 0x40002970 /end MEASUREMENT
/begin MEASUREMENT eqadc_cal_read_3 "eQADC calibration result 3 latest read." ULONG NO_COMPU_METHOD 0 0 0 4294967295 ECU_ADDRESS 0x40002974 /end MEASUREMENT
/begin MEASUREMENT eqadc_cal_extreme_1 "eQADC calibration result 1 running extreme (from CFIFO result register)." ULONG NO_COMPU_METHOD 0 0 0 4294967295 ECU_ADDRESS 0x40002984 /end MEASUREMENT
/begin MEASUREMENT eqadc_cal_read_1 "eQADC calibration result 1 latest read." ULONG NO_COMPU_METHOD 0 0 0 4294967295 ECU_ADDRESS 0x40002988 /end MEASUREMENT
/begin MEASUREMENT eqadc_cal_extreme_0 "eQADC calibration result 0 running extreme (from CFIFO result register)." ULONG NO_COMPU_METHOD 0 0 0 4294967295 ECU_ADDRESS 0x40002998 /end MEASUREMENT
/begin MEASUREMENT eqadc_cal_read_0 "eQADC calibration result 0 latest read." ULONG NO_COMPU_METHOD 0 0 0 4294967295 ECU_ADDRESS 0x4000299C /end MEASUREMENT
/begin MEASUREMENT engine_speed_100ms_prev "engine_speed_16bit 100 ms ago (engine_speed_delta100ms)." UWORD CM_u8_rspeed_rpm 0 0 0 65535 ECU_ADDRESS 0x40002E78 /end MEASUREMENT
/begin MEASUREMENT isr_period_ticks "ISR entry-to-entry period (0.1 us; nominal 5000 = 500 us). Was etpu_elapsed_ticks." ULONG CM_u32_time_100ns 0 0 0 429496729500 ECU_ADDRESS 0x40002EEC /end MEASUREMENT
/begin MEASUREMENT timer_main_start1 "undefined4" ULONG NO_COMPU_METHOD 0 0 0 4294967295 ECU_ADDRESS 0x40002EF0 /end MEASUREMENT
/begin MEASUREMENT timer_main3 "TCR1 timestamp at the end of the main loop." ULONG CM_u32_time_100ns 0 0 0 429496729500 ECU_ADDRESS 0x40002EF4 /end MEASUREMENT
/begin MEASUREMENT timing_main_loop_last "Last main-loop duration." ULONG CM_u32_time_100ns 0 0 0 429496729500 ECU_ADDRESS 0x40002EF8 /end MEASUREMENT
/begin MEASUREMENT timing_main_loop_max "Max main-loop duration." ULONG CM_u32_time_100ns 0 0 0 429496729500 ECU_ADDRESS 0x40002EFC /end MEASUREMENT
/begin MEASUREMENT timer_main_start1_40002F00 "TCR1 timestamp at the start of the main loop." ULONG CM_u32_time_100ns 0 0 0 429496729500 ECU_ADDRESS 0x40002F00 /end MEASUREMENT
/begin MEASUREMENT timer_main_start2_40002F04 "TCR1 timestamp after the CAN diagnostics step." ULONG CM_u32_time_100ns 0 0 0 429496729500 ECU_ADDRESS 0x40002F04 /end MEASUREMENT
/begin MEASUREMENT timing_flexcan_diag_last "Last CAN diagnostics duration." ULONG CM_u32_time_100ns 0 0 0 429496729500 ECU_ADDRESS 0x40002F08 /end MEASUREMENT
/begin MEASUREMENT timing_flexcan_diag_max "Max CAN diagnostics duration." ULONG CM_u32_time_100ns 0 0 0 429496729500 ECU_ADDRESS 0x40002F0C /end MEASUREMENT
/begin MEASUREMENT etpu_elapsed_max_ticks "u32_time_100ns" ULONG CM_u32_time_100ns 0 0 0 429496729500 ECU_ADDRESS 0x40002F3C /end MEASUREMENT
/begin MEASUREMENT etpu_timestamp_load_filter_end "u32_time_100ns" ULONG CM_u32_time_100ns 0 0 0 429496729500 ECU_ADDRESS 0x40002F44 /end MEASUREMENT
/begin MEASUREMENT etpu_timestamp_current "u32_time_100ns" ULONG CM_u32_time_100ns 0 0 0 429496729500 ECU_ADDRESS 0x40002F6C /end MEASUREMENT
/begin MEASUREMENT etpu_timestamp_1000hz_task "u32_time_100ns" ULONG CM_u32_time_100ns 0 0 0 429496729500 ECU_ADDRESS 0x40002F74 /end MEASUREMENT
/begin MEASUREMENT etpu_timestamp_200hz_task "u32_time_100ns" ULONG CM_u32_time_100ns 0 0 0 429496729500 ECU_ADDRESS 0x40002F78 /end MEASUREMENT
/begin MEASUREMENT etpu_timestamp_last "u32_time_100ns" ULONG CM_u32_time_100ns 0 0 0 429496729500 ECU_ADDRESS 0x40002F9C /end MEASUREMENT
/begin MEASUREMENT tps_error_flags "ETB driver error bits from the DSPI diagnostic read." UBYTE NO_COMPU_METHOD 0 0 0 255 ECU_ADDRESS 0x40003021 /end MEASUREMENT
/begin MEASUREMENT injector_driver_status_lo "Injector driver SPI diagnostic status byte (low)." UBYTE NO_COMPU_METHOD 0 0 0 255 ECU_ADDRESS 0x40003022 /end MEASUREMENT
/begin MEASUREMENT output_driver_status_lo "Output driver SPI diagnostic status byte (low)." UBYTE NO_COMPU_METHOD 0 0 0 255 ECU_ADDRESS 0x40003023 /end MEASUREMENT
/begin MEASUREMENT output_driver_status_hi "Output driver SPI diagnostic status byte (high)." UBYTE NO_COMPU_METHOD 0 0 0 255 ECU_ADDRESS 0x40003024 /end MEASUREMENT
/begin MEASUREMENT injector_driver_status_hi "Injector driver SPI diagnostic status byte (high)." UBYTE NO_COMPU_METHOD 0 0 0 255 ECU_ADDRESS 0x40003025 /end MEASUREMENT
/begin MEASUREMENT cac_driver_status_spi "Charge-cooler pump driver SPI status byte." UBYTE NO_COMPU_METHOD 0 0 0 255 ECU_ADDRESS 0x40003026 /end MEASUREMENT
/begin MEASUREMENT relay_driver_status_hi "Relay driver SPI diagnostic status byte (high)." UBYTE NO_COMPU_METHOD 0 0 0 255 ECU_ADDRESS 0x40003027 /end MEASUREMENT
/begin MEASUREMENT relay_driver_status_lo "Relay driver SPI diagnostic status byte (low)." UBYTE NO_COMPU_METHOD 0 0 0 255 ECU_ADDRESS 0x40003028 /end MEASUREMENT
/begin MEASUREMENT sport_button_toggle_state "uint8_t" UBYTE NO_COMPU_METHOD 0 0 0 255 ECU_ADDRESS 0x40003043 /end MEASUREMENT
/begin MEASUREMENT brake_pedal_switch_state_always_zero_ "Brake pedal switch state always zero? (boolean flag)." UBYTE NO_COMPU_METHOD 0 0 0 255 ECU_ADDRESS 0x40003044 /end MEASUREMENT
/begin MEASUREMENT tc_button_toggle_state "uint8_t" UBYTE NO_COMPU_METHOD 0 0 0 255 ECU_ADDRESS 0x40003046 /end MEASUREMENT
/begin MEASUREMENT trans_cooling_pump_enabled "Transmission cooling pump enabled (boolean flag)." UBYTE NO_COMPU_METHOD 0 0 0 255 ECU_ADDRESS 0x4000304A /end MEASUREMENT
/begin MEASUREMENT dpm_button_increase "Driver performance mode button increase (boolean flag)." UBYTE NO_COMPU_METHOD 0 0 0 255 ECU_ADDRESS 0x4000304B /end MEASUREMENT
/begin MEASUREMENT exahust_override_switch_status "uint8_t" UBYTE NO_COMPU_METHOD 0 0 0 255 ECU_ADDRESS 0x4000304C /end MEASUREMENT
/begin MEASUREMENT dpm_button_decrease "Driver performance mode button decrease (boolean flag)." UBYTE NO_COMPU_METHOD 0 0 0 255 ECU_ADDRESS 0x4000304D /end MEASUREMENT
/begin MEASUREMENT ign_torque_margin_cyl1 "i16_angle_1/4deg" SWORD CM_u8_angle_1_4deg 0 0 -8192 8191.75 ECU_ADDRESS 0x4000305E /end MEASUREMENT
/begin MEASUREMENT ign_torque_margin_cyl2 "i16_angle_1/4deg" SWORD CM_u8_angle_1_4deg 0 0 -8192 8191.75 ECU_ADDRESS 0x40003060 /end MEASUREMENT
/begin MEASUREMENT ign_torque_margin_cyl3 "i16_angle_1/4deg" SWORD CM_u8_angle_1_4deg 0 0 -8192 8191.75 ECU_ADDRESS 0x40003062 /end MEASUREMENT
/begin MEASUREMENT ign_torque_margin_cyl4 "i16_angle_1/4deg" SWORD CM_u8_angle_1_4deg 0 0 -8192 8191.75 ECU_ADDRESS 0x40003064 /end MEASUREMENT
/begin MEASUREMENT ign_torque_margin_cyl5 "i16_angle_1/4deg" SWORD CM_u8_angle_1_4deg 0 0 -8192 8191.75 ECU_ADDRESS 0x40003066 /end MEASUREMENT
/begin MEASUREMENT LEA_inj_fuel_learn_zone_2_bank1 "Fuel learn zone 2 trim, bank 1. (0091)" UBYTE CM_u8_percent_100_256_50 0 0 -50 49.609375 ECU_ADDRESS 0x40003478 /end MEASUREMENT
/begin MEASUREMENT LEA_inj_fuel_learn_zone_3_bank1 "Fuel learn zone 3 trim, bank 1. Was obd_ii_fuel_learn_zone_3_bank1. (0091)" UBYTE CM_u8_percent_100_256_50 0 0 -50 49.609375 ECU_ADDRESS 0x40003479 /end MEASUREMENT
/begin MEASUREMENT LEA_inj_fuel_learn_zone_2_bank2 "Fuel learn zone 2 trim, bank 2. (0091)" UBYTE CM_u8_percent_100_256_50 0 0 -50 49.609375 ECU_ADDRESS 0x4000347A /end MEASUREMENT
/begin MEASUREMENT LEA_inj_fuel_learn_zone_3_bank2 "Fuel learn zone 3 trim, bank 2. Was obd_ii_fuel_learn_zone_3_bank2. (0091)" UBYTE CM_u8_percent_100_256_50 0 0 -50 49.609375 ECU_ADDRESS 0x4000347B /end MEASUREMENT
/begin MEASUREMENT LEA_inj_offset_learn_off_idle_bank1 "Learned off-idle injector pulse offset (us), bank 1. Was LEA_fuel_learn_lean_time_bank1. (0091)" SWORD CM_u8_time_us 0 0 -32768 32767 ECU_ADDRESS 0x40003488 /end MEASUREMENT
/begin MEASUREMENT LEA_inj_offset_learn_off_idle_bank2 "Learned off-idle injector pulse offset (us), bank 2. Was LEA_fuel_learn_lean_time_bank2. (0091)" SWORD CM_u8_time_us 0 0 -32768 32767 ECU_ADDRESS 0x4000348A /end MEASUREMENT
/begin MEASUREMENT LEA_obd_ii_idle_learn "Learned idle air, warm, A/C off (mg/s = val*100/1024; >>10 = 100 mg/s units)." SWORD CM_i16_flow_100_1024mg_s 0 0 -3200 3199.90234375 ECU_ADDRESS 0x4000378C /end MEASUREMENT
/begin MEASUREMENT LEA_idle_learn_ac_on "Learned idle air, warm, A/C on (mg/s = val*100/1024)." SWORD CM_i16_flow_100_1024mg_s 0 0 -3200 3199.90234375 ECU_ADDRESS 0x4000378E /end MEASUREMENT
/begin MEASUREMENT LEA_pad_40003829 "Padding after LEA_fuel_learn_zone_cyl1[153] (154-byte stride)." UBYTE NO_COMPU_METHOD 0 0 0 255 ECU_ADDRESS 0x40003829 /end MEASUREMENT
/begin MEASUREMENT LEA_pad_400038c3 "Padding after LEA_fuel_learn_zone_cyl2[153]." UBYTE NO_COMPU_METHOD 0 0 0 255 ECU_ADDRESS 0x400038C3 /end MEASUREMENT
/begin MEASUREMENT LEA_pad_4000395d "Padding after LEA_fuel_learn_zone_cyl3[153]." UBYTE NO_COMPU_METHOD 0 0 0 255 ECU_ADDRESS 0x4000395D /end MEASUREMENT
/begin MEASUREMENT LEA_pad_400039f7 "Padding after LEA_fuel_learn_zone_cyl4[153]." UBYTE NO_COMPU_METHOD 0 0 0 255 ECU_ADDRESS 0x400039F7 /end MEASUREMENT
/begin MEASUREMENT LEA_pad_40003a91 "Padding after LEA_fuel_learn_zone_cyl5[153]." UBYTE NO_COMPU_METHOD 0 0 0 255 ECU_ADDRESS 0x40003A91 /end MEASUREMENT
/begin MEASUREMENT LEA_pad_40003b2b "Padding after LEA_fuel_learn_zone_cyl6[153]." UBYTE NO_COMPU_METHOD 0 0 0 255 ECU_ADDRESS 0x40003B2B /end MEASUREMENT
/begin MEASUREMENT LEA_inj_offset_learn_idle_bank1 "Learned injector pulse offset (us) added to bank 1 PW. Was LEA_fuel_learn_lean_time_bank1. (0091)" SWORD CM_u8_time_us 0 0 -32768 32767 ECU_ADDRESS 0x40003B98 /end MEASUREMENT
/begin MEASUREMENT LEA_inj_offset_learn_idle_bank2 "Learned injector pulse offset (us) added to bank 2 PW. Was LEA_fuel_learn_lean_time_bank2. (0091)" SWORD CM_u8_time_us 0 0 -32768 32767 ECU_ADDRESS 0x40003B9A /end MEASUREMENT
/begin MEASUREMENT LEA_idle_cold_learning_coolant "Learned idle air, cold, A/C off (mg/s = val*100/1024)." SWORD CM_i16_flow_100_1024mg_s 0 0 -3200 3199.90234375 ECU_ADDRESS 0x40003B9C /end MEASUREMENT
/begin MEASUREMENT LEA_idle_cold_learning_coolant_ac_on "Learned idle air, cold, A/C on (mg/s = val*100/1024)." SWORD CM_i16_flow_100_1024mg_s 0 0 -3200 3199.90234375 ECU_ADDRESS 0x40003B9E /end MEASUREMENT
/begin MEASUREMENT engine_run_timer_total "Engine run timer total (ms = val*100)." ULONG CM_u8_time_100ms 0 0 0 429496729500 ECU_ADDRESS 0x40003F10 /end MEASUREMENT
/begin MEASUREMENT LEA_perf_best_0_100kmh_time "Best 0-100 km/h time (min kept; reset 0xFF). Was LEA_perf_stat_sentinel_max1. (0091)" UBYTE CM_u8_time_100ms 0 0 0 25500 ECU_ADDRESS 0x40003F14 /end MEASUREMENT
/begin MEASUREMENT LEA_perf_best_0_160kmh_time "Best 0-160 km/h time. Was LEA_perf_stat_sentinel_max2. (0091)" UBYTE CM_u8_time_100ms 0 0 0 25500 ECU_ADDRESS 0x40003F15 /end MEASUREMENT
/begin MEASUREMENT LEA_perf_last_0_100kmh_time "Last 0-100 km/h time (Mode 22). Was LEA_obd_ii_last_standing_start_0_100kmh. (0091)" UBYTE CM_u8_time_100ms 0 0 0 25500 ECU_ADDRESS 0x40003F16 /end MEASUREMENT
/begin MEASUREMENT LEA_perf_last_0_160kmh_time "Last 0-160 km/h time (Mode 22). Was LEA_obd_ii_last_standing_start_0_160kmh. (0091)" UBYTE CM_u8_time_100ms 0 0 0 25500 ECU_ADDRESS 0x40003F17 /end MEASUREMENT
/begin MEASUREMENT LEA_number_standing_starts "Number of standing starts." UWORD NO_COMPU_METHOD 0 0 0 65535 ECU_ADDRESS 0x40003F18 /end MEASUREMENT
/begin MEASUREMENT LEA_tps_fault_ff_engine_runtime "TPS fault freeze data: engine runtime. (0091)" ULONG CM_u8_time_5ms 0 0 0 21474836475 ECU_ADDRESS 0x40003F4C /end MEASUREMENT
/begin MEASUREMENT LEA_tps_fault_ff_siu_rsr "TPS fault freeze data: SIU reset status register. Was LEA_perf_stat_extra2. (0091)" ULONG NO_COMPU_METHOD 0 0 0 4294967295 ECU_ADDRESS 0x40003F50 /end MEASUREMENT
/begin MEASUREMENT LEA_tps_fault_ff_ecu_runtime "TPS fault freeze data: ECU runtime (ecu_run_timer, u16_time_100ms)." UWORD CM_u8_time_100ms 0 0 0 6553500 ECU_ADDRESS 0x40004054 /end MEASUREMENT
/begin MEASUREMENT LEA_tps_fault_ff_ecu_voltage "TPS fault freeze data: ECU voltage. (0091)" UWORD CM_u16_voltage_18_1023v 0 0 0 1153.10850439883 ECU_ADDRESS 0x40004056 /end MEASUREMENT
/begin MEASUREMENT LEA_tps_fault_ff_adc_ch3 "TPS fault freeze data: ADC buffer ch3 sample. (0091)" UWORD NO_COMPU_METHOD 0 0 0 65535 ECU_ADDRESS 0x40004058 /end MEASUREMENT
/begin MEASUREMENT LEA_tps_calib_retry_count "TPS calibration retry count (saturating)." UWORD NO_COMPU_METHOD 0 0 0 65535 ECU_ADDRESS 0x4000405A /end MEASUREMENT
/begin MEASUREMENT LEA_tps_fault_event_count "TPS fault event count (saturating)." UWORD NO_COMPU_METHOD 0 0 0 65535 ECU_ADDRESS 0x4000405C /end MEASUREMENT
/begin MEASUREMENT LEA_tps_fault_recovery_count "TPS fault recovery count (saturating)." UWORD NO_COMPU_METHOD 0 0 0 65535 ECU_ADDRESS 0x4000405E /end MEASUREMENT
/begin MEASUREMENT LEA_tps_fault_count "TPS fault count (saturating)." UWORD NO_COMPU_METHOD 0 0 0 65535 ECU_ADDRESS 0x40004060 /end MEASUREMENT
/begin MEASUREMENT LEA_tps_calib_pass_first_attempt "TPS calibration passed first attempt (saturating)." UWORD NO_COMPU_METHOD 0 0 0 65535 ECU_ADDRESS 0x40004062 /end MEASUREMENT
/begin MEASUREMENT LEA_tps_calib_pass_after_retry "TPS calibration passed after retry (saturating)." UWORD NO_COMPU_METHOD 0 0 0 65535 ECU_ADDRESS 0x40004064 /end MEASUREMENT
/begin MEASUREMENT LEA_tps_fault_ff_etb_duty_pct "ETB duty % (etb_pwm_duty_percent = on*100/CAL_etb_pwm_period)." UBYTE CM_u8_factor_1_100 0 0 0 255 ECU_ADDRESS 0x40004066 /end MEASUREMENT
/begin MEASUREMENT LEA_tps_fault_log_count "TPS fault log index (<32) into the fault trace arrays. Was LEA_learned_flags_0E4F. (0091)" UBYTE NO_COMPU_METHOD 0 0 0 255 ECU_ADDRESS 0x40004067 /end MEASUREMENT
/begin MEASUREMENT LEA_low_oil_pressure_event_count "Low oil pressure event count. Was total_num_low_oil_pres_events. (0091)" UBYTE NO_COMPU_METHOD 0 0 0 255 ECU_ADDRESS 0x40004068 /end MEASUREMENT
/begin MEASUREMENT LEA_low_oil_pressure_event1_duration "(0091) was LEA_perf_struct_A_byte0" UBYTE CM_u8_time_100ms 0 0 0 25500 ECU_ADDRESS 0x40004084 /end MEASUREMENT
/begin MEASUREMENT LEA_low_oil_pressure_event1_car_speed "(0091) was LEA_perf_struct_A_byte1" UBYTE CM_u8_speed_kph 0 0 0 255 ECU_ADDRESS 0x40004085 /end MEASUREMENT
/begin MEASUREMENT LEA_low_oil_pressure_event1_rpm "(0091) was LEA_perf_struct_A_word0" UWORD CM_u8_rspeed_rpm 0 0 0 65535 ECU_ADDRESS 0x40004086 /end MEASUREMENT
/begin MEASUREMENT LEA_low_oil_pressure_event1_lat_accel_peak "Low-oil-pressure event 1: peak lateral accel (g = val/100)." SWORD CM_u8_accel_1_100g 0 0 -327.68 327.67 ECU_ADDRESS 0x40004088 /end MEASUREMENT
/begin MEASUREMENT LEA_low_oil_pressure_event1_runtime "(0091) was LEA_perf_struct_A_dword" ULONG CM_u8_time_100ms 0 0 0 429496729500 ECU_ADDRESS 0x4000408C /end MEASUREMENT
/begin MEASUREMENT LEA_low_oil_pressure_event2_duration "(0091) was LEA_perf_struct_B_byte0 (mis-sized)" UBYTE CM_u8_time_100ms 0 0 0 25500 ECU_ADDRESS 0x40004090 /end MEASUREMENT
/begin MEASUREMENT LEA_low_oil_pressure_event2_car_speed "(0091)" UBYTE CM_u8_speed_kph 0 0 0 255 ECU_ADDRESS 0x40004091 /end MEASUREMENT
/begin MEASUREMENT LEA_low_oil_pressure_event2_rpm "(0091)" UWORD CM_u8_rspeed_rpm 0 0 0 65535 ECU_ADDRESS 0x40004092 /end MEASUREMENT
/begin MEASUREMENT LEA_low_oil_pressure_event2_lat_accel_peak "Low-oil-pressure event 2: peak lateral accel (g = val/100)." SWORD CM_u8_accel_1_100g 0 0 -327.68 327.67 ECU_ADDRESS 0x40004094 /end MEASUREMENT
/begin MEASUREMENT LEA_low_oil_pressure_event2_runtime "(0091) was LEA_perf_struct_B_dword" ULONG CM_u8_time_100ms 0 0 0 429496729500 ECU_ADDRESS 0x40004098 /end MEASUREMENT
/begin MEASUREMENT LEA_low_oil_pressure_event3_duration "(0091)" UBYTE CM_u8_time_100ms 0 0 0 25500 ECU_ADDRESS 0x4000409C /end MEASUREMENT
/begin MEASUREMENT LEA_low_oil_pressure_event3_car_speed "(0091)" UBYTE CM_u8_speed_kph 0 0 0 255 ECU_ADDRESS 0x4000409D /end MEASUREMENT
/begin MEASUREMENT LEA_low_oil_pressure_event3_rpm "(0091)" UWORD CM_u8_rspeed_rpm 0 0 0 65535 ECU_ADDRESS 0x4000409E /end MEASUREMENT
/begin MEASUREMENT LEA_low_oil_pressure_event3_lat_accel_peak "Low-oil-pressure event 3: peak lateral accel (g = val/100)." SWORD CM_u8_accel_1_100g 0 0 -327.68 327.67 ECU_ADDRESS 0x400040A0 /end MEASUREMENT
/begin MEASUREMENT LEA_low_oil_pressure_event3_runtime "(0091)" ULONG CM_u8_time_100ms 0 0 0 429496729500 ECU_ADDRESS 0x400040A4 /end MEASUREMENT
/begin MEASUREMENT LEA_high_lat_accel_event1_duration "(0091) was LEA_perf_struct_A_b_byte0" UBYTE CM_u8_time_100ms 0 0 0 25500 ECU_ADDRESS 0x400040A8 /end MEASUREMENT
/begin MEASUREMENT LEA_high_lat_accel_event1_car_speed "(0091) was LEA_perf_struct_A_b_byte1" UBYTE CM_u8_speed_kph 0 0 0 255 ECU_ADDRESS 0x400040A9 /end MEASUREMENT
/begin MEASUREMENT LEA_high_lat_accel_event1_rpm "(0091) was LEA_perf_struct_A_b_word0" UWORD CM_u8_rspeed_rpm 0 0 0 65535 ECU_ADDRESS 0x400040AA /end MEASUREMENT
/begin MEASUREMENT LEA_high_lat_accel_event1_lat_accel_peak "High-lateral-g event 1: peak lateral accel (g = val/100)." SWORD CM_u8_accel_1_100g 0 0 -327.68 327.67 ECU_ADDRESS 0x400040AC /end MEASUREMENT
/begin MEASUREMENT LEA_high_lat_accel_event1_runtime "(0091) was LEA_perf_struct_A_b_dword" ULONG CM_u8_time_100ms 0 0 0 429496729500 ECU_ADDRESS 0x400040B0 /end MEASUREMENT
/begin MEASUREMENT LEA_high_lat_accel_event2_duration "(0091) was LEA_perf_struct_B_b_byte0 (mis-sized)" UBYTE CM_u8_time_100ms 0 0 0 25500 ECU_ADDRESS 0x400040B4 /end MEASUREMENT
/begin MEASUREMENT LEA_high_lat_accel_event2_car_speed "(0091)" UBYTE CM_u8_speed_kph 0 0 0 255 ECU_ADDRESS 0x400040B5 /end MEASUREMENT
/begin MEASUREMENT LEA_high_lat_accel_event2_rpm "(0091)" UWORD CM_u8_rspeed_rpm 0 0 0 65535 ECU_ADDRESS 0x400040B6 /end MEASUREMENT
/begin MEASUREMENT LEA_high_lat_accel_event2_lat_accel_peak "High-lateral-g event 2: peak lateral accel (g = val/100)." SWORD CM_u8_accel_1_100g 0 0 -327.68 327.67 ECU_ADDRESS 0x400040B8 /end MEASUREMENT
/begin MEASUREMENT LEA_high_lat_accel_event2_runtime "(0091) was LEA_perf_struct_B_b_dword" ULONG CM_u8_time_100ms 0 0 0 429496729500 ECU_ADDRESS 0x400040BC /end MEASUREMENT
/begin MEASUREMENT LEA_high_lat_accel_event3_duration "(0091)" UBYTE CM_u8_time_100ms 0 0 0 25500 ECU_ADDRESS 0x400040C0 /end MEASUREMENT
/begin MEASUREMENT LEA_high_lat_accel_event3_car_speed "(0091)" UBYTE CM_u8_speed_kph 0 0 0 255 ECU_ADDRESS 0x400040C1 /end MEASUREMENT
/begin MEASUREMENT LEA_high_lat_accel_event3_rpm "(0091)" UWORD CM_u8_rspeed_rpm 0 0 0 65535 ECU_ADDRESS 0x400040C2 /end MEASUREMENT
/end MODULE
/end PROJECT
