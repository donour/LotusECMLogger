/*
* Drafted by LotusECMLogger A2lGenerator v1 from the C132E0278 symbol catalog for C132E0278.
* Every axis has NO_INPUT_QUANTITY: add an InputQuantity only after checking the lookup in the decompile
* (scope, conditions, input transforms; CCP-client-plan.md section 5).
* Maps are ROW_DIR: the first AXIS_DESCR is X, stored fastest, as the firmware reads lut[y * size_x + x].
* Generator warnings:
* torque_limit_dpm_spark: also at another address; this one (0x4000163C) is named torque_limit_dpm_spark_4000163C.
* torque_limit_dpm_throttle: also at another address; this one (0x4000163E) is named torque_limit_dpm_throttle_4000163E.
* exhaust_flap_state: also at another address; this one (0x40001B11) is named exhaust_flap_state_40001B11.
* timer_main_start1: also at another address; this one (0x40002F00) is named timer_main_start1_40002F00.
* timer_main_start2: also at another address; this one (0x40002F04) is named timer_main_start2_40002F04.
* LEA_fuel_learn_lean_time_bank1: also at another address; this one (0x40003B98) is named LEA_fuel_learn_lean_time_bank1_40003B98.
* LEA_fuel_learn_lean_time_bank2: also at another address; this one (0x40003B9A) is named LEA_fuel_learn_lean_time_bank2_40003B9A.
* LEA_unused_byte3: also at another address; this one (0x40004C37) is named LEA_unused_byte3_40004C37.
* CAL_ign_comp_coolant_engine_stopped_min: also at another address; this one (0x400086A2) is named CAL_ign_comp_coolant_engine_stopped_min_400086A2.
* CAL_tps_limit_severe_misfire_1_cut: also at another address; this one (0x40008868) is named CAL_tps_limit_severe_misfire_1_cut_40008868.
* CAL_cluster_shiftlight_rpm_offset_manual: also at another address; this one (0x40009BA2) is named CAL_cluster_shiftlight_rpm_offset_manual_40009BA2.
* CAL_cluster_shiftlight_rpm_offset_ips: also at another address; this one (0x4000C682) is named CAL_cluster_shiftlight_rpm_offset_ips_4000C682.
* CAL_sensor_o2_rich_voltage_threshold: also at another address; this one (0x4000CAD2) is named CAL_sensor_o2_rich_voltage_threshold_4000CAD2.
* CAL_sensor_o2_lean_voltage_threshold: also at another address; this one (0x4000CAD4) is named CAL_sensor_o2_lean_voltage_threshold_4000CAD4.
* CAL_idle_air_warmup_factor_manual_X_coolant_temp: named like an axis but is a scalar.
* CAL_idle_air_warmup_factor_manual_Y_maf_accumulated: named like an axis but is a scalar.
* CAL_idle_air_warmup_factor_ips_Y_maf_accum: named like an axis but is a scalar.
* CAL_idle_air_warmup_factor_ips: 1 values for a 16-point axis; written as a VALUE without axes.
*/
ASAP2_VERSION 1 61
/begin PROJECT C132E0278 "Lotus T6 C132E0278"
/begin HEADER "" VERSION "generated v1" /end HEADER
/begin MODULE C132E0278 ""
/begin MOD_COMMON "" BYTE_ORDER MSB_FIRST ALIGNMENT_BYTE 1 ALIGNMENT_WORD 2 ALIGNMENT_LONG 4 /end MOD_COMMON
/begin MOD_PAR "" EPK "C132E0278" ADDR_EPK 0x40008654
 /begin MEMORY_SEGMENT CAL "Calibration RAM" DATA RAM INTERN 0x40008654 0x69AC -1 -1 -1 -1 -1 /end MEMORY_SEGMENT
/end MOD_PAR
/begin RECORD_LAYOUT RL_VALUE_UBYTE FNC_VALUES 1 UBYTE ROW_DIR DIRECT /end RECORD_LAYOUT
/begin RECORD_LAYOUT RL_AXIS_UBYTE AXIS_PTS_X 1 UBYTE INDEX_INCR DIRECT /end RECORD_LAYOUT
/begin RECORD_LAYOUT RL_VALUE_SBYTE FNC_VALUES 1 SBYTE ROW_DIR DIRECT /end RECORD_LAYOUT
/begin RECORD_LAYOUT RL_VALUE_UWORD FNC_VALUES 1 UWORD ROW_DIR DIRECT /end RECORD_LAYOUT
/begin RECORD_LAYOUT RL_AXIS_UWORD AXIS_PTS_X 1 UWORD INDEX_INCR DIRECT /end RECORD_LAYOUT
/begin RECORD_LAYOUT RL_VALUE_SWORD FNC_VALUES 1 SWORD ROW_DIR DIRECT /end RECORD_LAYOUT
/begin RECORD_LAYOUT RL_VALUE_ULONG FNC_VALUES 1 ULONG ROW_DIR DIRECT /end RECORD_LAYOUT
/begin COMPU_METHOD CM_i16_factor_1_20 "i16_factor_1/20" RAT_FUNC "%8.0" "%" COEFFS 0 1 0 0 0 5 /end COMPU_METHOD
/begin COMPU_METHOD CM_u16_afr_1_100 "u16_afr_1/100" RAT_FUNC "%10.2" "AFR" COEFFS 0 1 0 0 0 0.01 /end COMPU_METHOD
/begin COMPU_METHOD CM_u16_distance_km "u16_distance_km" RAT_FUNC "%8.0" "km" COEFFS 0 1 0 0 0 1 /end COMPU_METHOD
/begin COMPU_METHOD CM_u16_factor_1_1023 "u16_factor_1/1023" RAT_FUNC "%12.4" "%" COEFFS 0 1 0 0 0 0.0977517106549365 /end COMPU_METHOD
/begin COMPU_METHOD CM_u16_factor_1_32 "u16_factor_1/32" RAT_FUNC "%11.3" "%" COEFFS 0 1 0 0 0 3.125 /end COMPU_METHOD
/begin COMPU_METHOD CM_u16_factor_1_4095 "u16_factor_1/4095" RAT_FUNC "%12.4" "%" COEFFS 0 1 0 0 0 0.0244200244200244 /end COMPU_METHOD
/begin COMPU_METHOD CM_u16_flow_10mg_s "u16_flow_10mg/s" RAT_FUNC "%8.0" "mg/s" COEFFS 0 1 0 0 0 10 /end COMPU_METHOD
/begin COMPU_METHOD CM_u16_mass_mg "u16_mass_mg" RAT_FUNC "%8.0" "mg" COEFFS 0 1 0 0 0 1 /end COMPU_METHOD
/begin COMPU_METHOD CM_u16_pressure_mbar "u16_pressure_mbar" RAT_FUNC "%8.0" "mbar" COEFFS 0 1 0 0 0 1 /end COMPU_METHOD
/begin COMPU_METHOD CM_u16_rspeed_1_4rpm "u16_rspeed_1/4rpm" RAT_FUNC "%10.2" "rpm" COEFFS 0 1 0 0 0 0.25 /end COMPU_METHOD
/begin COMPU_METHOD CM_u16_rspeed_rpm "u16_rspeed_rpm" RAT_FUNC "%8.0" "rpm" COEFFS 0 1 0 0 0 1 /end COMPU_METHOD
/begin COMPU_METHOD CM_u16_slip_1_8pct "u16_slip_1/8pct" RAT_FUNC "%11.3" "%" COEFFS 0 1 0 0 0 0.125 /end COMPU_METHOD
/begin COMPU_METHOD CM_u16_voltage_18_1023v "u16_voltage_18/1023v" RAT_FUNC "%12.4" "V" COEFFS 0 1 0 0 0 0.0175953079178886 /end COMPU_METHOD
/begin COMPU_METHOD CM_u16_voltage_5_1023v "u16_voltage_5/1023v" RAT_FUNC "%12.4" "V" COEFFS 0 1 0 0 0 0.00488758553274682 /end COMPU_METHOD
/begin COMPU_METHOD CM_u16_volume_cc "u16_volume_cc" RAT_FUNC "%8.0" "cc" COEFFS 0 1 0 0 0 1 /end COMPU_METHOD
/begin COMPU_METHOD CM_u8__127 "u8_-127" RAT_FUNC "%8.0" "" COEFFS 0 1 127 0 0 1 /end COMPU_METHOD
/begin COMPU_METHOD CM_u8_afr_1_20_5 "u8_afr_1/20+5" RAT_FUNC "%10.2" "AFR" COEFFS 0 1 -5 0 0 0.05 /end COMPU_METHOD
/begin COMPU_METHOD CM_u8_angle_1_4_10deg "u8_angle_1/4-10deg" RAT_FUNC "%10.2" "deg" COEFFS 0 1 10 0 0 0.25 /end COMPU_METHOD
/begin COMPU_METHOD CM_u8_angle_1_4_32deg "u8_angle_1/4-32deg" RAT_FUNC "%10.2" "deg" COEFFS 0 1 32 0 0 0.25 /end COMPU_METHOD
/begin COMPU_METHOD CM_u8_angle_1_4deg "u8_angle_1/4deg" RAT_FUNC "%10.2" "deg" COEFFS 0 1 0 0 0 0.25 /end COMPU_METHOD
/begin COMPU_METHOD CM_u8_count_8x "u8_count_8x" RAT_FUNC "%8.0" "x" COEFFS 0 1 0 0 0 8 /end COMPU_METHOD
/begin COMPU_METHOD CM_u8_factor_1_100 "u8_factor_1/100" RAT_FUNC "%8.0" "%" COEFFS 0 1 0 0 0 1 /end COMPU_METHOD
/begin COMPU_METHOD CM_u8_factor_1_128 "u8_factor_1/128" RAT_FUNC "%12.4" "%" COEFFS 0 1 0 0 0 0.78125 /end COMPU_METHOD
/begin COMPU_METHOD CM_u8_factor_1_200 "u8_factor_1/200" RAT_FUNC "%9.1" "%" COEFFS 0 1 0 0 0 0.5 /end COMPU_METHOD
/begin COMPU_METHOD CM_u8_factor_1_255 "u8_factor_1/255" RAT_FUNC "%12.4" "%" COEFFS 0 1 0 0 0 0.392156862745098 /end COMPU_METHOD
/begin COMPU_METHOD CM_u8_factor_1_64 "u8_factor_1/64" RAT_FUNC "%12.4" "%" COEFFS 0 1 0 0 0 1.5625 /end COMPU_METHOD
/begin COMPU_METHOD CM_u8_load_1173mg_255stroke "u8_load_1173mg/255stroke" RAT_FUNC "%9.1" "mg/stroke" COEFFS 0 1 0 0 0 4.6 /end COMPU_METHOD
/begin COMPU_METHOD CM_u8_load_4mg_stroke "u8_load_4mg/stroke" RAT_FUNC "%8.0" "mg/stroke" COEFFS 0 1 0 0 0 4 /end COMPU_METHOD
/begin COMPU_METHOD CM_u8_mass_32mg "u8_mass_32mg" RAT_FUNC "%8.0" "mg" COEFFS 0 1 0 0 0 32 /end COMPU_METHOD
/begin COMPU_METHOD CM_u8_mass_g "u8_mass_g" RAT_FUNC "%8.0" "g" COEFFS 0 1 0 0 0 1 /end COMPU_METHOD
/begin COMPU_METHOD CM_u8_pressure_4mbar "u8_pressure_4mbar" RAT_FUNC "%8.0" "mbar" COEFFS 0 1 0 0 0 4 /end COMPU_METHOD
/begin COMPU_METHOD CM_u8_pressure_50mbar "u8_pressure_50mbar" RAT_FUNC "%8.0" "mbar" COEFFS 0 1 0 0 0 50 /end COMPU_METHOD
/begin COMPU_METHOD CM_u8_rspeed_10rpm "u8_rspeed_10rpm" RAT_FUNC "%8.0" "rpm" COEFFS 0 1 0 0 0 10 /end COMPU_METHOD
/begin COMPU_METHOD CM_u8_rspeed_125_4_500rpm "u8_rspeed_125/4+500rpm" RAT_FUNC "%10.2" "rpm" COEFFS 0 1 -500 0 0 31.25 /end COMPU_METHOD
/begin COMPU_METHOD CM_u8_rspeed_25rpm "u8_rspeed_25rpm" RAT_FUNC "%8.0" "rpm" COEFFS 0 1 0 0 0 25 /end COMPU_METHOD
/begin COMPU_METHOD CM_u8_rspeed_4_500rpm "u8_rspeed_4+500rpm" RAT_FUNC "%8.0" "rpm" COEFFS 0 1 -500 0 0 4 /end COMPU_METHOD
/begin COMPU_METHOD CM_u8_rspeed_4rpm "u8_rspeed_4rpm" RAT_FUNC "%8.0" "rpm" COEFFS 0 1 0 0 0 4 /end COMPU_METHOD
/begin COMPU_METHOD CM_u8_rspeed_8rpm "u8_rspeed_8rpm" RAT_FUNC "%8.0" "rpm" COEFFS 0 1 0 0 0 8 /end COMPU_METHOD
/begin COMPU_METHOD CM_u8_rspeed__128 "u8_rspeed_-128" RAT_FUNC "%8.0" "rpm" COEFFS 0 1 128 0 0 1 /end COMPU_METHOD
/begin COMPU_METHOD CM_u8_slip_2pct "u8_slip_2pct" RAT_FUNC "%8.0" "%" COEFFS 0 1 0 0 0 2 /end COMPU_METHOD
/begin COMPU_METHOD CM_u8_speed_1_100kph "u8_speed_1/100kph" RAT_FUNC "%10.2" "km/h" COEFFS 0 1 0 0 0 0.01 /end COMPU_METHOD
/begin COMPU_METHOD CM_u8_speed_1_10kph "u8_speed_1/10kph" RAT_FUNC "%9.1" "km/h" COEFFS 0 1 0 0 0 0.1 /end COMPU_METHOD
/begin COMPU_METHOD CM_u8_speed_kph "u8_speed_kph" RAT_FUNC "%8.0" "km/h" COEFFS 0 1 0 0 0 1 /end COMPU_METHOD
/begin COMPU_METHOD CM_u8_temp_1_10C "u8_temp_1/10C" RAT_FUNC "%9.1" "°C" COEFFS 0 1 0 0 0 0.1 /end COMPU_METHOD
/begin COMPU_METHOD CM_u8_temp_5_8_40c "u8_temp_5/8-40c" RAT_FUNC "%11.3" "°C" COEFFS 0 1 40 0 0 0.625 /end COMPU_METHOD
/begin COMPU_METHOD CM_u8_time_100ms "u8_time_100ms" RAT_FUNC "%8.0" "ms" COEFFS 0 1 0 0 0 100 /end COMPU_METHOD
/begin COMPU_METHOD CM_u8_time_10ms "u8_time_10ms" RAT_FUNC "%8.0" "ms" COEFFS 0 1 0 0 0 10 /end COMPU_METHOD
/begin COMPU_METHOD CM_u8_time_20ms "u8_time_20ms" RAT_FUNC "%8.0" "ms" COEFFS 0 1 0 0 0 20 /end COMPU_METHOD
/begin COMPU_METHOD CM_u8_time_20us "u8_time_20us" RAT_FUNC "%8.0" "us" COEFFS 0 1 0 0 0 20 /end COMPU_METHOD
/begin COMPU_METHOD CM_u8_time_250ms "u8_time_250ms" RAT_FUNC "%8.0" "ms" COEFFS 0 1 0 0 0 250 /end COMPU_METHOD
/begin COMPU_METHOD CM_u8_time_256us "u8_time_256us" RAT_FUNC "%8.0" "us" COEFFS 0 1 0 0 0 256 /end COMPU_METHOD
/begin COMPU_METHOD CM_u8_time_50ms "u8_time_50ms" RAT_FUNC "%8.0" "ms" COEFFS 0 1 0 0 0 50 /end COMPU_METHOD
/begin COMPU_METHOD CM_u8_time_5ms "u8_time_5ms" RAT_FUNC "%8.0" "ms" COEFFS 0 1 0 0 0 5 /end COMPU_METHOD
/begin COMPU_METHOD CM_u8_time_5s "u8_time_5s" RAT_FUNC "%8.0" "s" COEFFS 0 1 0 0 0 5 /end COMPU_METHOD
/begin COMPU_METHOD CM_u8_time_64us "u8_time_64us" RAT_FUNC "%8.0" "us" COEFFS 0 1 0 0 0 64 /end COMPU_METHOD
/begin COMPU_METHOD CM_u8_time_hours "u8_time_hours" RAT_FUNC "%8.0" "hours" COEFFS 0 1 0 0 0 1 /end COMPU_METHOD
/begin COMPU_METHOD CM_u8_time_ms "u8_time_ms" RAT_FUNC "%8.0" "ms" COEFFS 0 1 0 0 0 1 /end COMPU_METHOD
/begin COMPU_METHOD CM_u8_time_s "u8_time_s" RAT_FUNC "%8.0" "s" COEFFS 0 1 0 0 0 1 /end COMPU_METHOD
/begin COMPU_METHOD CM_u8_torque_2nm "u8_torque_2nm" RAT_FUNC "%8.0" "Nm" COEFFS 0 1 0 0 0 2 /end COMPU_METHOD
/begin COMPU_METHOD CM_u8_torque_4nm "u8_torque_4nm" RAT_FUNC "%8.0" "Nm" COEFFS 0 1 0 0 0 4 /end COMPU_METHOD
/begin COMPU_METHOD CM_u8_torque_nm "u8_torque_nm" RAT_FUNC "%8.0" "Nm" COEFFS 0 1 0 0 0 1 /end COMPU_METHOD
/begin COMPU_METHOD CM_u8_voltage_5_255v "u8_voltage_5/255v" RAT_FUNC "%12.4" "V" COEFFS 0 1 0 0 0 0.0196078431372549 /end COMPU_METHOD
/begin COMPU_METHOD CM_u8_voltage_72_1023v "u8_voltage_72/1023v" RAT_FUNC "%12.4" "V" COEFFS 0 1 0 0 0 0.0703812316715543 /end COMPU_METHOD
/begin COMPU_METHOD CM_u8_volume_1_10gallon "u8_volume_1/10gallon" RAT_FUNC "%9.1" "gallon" COEFFS 0 1 0 0 0 0.1 /end COMPU_METHOD
/begin CHARACTERISTIC CAL_base "T6-EVORA--F430-V000E#ROW#Lotus#Evora GT430#2019#MT#64kb#MPC5534#CRP#0x59D4#LOTUS EVORA GT430 MAN MY19 ROW" ASCII 0x40008654 RL_VALUE_UBYTE 0 NO_COMPU_METHOD 0 255 NUMBER 32 /end CHARACTERISTIC
/begin CHARACTERISTIC CAL_ecu_data_base "Calibration: ECU data base (val/1023)." VALUE 0x40008674 RL_VALUE_UWORD 0 CM_u16_factor_1_1023 0 6406.15835777126 /end CHARACTERISTIC
/begin CHARACTERISTIC CAL_tpssmooth_rate_closing_clamp_thresholds "Calibration: tpssmooth rate closing clamp thresholds (val/1023; 2-element array)." VAL_BLK 0x40008676 RL_VALUE_UWORD 0 CM_u16_factor_1_1023 0 6406.15835777126 NUMBER 2 /end CHARACTERISTIC
/begin CHARACTERISTIC CAL_idle_clutch_antistall_speed_threshold "Calibration: idle clutch antistall speed threshold (km/h = val/10)." VALUE 0x4000867A RL_VALUE_UBYTE 0 CM_u8_speed_1_10kph 0 25.5 /end CHARACTERISTIC
/begin CHARACTERISTIC CAL_ecu_ips_calibration_version "Calibration: ECU IPS calibration version." VALUE 0x4000867B RL_VALUE_UBYTE 0 NO_COMPU_METHOD 0 255 /end CHARACTERISTIC
/begin CHARACTERISTIC CAL_sensor_evap_purge_pressure_scaling "Calibration: sensor evaporative purge pressure scaling." VALUE 0x40008680 RL_VALUE_UWORD 0 NO_COMPU_METHOD 0 65535 /end CHARACTERISTIC
/begin CHARACTERISTIC CAL_evap_purge_pressure_offset "Calibration: evaporative purge pressure offset." VALUE 0x40008682 RL_VALUE_UWORD 0 NO_COMPU_METHOD 0 65535 /end CHARACTERISTIC
/begin CHARACTERISTIC CAL_sensor_manifold_pressure_sensor_scaling "Calibration: sensor manifold pressure sensor scaling." VALUE 0x40008684 RL_VALUE_UWORD 0 NO_COMPU_METHOD 0 65535 /end CHARACTERISTIC
/begin CHARACTERISTIC CAL_sensor_manifold_pressure_sensor_offset "Calibration: sensor manifold pressure sensor offset (mbar)." VALUE 0x40008686 RL_VALUE_UWORD 0 CM_u16_pressure_mbar 0 65535 /end CHARACTERISTIC
/begin CHARACTERISTIC CAL_ign_tps_rate_decay_period_opening "u8_time_5ms" VALUE 0x40008689 RL_VALUE_UBYTE 0 CM_u8_time_5ms 0 1275 /end CHARACTERISTIC
/begin CHARACTERISTIC CAL_ign_tps_rate_decay_period_closing "u8_time_5ms" VALUE 0x4000868A RL_VALUE_UBYTE 0 CM_u8_time_5ms 0 1275 /end CHARACTERISTIC
/begin CHARACTERISTIC CAL_cooling_fan_engine_bay_airtemp_enable "Calibration: cooling fan engine bay airtemp enable (°C = val*5/8−40)." VALUE 0x4000868B RL_VALUE_UBYTE 0 CM_u8_temp_5_8_40c -40 119.375 /end CHARACTERISTIC
/begin CHARACTERISTIC CAL_cooling_fan_startup_time "Calibration: cooling fan startup time (ms = val*5)." VALUE 0x4000868C RL_VALUE_UWORD 0 CM_u8_time_5ms 0 327675 /end CHARACTERISTIC
/begin CHARACTERISTIC CAL_cooling_fan_hotstart_temp "Calibration: cooling fan hotstart temperature (°C = val*5/8−40)." VALUE 0x4000868E RL_VALUE_UBYTE 0 CM_u8_temp_5_8_40c -40 119.375 /end CHARACTERISTIC
/begin CHARACTERISTIC CAL_cooling_fan_hotstart_dutycycle "Calibration: cooling fan hotstart dutycycle (val/255)." VALUE 0x4000868F RL_VALUE_UBYTE 0 CM_u8_factor_1_255 0 100 /end CHARACTERISTIC
/begin CHARACTERISTIC CAL_cac_pump_diag_dutycycle_min "Calibration: charge-air-cooler pump diag dutycycle minimum (val/255)." VALUE 0x40008690 RL_VALUE_UBYTE 0 CM_u8_factor_1_255 0 100 /end CHARACTERISTIC
/begin CHARACTERISTIC CAL_cooling_fan_engine_bay_radfan_threshold_enable "Calibration: cooling fan engine bay radfan threshold enable (val/255)." VALUE 0x40008691 RL_VALUE_UBYTE 0 CM_u8_factor_1_255 0 100 /end CHARACTERISTIC
/begin CHARACTERISTIC CAL_cooling_fan_engine_bay_radfan_threshold_disable "Calibration: cooling fan engine bay radfan threshold disable (val/255)." VALUE 0x40008692 RL_VALUE_UBYTE 0 CM_u8_factor_1_255 0 100 /end CHARACTERISTIC
/begin CHARACTERISTIC CAL_fuel_level_debounce_window_low "Calibration: fuel level debounce window low (gal = val/10)." VALUE 0x40008693 RL_VALUE_UBYTE 0 CM_u8_volume_1_10gallon 0 25.5 /end CHARACTERISTIC
/begin CHARACTERISTIC CAL_fuel_level_debounce_window_high_ "Calibration: fuel level debounce window high (gal = val/10)." VALUE 0x40008695 RL_VALUE_UWORD 0 CM_u8_volume_1_10gallon 0 6553.5 /end CHARACTERISTIC
/begin CHARACTERISTIC CAL_fuel_level_holdoff_count "u8_count_8x" VALUE 0x40008696 RL_VALUE_UBYTE 0 CM_u8_count_8x 0 2040 /end CHARACTERISTIC
/begin CHARACTERISTIC CAL_fuel_level_stable_count "u8_count" VALUE 0x40008697 RL_VALUE_UBYTE 0 NO_COMPU_METHOD 0 255 /end CHARACTERISTIC
/begin CHARACTERISTIC CAL_load_alphaN_hold_time "Calibration: load alphaN hold time (ms = val*5)." VALUE 0x40008698 RL_VALUE_UBYTE 0 CM_u8_time_5ms 0 1275 /end CHARACTERISTIC
/begin CHARACTERISTIC CAL_ign_comp_coolant_engine_stopped_max "undefined1" VALUE 0x40008699 RL_VALUE_UBYTE 0 NO_COMPU_METHOD 0 255 /end CHARACTERISTIC
/begin CHARACTERISTIC CAL_tps_rate_steadystate_window_size "Calibration: tpssmooth rate calculated window size." VALUE 0x4000869B RL_VALUE_UBYTE 0 NO_COMPU_METHOD 0 255 /end CHARACTERISTIC
/begin CHARACTERISTIC CAL_ecu_unknown_tire_circumference "Calibration: ECU tire circumference." VALUE 0x4000869C RL_VALUE_UWORD 0 NO_COMPU_METHOD 0 65535 /end CHARACTERISTIC
/begin CHARACTERISTIC CAL_ecu_abs_ring_teeth_count "Calibration: ECU ABS ring teeth count." VALUE 0x4000869E RL_VALUE_UBYTE 0 NO_COMPU_METHOD 0 255 /end CHARACTERISTIC
/begin CHARACTERISTIC CAL_injtip_fuel_film_disable_default_coeff "Calibration: injector tip-in fuel film disable default coeff (val/255)." VALUE 0x400086A0 RL_VALUE_UBYTE 0 CM_u8_factor_1_255 0 100 /end CHARACTERISTIC
/begin CHARACTERISTIC CAL_ign_comp_coolant_engine_stopped_min "Calibration: ignition compensation coolant engine stopped minimum (°C = val*5/8−40)." VALUE 0x400086A1 RL_VALUE_UBYTE 0 CM_u8_temp_5_8_40c -40 119.375 /end CHARACTERISTIC
/begin CHARACTERISTIC CAL_ign_comp_coolant_engine_stopped_min_400086A2 "Calibration: ignition compensation coolant engine stopped minimum (°C = val*5/8−40)." VALUE 0x400086A2 RL_VALUE_UBYTE 0 CM_u8_temp_5_8_40c -40 119.375 /end CHARACTERISTIC
/begin CHARACTERISTIC CAL_ign_fixed_timing_manual "Calibration: ignition fixed timing manual (° = val/4−10)." VALUE 0x400086A3 RL_VALUE_UBYTE 0 CM_u8_angle_1_4_10deg -10 53.75 /end CHARACTERISTIC
/begin CHARACTERISTIC CAL_torque_ext_torque_limit_hold_count "u8_time_10ms" VALUE 0x400086A4 RL_VALUE_UBYTE 0 CM_u8_time_10ms 0 2550 /end CHARACTERISTIC
/begin CHARACTERISTIC CAL_injtip_in_adj_gears "Calibration: injector tip-in in adj gears (6-element array)." VAL_BLK 0x400086A5 RL_VALUE_UBYTE 0 NO_COMPU_METHOD 0 255 NUMBER 6 /end CHARACTERISTIC
/begin CHARACTERISTIC CAL_knock_baseline_min_clamp "Calibration: knock baseline minimum clamp." VALUE 0x400086AC RL_VALUE_UBYTE 0 NO_COMPU_METHOD 0 255 /end CHARACTERISTIC
/begin CHARACTERISTIC CAL_sensor_ac_evap_temp_filter_alpha "undefined1" VALUE 0x400086AD RL_VALUE_UBYTE 0 NO_COMPU_METHOD 0 255 /end CHARACTERISTIC
/begin CHARACTERISTIC CAL_ign_trim_per_cyl "Calibration: ignition trim per cyl (° = val/4; 6-element array)." VAL_BLK 0x400086AE RL_VALUE_UBYTE 0 CM_u8_angle_1_4deg 0 63.75 NUMBER 6 /end CHARACTERISTIC
/begin CHARACTERISTIC CAL_ac_compressor_max_coolant_temp_max "Calibration: A/C compressor maximum coolant temperature maximum (val/255)." VALUE 0x400086B4 RL_VALUE_UBYTE 0 CM_u8_factor_1_255 0 100 /end CHARACTERISTIC
/begin CHARACTERISTIC CAL_ac_compressor_max_coolant_temp_min "Calibration: A/C compressor maximum coolant temperature minimum (val/255)." VALUE 0x400086B5 RL_VALUE_UBYTE 0 CM_u8_factor_1_255 0 100 /end CHARACTERISTIC
/begin CHARACTERISTIC CAL_ac_compressor_max_throttle "Calibration: A/C compressor maximum throttle (val/255)." VALUE 0x400086B6 RL_VALUE_UBYTE 0 CM_u8_factor_1_255 0 100 /end CHARACTERISTIC
/begin CHARACTERISTIC CAL_ac_ign_comp_delay "undefined1" VALUE 0x400086B8 RL_VALUE_UBYTE 0 NO_COMPU_METHOD 0 255 /end CHARACTERISTIC
/begin CHARACTERISTIC CAL_inj_max_duty_cycle_limit "Calibration: injector maximum duty cycle limit (val/255)." VALUE 0x400086B9 RL_VALUE_UBYTE 0 CM_u8_factor_1_255 0 100 /end CHARACTERISTIC
/begin CHARACTERISTIC CAL_fuel_trim_integral_max "undefined2" VALUE 0x400086BA RL_VALUE_UWORD 0 NO_COMPU_METHOD 0 65535 /end CHARACTERISTIC
/begin CHARACTERISTIC CAL_fuel_pressure_max "Calibration: fuel pressure maximum (mbar = val*50)." VALUE 0x400086BC RL_VALUE_UBYTE 0 CM_u8_pressure_50mbar 0 12750 /end CHARACTERISTIC
/begin CHARACTERISTIC CAL_fuel_pressure_target_max "Calibration: fuel pressure target maximum (mbar = val*50)." VALUE 0x400086BD RL_VALUE_UBYTE 0 CM_u8_pressure_50mbar 0 12750 /end CHARACTERISTIC
/begin CHARACTERISTIC CAL_fuel_pressure_target_min "Calibration: fuel pressure target minimum (mbar = val*50)." VALUE 0x400086BE RL_VALUE_UBYTE 0 CM_u8_pressure_50mbar 0 12750 /end CHARACTERISTIC
/begin CHARACTERISTIC CAL_cooling_fan_speed_disable_speed "Calibration: cooling fan speed disable speed (km/h)." VALUE 0x400086BF RL_VALUE_UBYTE 0 CM_u8_speed_kph 0 255 /end CHARACTERISTIC
/begin CHARACTERISTIC CAL_idle_learn_integral_max "undefined1" VALUE 0x400086C2 RL_VALUE_UBYTE 0 NO_COMPU_METHOD 0 255 /end CHARACTERISTIC
/begin CHARACTERISTIC CAL_idle_learn_integral_min "undefined1" VALUE 0x400086C3 RL_VALUE_UBYTE 0 NO_COMPU_METHOD 0 255 /end CHARACTERISTIC
/begin CHARACTERISTIC CAL_closedloop_cross_bank_check_enable "Calibration: closedloop cross bank check enable." VALUE 0x400086C5 RL_VALUE_UBYTE 0 NO_COMPU_METHOD 0 255 /end CHARACTERISTIC
/begin CHARACTERISTIC CAL_closedloop_o2_switch_timeout_engine_cycles_ips "undefined1" VALUE 0x400086C7 RL_VALUE_UBYTE 0 NO_COMPU_METHOD 0 255 /end CHARACTERISTIC
/begin CHARACTERISTIC CAL_ac_compressor_engine_speed_max "Calibration: A/C compressor engine speed maximum (RPM = val*125/4+500)." VALUE 0x400086C8 RL_VALUE_UBYTE 0 CM_u8_rspeed_125_4_500rpm 500 8468.75 /end CHARACTERISTIC
/begin CHARACTERISTIC CAL_ac_compressor_engine_speed_min "Calibration: A/C compressor engine speed minimum (RPM = val*125/4+500)." VALUE 0x400086C9 RL_VALUE_UBYTE 0 CM_u8_rspeed_125_4_500rpm 500 8468.75 /end CHARACTERISTIC
/begin CHARACTERISTIC CAL_ac_shutdown_delay "undefined1" VALUE 0x400086CC RL_VALUE_UBYTE 0 NO_COMPU_METHOD 0 255 /end CHARACTERISTIC
/begin CHARACTERISTIC CAL_cooling_recirc_reset_coolant_temp "Calibration: cooling recirc reset coolant temperature (°C = val*5/8−40)." VALUE 0x400086CD RL_VALUE_UBYTE 0 CM_u8_temp_5_8_40c -40 119.375 /end CHARACTERISTIC
/begin CHARACTERISTIC CAL_injtip_dfco_accel_pedal_max_manual_clutch_disengage "Calibration: injector tip-in decel fuel cut-off accelerator pedal maximum manual clutch disengage (val/255)." VALUE 0x400086CE RL_VALUE_UBYTE 0 CM_u8_factor_1_255 0 100 /end CHARACTERISTIC
/begin CHARACTERISTIC CAL_torque_torque_to_tps_scaling_rpm_range "Calibration: torque torque to throttle position scaling RPM range (RPM = val*125/4+500; 2-element array)." VAL_BLK 0x400086CF RL_VALUE_UBYTE 0 CM_u8_rspeed_125_4_500rpm 500 8468.75 NUMBER 2 /end CHARACTERISTIC
/begin CHARACTERISTIC CAL_ecu_learning_x_axis_stability_threshold "Calibration: ECU learning x axis stability threshold." VALUE 0x400086D1 RL_VALUE_UBYTE 0 NO_COMPU_METHOD 0 255 /end CHARACTERISTIC
/begin CHARACTERISTIC CAL_ecu_learning_y_axis_stability_threshold "Calibration: ECU learning y axis stability threshold." VALUE 0x400086D2 RL_VALUE_UBYTE 0 NO_COMPU_METHOD 0 255 /end CHARACTERISTIC
/begin CHARACTERISTIC CAL_wheel_speed_smoothing "Calibration: wheel speed smoothing." VALUE 0x400086D3 RL_VALUE_UBYTE 0 NO_COMPU_METHOD 0 255 /end CHARACTERISTIC
/begin CHARACTERISTIC CAL_load_alphaN_learning_temp_threshold "Calibration: load alphaN learning temperature threshold (°C = val*5/8−40)." VALUE 0x400086D4 RL_VALUE_UBYTE 0 CM_u8_temp_5_8_40c -40 119.375 /end CHARACTERISTIC
/begin CHARACTERISTIC CAL_sensor_airtemp_tmaf_filter_alpha "undefined1" VALUE 0x400086D7 RL_VALUE_UBYTE 0 NO_COMPU_METHOD 0 255 /end CHARACTERISTIC
/begin CHARACTERISTIC CAL_sensor_coolant_temp_derived1_scaling "Calibration: sensor coolant temperature derived1 scaling." VALUE 0x400086D8 RL_VALUE_UBYTE 0 NO_COMPU_METHOD 0 255 /end CHARACTERISTIC
/begin CHARACTERISTIC CAL_sensor_intake_air_temp_filter_scaling "Calibration: sensor intake air temperature filter scaling (val/100)." VALUE 0x400086D9 RL_VALUE_UBYTE 0 CM_u8_factor_1_100 0 255 /end CHARACTERISTIC
/begin CHARACTERISTIC CAL_closedloop_lean_protect_max_rpm "Disabled from the factory" VALUE 0x400086DA RL_VALUE_UBYTE 0 CM_u8_rspeed_125_4_500rpm 500 8468.75 /end CHARACTERISTIC
/begin CHARACTERISTIC CAL_fuel_level_filter_coeff_rise "undefined1" VALUE 0x400086DB RL_VALUE_UBYTE 0 NO_COMPU_METHOD 0 255 /end CHARACTERISTIC
/begin CHARACTERISTIC CAL_ac_compressor_deactivate_car_speed "Calibration: A/C compressor deactivate car speed (km/h; 2-element array)." VAL_BLK 0x400086DC RL_VALUE_UBYTE 0 CM_u8_speed_kph 0 255 NUMBER 2 /end CHARACTERISTIC
/begin CHARACTERISTIC CAL_evap_purge_idle_duty_max "undefined1" VALUE 0x400086DE RL_VALUE_UBYTE 0 NO_COMPU_METHOD 0 255 /end CHARACTERISTIC
/begin CHARACTERISTIC CAL_ecu_ign_threshold "Calibration: ECU ignition threshold (V = val*5/255)." VALUE 0x400086DF RL_VALUE_UBYTE 0 CM_u8_voltage_5_255v 0 5 /end CHARACTERISTIC
/begin CHARACTERISTIC CAL_injtip_dfco_enable_speed "Calibration: injector tip-in decel fuel cut-off enable speed (km/h)." VALUE 0x400086E0 RL_VALUE_UBYTE 0 CM_u8_speed_kph 0 255 /end CHARACTERISTIC
/begin CHARACTERISTIC CAL_injtip_dfco_low_speed_threshold "Calibration: injector tip-in decel fuel cut-off low speed threshold (km/h)." VALUE 0x400086E1 RL_VALUE_UBYTE 0 CM_u8_speed_kph 0 255 /end CHARACTERISTIC
/begin CHARACTERISTIC CAL_ign_enable_lea_knock_retard "Calibration: ignition enable lea knock retard (boolean flag)." VALUE 0x400086E2 RL_VALUE_UBYTE 0 NO_COMPU_METHOD 0 255 /end CHARACTERISTIC
/begin CHARACTERISTIC CAL_sensor_o2_heater_warmup_pwm_period "Calibration: sensor O2 heater warmup PWM period." VALUE 0x400086E3 RL_VALUE_UBYTE 0 NO_COMPU_METHOD 0 255 /end CHARACTERISTIC
/begin CHARACTERISTIC CAL_sensor_o2_heater_warmup_duration "Calibration: sensor O2 heater warmup duration (ms = val*5)." VALUE 0x400086E4 RL_VALUE_UWORD 0 CM_u8_time_5ms 0 327675 /end CHARACTERISTIC
/begin CHARACTERISTIC CAL_knock_corr_limit "Calibration: knock corr limit (° = val/4)." VALUE 0x400086E6 RL_VALUE_UBYTE 0 CM_u8_angle_1_4deg 0 63.75 /end CHARACTERISTIC
/begin CHARACTERISTIC CAL_knock_retard_hold_time "Calibration: knock retard hold time." VALUE 0x400086E7 RL_VALUE_UBYTE 0 NO_COMPU_METHOD 0 255 /end CHARACTERISTIC
/begin CHARACTERISTIC CAL_knock_ign_retard_decay_rate "Calibration: knock ignition retard decay rate (° = val/4)." VALUE 0x400086E8 RL_VALUE_UBYTE 0 CM_u8_angle_1_4deg 0 63.75 /end CHARACTERISTIC
/begin CHARACTERISTIC CAL_knock_octane_scaler_increment "Calibration: knock octane scaler increment." VALUE 0x400086E9 RL_VALUE_UBYTE 0 NO_COMPU_METHOD 0 255 /end CHARACTERISTIC
/begin CHARACTERISTIC CAL_knock_octane_scaler_decrement "Calibration: knock octane scaler decrement." VALUE 0x400086EA RL_VALUE_UBYTE 0 NO_COMPU_METHOD 0 255 /end CHARACTERISTIC
/begin CHARACTERISTIC CAL_knock_detection_engine_speed_max "Calibration: knock detection engine speed maximum (RPM = val*125/4+500)." VALUE 0x400086EB RL_VALUE_UBYTE 0 CM_u8_rspeed_125_4_500rpm 500 8468.75 /end CHARACTERISTIC
/begin CHARACTERISTIC CAL_knock_detection_engine_speed_min "Calibration: knock detection engine speed minimum (RPM = val*125/4+500)." VALUE 0x400086EC RL_VALUE_UBYTE 0 CM_u8_rspeed_125_4_500rpm 500 8468.75 /end CHARACTERISTIC
/begin CHARACTERISTIC CAL_knock_corr_temp_threshold "Calibration: knock corr temperature threshold (°C = val*5/8−40)." VALUE 0x400086ED RL_VALUE_UBYTE 0 CM_u8_temp_5_8_40c -40 119.375 /end CHARACTERISTIC
/begin CHARACTERISTIC CAL_knock_corr_octane_base "Calibration: knock corr octane base (° = val/4)." VALUE 0x400086EE RL_VALUE_UBYTE 0 CM_u8_angle_1_4deg 0 63.75 /end CHARACTERISTIC
/begin CHARACTERISTIC CAL_knock_baseline_filter_alpha "Calibration: knock baseline filter alpha." VALUE 0x400086EF RL_VALUE_UBYTE 0 NO_COMPU_METHOD 0 255 /end CHARACTERISTIC
/begin CHARACTERISTIC CAL_knock_detection_engine_speed_margin "Calibration: knock detection engine speed margin (RPM = val*125/4+500)." VALUE 0x400086F0 RL_VALUE_UBYTE 0 CM_u8_rspeed_125_4_500rpm 500 8468.75 /end CHARACTERISTIC
/begin CHARACTERISTIC CAL_knock_detection_load_margin_debounce "Calibration: knock detection load margin debounce (mg/stroke = val*4)." VALUE 0x400086F1 RL_VALUE_UBYTE 0 CM_u8_load_4mg_stroke 0 1020 /end CHARACTERISTIC
/begin CHARACTERISTIC CAL_knock_inhibit_timer_tps_rate "Calibration: knock inhibit timer throttle position rate (ms = val*5)." VALUE 0x400086F2 RL_VALUE_UBYTE 0 CM_u8_time_5ms 0 1275 /end CHARACTERISTIC
/begin CHARACTERISTIC CAL_knock_inhibit_tps_rate1 "Calibration: knock inhibit throttle position rate1 (val/1023)." VALUE 0x400086F4 RL_VALUE_UWORD 0 CM_u16_factor_1_1023 0 6406.15835777126 /end CHARACTERISTIC
/begin CHARACTERISTIC CAL_closedloop_stft_filter_unknown "undefined1" VALUE 0x400086F7 RL_VALUE_UBYTE 0 NO_COMPU_METHOD 0 255 /end CHARACTERISTIC
/begin CHARACTERISTIC CAL_evap_purge_conditioning_timer_100ms "undefined1" VALUE 0x400086F8 RL_VALUE_UBYTE 0 NO_COMPU_METHOD 0 255 /end CHARACTERISTIC
/begin CHARACTERISTIC CAL_evap_purge_min_inj_pulse_enter "undefined1" VALUE 0x400086F9 RL_VALUE_UBYTE 0 NO_COMPU_METHOD 0 255 /end CHARACTERISTIC
/begin CHARACTERISTIC CAL_evap_purge_min_inj_pulse_exit "undefined1" VALUE 0x400086FA RL_VALUE_UBYTE 0 NO_COMPU_METHOD 0 255 /end CHARACTERISTIC
/begin CHARACTERISTIC CAL_evap_purge_duty_ramp_up_min "undefined1" VALUE 0x400086FB RL_VALUE_UBYTE 0 NO_COMPU_METHOD 0 255 /end CHARACTERISTIC
/begin CHARACTERISTIC CAL_evap_purge_filter_alpha "undefined1" VALUE 0x400086FE RL_VALUE_UBYTE 0 NO_COMPU_METHOD 0 255 /end CHARACTERISTIC
/begin CHARACTERISTIC CAL_ign_comp_ac_compressor_active "Calibration: ignition compensation A/C compressor active (° = val/4)." VALUE 0x40008703 RL_VALUE_SBYTE 0 CM_u8_angle_1_4deg -32 31.75 /end CHARACTERISTIC
/begin CHARACTERISTIC CAL_injtip_in_adj_gears_6 "Calibration: injector tip-in in adj gears 6." VALUE 0x40008705 RL_VALUE_UBYTE 0 NO_COMPU_METHOD 0 255 /end CHARACTERISTIC
/begin CHARACTERISTIC CAL_engine_speed_avg_samples "undefined1" VALUE 0x40008706 RL_VALUE_UBYTE 0 NO_COMPU_METHOD 0 255 /end CHARACTERISTIC
/begin CHARACTERISTIC CAL_ac_inhibit_evap_temp "undefined1" VALUE 0x40008707 RL_VALUE_UBYTE 0 NO_COMPU_METHOD 0 255 /end CHARACTERISTIC
/begin CHARACTERISTIC CAL_ac_evap_timer_ticks_5ms "Calibration: A/C evaporative timer ticks 5ms." VALUE 0x40008709 RL_VALUE_UBYTE 0 NO_COMPU_METHOD 0 255 /end CHARACTERISTIC
/begin CHARACTERISTIC CAL_ac_evap_pid_derivative_filter_alpha "undefined1" VALUE 0x4000870B RL_VALUE_UBYTE 0 NO_COMPU_METHOD 0 255 /end CHARACTERISTIC
/begin CHARACTERISTIC CAL_inj_comp_power_enrich_from_ign_retard "Calibration: injector compensation power enrich from ignition retard (val/100)." VALUE 0x4000870F RL_VALUE_UBYTE 0 CM_u8_factor_1_100 0 255 /end CHARACTERISTIC
/begin CHARACTERISTIC CAL_inj_fuel_learn_time_step "Calibration: fuel learn time step." VALUE 0x40008711 RL_VALUE_UBYTE 0 NO_COMPU_METHOD 0 255 /end CHARACTERISTIC
/begin CHARACTERISTIC CAL_sensor_pps_unknown1 "undefined1" VALUE 0x40008712 RL_VALUE_UBYTE 0 NO_COMPU_METHOD 0 255 /end CHARACTERISTIC
/begin CHARACTERISTIC CAL_tps_accel_pedal_zero_calibrate_timer "Calibration: throttle position accelerator pedal zero calibrate timer (ms = val*5)." VALUE 0x40008715 RL_VALUE_UBYTE 0 CM_u8_time_5ms 0 1275 /end CHARACTERISTIC
/begin CHARACTERISTIC CAL_cruise_unknown2 "undefined1" VALUE 0x40008716 RL_VALUE_UBYTE 0 NO_COMPU_METHOD 0 255 /end CHARACTERISTIC
/begin CHARACTERISTIC CAL_sensor_map_avg_window_size "Calibration: sensor MAP avg window size." VALUE 0x40008717 RL_VALUE_UBYTE 0 NO_COMPU_METHOD 0 255 /end CHARACTERISTIC
/begin CHARACTERISTIC CAL_ac_evap_freeze_inhibit_delay "undefined1" VALUE 0x40008718 RL_VALUE_UBYTE 0 NO_COMPU_METHOD 0 255 /end CHARACTERISTIC
/begin CHARACTERISTIC CAL_knock_agc_threshold "Calibration: knock AGC threshold (RPM = val*125/4+500; 3-element array)." VAL_BLK 0x4000871A RL_VALUE_UBYTE 0 CM_u8_rspeed_125_4_500rpm 500 8468.75 NUMBER 3 /end CHARACTERISTIC
/begin CHARACTERISTIC CAL_knock_agc_hysteresis_band "Calibration: knock AGC hysteresis band (RPM = val*125/4+500)." VALUE 0x4000871D RL_VALUE_UBYTE 0 CM_u8_rspeed_125_4_500rpm 500 8468.75 /end CHARACTERISTIC
/begin CHARACTERISTIC CAL_ac_load_ramp_steps "undefined1" VALUE 0x4000871E RL_VALUE_UBYTE 0 NO_COMPU_METHOD 0 255 /end CHARACTERISTIC
/begin CHARACTERISTIC CAL_ac_evap_target_temp "Calibration: A/C evaporative target temperature (°C = val/10)." VALUE 0x4000871F RL_VALUE_UBYTE 0 CM_u8_temp_1_10C 0 25.5 /end CHARACTERISTIC
/begin CHARACTERISTIC CAL_ac_evap_pid_kd "undefined1" VALUE 0x40008720 RL_VALUE_UBYTE 0 NO_COMPU_METHOD 0 255 /end CHARACTERISTIC
/begin CHARACTERISTIC CAL_ac_evap_pid_ki_warm "undefined1" VALUE 0x40008721 RL_VALUE_UBYTE 0 NO_COMPU_METHOD 0 255 /end CHARACTERISTIC
/begin CHARACTERISTIC CAL_ac_evap_pid_integrator_limit "undefined1" VALUE 0x40008722 RL_VALUE_UBYTE 0 NO_COMPU_METHOD 0 255 /end CHARACTERISTIC
/begin CHARACTERISTIC CAL_ac_output_pwm_freq "Calibration: A/C output PWM freq." VALUE 0x40008724 RL_VALUE_UWORD 0 NO_COMPU_METHOD 0 65535 /end CHARACTERISTIC
/begin CHARACTERISTIC CAL_ac_compressor_soft_engage_time "undefined1" VALUE 0x40008727 RL_VALUE_UBYTE 0 NO_COMPU_METHOD 0 255 /end CHARACTERISTIC
/begin CHARACTERISTIC CAL_ign_zero_rpm_threshold "Calibration: ignition zero RPM threshold (RPM = val*125/4+500)." VALUE 0x40008728 RL_VALUE_UBYTE 0 CM_u8_rspeed_125_4_500rpm 500 8468.75 /end CHARACTERISTIC
/begin CHARACTERISTIC CAL_ac_unknown3 "undefined1" VALUE 0x40008729 RL_VALUE_UBYTE 0 NO_COMPU_METHOD 0 255 /end CHARACTERISTIC
/begin CHARACTERISTIC CAL_ign_comp_idle_transient_advance_max "u8_factor_1/255" VALUE 0x4000872B RL_VALUE_UBYTE 0 CM_u8_factor_1_255 0 100 /end CHARACTERISTIC
/begin CHARACTERISTIC CAL_idle_exit_rpm_offset "undefined1" VALUE 0x4000872C RL_VALUE_UBYTE 0 NO_COMPU_METHOD 0 255 /end CHARACTERISTIC
/begin CHARACTERISTIC CAL_obd_o2_tps_transient_threshold "undefined1" VALUE 0x4000872E RL_VALUE_UBYTE 0 NO_COMPU_METHOD 0 255 /end CHARACTERISTIC
/begin CHARACTERISTIC CAL_idle_car_moving_threshold "Calibration: idle car moving threshold (km/h)." VALUE 0x40008732 RL_VALUE_UBYTE 0 CM_u8_speed_kph 0 255 /end CHARACTERISTIC
/begin CHARACTERISTIC CAL_knock_octane_scaler_shortterm_multiplier "Calibration: knock octane scaler shortterm multiplier." VALUE 0x40008734 RL_VALUE_UBYTE 0 NO_COMPU_METHOD 0 255 /end CHARACTERISTIC
/begin CHARACTERISTIC CAL_knock_octane_scaler_shortterm_decrement "Calibration: knock octane scaler shortterm decrement." VALUE 0x40008735 RL_VALUE_UBYTE 0 NO_COMPU_METHOD 0 255 /end CHARACTERISTIC
/begin CHARACTERISTIC CAL_ac_compressor_power_offset "undefined1" VALUE 0x40008736 RL_VALUE_UBYTE 0 NO_COMPU_METHOD 0 255 /end CHARACTERISTIC
/begin CHARACTERISTIC CAL_cooling_recirc_enable_airtemp "Calibration: cooling recirc enable airtemp (°C = val*5/8−40)." VALUE 0x40008737 RL_VALUE_UBYTE 0 CM_u8_temp_5_8_40c -40 119.375 /end CHARACTERISTIC
/begin CHARACTERISTIC CAL_injtip_overrun_inhibit_timer "Calibration: injector tip-in overrun inhibit timer (ms = val*5)." VALUE 0x40008738 RL_VALUE_UWORD 0 CM_u8_time_5ms 0 327675 /end CHARACTERISTIC
/begin CHARACTERISTIC CAL_etb_pid_kd "uint16_t" VALUE 0x4000873A RL_VALUE_UWORD 0 NO_COMPU_METHOD 0 65535 /end CHARACTERISTIC
/begin CHARACTERISTIC CAL_ac_load_slew_up_period_ "undefined1" VALUE 0x4000873C RL_VALUE_UBYTE 0 NO_COMPU_METHOD 0 255 /end CHARACTERISTIC
/begin CHARACTERISTIC CAL_ac_load_slew_down_period "undefined1" VALUE 0x4000873D RL_VALUE_UBYTE 0 NO_COMPU_METHOD 0 255 /end CHARACTERISTIC
/begin CHARACTERISTIC CAL_etb_tps1_max_count "undefined2" VALUE 0x4000873E RL_VALUE_UWORD 0 NO_COMPU_METHOD 0 65535 /end CHARACTERISTIC
/begin CHARACTERISTIC CAL_ac_load_slew_up_step "undefined1" VALUE 0x40008740 RL_VALUE_UBYTE 0 NO_COMPU_METHOD 0 255 /end CHARACTERISTIC
/begin CHARACTERISTIC CAL_ac_load_slew_down_step "undefined1" VALUE 0x40008741 RL_VALUE_UBYTE 0 NO_COMPU_METHOD 0 255 /end CHARACTERISTIC
/begin CHARACTERISTIC CAL_etb_tps2_max_count "undefined2" VALUE 0x40008742 RL_VALUE_UWORD 0 NO_COMPU_METHOD 0 65535 /end CHARACTERISTIC
/begin CHARACTERISTIC CAL_etb_pwm_period "uint16_t" VALUE 0x40008744 RL_VALUE_UWORD 0 NO_COMPU_METHOD 0 65535 /end CHARACTERISTIC
/begin CHARACTERISTIC CAL_torque_limit_low_speed_min_torque "u8_torque_nm" VALUE 0x40008746 RL_VALUE_UBYTE 0 CM_u8_torque_nm 0 255 /end CHARACTERISTIC
/begin CHARACTERISTIC CAL_ac_evap_pid_ki_cold "undefined1" VALUE 0x40008747 RL_VALUE_UBYTE 0 NO_COMPU_METHOD 0 255 /end CHARACTERISTIC
/begin CHARACTERISTIC CAL_etb_pid_kp "uint16_t" VALUE 0x4000874A RL_VALUE_UWORD 0 NO_COMPU_METHOD 0 65535 /end CHARACTERISTIC
/begin CHARACTERISTIC CAL_torque_limit_low_speed_rpm_threshold "u16_rspeed_rpm" VALUE 0x4000874C RL_VALUE_UWORD 0 CM_u16_rspeed_rpm 0 65535 /end CHARACTERISTIC
/begin CHARACTERISTIC CAL_etb_pid_ki "uint16_t" VALUE 0x4000874E RL_VALUE_UWORD 0 NO_COMPU_METHOD 0 65535 /end CHARACTERISTIC
/begin CHARACTERISTIC CAL_injtip_overrun_hysteresis_timer "Calibration: injector tip-in overrun hysteresis timer (ms = val*5)." VALUE 0x40008750 RL_VALUE_UWORD 0 CM_u8_time_5ms 0 327675 /end CHARACTERISTIC
/begin CHARACTERISTIC CAL_etb_pid_integral_limit "uint16_t" VALUE 0x4000875A RL_VALUE_UWORD 0 NO_COMPU_METHOD 0 65535 /end CHARACTERISTIC
/begin CHARACTERISTIC CAL_tpssmooth_step_timer "Calibration: tpssmooth step timer." VALUE 0x4000875C RL_VALUE_UWORD 0 NO_COMPU_METHOD 0 65535 /end CHARACTERISTIC
/begin CHARACTERISTIC CAL_cooling_fan_inhibit_window_end_5s "undefined1" VALUE 0x4000875F RL_VALUE_UBYTE 0 NO_COMPU_METHOD 0 255 /end CHARACTERISTIC
/begin CHARACTERISTIC CAL_cooling_recirc_timer "Calibration: cooling recirc timer (s)." VALUE 0x40008760 RL_VALUE_UBYTE 0 CM_u8_time_s 0 255 /end CHARACTERISTIC
/begin CHARACTERISTIC CAL_closedloop_bank_sync_max_hold "undefined1" VALUE 0x40008761 RL_VALUE_UBYTE 0 NO_COMPU_METHOD 0 255 /end CHARACTERISTIC
/begin CHARACTERISTIC CAL_cooling_fan_inhibit_temp_drop_threshold "Calibration: cooling fan inhibit temperature drop threshold (°C = val*5/8−40)." VALUE 0x40008762 RL_VALUE_UBYTE 0 CM_u8_temp_5_8_40c -40 119.375 /end CHARACTERISTIC
/begin CHARACTERISTIC CAL_cooling_fan_inhibit_resample_period_100ms "undefined1" VALUE 0x40008763 RL_VALUE_UBYTE 0 NO_COMPU_METHOD 0 255 /end CHARACTERISTIC
/begin CHARACTERISTIC CAL_idle_unknown4 "u8_rspeed_8rpm" VALUE 0x40008764 RL_VALUE_UBYTE 0 CM_u8_rspeed_8rpm 0 2040 /end CHARACTERISTIC
/begin CHARACTERISTIC CAL_idle_unknown3 "u8_rspeed_8rpm" VALUE 0x40008765 RL_VALUE_UBYTE 0 CM_u8_rspeed_8rpm 0 2040 /end CHARACTERISTIC
/begin CHARACTERISTIC CAL_cooling_fan_inhibit_window_start_5s "undefined1" VALUE 0x40008766 RL_VALUE_UBYTE 0 NO_COMPU_METHOD 0 255 /end CHARACTERISTIC
/begin CHARACTERISTIC CAL_sensor_clutch_engaged_threshold "Calibration: sensor clutch engaged threshold (V = val*5/1023)." VALUE 0x40008768 RL_VALUE_UWORD 0 CM_u16_voltage_5_1023v 0 320.307917888563 /end CHARACTERISTIC
/begin CHARACTERISTIC CAL_sensor_clutch_disengaged_threshold "Calibration: sensor clutch disengaged threshold (V = val*5/1023)." VALUE 0x4000876A RL_VALUE_UWORD 0 CM_u16_voltage_5_1023v 0 320.307917888563 /end CHARACTERISTIC
/begin CHARACTERISTIC CAL_tpssmooth_decrement_comp_gears_manual "Calibration: tpssmooth decrement compensation gears manual (val/255; 7-element array)." VAL_BLK 0x4000876D RL_VALUE_UBYTE 0 CM_u8_factor_1_255 0 100 NUMBER 7 /end CHARACTERISTIC
/begin CHARACTERISTIC CAL_load_alphaN_learning_rpm_rate_max "Calibration: load alphaN learning RPM rate maximum." VALUE 0x4000877A RL_VALUE_UWORD 0 NO_COMPU_METHOD 0 65535 /end CHARACTERISTIC
/begin CHARACTERISTIC CAL_ecu_engine_running_threshold_unknown "Calibration: ECU engine running threshold (2-element array)." VAL_BLK 0x4000877E RL_VALUE_UBYTE 0 NO_COMPU_METHOD 0 255 NUMBER 2 /end CHARACTERISTIC
/begin CHARACTERISTIC CAL_misc_engine_detection_off "undefined2" VALUE 0x40008780 RL_VALUE_UWORD 0 NO_COMPU_METHOD 0 65535 /end CHARACTERISTIC
/begin CHARACTERISTIC CAL_ecu_vehicle_mode_button_time "Calibration: ECU vehicle mode button time (ms = val*10)." VALUE 0x40008782 RL_VALUE_UWORD 0 CM_u8_time_10ms 0 655350 /end CHARACTERISTIC
/begin CHARACTERISTIC CAL_closedloop_activate_timer_o2_check "Calibration: closedloop activate timer O2 check (ms = val*5)." VALUE 0x40008784 RL_VALUE_UWORD 0 CM_u8_time_5ms 0 327675 /end CHARACTERISTIC
/begin CHARACTERISTIC CAL_trans_gear_ratio_tour "Calibration: transmission gear ratio tour (10-element array)." VAL_BLK 0x40008788 RL_VALUE_UWORD 0 NO_COMPU_METHOD 0 65535 NUMBER 10 /end CHARACTERISTIC
/begin CHARACTERISTIC CAL_closedloop_afr "Calibration: closedloop AFR (val/100)." VALUE 0x4000879C RL_VALUE_UWORD 0 CM_u16_afr_1_100 0 655.35 /end CHARACTERISTIC
/begin CHARACTERISTIC CAL_closedloop_o2_sensor_voltage_switching_lean "Calibration: closedloop O2 sensor voltage switching lean (V = val*5/1023)." VALUE 0x4000879E RL_VALUE_UWORD 0 CM_u16_voltage_5_1023v 0 320.307917888563 /end CHARACTERISTIC
/begin CHARACTERISTIC CAL_closedloop_o2_sensor_voltage_switch_rich "Calibration: closedloop O2 sensor voltage switch rich (V = val*5/1023)." VALUE 0x400087A0 RL_VALUE_UWORD 0 CM_u16_voltage_5_1023v 0 320.307917888563 /end CHARACTERISTIC
/begin CHARACTERISTIC CAL_inj_stft_limit "Calibration: injector short-term fuel trim limit (val/20)." VALUE 0x400087A2 RL_VALUE_SWORD 0 CM_i16_factor_1_20 -163840 163835 /end CHARACTERISTIC
/begin CHARACTERISTIC CAL_ign_low_gear_number "Calibration: ignition low gear number." VALUE 0x400087A8 RL_VALUE_UBYTE 0 NO_COMPU_METHOD 0 255 /end CHARACTERISTIC
/begin CHARACTERISTIC CAL_cooling_engine_bay_fan_enable_delay "Calibration: cooling engine bay fan enable delay." VALUE 0x400087AC RL_VALUE_UWORD 0 NO_COMPU_METHOD 0 65535 /end CHARACTERISTIC
/begin CHARACTERISTIC CAL_ac_compressor_engine_speed2 "Calibration: A/C compressor engine speed2 (RPM = val*125/4+500; 2-element array)." VAL_BLK 0x400087AE RL_VALUE_UBYTE 0 CM_u8_rspeed_125_4_500rpm 500 8468.75 NUMBER 2 /end CHARACTERISTIC
/begin CHARACTERISTIC CAL_ac_compressor_runtime_min "Calibration: A/C compressor runtime minimum (ms = val*5)." VALUE 0x400087B0 RL_VALUE_UWORD 0 CM_u8_time_5ms 0 327675 /end CHARACTERISTIC
/begin CHARACTERISTIC CAL_load_learning_stabilization_delay "Calibration: load learning stabilization delay." VALUE 0x400087B2 RL_VALUE_UWORD 0 NO_COMPU_METHOD 0 65535 /end CHARACTERISTIC
/begin CHARACTERISTIC CAL_tps_idle_to_current_ratio_threshold "Calibration: throttle position idle to current ratio threshold (2-element array)." VAL_BLK 0x400087B4 RL_VALUE_UWORD 0 NO_COMPU_METHOD 0 65535 NUMBER 2 /end CHARACTERISTIC
/begin CHARACTERISTIC CAL_load_alphaN_learning_mass_accum_threshold "Calibration: load alphaN learning mass accum threshold (mg)." VALUE 0x400087B8 RL_VALUE_UWORD 0 CM_u16_mass_mg 0 65535 /end CHARACTERISTIC
/begin CHARACTERISTIC CAL_load_learning_holdoff_delay "Calibration: load learning holdoff delay." VALUE 0x400087BA RL_VALUE_UWORD 0 NO_COMPU_METHOD 0 65535 /end CHARACTERISTIC
/begin CHARACTERISTIC CAL_cruise_accel_pedal_override_threshold_exit "Calibration: cruise accelerator pedal override threshold exit (val/1023)." VALUE 0x400087BC RL_VALUE_UBYTE 0 CM_u16_factor_1_1023 0 24.9266862170088 /end CHARACTERISTIC
/begin CHARACTERISTIC CAL_cruise_accel_pedal_override_threshold_enter "Calibration: cruise accelerator pedal override threshold enter (val/1023)." VALUE 0x400087BD RL_VALUE_UBYTE 0 CM_u16_factor_1_1023 0 24.9266862170088 /end CHARACTERISTIC
/begin CHARACTERISTIC CAL_ecu_2gr_cylinder_air_mass_mg "Calibration: ECU 2gr cylinder air mass mg (mg)." VALUE 0x400087BE RL_VALUE_UWORD 0 CM_u16_mass_mg 0 65535 /end CHARACTERISTIC
/begin CHARACTERISTIC CAL_ecu_2gr_cylinder_air_mass_mg_obd_ii "Calibration: ECU 2gr cylinder air mass mg OBD-II (mg)." VALUE 0x400087C0 RL_VALUE_UWORD 0 CM_u16_mass_mg 0 65535 /end CHARACTERISTIC
/begin CHARACTERISTIC CAL_idle_air_control_unknown "undefined1" VALUE 0x400087C3 RL_VALUE_UBYTE 0 NO_COMPU_METHOD 0 255 /end CHARACTERISTIC
/begin CHARACTERISTIC CAL_vehicle_moving_speed_min "Calibration: vehicle moving speed minimum (km/h)." VALUE 0x400087C5 RL_VALUE_UBYTE 0 CM_u8_speed_kph 0 255 /end CHARACTERISTIC
/begin CHARACTERISTIC CAL_idle_unknown2 "u8_rspeed_8rpm" VALUE 0x400087C7 RL_VALUE_UBYTE 0 CM_u8_rspeed_8rpm 0 2040 /end CHARACTERISTIC
/begin CHARACTERISTIC CAL_idle_unknown1 "u8_rspeed_8rpm" VALUE 0x400087C8 RL_VALUE_UBYTE 0 CM_u8_rspeed_8rpm 0 2040 /end CHARACTERISTIC
/begin CHARACTERISTIC CAL_closedloop_prop_gain_lean_slow_switch_scale "undefined1" VALUE 0x400087C9 RL_VALUE_UBYTE 0 NO_COMPU_METHOD 0 255 /end CHARACTERISTIC
/begin CHARACTERISTIC CAL_obd_ii_o2_response_load_stability_max "undefined1" VALUE 0x400087CA RL_VALUE_UBYTE 0 NO_COMPU_METHOD 0 255 /end CHARACTERISTIC
/begin CHARACTERISTIC CAL_sensor_maf_buffer_size "Calibration: sensor MAF buffer size." VALUE 0x400087CC RL_VALUE_UBYTE 0 NO_COMPU_METHOD 0 255 /end CHARACTERISTIC
/begin CHARACTERISTIC CAL_cruise_resume_timer "Calibration: cruise resume timer (ms = val*10)." VALUE 0x400087CD RL_VALUE_UBYTE 0 CM_u8_time_10ms 0 2550 /end CHARACTERISTIC
/begin CHARACTERISTIC CAL_injtip_comp_base "Calibration: injector tip-in compensation base." VALUE 0x400087CE RL_VALUE_UBYTE 0 NO_COMPU_METHOD 0 255 /end CHARACTERISTIC
/begin CHARACTERISTIC CAL_tps_delta_rate_window_size "Calibration: throttle position delta rate window size." VALUE 0x400087CF RL_VALUE_UBYTE 0 NO_COMPU_METHOD 0 255 /end CHARACTERISTIC
/begin CHARACTERISTIC CAL_injtip_tipin_decay_rate_divider "Calibration: injector tip-in tipin decay rate divider." VALUE 0x400087D0 RL_VALUE_UBYTE 0 NO_COMPU_METHOD 0 255 /end CHARACTERISTIC
/begin CHARACTERISTIC CAL_injtip_tipout_decay_rate_divider "Calibration: injector tip-in tipout decay rate divider." VALUE 0x400087D1 RL_VALUE_UBYTE 0 NO_COMPU_METHOD 0 255 /end CHARACTERISTIC
/begin CHARACTERISTIC CAL_injtip_in_threshold "Calibration: injector tip-in in threshold (val/1023; 2-element array)." VAL_BLK 0x400087D2 RL_VALUE_UWORD 0 CM_u16_factor_1_1023 0 6406.15835777126 NUMBER 2 /end CHARACTERISTIC
/begin CHARACTERISTIC CAL_injtip_out_threshold "Calibration: injector tip-in out threshold (val/1023; 2-element array)." VAL_BLK 0x400087D6 RL_VALUE_UWORD 0 CM_u16_factor_1_1023 0 6406.15835777126 NUMBER 2 /end CHARACTERISTIC
/begin CHARACTERISTIC CAL_closedloop_stft_ramp_interval_manual "undefined1" VALUE 0x400087DA RL_VALUE_UBYTE 0 NO_COMPU_METHOD 0 255 /end CHARACTERISTIC
/begin CHARACTERISTIC CAL_closedloop_proportional_gain_scale "Calibration: closedloop proportional gain scale (val/64)." VALUE 0x400087DB RL_VALUE_UBYTE 0 CM_u8_factor_1_64 0 398.4375 /end CHARACTERISTIC
/begin CHARACTERISTIC CAL_closedloop_fuel_learn_iat_max "Calibration: closedloop fuel learn intake air temp maximum (°C = val*5/8−40)." VALUE 0x400087DC RL_VALUE_UBYTE 0 CM_u8_temp_5_8_40c -40 119.375 /end CHARACTERISTIC
/begin CHARACTERISTIC CAL_cluster_shift_light_deadband_rpm "Calibration: cluster shift light deadband RPM (RPM)." VALUE 0x400087DE RL_VALUE_UWORD 0 CM_u16_rspeed_rpm 0 65535 /end CHARACTERISTIC
/begin CHARACTERISTIC CAL_tps_warmup_max "u16_factor_1/1023" VALUE 0x400087E0 RL_VALUE_UWORD 0 CM_u16_factor_1_1023 0 6406.15835777126 /end CHARACTERISTIC
/begin CHARACTERISTIC CAL_tps_min "Effective TPS floor. TPS never be commanded less than this." VALUE 0x400087E2 RL_VALUE_UWORD 0 CM_u16_factor_1_1023 0 6406.15835777126 /end CHARACTERISTIC
/begin CHARACTERISTIC CAL_idle_tps_max_opening "Calibration: idle throttle position maximum opening (val/1023)." VALUE 0x400087E4 RL_VALUE_UWORD 0 CM_u16_factor_1_1023 0 6406.15835777126 /end CHARACTERISTIC
/begin CHARACTERISTIC CAL_injtip_dfco_disable_accel_pedal "Calibration: injector tip-in decel fuel cut-off disable accelerator pedal (val/1023)." VALUE 0x400087E6 RL_VALUE_UBYTE 0 CM_u16_factor_1_1023 0 24.9266862170088 /end CHARACTERISTIC
/begin CHARACTERISTIC CAL_injtip_dfco_enable_accel_pedal "Calibration: injector tip-in decel fuel cut-off enable accelerator pedal (val/1023)." VALUE 0x400087E7 RL_VALUE_UBYTE 0 CM_u16_factor_1_1023 0 24.9266862170088 /end CHARACTERISTIC
/begin CHARACTERISTIC CAL_cluster_fuel_level_zero_clip_threshold "Calibration: cluster fuel level zero clip threshold (gal = val/10)." VALUE 0x400087E8 RL_VALUE_UWORD 0 CM_u8_volume_1_10gallon 0 6553.5 /end CHARACTERISTIC
/begin CHARACTERISTIC CAL_fuel_level_filter_coeff_fall "undefined1" VALUE 0x400087E9 RL_VALUE_UBYTE 0 NO_COMPU_METHOD 0 255 /end CHARACTERISTIC
/begin CHARACTERISTIC CAL_cruise_integrator_clamp "undefined1" VALUE 0x400087EA RL_VALUE_UBYTE 0 NO_COMPU_METHOD 0 255 /end CHARACTERISTIC
/begin CHARACTERISTIC CAL_cruise_derivative_clamp "undefined1" VALUE 0x400087EB RL_VALUE_UBYTE 0 NO_COMPU_METHOD 0 255 /end CHARACTERISTIC
/begin CHARACTERISTIC CAL_injtip_dfco_enable_temp "Calibration: injector tip-in decel fuel cut-off enable temperature (°C = val*5/8−40)." VALUE 0x400087EC RL_VALUE_UBYTE 0 CM_u8_temp_5_8_40c -40 119.375 /end CHARACTERISTIC
/begin CHARACTERISTIC CAL_injtip_dfco_disable_temp "Calibration: injector tip-in decel fuel cut-off disable temperature (°C = val*5/8−40)." VALUE 0x400087ED RL_VALUE_UBYTE 0 CM_u8_temp_5_8_40c -40 119.375 /end CHARACTERISTIC
/begin CHARACTERISTIC CAL_dfco_cyl_ramp_length "undefined1" VALUE 0x400087EE RL_VALUE_UBYTE 0 NO_COMPU_METHOD 0 255 /end CHARACTERISTIC
/begin CHARACTERISTIC CAL_injtip_dfco_min_runtime "Calibration: injector tip-in decel fuel cut-off minimum runtime (ms = val*50)." VALUE 0x400087F1 RL_VALUE_UBYTE 0 CM_u8_time_50ms 0 12750 /end CHARACTERISTIC
/begin CHARACTERISTIC CAL_load_alphaN_max_rpm "Calibration: load alphaN maximum RPM (RPM)." VALUE 0x400087F2 RL_VALUE_UWORD 0 CM_u16_rspeed_rpm 0 65535 /end CHARACTERISTIC
/begin CHARACTERISTIC CAL_load_alphaN_tps_rate_closing_threshold "Calibration: load alphaN throttle position rate closing threshold (val/255)." VALUE 0x400087F4 RL_VALUE_UWORD 0 CM_u8_factor_1_255 0 25700 /end CHARACTERISTIC
/begin CHARACTERISTIC CAL_evap_commanded_purge_unknown "Calibration: evaporative commanded purge (val/255)." VALUE 0x400087FA RL_VALUE_UWORD 0 CM_u8_factor_1_255 0 25700 /end CHARACTERISTIC
/begin CHARACTERISTIC CAL_closedloop_fuel_learn_baro_min "Calibration: closedloop fuel learn baro minimum (mbar)." VALUE 0x400087FC RL_VALUE_UWORD 0 CM_u16_pressure_mbar 0 65535 /end CHARACTERISTIC
/begin CHARACTERISTIC CAL_obd_ii_commanded_evap_purge_max "undefined1" VALUE 0x40008802 RL_VALUE_UBYTE 0 NO_COMPU_METHOD 0 255 /end CHARACTERISTIC
/begin CHARACTERISTIC CAL_obd_ii_commanded_evap_purge_min "undefined1" VALUE 0x40008803 RL_VALUE_UBYTE 0 NO_COMPU_METHOD 0 255 /end CHARACTERISTIC
/begin CHARACTERISTIC CAL_vvt_pwm_driver_divisor "Calibration: VVT PWM driver divisor." VALUE 0x40008804 RL_VALUE_UWORD 0 NO_COMPU_METHOD 0 65535 /end CHARACTERISTIC
/begin CHARACTERISTIC CAL_exhaust_flap_sport_mode_enable "Calibration: exhaust flap sport mode enable (boolean flag)." VALUE 0x40008806 RL_VALUE_UBYTE 0 NO_COMPU_METHOD 0 255 /end CHARACTERISTIC
/begin CHARACTERISTIC CAL_exhaust_flap_tour_mode_enable "Calibration: exhaust flap tour mode enable (boolean flag)." VALUE 0x40008807 RL_VALUE_UBYTE 0 NO_COMPU_METHOD 0 255 /end CHARACTERISTIC
/begin CHARACTERISTIC CAL_cruise_speed_error_limit "Calibration: cruise speed error limit (km/h)." VALUE 0x4000880E RL_VALUE_UBYTE 0 CM_u8_speed_kph 0 255 /end CHARACTERISTIC
/begin CHARACTERISTIC CAL_cruise_integral_term_limit "Calibration: cruise integral term limit (val/100)." VALUE 0x4000880F RL_VALUE_UBYTE 0 CM_u8_factor_1_100 0 255 /end CHARACTERISTIC
/begin CHARACTERISTIC CAL_cruise_derivative_term_limit "Calibration: cruise derivative term limit (val/100)." VALUE 0x40008810 RL_VALUE_UBYTE 0 CM_u8_factor_1_100 0 255 /end CHARACTERISTIC
/begin CHARACTERISTIC CAL_injtip_dfco_enable_rpm_manual_clutch_disengage "Calibration: injector tip-in decel fuel cut-off enable RPM manual clutch disengage (RPM = val*10)." VALUE 0x40008811 RL_VALUE_UBYTE 0 CM_u8_rspeed_10rpm 0 2550 /end CHARACTERISTIC
/begin CHARACTERISTIC CAL_vvt_error_gain_startup "Calibration: VVT error gain startup (val/255)." VALUE 0x40008812 RL_VALUE_UWORD 0 CM_u8_factor_1_255 0 25700 /end CHARACTERISTIC
/begin CHARACTERISTIC CAL_vvt_integral_gain "Calibration: VVT integral gain." VALUE 0x40008814 RL_VALUE_UWORD 0 NO_COMPU_METHOD 0 65535 /end CHARACTERISTIC
/begin CHARACTERISTIC CAL_idle_flow_adj1_maf_accum_max "undefined2" VALUE 0x40008816 RL_VALUE_UWORD 0 NO_COMPU_METHOD 0 65535 /end CHARACTERISTIC
/begin CHARACTERISTIC CAL_closedloop_stft_increment_period "Calibration: closedloop short-term fuel trim increment period (ms = val*5)." VALUE 0x40008818 RL_VALUE_UBYTE 0 CM_u8_time_5ms 0 1275 /end CHARACTERISTIC
/begin CHARACTERISTIC CAL_cooling_recirc_enginespeed_disable_engine_on "Calibration: cooling recirc enginespeed disable engine on (RPM)." VALUE 0x4000881A RL_VALUE_UWORD 0 CM_u16_rspeed_rpm 0 65535 /end CHARACTERISTIC
/begin CHARACTERISTIC CAL_revlimit_fuelcut_hysteresis "Calibration: rev-limit fuelcut hysteresis (RPM)." VALUE 0x40008820 RL_VALUE_UWORD 0 CM_u16_rspeed_rpm 0 65535 /end CHARACTERISTIC
/begin CHARACTERISTIC CAL_load_alphaN_tps_rate_opening_threshold "Calibration: load alphaN throttle position rate opening threshold (val/255)." VALUE 0x40008822 RL_VALUE_UWORD 0 CM_u8_factor_1_255 0 25700 /end CHARACTERISTIC
/begin CHARACTERISTIC CAL_trans_gear_lookup_unknown2 "Calibration: transmission gear lookup unknown2 (2-element array)." VAL_BLK 0x40008824 RL_VALUE_UWORD 0 NO_COMPU_METHOD 0 65535 NUMBER 2 /end CHARACTERISTIC
/begin CHARACTERISTIC CAL_evap_purge_power_enrich_suspend_timeout "undefined1" VALUE 0x40008829 RL_VALUE_UBYTE 0 NO_COMPU_METHOD 0 255 /end CHARACTERISTIC
/begin CHARACTERISTIC CAL_inj_fuel_learn_offset_maf_max "u16_flow_10mg/s" VALUE 0x4000882A RL_VALUE_UWORD 0 CM_u16_flow_10mg_s 0 655350 /end CHARACTERISTIC
/begin CHARACTERISTIC CAL_inj_fuel_learn_zone_2_maf_max "u16_flow_10mg/s" VALUE 0x4000882E RL_VALUE_UWORD 0 CM_u16_flow_10mg_s 0 655350 /end CHARACTERISTIC
/begin CHARACTERISTIC CAL_inj_fuel_learn_zone_2_maf_min "u16_flow_10mg/s" VALUE 0x40008830 RL_VALUE_UWORD 0 CM_u16_flow_10mg_s 0 655350 /end CHARACTERISTIC
/begin CHARACTERISTIC CAL_inj_fuel_learn_zone_2_load_max "undefined2" VALUE 0x40008832 RL_VALUE_UWORD 0 NO_COMPU_METHOD 0 65535 /end CHARACTERISTIC
/begin CHARACTERISTIC CAL_inj_fuel_learn_zone_2_load_min "undefined2" VALUE 0x40008834 RL_VALUE_UWORD 0 NO_COMPU_METHOD 0 65535 /end CHARACTERISTIC
/begin CHARACTERISTIC CAL_inj_fuel_learn_zone_3_maf_min "u16_flow_10mg/s" VALUE 0x40008836 RL_VALUE_UWORD 0 CM_u16_flow_10mg_s 0 655350 /end CHARACTERISTIC
/begin CHARACTERISTIC CAL_inj_fuel_learn_zone_3_load_min "undefined2" VALUE 0x40008838 RL_VALUE_UWORD 0 NO_COMPU_METHOD 0 65535 /end CHARACTERISTIC
/begin CHARACTERISTIC CAL_closedloop_fuel_learn_coolant_min "Calibration: closedloop fuel learn coolant minimum (°C = val*5/8−40)." VALUE 0x4000883A RL_VALUE_UBYTE 0 CM_u8_temp_5_8_40c -40 119.375 /end CHARACTERISTIC
/begin CHARACTERISTIC CAL_inj_fuel_learn_step_period "undefined1" VALUE 0x4000883B RL_VALUE_UBYTE 0 NO_COMPU_METHOD 0 255 /end CHARACTERISTIC
/begin CHARACTERISTIC CAL_inj_fuel_learn_stft_rich_limit "undefined2" VALUE 0x4000883E RL_VALUE_UWORD 0 NO_COMPU_METHOD 0 65535 /end CHARACTERISTIC
/begin CHARACTERISTIC CAL_inj_fuel_learn_lean_time_limit "undefined1" VALUE 0x40008840 RL_VALUE_UBYTE 0 NO_COMPU_METHOD 0 255 /end CHARACTERISTIC
/begin CHARACTERISTIC CAL_inj_fuel_learn_rich_time_limit "undefined1" VALUE 0x40008841 RL_VALUE_UBYTE 0 NO_COMPU_METHOD 0 255 /end CHARACTERISTIC
/begin CHARACTERISTIC CAL_inj_fuel_learn_zone_2_max "undefined1" VALUE 0x40008842 RL_VALUE_UBYTE 0 NO_COMPU_METHOD 0 255 /end CHARACTERISTIC
/begin CHARACTERISTIC CAL_inj_fuel_learn_zone_2_min "undefined1" VALUE 0x40008843 RL_VALUE_UBYTE 0 NO_COMPU_METHOD 0 255 /end CHARACTERISTIC
/begin CHARACTERISTIC CAL_inj_fuel_learn_zone_3_max "undefined1" VALUE 0x40008844 RL_VALUE_UBYTE 0 NO_COMPU_METHOD 0 255 /end CHARACTERISTIC
/begin CHARACTERISTIC CAL_inj_fuel_learn_zone_3_min "undefined1" VALUE 0x40008845 RL_VALUE_UBYTE 0 NO_COMPU_METHOD 0 255 /end CHARACTERISTIC
/begin CHARACTERISTIC CAL_closedloop_proportional_gain_rich_ips "Calibration: closedloop proportional gain rich IPS." VALUE 0x40008846 RL_VALUE_UWORD 0 NO_COMPU_METHOD 0 65535 /end CHARACTERISTIC
/begin CHARACTERISTIC CAL_closedloop_proportional_gain_lean_ips "Calibration: closedloop proportional gain lean IPS." VALUE 0x40008848 RL_VALUE_UWORD 0 NO_COMPU_METHOD 0 65535 /end CHARACTERISTIC
/begin CHARACTERISTIC CAL_closedloop_integral_gain_ips "Calibration: closedloop integral gain IPS." VALUE 0x4000884A RL_VALUE_UWORD 0 NO_COMPU_METHOD 0 65535 /end CHARACTERISTIC
/begin CHARACTERISTIC CAL_closedloop_derivative_gain_ips "Calibration: closedloop derivative gain IPS." VALUE 0x4000884C RL_VALUE_UWORD 0 NO_COMPU_METHOD 0 65535 /end CHARACTERISTIC
/begin CHARACTERISTIC CAL_closedloop_o2_sensor_threshold_rich "Calibration: closedloop O2 sensor threshold rich (V = val*5/1023)." VALUE 0x4000884E RL_VALUE_UWORD 0 CM_u16_voltage_5_1023v 0 320.307917888563 /end CHARACTERISTIC
/begin CHARACTERISTIC CAL_closedloop_o2_sensor_threshold_lean "Calibration: closedloop O2 sensor threshold lean (V = val*5/1023)." VALUE 0x40008850 RL_VALUE_UWORD 0 CM_u16_voltage_5_1023v 0 320.307917888563 /end CHARACTERISTIC
/begin CHARACTERISTIC CAL_revlimit_startup_offset_decrement "Calibration: rev-limit startup offset decrement." VALUE 0x40008854 RL_VALUE_UBYTE 0 NO_COMPU_METHOD 0 255 /end CHARACTERISTIC
/begin CHARACTERISTIC CAL_fuel_level_change_threshold "Calibration: fuel level change threshold (gal = val/10)." VALUE 0x40008855 RL_VALUE_UWORD 0 CM_u8_volume_1_10gallon 0 6553.5 /end CHARACTERISTIC
/begin CHARACTERISTIC CAL_tps_idle_request_max "u16_factor_1/4095" VALUE 0x40008856 RL_VALUE_UWORD 0 CM_u16_factor_1_4095 0 1600.3663003663 /end CHARACTERISTIC
/begin CHARACTERISTIC CAL_idle_rpm_ramp_step "uint8_t" VALUE 0x40008858 RL_VALUE_UBYTE 0 NO_COMPU_METHOD 0 255 /end CHARACTERISTIC
/begin CHARACTERISTIC CAL_tps_limit_severe_misfire_1_cut "u8_factor_1/255" VALUE 0x40008859 RL_VALUE_UBYTE 0 CM_u8_factor_1_255 0 100 /end CHARACTERISTIC
/begin CHARACTERISTIC CAL_ign_zero_load_threshold "Calibration: ignition zero load threshold (mg/stroke = val*4)." VALUE 0x4000885C RL_VALUE_UBYTE 0 CM_u8_load_4mg_stroke 0 1020 /end CHARACTERISTIC
/begin CHARACTERISTIC CAL_ign_zero_gear "Calibration: ignition zero gear." VALUE 0x4000885D RL_VALUE_UBYTE 0 NO_COMPU_METHOD 0 255 /end CHARACTERISTIC
/begin CHARACTERISTIC CAL_ign_comp_recovery_timer "Calibration: ignition compensation recovery timer (ms = val*5)." VALUE 0x4000885E RL_VALUE_UBYTE 0 CM_u8_time_5ms 0 1275 /end CHARACTERISTIC
/begin CHARACTERISTIC CAL_torque_tps_gain "u8_factor_1/255" VALUE 0x4000885F RL_VALUE_UBYTE 0 CM_u8_factor_1_255 0 100 /end CHARACTERISTIC
/begin CHARACTERISTIC CAL_cruise_speed_limit "Calibration: cruise speed limit (km/h; 2-element array)." VAL_BLK 0x40008860 RL_VALUE_UBYTE 0 CM_u8_speed_kph 0 255 NUMBER 2 /end CHARACTERISTIC
/begin CHARACTERISTIC CAL_cruise_speed_deadband "Calibration: cruise speed deadband (km/h)." VALUE 0x40008864 RL_VALUE_UBYTE 0 CM_u8_speed_kph 0 255 /end CHARACTERISTIC
/begin CHARACTERISTIC CAL_cruise_speed_increment "Calibration: cruise speed increment (km/h = val/100)." VALUE 0x40008865 RL_VALUE_UBYTE 0 CM_u8_speed_1_100kph 0 2.55 /end CHARACTERISTIC
/begin CHARACTERISTIC CAL_cruise_speed_decrement "Calibration: cruise speed decrement (km/h = val/100)." VALUE 0x40008866 RL_VALUE_UBYTE 0 CM_u8_speed_1_100kph 0 2.55 /end CHARACTERISTIC
/begin CHARACTERISTIC CAL_tps_limit_severe_misfire_multi_cut "u8_factor_1/255" VALUE 0x40008867 RL_VALUE_UBYTE 0 CM_u8_factor_1_255 0 100 /end CHARACTERISTIC
/begin CHARACTERISTIC CAL_tps_limit_severe_misfire_1_cut_40008868 "u8_factor_1/255" VALUE 0x40008868 RL_VALUE_UBYTE 0 CM_u8_factor_1_255 0 100 /end CHARACTERISTIC
/begin CHARACTERISTIC CAL_tps_limit_severe_misfire_no_cut "u8_factor_1/255" VALUE 0x40008869 RL_VALUE_UBYTE 0 CM_u8_factor_1_255 0 100 /end CHARACTERISTIC
/begin CHARACTERISTIC CAL_cruise_speed_increment2 "Calibration: cruise speed increment2 (km/h = val/10)." VALUE 0x4000886C RL_VALUE_UBYTE 0 CM_u8_speed_1_10kph 0 25.5 /end CHARACTERISTIC
/begin CHARACTERISTIC CAL_cruise_airflow_slew_step "undefined1" VALUE 0x4000886D RL_VALUE_UBYTE 0 NO_COMPU_METHOD 0 255 /end CHARACTERISTIC
/begin CHARACTERISTIC CAL_tps_limit_warmup_stepsize "Calibration: throttle position limit warmup stepsize (val/1023)." VALUE 0x40008871 RL_VALUE_UBYTE 0 CM_u16_factor_1_1023 0 24.9266862170088 /end CHARACTERISTIC
/begin CHARACTERISTIC CAL_ecu_brake_or_clutch_inactive_timer "Calibration: ECU brake or clutch inactive timer (ms = val*5)." VALUE 0x40008875 RL_VALUE_UBYTE 0 CM_u8_time_5ms 0 1275 /end CHARACTERISTIC
/begin CHARACTERISTIC CAL_torque_limit_tps_filter_coeff "u8_factor_1/1023" VALUE 0x40008876 RL_VALUE_UBYTE 0 CM_u16_factor_1_1023 0 24.9266862170088 /end CHARACTERISTIC
/begin CHARACTERISTIC CAL_tmap_use_for_inj "Calibration: TMAP use for injector (boolean flag)." VALUE 0x40008877 RL_VALUE_UBYTE 0 NO_COMPU_METHOD 0 255 /end CHARACTERISTIC
/begin CHARACTERISTIC CAL_load_cylinder_volume "Calibration: load cylinder volume (cc)." VALUE 0x40008878 RL_VALUE_UWORD 0 CM_u16_volume_cc 0 65535 /end CHARACTERISTIC
/begin CHARACTERISTIC CAL_cooling_recirc_airtemp_disable_engine_on "Calibration: cooling recirc airtemp disable engine on (°C = val*5/8−40)." VALUE 0x4000887A RL_VALUE_UBYTE 0 CM_u8_temp_5_8_40c -40 119.375 /end CHARACTERISTIC
/begin CHARACTERISTIC CAL_ac_compressor_speed_filter_coeff "undefined1" VALUE 0x4000887B RL_VALUE_UBYTE 0 NO_COMPU_METHOD 0 255 /end CHARACTERISTIC
/begin CHARACTERISTIC CAL_cooling_recirc_rpm_enable_engine_on "Calibration: cooling recirc RPM enable engine on (RPM)." VALUE 0x4000887C RL_VALUE_UWORD 0 CM_u16_rspeed_rpm 0 65535 /end CHARACTERISTIC
/begin CHARACTERISTIC CAL_tpssmooth_decrement_comp_gears_ips "Calibration: tpssmooth decrement compensation gears IPS (val/255; 7-element array)." VAL_BLK 0x4000887E RL_VALUE_UBYTE 0 CM_u8_factor_1_255 0 100 NUMBER 7 /end CHARACTERISTIC
/begin CHARACTERISTIC CAL_ign_idle_mode_holdover_time "hold-over timer that keeps the idle/cruise ignition modes selectable for a window after a fuel cut ends." VALUE 0x40008885 RL_VALUE_UBYTE 0 CM_u8_time_10ms 0 2550 /end CHARACTERISTIC
/begin CHARACTERISTIC CAL_closedloop_engine_run_learn_timer_unknown "Calibration: closedloop engine run learn timer (hours)." VALUE 0x40008886 RL_VALUE_UBYTE 0 CM_u8_time_hours 0 255 /end CHARACTERISTIC
/begin CHARACTERISTIC CAL_closedloop_integral_gain_scale_manual "Calibration: closedloop integral gain scale manual (val/255)." VALUE 0x40008887 RL_VALUE_UBYTE 0 CM_u8_factor_1_255 0 100 /end CHARACTERISTIC
/begin CHARACTERISTIC CAL_closedloop_entry_delay_power_enrich "Calibration: closedloop entry delay power enrich (ms)." VALUE 0x40008888 RL_VALUE_UBYTE 0 CM_u8_time_ms 0 255 /end CHARACTERISTIC
/begin CHARACTERISTIC CAL_idle_air_fast_decay_period "undefined1" VALUE 0x40008889 RL_VALUE_UBYTE 0 NO_COMPU_METHOD 0 255 /end CHARACTERISTIC
/begin CHARACTERISTIC CAL_exhaust_flap_RPM_threshold_open "Calibration: exhaust flap RPM threshold open (RPM)." VALUE 0x4000888A RL_VALUE_UWORD 0 CM_u16_rspeed_rpm 0 65535 /end CHARACTERISTIC
/begin CHARACTERISTIC CAL_exhaust_flap_RPM_threshold_close "Calibration: exhaust flap RPM threshold close (RPM)." VALUE 0x4000888C RL_VALUE_UWORD 0 CM_u16_rspeed_rpm 0 65535 /end CHARACTERISTIC
/begin CHARACTERISTIC CAL_closedloop_entry_delay_time_cruise "Calibration: closedloop entry delay time cruise (ms)." VALUE 0x4000888E RL_VALUE_UBYTE 0 CM_u8_time_ms 0 255 /end CHARACTERISTIC
/begin CHARACTERISTIC CAL_exhaust_flap_startup_threshold "Calibration: exhaust flap startup threshold (ms = val*100)." VALUE 0x40008893 RL_VALUE_UBYTE 0 CM_u8_time_100ms 0 25500 /end CHARACTERISTIC
/begin CHARACTERISTIC CAL_revlimit_flow_proportional_limit "Calibration: rev-limit flow proportional term (g)." VALUE 0x40008894 RL_VALUE_UBYTE 0 CM_u8_mass_g 0 255 /end CHARACTERISTIC
/begin CHARACTERISTIC CAL_revlimit_flow_integral_limit "Calibration: rev-limit flow unknown2 (g)." VALUE 0x40008895 RL_VALUE_UBYTE 0 CM_u8_mass_g 0 255 /end CHARACTERISTIC
/begin CHARACTERISTIC CAL_revlimit_maf_error_max_10g "Calibration: rev-limit MAF error maximum 10g." VALUE 0x40008896 RL_VALUE_UBYTE 0 NO_COMPU_METHOD 0 255 /end CHARACTERISTIC
/begin CHARACTERISTIC CAL_revlimit_integrator_limit "Calibration: rev-limit integrator limit (val/100)." VALUE 0x40008897 RL_VALUE_UBYTE 0 CM_u8_factor_1_100 0 255 /end CHARACTERISTIC
/begin CHARACTERISTIC CAL_revlimit_rpm_rate_limit "Calibration: rev-limit RPM rate limit (RPM = val*25)." VALUE 0x40008898 RL_VALUE_UBYTE 0 CM_u8_rspeed_25rpm 0 6375 /end CHARACTERISTIC
/begin CHARACTERISTIC CAL_revlimit_flow_rpm_rate_limit "u8_factor_1/100" VALUE 0x40008899 RL_VALUE_UBYTE 0 CM_u8_factor_1_100 0 255 /end CHARACTERISTIC
/begin CHARACTERISTIC CAL_roughness_enable_rpm "Calibration: roughness enable RPM (RPM = val/4; 2-element array)." VAL_BLK 0x4000889A RL_VALUE_UWORD 0 CM_u16_rspeed_1_4rpm 0 16383.75 NUMBER 2 /end CHARACTERISTIC
/begin CHARACTERISTIC CAL_roughness_enable_load "Calibration: roughness enable load (mg/stroke = val*4; 2-element array)." VAL_BLK 0x4000889E RL_VALUE_UBYTE 0 CM_u8_load_4mg_stroke 0 1020 NUMBER 2 /end CHARACTERISTIC
/begin CHARACTERISTIC CAL_roughness_delta_rpm_smoothing_factor "Calibration: roughness delta RPM smoothing factor (val/100)." VALUE 0x400088A2 RL_VALUE_UBYTE 0 CM_u8_factor_1_100 0 255 /end CHARACTERISTIC
/begin CHARACTERISTIC CAL_roughness_min_edge_count "undefined1" VALUE 0x400088A3 RL_VALUE_UBYTE 0 NO_COMPU_METHOD 0 255 /end CHARACTERISTIC
/begin CHARACTERISTIC CAL_roughness_cycle_count_threshold "Calibration: roughness cycle count threshold." VALUE 0x400088A4 RL_VALUE_UBYTE 0 NO_COMPU_METHOD 0 255 /end CHARACTERISTIC
/begin CHARACTERISTIC CAL_roughness_peak_valley_imblance_threshold "Calibration: roughness peak valley imblance threshold." VALUE 0x400088A7 RL_VALUE_UBYTE 0 NO_COMPU_METHOD 0 255 /end CHARACTERISTIC
/begin CHARACTERISTIC CAL_roughness_ign_adv_min_sign_flipped "Calibration: roughness ignition adv minimum sign flipped (° = val/4)." VALUE 0x400088AA RL_VALUE_UBYTE 0 CM_u8_angle_1_4deg 0 63.75 /end CHARACTERISTIC
/begin CHARACTERISTIC CAL_roughness_ign_adv_max "Calibration: roughness ignition adv maximum (° = val/4)." VALUE 0x400088AB RL_VALUE_UBYTE 0 CM_u8_angle_1_4deg 0 63.75 /end CHARACTERISTIC
/begin CHARACTERISTIC CAL_wheel_speed_front_dvdt_scaling "Calibration: wheel speed front dvdt scaling (val/255)." VALUE 0x400088AD RL_VALUE_UBYTE 0 CM_u8_factor_1_255 0 100 /end CHARACTERISTIC
/begin CHARACTERISTIC CAL_ecu_wheelspeed_update_timer "Calibration: ECU wheelspeed update timer (ms = val*5)." VALUE 0x400088AE RL_VALUE_UBYTE 0 CM_u8_time_5ms 0 1275 /end CHARACTERISTIC
/begin CHARACTERISTIC CAL_cruise_integral_gearchange_retain "u8_factor_1/255" VALUE 0x400088AF RL_VALUE_UBYTE 0 CM_u8_factor_1_255 0 100 /end CHARACTERISTIC
/begin CHARACTERISTIC CAL_cruise_integral_freeze_accel "uint8_t" VALUE 0x400088B0 RL_VALUE_UBYTE 0 NO_COMPU_METHOD 0 255 /end CHARACTERISTIC
/begin CHARACTERISTIC CAL_revlimit_throttle_clamp "Calibration: rev-limit throttle clamp (boolean flag)." VALUE 0x400088B1 RL_VALUE_UBYTE 0 NO_COMPU_METHOD 0 255 /end CHARACTERISTIC
/begin CHARACTERISTIC CAL_revlimit_release_rpm_delta "Calibration: rev-limit scaler (RPM = val*10)." VALUE 0x400088B2 RL_VALUE_UBYTE 0 CM_u8_rspeed_10rpm 0 2550 /end CHARACTERISTIC
/begin CHARACTERISTIC CAL_revlimit_overspeed_time "Calibration: rev-limit overspeed time (ms = val*100)." VALUE 0x400088B3 RL_VALUE_UBYTE 0 CM_u8_time_100ms 0 25500 /end CHARACTERISTIC
/begin CHARACTERISTIC CAL_revlimit_max_with_speedlimit "Calibration: rev-limit maximum with speedlimit (RPM)." VALUE 0x400088B4 RL_VALUE_UWORD 0 CM_u16_rspeed_rpm 0 65535 /end CHARACTERISTIC
/begin CHARACTERISTIC CAL_vehicle_speed_limit "Calibration: vehicle speed limit (km/h)." VALUE 0x400088B6 RL_VALUE_UBYTE 0 CM_u8_speed_kph 0 255 /end CHARACTERISTIC
/begin CHARACTERISTIC CAL_revlimit_overrun_count_threshold "Calibration: rev-limit overrun count threshold." VALUE 0x400088B7 RL_VALUE_UBYTE 0 NO_COMPU_METHOD 0 255 /end CHARACTERISTIC
/begin CHARACTERISTIC CAL_vehicle_speed_limit_enforce "Calibration: vehicle speed limit enforce (boolean flag)." VALUE 0x400088B8 RL_VALUE_UBYTE 0 NO_COMPU_METHOD 0 255 /end CHARACTERISTIC
/begin CHARACTERISTIC CAL_vehicle_speed_limit_enforce_margin "Calibration: vehicle speed limit enforce margin." VALUE 0x400088B9 RL_VALUE_UBYTE 0 NO_COMPU_METHOD 0 255 /end CHARACTERISTIC
/begin CHARACTERISTIC CAL_vehicle_standing_start_throttle_threshold "Calibration: vehicle standing start throttle threshold (val/1023)." VALUE 0x400088BA RL_VALUE_UWORD 0 CM_u16_factor_1_1023 0 6406.15835777126 /end CHARACTERISTIC
/begin CHARACTERISTIC CAL_ecu_engine_breakin_distance "Calibration: ECU engine breakin distance (km)." VALUE 0x400088BC RL_VALUE_UWORD 0 CM_u16_distance_km 0 65535 /end CHARACTERISTIC
/begin CHARACTERISTIC CAL_idle_rpm_ramp_step_ips "uint8_t" VALUE 0x400088BE RL_VALUE_UBYTE 0 NO_COMPU_METHOD 0 255 /end CHARACTERISTIC
/begin CHARACTERISTIC CAL_cruise_tps_accelerating_threshold "Calibration: cruise throttle position accelerating threshold (val/1023)." VALUE 0x400088BF RL_VALUE_UBYTE 0 CM_u16_factor_1_1023 0 24.9266862170088 /end CHARACTERISTIC
/begin CHARACTERISTIC CAL_cluster_brake_switch_max_speed_ips_unknown "Calibration: cluster brake switch maximum speed IPS (km/h)." VALUE 0x400088C0 RL_VALUE_UBYTE 0 CM_u8_speed_kph 0 255 /end CHARACTERISTIC
/begin CHARACTERISTIC CAL_ign_fixed_timing_ips "Calibration: ignition fixed timing IPS (° = val/4−10)." VALUE 0x400088C1 RL_VALUE_UBYTE 0 CM_u8_angle_1_4_10deg -10 53.75 /end CHARACTERISTIC
/begin CHARACTERISTIC CAL_knock_freq_band_centers "Calibration: knock freq band centers (11-element array)." VAL_BLK 0x400088C2 RL_VALUE_UWORD 0 NO_COMPU_METHOD 0 65535 NUMBER 11 /end CHARACTERISTIC
/begin CHARACTERISTIC CAL_tps_brake_wheeldecel_tps_cut_threshold "Calibration: throttle position brake wheeldecel throttle position cut threshold." VALUE 0x400088D8 RL_VALUE_UBYTE 0 NO_COMPU_METHOD 0 255 /end CHARACTERISTIC
/begin CHARACTERISTIC CAL_tps_brake_safety_floor "Calibration: throttle position brake safety floor (val/1023)." VALUE 0x400088D9 RL_VALUE_UBYTE 0 CM_u16_factor_1_1023 0 24.9266862170088 /end CHARACTERISTIC
/begin CHARACTERISTIC CAL_cruise_brake_cancel_time "Calibration: cruise brake cancel time (ms = val*10)." VALUE 0x400088DE RL_VALUE_UWORD 0 CM_u8_time_10ms 0 655350 /end CHARACTERISTIC
/begin CHARACTERISTIC CAL_knock_agc_scaling_threshold "Calibration: knock AGC scaling threshold." VALUE 0x400088E0 RL_VALUE_UWORD 0 NO_COMPU_METHOD 0 65535 /end CHARACTERISTIC
/begin CHARACTERISTIC CAL_knock_mode "Calibration: knock mode (enumerated state)." VALUE 0x400088E2 RL_VALUE_UBYTE 0 NO_COMPU_METHOD 0 255 /end CHARACTERISTIC
/begin CHARACTERISTIC CAL_dca_enable_untested "Drive Cycle Assist is a disabled throttle control mechanism in the T6E firmware. It has not been tested in the aftermarket and requires a special VIN in addition to this flag for activation. As of now, there is no reason to change it. The current the" VALUE 0x400088E3 RL_VALUE_UBYTE 0 NO_COMPU_METHOD 0 255 /end CHARACTERISTIC
/begin CHARACTERISTIC CAL_ecu_engine_speed_reference_enable "Calibration: ECU engine speed reference enable (boolean flag)." VALUE 0x400088E4 RL_VALUE_UBYTE 0 NO_COMPU_METHOD 0 255 /end CHARACTERISTIC
/begin CHARACTERISTIC CAL_vvt_low_load_disable "Calibration: VVT low load disable (boolean flag)." VALUE 0x400088E5 RL_VALUE_UBYTE 0 NO_COMPU_METHOD 0 255 /end CHARACTERISTIC
/begin CHARACTERISTIC CAL_obd_ii_diag_unknown "Calibration: OBD-II diag." VALUE 0x400088E6 RL_VALUE_UBYTE 0 NO_COMPU_METHOD 0 255 /end CHARACTERISTIC
/begin CHARACTERISTIC CAL_vvt_low_load_map_enable_temp "Calibration: VVT low load MAP enable temperature (°C = val*5/8−40)." VALUE 0x400088E7 RL_VALUE_UBYTE 0 CM_u8_temp_5_8_40c -40 119.375 /end CHARACTERISTIC
/begin CHARACTERISTIC CAL_tpssmooth_accel_pedal_modes_enable "Calibration: tpssmooth accelerator pedal modes enable (boolean flag)." VALUE 0x400088E9 RL_VALUE_UBYTE 0 NO_COMPU_METHOD 0 255 /end CHARACTERISTIC
/begin CHARACTERISTIC CAL_oil_pressure_warning_light_mode "Calibration: oil pressure warning light mode (enumerated state)." VALUE 0x400088EA RL_VALUE_UBYTE 0 NO_COMPU_METHOD 0 255 /end CHARACTERISTIC
/begin CHARACTERISTIC CAL_tpstarget_pedalmap_low_gear_threshold "Calibration: tpstarget pedalmap low gear threshold." VALUE 0x400088EB RL_VALUE_UBYTE 0 NO_COMPU_METHOD 0 255 /end CHARACTERISTIC
/begin CHARACTERISTIC CAL_logger_high_speed_logger_enable "To enable the built-in highspeed data logger, set this configuration option." VALUE 0x400088EC RL_VALUE_UBYTE 0 NO_COMPU_METHOD 0 255 /end CHARACTERISTIC
/begin CHARACTERISTIC CAL_tpssmooth_parking_threshold_tps "Calibration: tpssmooth parking threshold throttle position (val/255)." VALUE 0x400088ED RL_VALUE_UBYTE 0 CM_u8_factor_1_255 0 100 /end CHARACTERISTIC
/begin CHARACTERISTIC CAL_tpssmooth_parking_threshold_carspeed "Calibration: tpssmooth parking threshold carspeed (km/h)." VALUE 0x400088EE RL_VALUE_UBYTE 0 CM_u8_speed_kph 0 255 /end CHARACTERISTIC
/begin CHARACTERISTIC CAL_tpssmooth_parking_threshold_gear "Calibration: tpssmooth parking threshold gear." VALUE 0x400088EF RL_VALUE_UBYTE 0 NO_COMPU_METHOD 0 255 /end CHARACTERISTIC
/begin CHARACTERISTIC CAL_revlimit_startup_delay "Calibration: rev-limit startup delay (ms = val*250)." VALUE 0x400088F0 RL_VALUE_UBYTE 0 CM_u8_time_250ms 0 63750 /end CHARACTERISTIC
/begin CHARACTERISTIC CAL_revlimit_coolant_coldstart_threshold "Calibration: rev-limit coolant coldstart threshold (°C = val*5/8−40)." VALUE 0x400088F1 RL_VALUE_UBYTE 0 CM_u8_temp_5_8_40c -40 119.375 /end CHARACTERISTIC
/begin CHARACTERISTIC CAL_ips_speed_match_p_gain "undefined" VALUE 0x400088F2 RL_VALUE_ULONG 0 NO_COMPU_METHOD 0 4294967295 /end CHARACTERISTIC
/begin CHARACTERISTIC CAL_torque_estimate_min_ips "undefined2" VALUE 0x4000890E RL_VALUE_UWORD 0 NO_COMPU_METHOD 0 65535 /end CHARACTERISTIC
/begin CHARACTERISTIC CAL_ips_torque_reduction_slow_scale_pct "u8_factor_1/255" VALUE 0x40008910 RL_VALUE_UBYTE 0 CM_u8_factor_1_255 0 100 /end CHARACTERISTIC
/begin CHARACTERISTIC CAL_ips_torque_reduction_slow_floor_nm_ "u8_torque_nm" VALUE 0x40008911 RL_VALUE_UBYTE 0 CM_u8_torque_nm 0 255 /end CHARACTERISTIC
/begin CHARACTERISTIC CAL_idle_unknown6 "u8_temp_5/8-40c" VALUE 0x40008912 RL_VALUE_UBYTE 0 CM_u8_temp_5_8_40c -40 119.375 /end CHARACTERISTIC
/begin CHARACTERISTIC CAL_idle_learn_temp_range "Calibration: idle learn temperature range (°C = val*5/8−40; 2-element array)." VAL_BLK 0x40008913 RL_VALUE_UBYTE 0 CM_u8_temp_5_8_40c -40 119.375 NUMBER 2 /end CHARACTERISTIC
/begin CHARACTERISTIC CAL_dca_enable_steering_max "Calibration: drive-cycle-assist enable steering maximum." VALUE 0x40008915 RL_VALUE_UBYTE 0 NO_COMPU_METHOD 0 255 /end CHARACTERISTIC
/begin CHARACTERISTIC CAL_dca_enable_carspeed "Calibration: drive-cycle-assist enable carspeed (km/h; 2-element array)." VAL_BLK 0x40008916 RL_VALUE_UBYTE 0 CM_u8_speed_kph 0 255 NUMBER 2 /end CHARACTERISTIC
/begin CHARACTERISTIC CAL_dca_stationary_wait_time "Calibration: drive-cycle-assist stationary wait time (ms = val*100)." VALUE 0x40008918 RL_VALUE_UBYTE 0 CM_u8_time_100ms 0 25500 /end CHARACTERISTIC
/begin CHARACTERISTIC CAL_dca_enable_tps_margin "Calibration: drive-cycle-assist enable throttle position margin (val/1023)." VALUE 0x4000891A RL_VALUE_UBYTE 0 CM_u16_factor_1_1023 0 24.9266862170088 /end CHARACTERISTIC
/begin CHARACTERISTIC CAL_dca_activate_timer "Calibration: drive-cycle-assist activate timer (ms = val*5)." VALUE 0x4000891B RL_VALUE_UBYTE 0 CM_u8_time_5ms 0 1275 /end CHARACTERISTIC
/begin CHARACTERISTIC CAL_dca_activate_tps_threshold "Calibration: drive-cycle-assist activate throttle position threshold (val/1023)." VALUE 0x4000891C RL_VALUE_UWORD 0 CM_u16_factor_1_1023 0 6406.15835777126 /end CHARACTERISTIC
/begin CHARACTERISTIC CAL_vvt_low_load_ips_enable "Calibration: VVT low load IPS enable (boolean flag)." VALUE 0x4000891E RL_VALUE_UBYTE 0 NO_COMPU_METHOD 0 255 /end CHARACTERISTIC
/begin CHARACTERISTIC CAL_dca_ramp_timer_unknown "Calibration: drive-cycle-assist ramp timer (ms = val*20)." VALUE 0x40008920 RL_VALUE_UBYTE 0 CM_u8_time_20ms 0 5100 /end CHARACTERISTIC
/begin CHARACTERISTIC CAL_ecu_rpm_600 "Calibration: ECU RPM 600 (RPM = val*4)." VALUE 0x40008921 RL_VALUE_UBYTE 0 CM_u8_rspeed_4rpm 0 1020 /end CHARACTERISTIC
/begin CHARACTERISTIC CAL_revlimit_enforce_delay_after_start "Calibration: rev-limit enforce delay after start (ms = val*50)." VALUE 0x40008923 RL_VALUE_UBYTE 0 CM_u8_time_50ms 0 12750 /end CHARACTERISTIC
/begin CHARACTERISTIC CAL_ecu_engine_speed_decel_hysteresis_rpm "Calibration: ECU engine speed decel hysteresis RPM (RPM = val/4)." VALUE 0x40008924 RL_VALUE_UWORD 0 CM_u16_rspeed_1_4rpm 0 16383.75 /end CHARACTERISTIC
/begin CHARACTERISTIC CAL_ecu_rpm_5250 "Calibration: ECU RPM 5250 (RPM)." VALUE 0x40008928 RL_VALUE_UWORD 0 CM_u16_rspeed_rpm 0 65535 /end CHARACTERISTIC
/begin CHARACTERISTIC CAL_exhaust_flap_load_threshold_open "Calibration: exhaust flap load threshold open (mg/stroke = val*4)." VALUE 0x4000892A RL_VALUE_UBYTE 0 CM_u8_load_4mg_stroke 0 1020 /end CHARACTERISTIC
/begin CHARACTERISTIC CAL_exhaust_flap_load_threshold_close "Calibration: exhaust flap load threshold close (mg/stroke = val*4)." VALUE 0x4000892B RL_VALUE_UBYTE 0 CM_u8_load_4mg_stroke 0 1020 /end CHARACTERISTIC
/begin CHARACTERISTIC CAL_torque_hysteresis_threshold1 "Calibration: torque hysteresis threshold1 (Nm)." VALUE 0x4000892C RL_VALUE_UBYTE 0 CM_u8_torque_nm 0 255 /end CHARACTERISTIC
/begin CHARACTERISTIC CAL_tpssmooth_parking_clutch_threshold "Calibration: tpssmooth parking clutch threshold (V = val*5/255)." VALUE 0x4000892D RL_VALUE_UBYTE 0 CM_u8_voltage_5_255v 0 5 /end CHARACTERISTIC
/begin CHARACTERISTIC CAL_lfb_timer_entry "Calibration: lfb timer entry." VALUE 0x4000892E RL_VALUE_UBYTE 0 NO_COMPU_METHOD 0 255 /end CHARACTERISTIC
/begin CHARACTERISTIC CAL_lfb_timer_hold "Calibration: lfb timer hold." VALUE 0x4000892F RL_VALUE_UBYTE 0 NO_COMPU_METHOD 0 255 /end CHARACTERISTIC
/begin CHARACTERISTIC CAL_lfb_tps_max "Calibration: lfb throttle position maximum (val/255)." VALUE 0x40008931 RL_VALUE_UBYTE 0 CM_u8_factor_1_255 0 100 /end CHARACTERISTIC
/begin CHARACTERISTIC CAL_lfb_detect_carspeed_min "Calibration: lfb detect carspeed minimum (km/h)." VALUE 0x40008932 RL_VALUE_UBYTE 0 CM_u8_speed_kph 0 255 /end CHARACTERISTIC
/begin CHARACTERISTIC CAL_lfb_pedal_override_rate "undefined1" VALUE 0x40008933 RL_VALUE_UBYTE 0 NO_COMPU_METHOD 0 255 /end CHARACTERISTIC
/begin CHARACTERISTIC CAL_lfb_pulse_toggle_period "undefined1" VALUE 0x40008937 RL_VALUE_UBYTE 0 NO_COMPU_METHOD 0 255 /end CHARACTERISTIC
/begin CHARACTERISTIC CAL_lfb_pulse_enable "Calibration: lfb pulse enable (boolean flag)." VALUE 0x40008938 RL_VALUE_UBYTE 0 NO_COMPU_METHOD 0 255 /end CHARACTERISTIC
/begin CHARACTERISTIC CAL_lfb_clutch_threshold "Calibration: lfb clutch threshold (V = val*5/1023)." VALUE 0x4000893A RL_VALUE_UWORD 0 CM_u16_voltage_5_1023v 0 320.307917888563 /end CHARACTERISTIC
/begin CHARACTERISTIC CAL_cruise_feedforward_blend_threshold "undefined1" VALUE 0x4000893E RL_VALUE_UBYTE 0 NO_COMPU_METHOD 0 255 /end CHARACTERISTIC
/begin CHARACTERISTIC CAL_sensor_fuel_pressure_scaling "Calibration: sensor fuel pressure scaling." VALUE 0x40008940 RL_VALUE_UWORD 0 NO_COMPU_METHOD 0 65535 /end CHARACTERISTIC
/begin CHARACTERISTIC CAL_sensor_fuel_pressure_offset "Calibration: sensor fuel pressure offset (mbar)." VALUE 0x40008942 RL_VALUE_UWORD 0 CM_u16_pressure_mbar 0 65535 /end CHARACTERISTIC
/begin CHARACTERISTIC CAL_idle_low_car_speed_exit "Calibration: idle low car speed exit (km/h)." VALUE 0x40008944 RL_VALUE_UBYTE 0 CM_u8_speed_kph 0 255 /end CHARACTERISTIC
/begin CHARACTERISTIC CAL_idle_low_car_speed_enter "Calibration: idle low car speed enter (km/h)." VALUE 0x40008945 RL_VALUE_UBYTE 0 CM_u8_speed_kph 0 255 /end CHARACTERISTIC
/begin CHARACTERISTIC CAL_injtip_dfco_recovery_enrichment_max_rpm "Calibration: injector tip-in decel fuel cut-off recovery enrichment maximum RPM (RPM)." VALUE 0x40008946 RL_VALUE_UWORD 0 CM_u16_rspeed_rpm 0 65535 /end CHARACTERISTIC
/begin CHARACTERISTIC CAL_lfb_brake_off_hold_ticks "undefined2" VALUE 0x4000894C RL_VALUE_UWORD 0 NO_COMPU_METHOD 0 65535 /end CHARACTERISTIC
/begin CHARACTERISTIC CAL_ac_compressor_engine_speed3 "Calibration: A/C compressor engine speed3 (RPM = val*4; 2-element array)." VAL_BLK 0x40008950 RL_VALUE_UBYTE 0 CM_u8_rspeed_4rpm 0 1020 NUMBER 2 /end CHARACTERISTIC
/begin CHARACTERISTIC CAL_cooling_fan_low_rpm_hysteresis_threshold "Calibration: cooling fan low RPM hysteresis threshold (RPM = val*4; 2-element array)." VAL_BLK 0x40008952 RL_VALUE_UBYTE 0 CM_u8_rspeed_4rpm 0 1020 NUMBER 2 /end CHARACTERISTIC
/begin CHARACTERISTIC CAL_oil_pressure_switch_voltage_scaling "Calibration: oil pressure switch voltage scaling (mbar)." VALUE 0x40008954 RL_VALUE_UWORD 0 CM_u16_pressure_mbar 0 65535 /end CHARACTERISTIC
/begin CHARACTERISTIC CAL_oil_pressure_switch_offset "Calibration: oil pressure switch offset (mbar)." VALUE 0x40008956 RL_VALUE_UWORD 0 CM_u16_pressure_mbar 0 65535 /end CHARACTERISTIC
/begin CHARACTERISTIC CAL_inj_soak_time_max "Calibration: injector soak time maximum (ms = val*100)." VALUE 0x40008962 RL_VALUE_UWORD 0 CM_u8_time_100ms 0 6553500 /end CHARACTERISTIC
/begin CHARACTERISTIC CAL_fuel_pump_integral_update_period "Calibration: fuel pump integral update period." VALUE 0x40008965 RL_VALUE_UBYTE 0 NO_COMPU_METHOD 0 255 /end CHARACTERISTIC
/begin CHARACTERISTIC CAL_fuel_pump_proportional_limit "Calibration: fuel pump proportional limit (val/100; 2-element array)." VAL_BLK 0x40008966 RL_VALUE_UBYTE 0 CM_u8_factor_1_100 0 255 NUMBER 2 /end CHARACTERISTIC
/begin CHARACTERISTIC CAL_fuel_pump_integral_gain "Calibration: fuel pump integral gain (val/100)." VALUE 0x40008968 RL_VALUE_UBYTE 0 CM_u8_factor_1_100 0 255 /end CHARACTERISTIC
/begin CHARACTERISTIC CAL_fuel_pump_integral_hold_on_dfco "Calibration: fuel pump integral hold on decel fuel cut-off (boolean flag)." VALUE 0x40008969 RL_VALUE_UBYTE 0 NO_COMPU_METHOD 0 255 /end CHARACTERISTIC
/begin CHARACTERISTIC CAL_fuel_pump_integral_pressure_deadband "Calibration: fuel pump integral pressure deadband." VALUE 0x4000896A RL_VALUE_UBYTE 0 NO_COMPU_METHOD 0 255 /end CHARACTERISTIC
/begin CHARACTERISTIC CAL_fuel_pump_integral_enable "Calibration: fuel pump integral enable (boolean flag)." VALUE 0x4000896E RL_VALUE_UBYTE 0 NO_COMPU_METHOD 0 255 /end CHARACTERISTIC
/begin CHARACTERISTIC CAL_fuel_pump_integral_fuel_level_min "Calibration: fuel pump integral fuel level minimum (gal = val/10)." VALUE 0x40008978 RL_VALUE_UWORD 0 CM_u8_volume_1_10gallon 0 6553.5 /end CHARACTERISTIC
/begin CHARACTERISTIC CAL_cluster_fuel_economy_factory_stepsize "Calibration: cluster fuel economy factory stepsize." VALUE 0x40008979 RL_VALUE_UBYTE 0 NO_COMPU_METHOD 0 255 /end CHARACTERISTIC
/begin CHARACTERISTIC CAL_tpssmooth_rate_opening_clamp_thresholds "Calibration: tpssmooth rate opening clamp thresholds (val/1023; 2-element array)." VAL_BLK 0x4000897C RL_VALUE_UWORD 0 CM_u16_factor_1_1023 0 6406.15835777126 NUMBER 2 /end CHARACTERISTIC
/begin CHARACTERISTIC CAL_torque_proportional_limit_positive "Calibration: torque proportional limit positive (val/1023)." VALUE 0x40008980 RL_VALUE_UWORD 0 CM_u16_factor_1_1023 0 6406.15835777126 /end CHARACTERISTIC
/begin CHARACTERISTIC CAL_torque_proportional_limit_negative "Calibration: torque proportional limit negative (val/1023)." VALUE 0x40008982 RL_VALUE_UWORD 0 CM_u16_factor_1_1023 0 6406.15835777126 /end CHARACTERISTIC
/begin CHARACTERISTIC CAL_torque_integral_limit_positive "Calibration: torque integral limit positive (val/4095)." VALUE 0x40008984 RL_VALUE_UWORD 0 CM_u16_factor_1_4095 0 1600.3663003663 /end CHARACTERISTIC
/begin CHARACTERISTIC CAL_torque_integral_limit_negative "Calibration: torque integral limit negative (val/4095)." VALUE 0x40008986 RL_VALUE_UWORD 0 CM_u16_factor_1_4095 0 1600.3663003663 /end CHARACTERISTIC
/begin CHARACTERISTIC CAL_revlimit_torque_limit_confirmation_threshold "Calibration: rev-limit torque limit confirmation threshold (Nm = val*2)." VALUE 0x40008988 RL_VALUE_UBYTE 0 CM_u8_torque_2nm 0 510 /end CHARACTERISTIC
/begin CHARACTERISTIC CAL_torque_limit_integral_update_period "u8_time_ms" VALUE 0x40008989 RL_VALUE_UBYTE 0 CM_u8_time_ms 0 255 /end CHARACTERISTIC
/begin CHARACTERISTIC CAL_torque_limit_integral_deadband "Calibration: torque limit integral deadband." VALUE 0x4000898A RL_VALUE_UBYTE 0 NO_COMPU_METHOD 0 255 /end CHARACTERISTIC
/begin CHARACTERISTIC CAL_injtip_fuel_film_xtau_enable "Calibration: injector tip-in fuel film X-tau film enable (boolean flag)." VALUE 0x4000898B RL_VALUE_UBYTE 0 NO_COMPU_METHOD 0 255 /end CHARACTERISTIC
/begin CHARACTERISTIC CAL_fuel_pump_reference_voltage "Calibration: fuel pump reference voltage (V = val*18/1023)." VALUE 0x4000898C RL_VALUE_UWORD 0 CM_u16_voltage_18_1023v 0 1153.10850439883 /end CHARACTERISTIC
/begin CHARACTERISTIC CAL_cluster_dte_min_distance_threshold "Calibration: cluster dte minimum distance threshold (km)." VALUE 0x4000898E RL_VALUE_UBYTE 0 CM_u16_distance_km 0 255 /end CHARACTERISTIC
/begin CHARACTERISTIC CAL_cluster_fuel_range_remaining_smoothing_factor "Calibration: cluster fuel range remaining smoothing factor." VALUE 0x4000898F RL_VALUE_UBYTE 0 NO_COMPU_METHOD 0 255 /end CHARACTERISTIC
/begin CHARACTERISTIC CAL_cluster_fuel_mileage_update_timer "Calibration: cluster fuel mileage update timer (ms = val*100)." VALUE 0x40008991 RL_VALUE_UBYTE 0 CM_u8_time_100ms 0 25500 /end CHARACTERISTIC
/begin CHARACTERISTIC CAL_tpssmooth_increment_b_neutral_tour "Calibration: tpssmooth increment b neutral tour (val/255)." VALUE 0x40008992 RL_VALUE_UBYTE 0 CM_u8_factor_1_255 0 100 /end CHARACTERISTIC
/begin CHARACTERISTIC CAL_tpssmooth_increment_b_neutral_sport "Calibration: tpssmooth increment b neutral sport (val/255)." VALUE 0x40008993 RL_VALUE_UBYTE 0 CM_u8_factor_1_255 0 100 /end CHARACTERISTIC
/begin CHARACTERISTIC CAL_ign_comp_idle_error_driveaway_speed_max "u8_speed_kph" VALUE 0x40008994 RL_VALUE_UBYTE 0 CM_u8_speed_kph 0 255 /end CHARACTERISTIC
/begin CHARACTERISTIC CAL_ign_comp_idle_error_driveaway_rpm_max "u8_rspeed_10rpm" VALUE 0x40008995 RL_VALUE_UBYTE 0 CM_u8_rspeed_10rpm 0 2550 /end CHARACTERISTIC
/begin AXIS_PTS CAL_ign_comp_idle_error_driveaway_X_rpm "Calibration: X-axis (rpm) for the ignition compensation idle error3 table (16-element array)." 0x40008996 NO_INPUT_QUANTITY RL_AXIS_UBYTE 0 CM_u8__127 16 -127 128 /end AXIS_PTS
/begin CHARACTERISTIC CAL_ign_comp_idle_error_driveaway "Calibration: ignition compensation idle error3 (° = val/4−32; 16-element array)." CURVE 0x400089A6 RL_VALUE_UBYTE 0 CM_u8_angle_1_4_32deg -32 31.75
 /begin AXIS_DESCR COM_AXIS NO_INPUT_QUANTITY CM_u8__127 16 -127 128 AXIS_PTS_REF CAL_ign_comp_idle_error_driveaway_X_rpm /end AXIS_DESCR
/end CHARACTERISTIC
/begin AXIS_PTS CAL_idle_comp_accel_pedal_pos_X_pps "Calibration: X-axis (pps) for the idle compensation accelerator pedal position table (val/255; 8-element array)." 0x400089B6 NO_INPUT_QUANTITY RL_AXIS_UBYTE 0 CM_u8_factor_1_255 8 0 100 /end AXIS_PTS
/begin CHARACTERISTIC CAL_idle_comp_accel_pedal_pos "Calibration: idle compensation accelerator pedal position (8-element array)." CURVE 0x400089BE RL_VALUE_UBYTE 0 NO_COMPU_METHOD 0 255
 /begin AXIS_DESCR COM_AXIS NO_INPUT_QUANTITY CM_u8_factor_1_255 8 0 100 AXIS_PTS_REF CAL_idle_comp_accel_pedal_pos_X_pps /end AXIS_DESCR
/end CHARACTERISTIC
/begin CHARACTERISTIC CAL_cluster_fuel_economy_factor_limit "This is a fuel economy limit for calculating avaiable range." VAL_BLK 0x400089C6 RL_VALUE_UBYTE 0 NO_COMPU_METHOD 0 255 NUMBER 2 /end CHARACTERISTIC
/begin CHARACTERISTIC CAL_cluster_fuel_range_smoothing_interval "Calibration: cluster fuel range smoothing interval (ms = val*100)." VALUE 0x400089C8 RL_VALUE_UBYTE 0 CM_u8_time_100ms 0 25500 /end CHARACTERISTIC
/begin CHARACTERISTIC CAL_cluster_fuel_usage_reset_request_timer "Calibration: cluster fuel usage reset request timer (ms = val*100)." VALUE 0x400089C9 RL_VALUE_UBYTE 0 CM_u8_time_100ms 0 25500 /end CHARACTERISTIC
/begin AXIS_PTS CAL_tpssmooth_rate_decay_opening_X_rpm "Calibration: X-axis (rpm) for the tpssmooth rate decay opening table (RPM = val*125/4+500; 8-element array)." 0x40008A6A NO_INPUT_QUANTITY RL_AXIS_UBYTE 0 CM_u8_rspeed_125_4_500rpm 8 500 8468.75 /end AXIS_PTS
/begin CHARACTERISTIC CAL_tpssmooth_rate_decay_opening "Calibration: tpssmooth rate decay opening (8-element array)." CURVE 0x40008A72 RL_VALUE_UBYTE 0 CM_u16_factor_1_1023 0 24.9266862170088
 /begin AXIS_DESCR COM_AXIS NO_INPUT_QUANTITY CM_u8_rspeed_125_4_500rpm 8 500 8468.75 AXIS_PTS_REF CAL_tpssmooth_rate_decay_opening_X_rpm /end AXIS_DESCR
/end CHARACTERISTIC
/begin AXIS_PTS CAL_tpssmooth_rate_decay_closing_X_rpm "Calibration: X-axis (rpm) for the tpssmooth rate decay closing table (RPM = val*125/4+500; 8-element array)." 0x40008A7A NO_INPUT_QUANTITY RL_AXIS_UBYTE 0 CM_u8_rspeed_125_4_500rpm 8 500 8468.75 /end AXIS_PTS
/begin CHARACTERISTIC CAL_tpssmooth_rate_decay_closing "Calibration: tpssmooth rate decay closing (8-element array)." CURVE 0x40008A82 RL_VALUE_UBYTE 0 CM_u16_factor_1_1023 0 24.9266862170088
 /begin AXIS_DESCR COM_AXIS NO_INPUT_QUANTITY CM_u8_rspeed_125_4_500rpm 8 500 8468.75 AXIS_PTS_REF CAL_tpssmooth_rate_decay_closing_X_rpm /end AXIS_DESCR
/end CHARACTERISTIC
/begin AXIS_PTS CAL_injtip_transient_throttle_response_time_X_coolant_tmp "Calibration: X-axis (coolant tmp) for the injector tip-in transient throttle response time table (°C = val*5/8−40; 8-element array)." 0x40008A8A NO_INPUT_QUANTITY RL_AXIS_UBYTE 0 CM_u8_temp_5_8_40c 8 -40 119.375 /end AXIS_PTS
/begin AXIS_PTS CAL_injtip_transient_throttle_response_time_Y_rpm "Calibration: Y-axis (rpm) for the injector tip-in transient throttle response time table (RPM = val*125/4+500; 8-element array)." 0x40008A92 NO_INPUT_QUANTITY RL_AXIS_UBYTE 0 CM_u8_rspeed_125_4_500rpm 8 500 8468.75 /end AXIS_PTS
/begin CHARACTERISTIC CAL_injtip_transient_throttle_response_time "Calibration: injector tip-in transient throttle response time (ms = val*5; 64-element array)." MAP 0x40008A9A RL_VALUE_UBYTE 0 CM_u8_time_5ms 0 1275
 /begin AXIS_DESCR COM_AXIS NO_INPUT_QUANTITY CM_u8_temp_5_8_40c 8 -40 119.375 AXIS_PTS_REF CAL_injtip_transient_throttle_response_time_X_coolant_tmp /end AXIS_DESCR
 /begin AXIS_DESCR COM_AXIS NO_INPUT_QUANTITY CM_u8_rspeed_125_4_500rpm 8 500 8468.75 AXIS_PTS_REF CAL_injtip_transient_throttle_response_time_Y_rpm /end AXIS_DESCR
/end CHARACTERISTIC
/begin AXIS_PTS CAL_injtip_comp_load1_X_load "Calibration: X-axis (load) for the injector tip-in compensation load1 table (mg/stroke = val*4; 16-element array)." 0x40008ADA NO_INPUT_QUANTITY RL_AXIS_UBYTE 0 CM_u8_load_4mg_stroke 16 0 1020 /end AXIS_PTS
/begin CHARACTERISTIC CAL_injtip_comp_load1 "Calibration: injector tip-in compensation load1 (16-element array)." CURVE 0x40008AEA RL_VALUE_UBYTE 0 NO_COMPU_METHOD 0 255
 /begin AXIS_DESCR COM_AXIS NO_INPUT_QUANTITY CM_u8_load_4mg_stroke 16 0 1020 AXIS_PTS_REF CAL_injtip_comp_load1_X_load /end AXIS_DESCR
/end CHARACTERISTIC
/begin AXIS_PTS CAL_inj_warmup_factor_ips_X_load "Calibration: X-axis (load) for the injector enrichment factor load n coolant IPS table (mg/stroke = val*4; 12-element array)." 0x40008AFA NO_INPUT_QUANTITY RL_AXIS_UBYTE 0 CM_u8_load_4mg_stroke 12 0 1020 /end AXIS_PTS
/begin AXIS_PTS CAL_inj_warmup_factor_ips_Y_coolant "Calibration: Y-axis (coolant) for the injector enrichment factor load n coolant IPS table (°C = val*5/8−40; 16-element array)." 0x40008B06 NO_INPUT_QUANTITY RL_AXIS_UBYTE 0 CM_u8_temp_5_8_40c 16 -40 119.375 /end AXIS_PTS
/begin CHARACTERISTIC CAL_inj_warmup_factor_ips "Calibration: injector enrichment factor load n coolant IPS (val/64; 192-element array)." MAP 0x40008B16 RL_VALUE_UBYTE 0 CM_u8_factor_1_64 0 398.4375
 /begin AXIS_DESCR COM_AXIS NO_INPUT_QUANTITY CM_u8_load_4mg_stroke 12 0 1020 AXIS_PTS_REF CAL_inj_warmup_factor_ips_X_load /end AXIS_DESCR
 /begin AXIS_DESCR COM_AXIS NO_INPUT_QUANTITY CM_u8_temp_5_8_40c 16 -40 119.375 AXIS_PTS_REF CAL_inj_warmup_factor_ips_Y_coolant /end AXIS_DESCR
/end CHARACTERISTIC
/begin AXIS_PTS CAL_cruise_proportional_gain_ips_X_gear "Calibration: X-axis (gear) for the cruise proportional gain IPS table (4-element array)." 0x40008BD6 NO_INPUT_QUANTITY RL_AXIS_UBYTE 0 NO_COMPU_METHOD 4 0 255 /end AXIS_PTS
/begin CHARACTERISTIC CAL_cruise_proportional_gain_ips "Calibration: cruise proportional gain IPS (4-element array)." CURVE 0x40008BDA RL_VALUE_UBYTE 0 NO_COMPU_METHOD 0 255
 /begin AXIS_DESCR COM_AXIS NO_INPUT_QUANTITY NO_COMPU_METHOD 4 0 255 AXIS_PTS_REF CAL_cruise_proportional_gain_ips_X_gear /end AXIS_DESCR
/end CHARACTERISTIC
/begin AXIS_PTS CAL_cruise_integral_gain_ips_X_gear "Calibration: X-axis (gear) for the cruise integral gain IPS table (4-element array)." 0x40008BDE NO_INPUT_QUANTITY RL_AXIS_UBYTE 0 NO_COMPU_METHOD 4 0 255 /end AXIS_PTS
/begin CHARACTERISTIC CAL_cruise_integral_gain_ips "Calibration: cruise integral gain IPS (val/100; 4-element array)." CURVE 0x40008BE2 RL_VALUE_UBYTE 0 CM_u8_factor_1_100 0 255
 /begin AXIS_DESCR COM_AXIS NO_INPUT_QUANTITY NO_COMPU_METHOD 4 0 255 AXIS_PTS_REF CAL_cruise_integral_gain_ips_X_gear /end AXIS_DESCR
/end CHARACTERISTIC
/begin AXIS_PTS CAL_cruise_derivative_gain_ips_X_gear "Calibration: X-axis (gear) for the cruise derivative gain IPS table (4-element array)." 0x40008BE6 NO_INPUT_QUANTITY RL_AXIS_UBYTE 0 NO_COMPU_METHOD 4 0 255 /end AXIS_PTS
/begin CHARACTERISTIC CAL_cruise_derivative_gain_ips "Calibration: cruise derivative gain IPS (4-element array)." CURVE 0x40008BEA RL_VALUE_UBYTE 0 NO_COMPU_METHOD 0 255
 /begin AXIS_DESCR COM_AXIS NO_INPUT_QUANTITY NO_COMPU_METHOD 4 0 255 AXIS_PTS_REF CAL_cruise_derivative_gain_ips_X_gear /end AXIS_DESCR
/end CHARACTERISTIC
/begin AXIS_PTS CAL_inj_cranking_comp_air_temp_X_iat "Calibration: X-axis (air temp) for the injector compensation air temperature startup table (°C = val*5/8−40; 10-element array)." 0x40008BEE NO_INPUT_QUANTITY RL_AXIS_UBYTE 0 CM_u8_temp_5_8_40c 10 -40 119.375 /end AXIS_PTS
/begin AXIS_PTS CAL_inj_cranking_comp_air_temp_Y_maf_accum "Calibration: Y-axis (maf accum) for the injector compensation air temperature startup table (g; 10-element array)." 0x40008BF8 NO_INPUT_QUANTITY RL_AXIS_UBYTE 0 CM_u8_mass_g 10 0 255 /end AXIS_PTS
/begin CHARACTERISTIC CAL_inj_cranking_comp_air_temp "Calibration: injector compensation air temperature startup (100-element array)." MAP 0x40008C02 RL_VALUE_UBYTE 0 NO_COMPU_METHOD 0 255
 /begin AXIS_DESCR COM_AXIS NO_INPUT_QUANTITY CM_u8_temp_5_8_40c 10 -40 119.375 AXIS_PTS_REF CAL_inj_cranking_comp_air_temp_X_iat /end AXIS_DESCR
 /begin AXIS_DESCR COM_AXIS NO_INPUT_QUANTITY CM_u8_mass_g 10 0 255 AXIS_PTS_REF CAL_inj_cranking_comp_air_temp_Y_maf_accum /end AXIS_DESCR
/end CHARACTERISTIC
/begin CHARACTERISTIC CAL_sensor_engine_air_scaling "Calibration: sensor engine air scaling (°C = val*5/8−40; 33-element array)." VAL_BLK 0x40008C66 RL_VALUE_UBYTE 0 CM_u8_temp_5_8_40c -40 119.375 NUMBER 34 /end CHARACTERISTIC
/begin CHARACTERISTIC CAL_sensor_coolant_temp_sensor_engine_off_scaling "Calibration: sensor coolant temperature sensor engine off scaling (°C = val*5/8−40; 33-element array)." VAL_BLK 0x40008C88 RL_VALUE_UBYTE 0 CM_u8_temp_5_8_40c -40 119.375 NUMBER 34 /end CHARACTERISTIC
/begin CHARACTERISTIC CAL_sensor_intake_air_scaling "Calibration: sensor intake air scaling (32-element array)." VAL_BLK 0x40008CAA RL_VALUE_UBYTE 0 CM_u8_temp_5_8_40c -40 119.375 NUMBER 34 /end CHARACTERISTIC
/begin AXIS_PTS CAL_injtip_dfco_manual_default_X_coolant_temp "Calibration: X-axis (coolant temp) for the injector tip-in decel fuel cut-off manual default table (°C = val*5/8−40; 4-element array)." 0x40008CEC NO_INPUT_QUANTITY RL_AXIS_UBYTE 0 CM_u8_temp_5_8_40c 4 -40 119.375 /end AXIS_PTS
/begin CHARACTERISTIC CAL_injtip_dfco_manual_default "Calibration: injector tip-in decel fuel cut-off manual default (RPM = val*10; 4-element array)." CURVE 0x40008CF0 RL_VALUE_UBYTE 0 CM_u8_rspeed_10rpm 0 2550
 /begin AXIS_DESCR COM_AXIS NO_INPUT_QUANTITY CM_u8_temp_5_8_40c 4 -40 119.375 AXIS_PTS_REF CAL_injtip_dfco_manual_default_X_coolant_temp /end AXIS_DESCR
/end CHARACTERISTIC
/begin AXIS_PTS CAL_injtip_dfco_disasble_ingear_manual_X_coolant_temp "Calibration: X-axis (coolant temp) for the injector tip-in decel fuel cut-off disasble ingear manual table (°C = val*5/8−40; 4-element array)." 0x40008CF4 NO_INPUT_QUANTITY RL_AXIS_UBYTE 0 CM_u8_temp_5_8_40c 4 -40 119.375 /end AXIS_PTS
/begin CHARACTERISTIC CAL_injtip_dfco_disasble_ingear_manual "Calibration: injector tip-in decel fuel cut-off disasble ingear manual (RPM = val*10; 4-element array)." CURVE 0x40008CF8 RL_VALUE_UBYTE 0 CM_u8_rspeed_10rpm 0 2550
 /begin AXIS_DESCR COM_AXIS NO_INPUT_QUANTITY CM_u8_temp_5_8_40c 4 -40 119.375 AXIS_PTS_REF CAL_injtip_dfco_disasble_ingear_manual_X_coolant_temp /end AXIS_DESCR
/end CHARACTERISTIC
/begin AXIS_PTS CAL_injtip_dfco_disasble_neutral_X_coolant_temp "Calibration: X-axis (coolant temp) for the injector tip-in decel fuel cut-off disasble neutral table (°C = val*5/8−40; 4-element array)." 0x40008CFC NO_INPUT_QUANTITY RL_AXIS_UBYTE 0 CM_u8_temp_5_8_40c 4 -40 119.375 /end AXIS_PTS
/begin CHARACTERISTIC CAL_injtip_dfco_disasble_neutral "Calibration: injector tip-in decel fuel cut-off disasble neutral (RPM = val*10; 4-element array)." CURVE 0x40008D00 RL_VALUE_UBYTE 0 CM_u8_rspeed_10rpm 0 2550
 /begin AXIS_DESCR COM_AXIS NO_INPUT_QUANTITY CM_u8_temp_5_8_40c 4 -40 119.375 AXIS_PTS_REF CAL_injtip_dfco_disasble_neutral_X_coolant_temp /end AXIS_DESCR
/end CHARACTERISTIC
/begin AXIS_PTS CAL_ign_comp_coldstart_X_coolant_temp "Calibration: X-axis (coolant temp) for the ignition compensation coldstart table (°C = val*5/8−40; 8-element array)." 0x40008D09 NO_INPUT_QUANTITY RL_AXIS_UBYTE 0 CM_u8_temp_5_8_40c 8 -40 119.375 /end AXIS_PTS
/begin CHARACTERISTIC CAL_ign_comp_coldstart "Calibration: ignition compensation coldstart (° = val/4−10; 8-element array)." CURVE 0x40008D16 RL_VALUE_UBYTE 0 CM_u8_angle_1_4_10deg -10 53.75
 /begin AXIS_DESCR COM_AXIS NO_INPUT_QUANTITY CM_u8_temp_5_8_40c 8 -40 119.375 AXIS_PTS_REF CAL_ign_comp_coldstart_X_coolant_temp /end AXIS_DESCR
/end CHARACTERISTIC
/begin AXIS_PTS CAL_evap_purge_warmup_time_X_coolant_temp "Calibration: X-axis (coolant temp) for the evaporative purge warmup time table (°C = val*5/8−40; 8-element array)." 0x40008D1E NO_INPUT_QUANTITY RL_AXIS_UBYTE 0 CM_u8_temp_5_8_40c 8 -40 119.375 /end AXIS_PTS
/begin CHARACTERISTIC CAL_evap_purge_warmup_time "Calibration: evaporative purge warmup time (8-element array)." CURVE 0x40008D26 RL_VALUE_UBYTE 0 NO_COMPU_METHOD 0 255
 /begin AXIS_DESCR COM_AXIS NO_INPUT_QUANTITY CM_u8_temp_5_8_40c 8 -40 119.375 AXIS_PTS_REF CAL_evap_purge_warmup_time_X_coolant_temp /end AXIS_DESCR
/end CHARACTERISTIC
/begin AXIS_PTS CAL_injtip_dfco_enable_rpm_manual_alt_X_coolant_temp "Calibration: X-axis (coolant temp) for the injector tip-in decel fuel cut-off enable RPM manual alt table (°C = val*5/8−40; 4-element array)." 0x40008D3E NO_INPUT_QUANTITY RL_AXIS_UBYTE 0 CM_u8_temp_5_8_40c 4 -40 119.375 /end AXIS_PTS
/begin CHARACTERISTIC CAL_injtip_dfco_enable_rpm_manual_alt "Calibration: injector tip-in decel fuel cut-off enable RPM manual alt (RPM = val*10; 4-element array)." CURVE 0x40008D42 RL_VALUE_UBYTE 0 CM_u8_rspeed_10rpm 0 2550
 /begin AXIS_DESCR COM_AXIS NO_INPUT_QUANTITY CM_u8_temp_5_8_40c 4 -40 119.375 AXIS_PTS_REF CAL_injtip_dfco_enable_rpm_manual_alt_X_coolant_temp /end AXIS_DESCR
/end CHARACTERISTIC
/begin AXIS_PTS CAL_ac_load_limit_X_rpm "Calibration: X-axis (rpm) for the A/C load limit table (RPM = val*125/4+500; 4-element array)." 0x40008D48 NO_INPUT_QUANTITY RL_AXIS_UBYTE 0 CM_u8_rspeed_125_4_500rpm 4 500 8468.75 /end AXIS_PTS
/begin CHARACTERISTIC CAL_ac_load_limit "Calibration: A/C load limit (4-element array)." CURVE 0x40008D4C RL_VALUE_UBYTE 0 NO_COMPU_METHOD 0 255
 /begin AXIS_DESCR COM_AXIS NO_INPUT_QUANTITY CM_u8_rspeed_125_4_500rpm 4 500 8468.75 AXIS_PTS_REF CAL_ac_load_limit_X_rpm /end AXIS_DESCR
/end CHARACTERISTIC
/begin AXIS_PTS CAL_idle_comp_iat_X_iat "Calibration: X-axis (iat) for the idle compensation intake air temp table (°C = val*5/8−40; 8-element array)." 0x40008D56 NO_INPUT_QUANTITY RL_AXIS_UBYTE 0 CM_u8_temp_5_8_40c 8 -40 119.375 /end AXIS_PTS
/begin CHARACTERISTIC CAL_idle_comp_iat "Calibration: idle compensation intake air temp (RPM; 8-element array)." CURVE 0x40008D5E RL_VALUE_UBYTE 0 CM_u16_rspeed_rpm 0 255
 /begin AXIS_DESCR COM_AXIS NO_INPUT_QUANTITY CM_u8_temp_5_8_40c 8 -40 119.375 AXIS_PTS_REF CAL_idle_comp_iat_X_iat /end AXIS_DESCR
/end CHARACTERISTIC
/begin AXIS_PTS CAL_cruise_proportional_gain_manual_longbox_X_gear "Calibration: X-axis (gear) for the cruise proportional gain manual longbox table (4-element array)." 0x40008D66 NO_INPUT_QUANTITY RL_AXIS_UBYTE 0 NO_COMPU_METHOD 4 0 255 /end AXIS_PTS
/begin CHARACTERISTIC CAL_cruise_proportional_gain_manual_longbox "Calibration: cruise proportional gain manual longbox (4-element array)." CURVE 0x40008D6A RL_VALUE_UBYTE 0 NO_COMPU_METHOD 0 255
 /begin AXIS_DESCR COM_AXIS NO_INPUT_QUANTITY NO_COMPU_METHOD 4 0 255 AXIS_PTS_REF CAL_cruise_proportional_gain_manual_longbox_X_gear /end AXIS_DESCR
/end CHARACTERISTIC
/begin AXIS_PTS CAL_cruise_integral_gain_manual_longbox_X_gear "Calibration: X-axis (gear) for the cruise integral gain manual longbox table (4-element array)." 0x40008D6E NO_INPUT_QUANTITY RL_AXIS_UBYTE 0 NO_COMPU_METHOD 4 0 255 /end AXIS_PTS
/begin CHARACTERISTIC CAL_cruise_integral_gain_manual_longbox "Calibration: cruise integral gain manual longbox (val/100; 4-element array)." CURVE 0x40008D72 RL_VALUE_UBYTE 0 CM_u8_factor_1_100 0 255
 /begin AXIS_DESCR COM_AXIS NO_INPUT_QUANTITY NO_COMPU_METHOD 4 0 255 AXIS_PTS_REF CAL_cruise_integral_gain_manual_longbox_X_gear /end AXIS_DESCR
/end CHARACTERISTIC
/begin AXIS_PTS CAL_cruise_derivative_gain_manual_longbox_X_gear "Calibration: X-axis (gear) for the cruise derivative gain manual longbox table (4-element array)." 0x40008D76 NO_INPUT_QUANTITY RL_AXIS_UBYTE 0 NO_COMPU_METHOD 4 0 255 /end AXIS_PTS
/begin CHARACTERISTIC CAL_cruise_derivative_gain_manual_longbox "Calibration: cruise derivative gain manual longbox (4-element array)." CURVE 0x40008D7A RL_VALUE_UBYTE 0 NO_COMPU_METHOD 0 255
 /begin AXIS_DESCR COM_AXIS NO_INPUT_QUANTITY NO_COMPU_METHOD 4 0 255 AXIS_PTS_REF CAL_cruise_derivative_gain_manual_longbox_X_gear /end AXIS_DESCR
/end CHARACTERISTIC
/begin CHARACTERISTIC CAL_injtip_dfco_recovery_enrich_by_duration "undefined" VALUE 0x40008D7E RL_VALUE_ULONG 0 NO_COMPU_METHOD 0 4294967295 /end CHARACTERISTIC
/begin AXIS_PTS CAL_ign_comp_idle_error_moving_X_rpm "Calibration: X-axis (idle speed error) for the ignition compensation idle error2 table (16-element array)." 0x40008D90 NO_INPUT_QUANTITY RL_AXIS_UBYTE 0 CM_u8__127 16 -127 128 /end AXIS_PTS
/begin CHARACTERISTIC CAL_ign_comp_idle_error_moving "Calibration: ignition compensation idle error2 (° = val/4−32; 16-element array)." CURVE 0x40008DA0 RL_VALUE_UBYTE 0 CM_u8_angle_1_4_32deg -32 31.75
 /begin AXIS_DESCR COM_AXIS NO_INPUT_QUANTITY CM_u8__127 16 -127 128 AXIS_PTS_REF CAL_ign_comp_idle_error_moving_X_rpm /end AXIS_DESCR
/end CHARACTERISTIC
/begin AXIS_PTS CAL_ign_target_step_advance_accel_pedal_manual_X_rpm "Calibration: X-axis (engine speed) for the ignition compensation throttle position manual table (RPM = val*125/4+500; 8-element array)." 0x40008DB0 NO_INPUT_QUANTITY RL_AXIS_UBYTE 0 CM_u8_rspeed_125_4_500rpm 8 500 8468.75 /end AXIS_PTS
/begin AXIS_PTS CAL_ign_target_step_advance_accel_pedal_manual_Y_pps "Calibration: Y-axis (accel pedal) for the ignition compensation throttle position manual table (val/255; 8-element array)." 0x40008DB8 NO_INPUT_QUANTITY RL_AXIS_UBYTE 0 CM_u8_factor_1_255 8 0 100 /end AXIS_PTS
/begin CHARACTERISTIC CAL_ign_target_step_advance_accel_pedal_manual "ign_target_step_advance — how fast timing comes back. This table sets the rate limit on ignition timing moving in the advance direction: when the ECU's timing target rises above what's currently being run, this is the biggest bite it's allowed to tak" MAP 0x40008DC0 RL_VALUE_UBYTE 0 CM_u8_angle_1_4deg 0 63.75
 /begin AXIS_DESCR COM_AXIS NO_INPUT_QUANTITY CM_u8_rspeed_125_4_500rpm 8 500 8468.75 AXIS_PTS_REF CAL_ign_target_step_advance_accel_pedal_manual_X_rpm /end AXIS_DESCR
 /begin AXIS_DESCR COM_AXIS NO_INPUT_QUANTITY CM_u8_factor_1_255 8 0 100 AXIS_PTS_REF CAL_ign_target_step_advance_accel_pedal_manual_Y_pps /end AXIS_DESCR
/end CHARACTERISTIC
/begin AXIS_PTS CAL_ign_target_step_advance_accel_pedal_ips_X_rpm "Calibration: X-axis (engine speed) for the ignition compensation throttle position IPS table (RPM = val*125/4+500; 7-element array)." 0x40008E00 NO_INPUT_QUANTITY RL_AXIS_UBYTE 0 CM_u8_rspeed_125_4_500rpm 7 500 8468.75 /end AXIS_PTS
/begin AXIS_PTS CAL_ign_target_step_advance_accel_pedal_ips_Y_pps "Calibration: Y-axis (pedal pos) for the ignition compensation throttle position IPS table (val/255; 8-element array)." 0x40008E07 NO_INPUT_QUANTITY RL_AXIS_UBYTE 0 CM_u8_factor_1_255 8 0 100 /end AXIS_PTS
/begin CHARACTERISTIC CAL_ign_target_step_advance_accel_pedal_ips "ign_target_step_advance — how fast timing comes back. This table sets the rate limit on ignition timing moving in the advance direction: when the ECU's timing target rises above what's currently being run, this is the biggest bite it's allowed to tak" MAP 0x40008E0F RL_VALUE_UBYTE 0 CM_u8_angle_1_4deg 0 63.75
 /begin AXIS_DESCR COM_AXIS NO_INPUT_QUANTITY CM_u8_rspeed_125_4_500rpm 7 500 8468.75 AXIS_PTS_REF CAL_ign_target_step_advance_accel_pedal_ips_X_rpm /end AXIS_DESCR
 /begin AXIS_DESCR COM_AXIS NO_INPUT_QUANTITY CM_u8_factor_1_255 8 0 100 AXIS_PTS_REF CAL_ign_target_step_advance_accel_pedal_ips_Y_pps /end AXIS_DESCR
/end CHARACTERISTIC
/begin AXIS_PTS CAL_torque_limit_proportional_X_load_error "Calibration: X-axis (load error) for the torque limit proportional table (8-element array)." 0x40008E48 NO_INPUT_QUANTITY RL_AXIS_UBYTE 0 CM_u8__127 8 -127 128 /end AXIS_PTS
/begin CHARACTERISTIC CAL_torque_limit_proportional "Calibration: torque limit proportional (val/255; 8-element array)." CURVE 0x40008E50 RL_VALUE_UBYTE 0 CM_u8_factor_1_255 0 100
 /begin AXIS_DESCR COM_AXIS NO_INPUT_QUANTITY CM_u8__127 8 -127 128 AXIS_PTS_REF CAL_torque_limit_proportional_X_load_error /end AXIS_DESCR
/end CHARACTERISTIC
/begin AXIS_PTS CAL_ecu_engine_speed_target_dec_gain_X_coolant_temp "Calibration: X-axis (coolant temp) for the ECU engine speed target dec gain table (°C = val*5/8−40; 4-element array)." 0x40008E58 NO_INPUT_QUANTITY RL_AXIS_UBYTE 0 CM_u8_temp_5_8_40c 4 -40 119.375 /end AXIS_PTS
/begin CHARACTERISTIC CAL_ecu_engine_speed_target_dec_gain "Calibration: ECU engine speed target dec gain (val/255; 4-element array)." CURVE 0x40008E5C RL_VALUE_UBYTE 0 CM_u8_factor_1_255 0 100
 /begin AXIS_DESCR COM_AXIS NO_INPUT_QUANTITY CM_u8_temp_5_8_40c 4 -40 119.375 AXIS_PTS_REF CAL_ecu_engine_speed_target_dec_gain_X_coolant_temp /end AXIS_DESCR
/end CHARACTERISTIC
/begin CHARACTERISTIC CAL_closedloop_activate_engine_timer "Calibration: closedloop activate engine timer (s; 16-element array)." VAL_BLK 0x40008E62 RL_VALUE_UBYTE 0 CM_u8_time_s 0 255 NUMBER 16 /end CHARACTERISTIC
/begin AXIS_PTS CAL_vvt_intake_advance_base_X_engine_speed "Calibration: X-axis (engine speed) for the VVT intake advance base table (RPM = val*125/4+500; 16-element array)." 0x40008E7A NO_INPUT_QUANTITY RL_AXIS_UBYTE 0 CM_u8_rspeed_125_4_500rpm 16 500 8468.75 /end AXIS_PTS
/begin AXIS_PTS CAL_vvt_intake_advance_base_Y_load "Calibration: Y-axis (load) for the VVT intake advance base table (mg/stroke = val*4; 16-element array)." 0x40008E8A NO_INPUT_QUANTITY RL_AXIS_UBYTE 0 CM_u8_load_4mg_stroke 16 0 1020 /end AXIS_PTS
/begin CHARACTERISTIC CAL_vvt_intake_advance_base "Calibration: VVT intake advance base (° = val/4; 256-element array)." MAP 0x40008E9A RL_VALUE_UBYTE 0 CM_u8_angle_1_4deg 0 63.75
 /begin AXIS_DESCR COM_AXIS NO_INPUT_QUANTITY CM_u8_rspeed_125_4_500rpm 16 500 8468.75 AXIS_PTS_REF CAL_vvt_intake_advance_base_X_engine_speed /end AXIS_DESCR
 /begin AXIS_DESCR COM_AXIS NO_INPUT_QUANTITY CM_u8_load_4mg_stroke 16 0 1020 AXIS_PTS_REF CAL_vvt_intake_advance_base_Y_load /end AXIS_DESCR
/end CHARACTERISTIC
/begin AXIS_PTS CAL_vvt_intake_advance_coolant_offset_X_temp "Calibration: X-axis (temp) for the VVT intake advance coolant offset table (°C = val*5/8−40; 16-element array)." 0x40008F9A NO_INPUT_QUANTITY RL_AXIS_UBYTE 0 CM_u8_temp_5_8_40c 16 -40 119.375 /end AXIS_PTS
/begin CHARACTERISTIC CAL_vvt_intake_advance_coolant_offset "Calibration: VVT intake advance coolant offset (° = val/4; 16-element array)." CURVE 0x40008FAA RL_VALUE_UBYTE 0 CM_u8_angle_1_4deg 0 63.75
 /begin AXIS_DESCR COM_AXIS NO_INPUT_QUANTITY CM_u8_temp_5_8_40c 16 -40 119.375 AXIS_PTS_REF CAL_vvt_intake_advance_coolant_offset_X_temp /end AXIS_DESCR
/end CHARACTERISTIC
/begin AXIS_PTS CAL_inj_post_start_trim_decay_rich_X_mass_accum "u8_mass_32mg[8]" 0x40008FBA NO_INPUT_QUANTITY RL_AXIS_UBYTE 0 CM_u8_mass_32mg 8 0 8160 /end AXIS_PTS
/begin AXIS_PTS CAL_inj_post_start_trim_decay_rich_Y_coolant_temp "u8_temp_5/8-40c[8]" 0x40008FC2 NO_INPUT_QUANTITY RL_AXIS_UBYTE 0 CM_u8_temp_5_8_40c 8 -40 119.375 /end AXIS_PTS
/begin CHARACTERISTIC CAL_inj_post_start_trim_decay_rich "uint8_t[64]" MAP 0x40008FCA RL_VALUE_UBYTE 0 NO_COMPU_METHOD 0 255
 /begin AXIS_DESCR COM_AXIS NO_INPUT_QUANTITY CM_u8_mass_32mg 8 0 8160 AXIS_PTS_REF CAL_inj_post_start_trim_decay_rich_X_mass_accum /end AXIS_DESCR
 /begin AXIS_DESCR COM_AXIS NO_INPUT_QUANTITY CM_u8_temp_5_8_40c 8 -40 119.375 AXIS_PTS_REF CAL_inj_post_start_trim_decay_rich_Y_coolant_temp /end AXIS_DESCR
/end CHARACTERISTIC
/begin AXIS_PTS CAL_inj_post_start_trim_decay_lean_X_maf_accum "u8_mass_32mg[8]" 0x4000900A NO_INPUT_QUANTITY RL_AXIS_UBYTE 0 CM_u8_mass_32mg 8 0 8160 /end AXIS_PTS
/begin AXIS_PTS CAL_inj_post_start_trim_decay_lean_Y_coolant_temp "u8_temp_5/8-40c[8]" 0x40009012 NO_INPUT_QUANTITY RL_AXIS_UBYTE 0 CM_u8_temp_5_8_40c 8 -40 119.375 /end AXIS_PTS
/begin CHARACTERISTIC CAL_inj_post_start_trim_decay_lean "uint8_t[64]" MAP 0x4000901A RL_VALUE_UBYTE 0 NO_COMPU_METHOD 0 255
 /begin AXIS_DESCR COM_AXIS NO_INPUT_QUANTITY CM_u8_mass_32mg 8 0 8160 AXIS_PTS_REF CAL_inj_post_start_trim_decay_lean_X_maf_accum /end AXIS_DESCR
 /begin AXIS_DESCR COM_AXIS NO_INPUT_QUANTITY CM_u8_temp_5_8_40c 8 -40 119.375 AXIS_PTS_REF CAL_inj_post_start_trim_decay_lean_Y_coolant_temp /end AXIS_DESCR
/end CHARACTERISTIC
/begin AXIS_PTS CAL_torque_engine_ac_load_base_X_ac "Calibration: X-axis (ac) for the torque engine A/C load base table (16-element array)." 0x4000913E NO_INPUT_QUANTITY RL_AXIS_UBYTE 0 NO_COMPU_METHOD 16 0 255 /end AXIS_PTS
/begin CHARACTERISTIC CAL_torque_engine_ac_load_base "Calibration: torque engine A/C load base (Nm; 16-element array)." CURVE 0x4000914E RL_VALUE_UBYTE 0 CM_u8_torque_nm 0 255
 /begin AXIS_DESCR COM_AXIS NO_INPUT_QUANTITY NO_COMPU_METHOD 16 0 255 AXIS_PTS_REF CAL_torque_engine_ac_load_base_X_ac /end AXIS_DESCR
/end CHARACTERISTIC
/begin AXIS_PTS CAL_load_alphaN_seed_X_tps "Calibration: X-axis (tps) for the load alphaN seed table (val/255; 16-element array)." 0x40009162 NO_INPUT_QUANTITY RL_AXIS_UBYTE 0 CM_u8_factor_1_255 16 0 100 /end AXIS_PTS
/begin CHARACTERISTIC CAL_load_alphaN_seed "Calibration: load alphaN seed (mg/stroke = val*4; 16-element array)." CURVE 0x40009172 RL_VALUE_UBYTE 0 CM_u8_load_4mg_stroke 0 1020
 /begin AXIS_DESCR COM_AXIS NO_INPUT_QUANTITY CM_u8_factor_1_255 16 0 100 AXIS_PTS_REF CAL_load_alphaN_seed_X_tps /end AXIS_DESCR
/end CHARACTERISTIC
/begin AXIS_PTS CAL_injtip_dfco_ips_default_X_coolant_temp "Calibration: X-axis (coolant temp) for the injector tip-in decel fuel cut-off IPS default table (°C = val*5/8−40; 4-element array)." 0x40009192 NO_INPUT_QUANTITY RL_AXIS_UBYTE 0 CM_u8_temp_5_8_40c 4 -40 119.375 /end AXIS_PTS
/begin CHARACTERISTIC CAL_injtip_dfco_ips_default "Calibration: injector tip-in decel fuel cut-off IPS default (RPM = val*10; 4-element array)." CURVE 0x40009196 RL_VALUE_UBYTE 0 CM_u8_rspeed_10rpm 0 2550
 /begin AXIS_DESCR COM_AXIS NO_INPUT_QUANTITY CM_u8_temp_5_8_40c 4 -40 119.375 AXIS_PTS_REF CAL_injtip_dfco_ips_default_X_coolant_temp /end AXIS_DESCR
/end CHARACTERISTIC
/begin AXIS_PTS CAL_injtip_dfco_disasble_ingear_ips_X_coolant_temp "Calibration: X-axis (coolant temp) for the injector tip-in decel fuel cut-off disasble ingear IPS table (°C = val*5/8−40; 4-element array)." 0x4000919A NO_INPUT_QUANTITY RL_AXIS_UBYTE 0 CM_u8_temp_5_8_40c 4 -40 119.375 /end AXIS_PTS
/begin CHARACTERISTIC CAL_injtip_dfco_disasble_ingear_ips "Calibration: injector tip-in decel fuel cut-off disasble ingear IPS (RPM = val*10; 4-element array)." CURVE 0x4000919E RL_VALUE_UBYTE 0 CM_u8_rspeed_10rpm 0 2550
 /begin AXIS_DESCR COM_AXIS NO_INPUT_QUANTITY CM_u8_temp_5_8_40c 4 -40 119.375 AXIS_PTS_REF CAL_injtip_dfco_disasble_ingear_ips_X_coolant_temp /end AXIS_DESCR
/end CHARACTERISTIC
/begin AXIS_PTS CAL_injtip_comp_negative_load_X_load "Calibration: X-axis (load) for the injector tip-in compensation negative load table (mg/stroke = val*4; 16-element array)." 0x400091A2 NO_INPUT_QUANTITY RL_AXIS_UBYTE 0 CM_u8_load_4mg_stroke 16 0 1020 /end AXIS_PTS
/begin CHARACTERISTIC CAL_injtip_comp_negative_load "Calibration: injector tip-in compensation negative load (16-element array)." CURVE 0x400091B2 RL_VALUE_UBYTE 0 NO_COMPU_METHOD 0 255
 /begin AXIS_DESCR COM_AXIS NO_INPUT_QUANTITY CM_u8_load_4mg_stroke 16 0 1020 AXIS_PTS_REF CAL_injtip_comp_negative_load_X_load /end AXIS_DESCR
/end CHARACTERISTIC
/begin AXIS_PTS CAL_idle_target_manual_tour_X_coolant_temp "Calibration: X-axis (coolant temp) for the idle target manual tour table (°C = val*5/8−40; 16-element array)." 0x400091C2 NO_INPUT_QUANTITY RL_AXIS_UBYTE 0 CM_u8_temp_5_8_40c 16 -40 119.375 /end AXIS_PTS
/begin CHARACTERISTIC CAL_idle_target_manual_tour "Calibration: idle target manual tour (RPM = val*4+500; 16-element array)." CURVE 0x400091D2 RL_VALUE_UBYTE 0 CM_u8_rspeed_4_500rpm 500 1520
 /begin AXIS_DESCR COM_AXIS NO_INPUT_QUANTITY CM_u8_temp_5_8_40c 16 -40 119.375 AXIS_PTS_REF CAL_idle_target_manual_tour_X_coolant_temp /end AXIS_DESCR
/end CHARACTERISTIC
/begin CHARACTERISTIC CAL_idle_air_warmup_factor_manual_X_coolant_temp "undefined" VALUE 0x400091E2 RL_VALUE_ULONG 0 NO_COMPU_METHOD 0 4294967295 /end CHARACTERISTIC
/begin CHARACTERISTIC CAL_idle_air_warmup_factor_manual_Y_maf_accumulated "undefined" VALUE 0x400091F2 RL_VALUE_ULONG 0 NO_COMPU_METHOD 0 4294967295 /end CHARACTERISTIC
/begin CHARACTERISTIC CAL_idle_air_warmup_factor_manual "undefined" VALUE 0x400091FA RL_VALUE_ULONG 0 NO_COMPU_METHOD 0 4294967295 /end CHARACTERISTIC
/begin AXIS_PTS CAL_tpssmooth_increment_rpm_X_rpm "Calibration: X-axis (rpm) for the tpssmooth increment RPM table (RPM = val*125/4+500; 8-element array)." 0x4000927A NO_INPUT_QUANTITY RL_AXIS_UBYTE 0 CM_u8_rspeed_125_4_500rpm 8 500 8468.75 /end AXIS_PTS
/begin CHARACTERISTIC CAL_tpssmooth_increment_rpm "Calibration: tpssmooth increment RPM (val/255; 8-element array)." CURVE 0x40009282 RL_VALUE_UBYTE 0 CM_u8_factor_1_255 0 100
 /begin AXIS_DESCR COM_AXIS NO_INPUT_QUANTITY CM_u8_rspeed_125_4_500rpm 8 500 8468.75 AXIS_PTS_REF CAL_tpssmooth_increment_rpm_X_rpm /end AXIS_DESCR
/end CHARACTERISTIC
/begin AXIS_PTS CAL_tpssmooth_increment_sport_X_tps_diff "Calibration: X-axis (tps diff) for the tpssmooth increment sport table (val/255; 8-element array)." 0x4000928A NO_INPUT_QUANTITY RL_AXIS_UBYTE 0 CM_u8_factor_1_255 8 0 100 /end AXIS_PTS
/begin CHARACTERISTIC CAL_tpssmooth_increment_sport "Calibration: tpssmooth increment sport (val/255; 8-element array)." CURVE 0x40009292 RL_VALUE_UBYTE 0 CM_u8_factor_1_255 0 100
 /begin AXIS_DESCR COM_AXIS NO_INPUT_QUANTITY CM_u8_factor_1_255 8 0 100 AXIS_PTS_REF CAL_tpssmooth_increment_sport_X_tps_diff /end AXIS_DESCR
/end CHARACTERISTIC
/begin AXIS_PTS CAL_idle_comp_ac_X_ac_load "Calibration: X-axis (ac load) for the idle compensation A/C table (8-element array)." 0x4000929A NO_INPUT_QUANTITY RL_AXIS_UWORD 0 NO_COMPU_METHOD 8 0 65535 /end AXIS_PTS
/begin CHARACTERISTIC CAL_idle_comp_ac "Calibration: idle compensation A/C (8-element array)." CURVE 0x400092AA RL_VALUE_UWORD 0 NO_COMPU_METHOD 0 65535
 /begin AXIS_DESCR COM_AXIS NO_INPUT_QUANTITY NO_COMPU_METHOD 8 0 65535 AXIS_PTS_REF CAL_idle_comp_ac_X_ac_load /end AXIS_DESCR
/end CHARACTERISTIC
/begin AXIS_PTS CAL_ign_comp_coolant_manual1_X_coolant_temp "Calibration: X-axis (coolant temp) for the ignition compensation coolant manual1 table (°C = val*5/8−40; 16-element array)." 0x400092DA NO_INPUT_QUANTITY RL_AXIS_UBYTE 0 CM_u8_temp_5_8_40c 16 -40 119.375 /end AXIS_PTS
/begin CHARACTERISTIC CAL_ign_comp_coolant_manual1 "Calibration: ignition compensation coolant manual1 (° = val/4; 16-element array)." CURVE 0x400092EA RL_VALUE_UBYTE 0 CM_u8_angle_1_4deg 0 63.75
 /begin AXIS_DESCR COM_AXIS NO_INPUT_QUANTITY CM_u8_temp_5_8_40c 16 -40 119.375 AXIS_PTS_REF CAL_ign_comp_coolant_manual1_X_coolant_temp /end AXIS_DESCR
/end CHARACTERISTIC
/begin AXIS_PTS CAL_ign_comp_idle_error_X_rpm "Calibration: X-axis (rpm) for the ignition compensation idle error1 table (RPM = val−128; 16-element array)." 0x400092FA NO_INPUT_QUANTITY RL_AXIS_UBYTE 0 CM_u8_rspeed__128 16 -128 127 /end AXIS_PTS
/begin CHARACTERISTIC CAL_ign_comp_idle_error "Calibration: ignition compensation idle error1 (° = val/4−32; 16-element array)." CURVE 0x4000930A RL_VALUE_UBYTE 0 CM_u8_angle_1_4_32deg -32 31.75
 /begin AXIS_DESCR COM_AXIS NO_INPUT_QUANTITY CM_u8_rspeed__128 16 -128 127 AXIS_PTS_REF CAL_ign_comp_idle_error_X_rpm /end AXIS_DESCR
/end CHARACTERISTIC
/begin AXIS_PTS CAL_ign_comp_engine_air_X_air_temp "Calibration: X-axis (air temp) for the ignition compensation engine air table (°C = val*5/8−40; 16-element array)." 0x4000931A NO_INPUT_QUANTITY RL_AXIS_UBYTE 0 CM_u8_temp_5_8_40c 16 -40 119.375 /end AXIS_PTS
/begin CHARACTERISTIC CAL_ign_comp_engine_air "Calibration: ignition compensation engine air (° = val/4−32; 16-element array)." CURVE 0x4000932A RL_VALUE_UBYTE 0 CM_u8_angle_1_4_32deg -32 31.75
 /begin AXIS_DESCR COM_AXIS NO_INPUT_QUANTITY CM_u8_temp_5_8_40c 16 -40 119.375 AXIS_PTS_REF CAL_ign_comp_engine_air_X_air_temp /end AXIS_DESCR
/end CHARACTERISTIC
/begin AXIS_PTS CAL_injtip_in_rpm_scale_X_rpm "Calibration: X-axis (rpm) for the injector tip-in in RPM scale table (RPM = val*125/4+500; 16-element array)." 0x4000933A NO_INPUT_QUANTITY RL_AXIS_UBYTE 0 CM_u8_rspeed_125_4_500rpm 16 500 8468.75 /end AXIS_PTS
/begin CHARACTERISTIC CAL_injtip_in_rpm_scale "Calibration: injector tip-in in RPM scale (16-element array)." CURVE 0x4000934A RL_VALUE_UBYTE 0 NO_COMPU_METHOD 0 255
 /begin AXIS_DESCR COM_AXIS NO_INPUT_QUANTITY CM_u8_rspeed_125_4_500rpm 16 500 8468.75 AXIS_PTS_REF CAL_injtip_in_rpm_scale_X_rpm /end AXIS_DESCR
/end CHARACTERISTIC
/begin AXIS_PTS CAL_injtip_in_rpm_decay_X_rpm "Calibration: X-axis (rpm) for the injector tip-in in RPM decay table (RPM = val*125/4+500; 16-element array)." 0x4000935A NO_INPUT_QUANTITY RL_AXIS_UBYTE 0 CM_u8_rspeed_125_4_500rpm 16 500 8468.75 /end AXIS_PTS
/begin CHARACTERISTIC CAL_injtip_in_rpm_decay "Calibration: injector tip-in in RPM decay (16-element array)." CURVE 0x4000936A RL_VALUE_UBYTE 0 NO_COMPU_METHOD 0 255
 /begin AXIS_DESCR COM_AXIS NO_INPUT_QUANTITY CM_u8_rspeed_125_4_500rpm 16 500 8468.75 AXIS_PTS_REF CAL_injtip_in_rpm_decay_X_rpm /end AXIS_DESCR
/end CHARACTERISTIC
/begin AXIS_PTS CAL_injtip_in_coolant_scale_X_coolant_temp "Calibration: X-axis (coolant temp) for the injector tip-in in coolant scale table (°C = val*5/8−40; 16-element array)." 0x4000937A NO_INPUT_QUANTITY RL_AXIS_UBYTE 0 CM_u8_temp_5_8_40c 16 -40 119.375 /end AXIS_PTS
/begin CHARACTERISTIC CAL_injtip_in_coolant_scale "Calibration: injector tip-in in coolant scale (val/64; 16-element array)." CURVE 0x4000938A RL_VALUE_UBYTE 0 CM_u8_factor_1_64 0 398.4375
 /begin AXIS_DESCR COM_AXIS NO_INPUT_QUANTITY CM_u8_temp_5_8_40c 16 -40 119.375 AXIS_PTS_REF CAL_injtip_in_coolant_scale_X_coolant_temp /end AXIS_DESCR
/end CHARACTERISTIC
/begin AXIS_PTS CAL_injtip_out_rpm_scale_X_rpm "Calibration: X-axis (rpm) for the injector tip-in out RPM scale table (RPM = val*125/4+500; 16-element array)." 0x4000939A NO_INPUT_QUANTITY RL_AXIS_UBYTE 0 CM_u8_rspeed_125_4_500rpm 16 500 8468.75 /end AXIS_PTS
/begin CHARACTERISTIC CAL_injtip_out_rpm_scale "Calibration: injector tip-in out RPM scale (16-element array)." CURVE 0x400093AA RL_VALUE_UBYTE 0 NO_COMPU_METHOD 0 255
 /begin AXIS_DESCR COM_AXIS NO_INPUT_QUANTITY CM_u8_rspeed_125_4_500rpm 16 500 8468.75 AXIS_PTS_REF CAL_injtip_out_rpm_scale_X_rpm /end AXIS_DESCR
/end CHARACTERISTIC
/begin AXIS_PTS CAL_injtip_out_rpm_decay_X_rpm "Calibration: X-axis (rpm) for the injector tip-in out RPM decay table (RPM = val*125/4+500; 16-element array)." 0x400093BA NO_INPUT_QUANTITY RL_AXIS_UBYTE 0 CM_u8_rspeed_125_4_500rpm 16 500 8468.75 /end AXIS_PTS
/begin CHARACTERISTIC CAL_injtip_out_rpm_decay "Calibration: injector tip-in out RPM decay (val/1023; 16-element array)." CURVE 0x400093CA RL_VALUE_UBYTE 0 CM_u16_factor_1_1023 0 24.9266862170088
 /begin AXIS_DESCR COM_AXIS NO_INPUT_QUANTITY CM_u8_rspeed_125_4_500rpm 16 500 8468.75 AXIS_PTS_REF CAL_injtip_out_rpm_decay_X_rpm /end AXIS_DESCR
/end CHARACTERISTIC
/begin AXIS_PTS CAL_injtip_out_coolant_scale_X_rpm "Calibration: X-axis (rpm) for the injector tip-in out coolant scale table (°C = val*5/8−40; 16-element array)." 0x400093DA NO_INPUT_QUANTITY RL_AXIS_UBYTE 0 CM_u8_temp_5_8_40c 16 -40 119.375 /end AXIS_PTS
/begin CHARACTERISTIC CAL_injtip_out_coolant_scale "Calibration: injector tip-in out coolant scale (val/64; 16-element array)." CURVE 0x400093EA RL_VALUE_UBYTE 0 CM_u8_factor_1_64 0 398.4375
 /begin AXIS_DESCR COM_AXIS NO_INPUT_QUANTITY CM_u8_temp_5_8_40c 16 -40 119.375 AXIS_PTS_REF CAL_injtip_out_coolant_scale_X_rpm /end AXIS_DESCR
/end CHARACTERISTIC
/begin AXIS_PTS CAL_ign_limit_first_gear_manual_X_engine_speed "Calibration: X-axis (engine speed) for the ignition limit first gear manual table (RPM = val*125/4+500; 8-element array)." 0x4000940A NO_INPUT_QUANTITY RL_AXIS_UBYTE 0 CM_u8_rspeed_125_4_500rpm 8 500 8468.75 /end AXIS_PTS
/begin CHARACTERISTIC CAL_ign_limit_first_gear_manual "Calibration: ignition limit first gear manual (° = val/4−10; 8-element array)." CURVE 0x40009412 RL_VALUE_UBYTE 0 CM_u8_angle_1_4_10deg -10 53.75
 /begin AXIS_DESCR COM_AXIS NO_INPUT_QUANTITY CM_u8_rspeed_125_4_500rpm 8 500 8468.75 AXIS_PTS_REF CAL_ign_limit_first_gear_manual_X_engine_speed /end AXIS_DESCR
/end CHARACTERISTIC
/begin AXIS_PTS CAL_idle_comp_baro2_X_ambient_baro "Calibration: X-axis (ambiant baro) for the idle compensation baro2 table (mbar; 8-element array)." 0x4000941A NO_INPUT_QUANTITY RL_AXIS_UWORD 0 CM_u16_pressure_mbar 8 0 65535 /end AXIS_PTS
/begin CHARACTERISTIC CAL_idle_comp_baro2 "Calibration: idle compensation baro2 (8-element array)." CURVE 0x4000942A RL_VALUE_SWORD 0 NO_COMPU_METHOD -32768 32767
 /begin AXIS_DESCR COM_AXIS NO_INPUT_QUANTITY CM_u16_pressure_mbar 8 0 65535 AXIS_PTS_REF CAL_idle_comp_baro2_X_ambient_baro /end AXIS_DESCR
/end CHARACTERISTIC
/begin AXIS_PTS CAL_tpssmooth_decrement_by_rpm_X_rpm "Calibration: X-axis (rpm) for the tpssmooth decrement by RPM table (RPM = val*125/4+500; 8-element array)." 0x4000945A NO_INPUT_QUANTITY RL_AXIS_UBYTE 0 CM_u8_rspeed_125_4_500rpm 8 500 8468.75 /end AXIS_PTS
/begin CHARACTERISTIC CAL_tpssmooth_decrement_by_rpm "Calibration: tpssmooth decrement by RPM (val/255; 8-element array)." CURVE 0x40009462 RL_VALUE_UBYTE 0 CM_u8_factor_1_255 0 100
 /begin AXIS_DESCR COM_AXIS NO_INPUT_QUANTITY CM_u8_rspeed_125_4_500rpm 8 500 8468.75 AXIS_PTS_REF CAL_tpssmooth_decrement_by_rpm_X_rpm /end AXIS_DESCR
/end CHARACTERISTIC
/begin AXIS_PTS CAL_cruise_proportional_gain_manual_cr_X_gear "Calibration: X-axis (gear) for the cruise proportional gain manual cr table (4-element array)." 0x4000946A NO_INPUT_QUANTITY RL_AXIS_UBYTE 0 NO_COMPU_METHOD 4 0 255 /end AXIS_PTS
/begin CHARACTERISTIC CAL_cruise_proportional_gain_manual_cr "Calibration: cruise proportional gain manual cr (4-element array)." CURVE 0x4000946E RL_VALUE_UBYTE 0 NO_COMPU_METHOD 0 255
 /begin AXIS_DESCR COM_AXIS NO_INPUT_QUANTITY NO_COMPU_METHOD 4 0 255 AXIS_PTS_REF CAL_cruise_proportional_gain_manual_cr_X_gear /end AXIS_DESCR
/end CHARACTERISTIC
/begin AXIS_PTS CAL_cruise_integral_gain_manual_cr_X_gear "Calibration: X-axis (gear) for the cruise integral gain manual cr table (4-element array)." 0x40009472 NO_INPUT_QUANTITY RL_AXIS_UBYTE 0 NO_COMPU_METHOD 4 0 255 /end AXIS_PTS
/begin CHARACTERISTIC CAL_cruise_integral_gain_manual_cr "Calibration: cruise integral gain manual cr (val/100; 4-element array)." CURVE 0x40009476 RL_VALUE_UBYTE 0 CM_u8_factor_1_100 0 255
 /begin AXIS_DESCR COM_AXIS NO_INPUT_QUANTITY NO_COMPU_METHOD 4 0 255 AXIS_PTS_REF CAL_cruise_integral_gain_manual_cr_X_gear /end AXIS_DESCR
/end CHARACTERISTIC
/begin AXIS_PTS CAL_cruise_derivative_gain_manual_cr_X_gear "Calibration: X-axis (gear) for the cruise derivative gain manual cr table (4-element array)." 0x4000947A NO_INPUT_QUANTITY RL_AXIS_UBYTE 0 NO_COMPU_METHOD 4 0 255 /end AXIS_PTS
/begin CHARACTERISTIC CAL_cruise_derivative_gain_manual_cr "Calibration: cruise derivative gain manual cr (4-element array)." CURVE 0x4000947E RL_VALUE_UBYTE 0 NO_COMPU_METHOD 0 255
 /begin AXIS_DESCR COM_AXIS NO_INPUT_QUANTITY NO_COMPU_METHOD 4 0 255 AXIS_PTS_REF CAL_cruise_derivative_gain_manual_cr_X_gear /end AXIS_DESCR
/end CHARACTERISTIC
/begin AXIS_PTS CAL_tps_scaling_factor_rpm_X_rpm "Calibration: X-axis (rpm) for the throttle position scaling factor RPM table (RPM = val*125/4+500; 16-element array)." 0x40009482 NO_INPUT_QUANTITY RL_AXIS_UBYTE 0 CM_u8_rspeed_125_4_500rpm 16 500 8468.75 /end AXIS_PTS
/begin CHARACTERISTIC CAL_tps_scaling_factor_rpm "Calibration: throttle position scaling factor RPM (val/255; 16-element array)." CURVE 0x40009492 RL_VALUE_UBYTE 0 CM_u8_factor_1_255 0 100
 /begin AXIS_DESCR COM_AXIS NO_INPUT_QUANTITY CM_u8_rspeed_125_4_500rpm 16 500 8468.75 AXIS_PTS_REF CAL_tps_scaling_factor_rpm_X_rpm /end AXIS_DESCR
/end CHARACTERISTIC
/begin AXIS_PTS CAL_injtip_dfco_enable_rpm_ips_alt_X_coolant_temp "Calibration: X-axis (coolant temp) for the injector tip-in decel fuel cut-off enable RPM IPS alt table (°C = val*5/8−40; 4-element array)." 0x400094B2 NO_INPUT_QUANTITY RL_AXIS_UBYTE 0 CM_u8_temp_5_8_40c 4 -40 119.375 /end AXIS_PTS
/begin CHARACTERISTIC CAL_injtip_dfco_enable_rpm_ips_alt "Calibration: injector tip-in decel fuel cut-off enable RPM IPS alt (RPM = val*10; 4-element array)." CURVE 0x400094B6 RL_VALUE_UBYTE 0 CM_u8_rspeed_10rpm 0 2550
 /begin AXIS_DESCR COM_AXIS NO_INPUT_QUANTITY CM_u8_temp_5_8_40c 4 -40 119.375 AXIS_PTS_REF CAL_injtip_dfco_enable_rpm_ips_alt_X_coolant_temp /end AXIS_DESCR
/end CHARACTERISTIC
/begin AXIS_PTS CAL_closedloop_proportional_gain_rich_table_X_rpm "Calibration: X-axis (rpm) for the closedloop proportional gain rich table table (RPM = val*125/4+500; 8-element array)." 0x400094BA NO_INPUT_QUANTITY RL_AXIS_UBYTE 0 CM_u8_rspeed_125_4_500rpm 8 500 8468.75 /end AXIS_PTS
/begin AXIS_PTS CAL_closedloop_proportional_gain_rich_table_Y_load "Calibration: Y-axis (load) for the closedloop proportional gain rich table table (mg/stroke = val*4; 8-element array)." 0x400094C2 NO_INPUT_QUANTITY RL_AXIS_UBYTE 0 CM_u8_load_4mg_stroke 8 0 1020 /end AXIS_PTS
/begin CHARACTERISTIC CAL_closedloop_proportional_gain_rich_table "Calibration: closedloop proportional gain rich table (val/255; 64-element array)." MAP 0x400094CA RL_VALUE_UBYTE 0 CM_u8_factor_1_255 0 100
 /begin AXIS_DESCR COM_AXIS NO_INPUT_QUANTITY CM_u8_rspeed_125_4_500rpm 8 500 8468.75 AXIS_PTS_REF CAL_closedloop_proportional_gain_rich_table_X_rpm /end AXIS_DESCR
 /begin AXIS_DESCR COM_AXIS NO_INPUT_QUANTITY CM_u8_load_4mg_stroke 8 0 1020 AXIS_PTS_REF CAL_closedloop_proportional_gain_rich_table_Y_load /end AXIS_DESCR
/end CHARACTERISTIC
/begin AXIS_PTS CAL_closedloop_proportional_gain_lean_table_X_rpm "Calibration: X-axis (rpm) for the closedloop proportional gain lean table table (RPM = val*125/4+500; 8-element array)." 0x4000950A NO_INPUT_QUANTITY RL_AXIS_UBYTE 0 CM_u8_rspeed_125_4_500rpm 8 500 8468.75 /end AXIS_PTS
/begin AXIS_PTS CAL_closedloop_proportional_gain_lean_table_Y_load "Calibration: Y-axis (load) for the closedloop proportional gain lean table table (mg/stroke = val*4; 8-element array)." 0x40009512 NO_INPUT_QUANTITY RL_AXIS_UBYTE 0 CM_u8_load_4mg_stroke 8 0 1020 /end AXIS_PTS
/begin CHARACTERISTIC CAL_closedloop_proportional_gain_lean_table "Calibration: closedloop proportional gain lean table (val/255; 64-element array)." MAP 0x4000951A RL_VALUE_UBYTE 0 CM_u8_factor_1_255 0 100
 /begin AXIS_DESCR COM_AXIS NO_INPUT_QUANTITY CM_u8_rspeed_125_4_500rpm 8 500 8468.75 AXIS_PTS_REF CAL_closedloop_proportional_gain_lean_table_X_rpm /end AXIS_DESCR
 /begin AXIS_DESCR COM_AXIS NO_INPUT_QUANTITY CM_u8_load_4mg_stroke 8 0 1020 AXIS_PTS_REF CAL_closedloop_proportional_gain_lean_table_Y_load /end AXIS_DESCR
/end CHARACTERISTIC
/begin AXIS_PTS CAL_closedloop_integral_gain_table_X_rpm "Calibration: X-axis (rpm) for the closedloop integral gain table table (RPM = val*125/4+500; 8-element array)." 0x4000955A NO_INPUT_QUANTITY RL_AXIS_UBYTE 0 CM_u8_rspeed_125_4_500rpm 8 500 8468.75 /end AXIS_PTS
/begin AXIS_PTS CAL_closedloop_integral_gain_table_Y_load "Calibration: Y-axis (load) for the closedloop integral gain table table (mg/stroke = val*4; 8-element array)." 0x40009562 NO_INPUT_QUANTITY RL_AXIS_UBYTE 0 CM_u8_load_4mg_stroke 8 0 1020 /end AXIS_PTS
/begin CHARACTERISTIC CAL_closedloop_integral_gain_table "Calibration: closedloop integral gain table (val/255; 64-element array)." MAP 0x4000956A RL_VALUE_UBYTE 0 CM_u8_factor_1_255 0 100
 /begin AXIS_DESCR COM_AXIS NO_INPUT_QUANTITY CM_u8_rspeed_125_4_500rpm 8 500 8468.75 AXIS_PTS_REF CAL_closedloop_integral_gain_table_X_rpm /end AXIS_DESCR
 /begin AXIS_DESCR COM_AXIS NO_INPUT_QUANTITY CM_u8_load_4mg_stroke 8 0 1020 AXIS_PTS_REF CAL_closedloop_integral_gain_table_Y_load /end AXIS_DESCR
/end CHARACTERISTIC
/begin AXIS_PTS CAL_closedloop_derivative_gain_table_X_rpm "Calibration: X-axis (rpm) for the closedloop derivative gain table table (RPM = val*125/4+500; 8-element array)." 0x400095AA NO_INPUT_QUANTITY RL_AXIS_UBYTE 0 CM_u8_rspeed_125_4_500rpm 8 500 8468.75 /end AXIS_PTS
/begin AXIS_PTS CAL_closedloop_derivative_gain_table_Y_load "Calibration: Y-axis (load) for the closedloop derivative gain table table (mg/stroke = val*4; 8-element array)." 0x400095B2 NO_INPUT_QUANTITY RL_AXIS_UBYTE 0 CM_u8_load_4mg_stroke 8 0 1020 /end AXIS_PTS
/begin CHARACTERISTIC CAL_closedloop_derivative_gain_table "Calibration: closedloop derivative gain table (val/255; 64-element array)." MAP 0x400095BA RL_VALUE_UBYTE 0 CM_u8_factor_1_255 0 100
 /begin AXIS_DESCR COM_AXIS NO_INPUT_QUANTITY CM_u8_rspeed_125_4_500rpm 8 500 8468.75 AXIS_PTS_REF CAL_closedloop_derivative_gain_table_X_rpm /end AXIS_DESCR
 /begin AXIS_DESCR COM_AXIS NO_INPUT_QUANTITY CM_u8_load_4mg_stroke 8 0 1020 AXIS_PTS_REF CAL_closedloop_derivative_gain_table_Y_load /end AXIS_DESCR
/end CHARACTERISTIC
/begin AXIS_PTS CAL_inj_efficiency_X_engine_speed "Calibration: X-axis (engine speed) for the injector efficiency table (RPM = val*125/4+500; 20-element array)." 0x400095FA NO_INPUT_QUANTITY RL_AXIS_UBYTE 0 CM_u8_rspeed_125_4_500rpm 20 500 8468.75 /end AXIS_PTS
/begin AXIS_PTS CAL_inj_efficiency_Y_engine_load "Calibration: Y-axis (engine load) for the injector efficiency table (mg/stroke = val*1173; 20-element array)." 0x4000960E NO_INPUT_QUANTITY RL_AXIS_UBYTE 0 CM_u8_load_1173mg_255stroke 20 0 1173 /end AXIS_PTS
/begin CHARACTERISTIC CAL_inj_efficiency "Calibration: injector efficiency (val/200; 400-element array)." MAP 0x40009622 RL_VALUE_UBYTE 0 CM_u8_factor_1_200 0 127.5
 /begin AXIS_DESCR COM_AXIS NO_INPUT_QUANTITY CM_u8_rspeed_125_4_500rpm 20 500 8468.75 AXIS_PTS_REF CAL_inj_efficiency_X_engine_speed /end AXIS_DESCR
 /begin AXIS_DESCR COM_AXIS NO_INPUT_QUANTITY CM_u8_load_1173mg_255stroke 20 0 1173 AXIS_PTS_REF CAL_inj_efficiency_Y_engine_load /end AXIS_DESCR
/end CHARACTERISTIC
/begin AXIS_PTS CAL_load_to_tps_mapping_X_rpm "Calibration: X-axis (rpm) for the load to throttle position mapping table (RPM = val*125/4+500; 20-element array)." 0x400097B2 NO_INPUT_QUANTITY RL_AXIS_UBYTE 0 CM_u8_rspeed_125_4_500rpm 20 500 8468.75 /end AXIS_PTS
/begin AXIS_PTS CAL_load_to_tps_mapping_Y_load "Calibration: Y-axis (load) for the load to throttle position mapping table (mg/stroke = val*1173; 20-element array)." 0x400097C6 NO_INPUT_QUANTITY RL_AXIS_UBYTE 0 CM_u8_load_1173mg_255stroke 20 0 1173 /end AXIS_PTS
/begin CHARACTERISTIC CAL_load_to_tps_mapping "Calibration: load to throttle position mapping (val/255; 400-element array)." MAP 0x400097DA RL_VALUE_UBYTE 0 CM_u8_factor_1_255 0 100
 /begin AXIS_DESCR COM_AXIS NO_INPUT_QUANTITY CM_u8_rspeed_125_4_500rpm 20 500 8468.75 AXIS_PTS_REF CAL_load_to_tps_mapping_X_rpm /end AXIS_DESCR
 /begin AXIS_DESCR COM_AXIS NO_INPUT_QUANTITY CM_u8_load_1173mg_255stroke 20 0 1173 AXIS_PTS_REF CAL_load_to_tps_mapping_Y_load /end AXIS_DESCR
/end CHARACTERISTIC
/begin AXIS_PTS CAL_dpm_torque_cut_p_term_X_carspeed "Calibration: X-axis (carspeed) for the driver performance mode torque cut factor table (km/h = val/100; 6-element array)." 0x4000996A NO_INPUT_QUANTITY RL_AXIS_UWORD 0 CM_u8_speed_1_100kph 6 0 655.35 /end AXIS_PTS
/begin AXIS_PTS CAL_dpm_torque_cut_p_term_Y_slip "Calibration: Y-axis (slip) for the driver performance mode torque cut factor table (% = val/8; 10-element array)." 0x40009976 NO_INPUT_QUANTITY RL_AXIS_UWORD 0 CM_u16_slip_1_8pct 10 0 8191.875 /end AXIS_PTS
/begin CHARACTERISTIC CAL_dpm_torque_cut_p_term "dpm_torque_cut_factor is the proportional part of the GT430's ECU traction control. Once the filtered slip error (how far wheel slip is above the target) passes CAL_dpm_intervention_threshold, the ECU looks it up in the 6×10 table CAL_dpm_torque_cut_" MAP 0x4000998A RL_VALUE_UWORD 0 CM_u8_factor_1_255 0 25700
 /begin AXIS_DESCR COM_AXIS NO_INPUT_QUANTITY CM_u8_speed_1_100kph 6 0 655.35 AXIS_PTS_REF CAL_dpm_torque_cut_p_term_X_carspeed /end AXIS_DESCR
 /begin AXIS_DESCR COM_AXIS NO_INPUT_QUANTITY CM_u16_slip_1_8pct 10 0 8191.875 AXIS_PTS_REF CAL_dpm_torque_cut_p_term_Y_slip /end AXIS_DESCR
/end CHARACTERISTIC
/begin AXIS_PTS CAL_dpm_slip_target_from_pedal_X_carspeed "Calibration: X-axis (carspeed) for the driver performance mode slip target compensation pedal table (km/h; 6-element array)." 0x40009A02 NO_INPUT_QUANTITY RL_AXIS_UBYTE 0 CM_u8_speed_kph 6 0 255 /end AXIS_PTS
/begin AXIS_PTS CAL_dpm_slip_target_from_pedal_Y_pps "Calibration: Y-axis (pps) for the driver performance mode slip target compensation pedal table (val/255; 6-element array)." 0x40009A08 NO_INPUT_QUANTITY RL_AXIS_UBYTE 0 CM_u8_factor_1_255 6 0 100 /end AXIS_PTS
/begin CHARACTERISTIC CAL_dpm_slip_target_from_pedal "Calibration: driver performance mode slip target compensation pedal (% = val*2; 36-element array)." MAP 0x40009A0E RL_VALUE_UBYTE 0 CM_u8_slip_2pct 0 510
 /begin AXIS_DESCR COM_AXIS NO_INPUT_QUANTITY CM_u8_speed_kph 6 0 255 AXIS_PTS_REF CAL_dpm_slip_target_from_pedal_X_carspeed /end AXIS_DESCR
 /begin AXIS_DESCR COM_AXIS NO_INPUT_QUANTITY CM_u8_factor_1_255 6 0 100 AXIS_PTS_REF CAL_dpm_slip_target_from_pedal_Y_pps /end AXIS_DESCR
/end CHARACTERISTIC
/begin AXIS_PTS CAL_idle_target_manual_sport_X_coolant_temp "Calibration: X-axis (coolant temp) for the idle target manual sport table (°C = val*5/8−40; 16-element array)." 0x40009A3A NO_INPUT_QUANTITY RL_AXIS_UBYTE 0 CM_u8_temp_5_8_40c 16 -40 119.375 /end AXIS_PTS
/begin CHARACTERISTIC CAL_idle_target_manual_sport "Calibration: idle target manual sport (RPM = val*4+500; 16-element array)." CURVE 0x40009A4A RL_VALUE_UBYTE 0 CM_u8_rspeed_4_500rpm 500 1520
 /begin AXIS_DESCR COM_AXIS NO_INPUT_QUANTITY CM_u8_temp_5_8_40c 16 -40 119.375 AXIS_PTS_REF CAL_idle_target_manual_sport_X_coolant_temp /end AXIS_DESCR
/end CHARACTERISTIC
/begin AXIS_PTS CAL_inj_post_start_tipin_factor_X_rise_rate "uint8_t[8]" 0x40009A5A NO_INPUT_QUANTITY RL_AXIS_UBYTE 0 NO_COMPU_METHOD 8 0 255 /end AXIS_PTS
/begin CHARACTERISTIC CAL_inj_post_start_tipin_factor "u8_factor_1/255[8]" CURVE 0x40009A62 RL_VALUE_UBYTE 0 CM_u8_factor_1_255 0 100
 /begin AXIS_DESCR COM_AXIS NO_INPUT_QUANTITY NO_COMPU_METHOD 8 0 255 AXIS_PTS_REF CAL_inj_post_start_tipin_factor_X_rise_rate /end AXIS_DESCR
/end CHARACTERISTIC
/begin AXIS_PTS CAL_inj_post_start_tipout_factor_X_drop_rate "uint8_t[8]" 0x40009A6A NO_INPUT_QUANTITY RL_AXIS_UBYTE 0 NO_COMPU_METHOD 8 0 255 /end AXIS_PTS
/begin CHARACTERISTIC CAL_inj_post_start_tipout_factor "u8_factor_1/255[8]" CURVE 0x40009A72 RL_VALUE_UBYTE 0 CM_u8_factor_1_255 0 100
 /begin AXIS_DESCR COM_AXIS NO_INPUT_QUANTITY NO_COMPU_METHOD 8 0 255 AXIS_PTS_REF CAL_inj_post_start_tipout_factor_X_drop_rate /end AXIS_DESCR
/end CHARACTERISTIC
/begin AXIS_PTS CAL_vvt_exhaust_advance_base_X_engine_speed "Calibration: X-axis (engine speed) for the VVT exhaust advance base table (RPM = val*125/4+500; 16-element array)." 0x40009A7A NO_INPUT_QUANTITY RL_AXIS_UBYTE 0 CM_u8_rspeed_125_4_500rpm 16 500 8468.75 /end AXIS_PTS
/begin AXIS_PTS CAL_vvt_exhaust_advance_base_Y_load "Calibration: Y-axis (load) for the VVT exhaust advance base table (mg/stroke = val*4; 16-element array)." 0x40009A8A NO_INPUT_QUANTITY RL_AXIS_UBYTE 0 CM_u8_load_4mg_stroke 16 0 1020 /end AXIS_PTS
/begin CHARACTERISTIC CAL_vvt_exhaust_advance_base "Calibration: VVT exhaust advance base (° = val/4; 256-element array)." MAP 0x40009A9A RL_VALUE_UBYTE 0 CM_u8_angle_1_4deg 0 63.75
 /begin AXIS_DESCR COM_AXIS NO_INPUT_QUANTITY CM_u8_rspeed_125_4_500rpm 16 500 8468.75 AXIS_PTS_REF CAL_vvt_exhaust_advance_base_X_engine_speed /end AXIS_DESCR
 /begin AXIS_DESCR COM_AXIS NO_INPUT_QUANTITY CM_u8_load_4mg_stroke 16 0 1020 AXIS_PTS_REF CAL_vvt_exhaust_advance_base_Y_load /end AXIS_DESCR
/end CHARACTERISTIC
/begin CHARACTERISTIC CAL_cluster_shiftlight_rpm_offset_manual "Calibration: cluster shiftlight RPM offset manual (8-element array)." VAL_BLK 0x40009B9A RL_VALUE_UBYTE 0 NO_COMPU_METHOD 0 255 NUMBER 8 /end CHARACTERISTIC
/begin CHARACTERISTIC CAL_cluster_shiftlight_rpm_offset_manual_40009BA2 "Calibration: cluster shiftlight RPM offset manual (RPM = val*8; 8-element array)." VAL_BLK 0x40009BA2 RL_VALUE_UBYTE 0 CM_u8_rspeed_8rpm 0 2040 NUMBER 8 /end CHARACTERISTIC
/begin AXIS_PTS CAL_load_reference_charge_X_rpm "Calibration: X-axis (rpm) for the load reference charge table (RPM = val*125/4+500; 16-element array)." 0x40009BAA NO_INPUT_QUANTITY RL_AXIS_UBYTE 0 CM_u8_rspeed_125_4_500rpm 16 500 8468.75 /end AXIS_PTS
/begin CHARACTERISTIC CAL_load_reference_charge "Calibration: load reference charge (mg/stroke = val*4; 16-element array)." CURVE 0x40009BBA RL_VALUE_UBYTE 0 CM_u8_load_4mg_stroke 0 1020
 /begin AXIS_DESCR COM_AXIS NO_INPUT_QUANTITY CM_u8_rspeed_125_4_500rpm 16 500 8468.75 AXIS_PTS_REF CAL_load_reference_charge_X_rpm /end AXIS_DESCR
/end CHARACTERISTIC
/begin AXIS_PTS CAL_tpssmooth_increment_tour_X_tps_diff "Calibration: X-axis (tps diff) for the tpssmooth increment tour table (val/255; 8-element array)." 0x40009BCA NO_INPUT_QUANTITY RL_AXIS_UBYTE 0 CM_u8_factor_1_255 8 0 100 /end AXIS_PTS
/begin CHARACTERISTIC CAL_tpssmooth_increment_tour "Calibration: tpssmooth increment tour (val/255; 8-element array)." CURVE 0x40009BD2 RL_VALUE_UBYTE 0 CM_u8_factor_1_255 0 100
 /begin AXIS_DESCR COM_AXIS NO_INPUT_QUANTITY CM_u8_factor_1_255 8 0 100 AXIS_PTS_REF CAL_tpssmooth_increment_tour_X_tps_diff /end AXIS_DESCR
/end CHARACTERISTIC
/begin AXIS_PTS CAL_load_unused1_X_rpm "Calibration: X-axis (rpm) for the load unused1 table (RPM = val*125/4+500; 16-element array)." 0x40009BDA NO_INPUT_QUANTITY RL_AXIS_UBYTE 0 CM_u8_rspeed_125_4_500rpm 16 500 8468.75 /end AXIS_PTS
/begin CHARACTERISTIC CAL_load_unused1 "Calibration: load unused1 (16-element array)." CURVE 0x40009BEA RL_VALUE_UBYTE 0 NO_COMPU_METHOD 0 255
 /begin AXIS_DESCR COM_AXIS NO_INPUT_QUANTITY CM_u8_rspeed_125_4_500rpm 16 500 8468.75 AXIS_PTS_REF CAL_load_unused1_X_rpm /end AXIS_DESCR
/end CHARACTERISTIC
/begin AXIS_PTS CAL_inj_warmup_factor_manual_X_load "Calibration: X-axis (load) for the injector enrichment factor load n coolant manual table (mg/stroke = val*4; 12-element array)." 0x40009BFA NO_INPUT_QUANTITY RL_AXIS_UBYTE 0 CM_u8_load_4mg_stroke 12 0 1020 /end AXIS_PTS
/begin AXIS_PTS CAL_inj_warmup_factor_manual_Y_cooland "Calibration: Y-axis (coolant) for the injector enrichment factor load n coolant manual table (°C = val*5/8−40; 16-element array)." 0x40009C06 NO_INPUT_QUANTITY RL_AXIS_UBYTE 0 CM_u8_temp_5_8_40c 16 -40 119.375 /end AXIS_PTS
/begin CHARACTERISTIC CAL_inj_warmup_factor_manual "Calibration: injector enrichment factor load n coolant manual (val/64; 192-element array)." MAP 0x40009C16 RL_VALUE_UBYTE 0 CM_u8_factor_1_64 0 398.4375
 /begin AXIS_DESCR COM_AXIS NO_INPUT_QUANTITY CM_u8_load_4mg_stroke 12 0 1020 AXIS_PTS_REF CAL_inj_warmup_factor_manual_X_load /end AXIS_DESCR
 /begin AXIS_DESCR COM_AXIS NO_INPUT_QUANTITY CM_u8_temp_5_8_40c 16 -40 119.375 AXIS_PTS_REF CAL_inj_warmup_factor_manual_Y_cooland /end AXIS_DESCR
/end CHARACTERISTIC
/begin AXIS_PTS CAL_torque_engine_ac_load_scaler_X_engine_speed "Calibration: X-axis (engine speed) for the torque engine A/C load scaler table (RPM = val*125/4+500; 8-element array)." 0x40009CD6 NO_INPUT_QUANTITY RL_AXIS_UBYTE 0 CM_u8_rspeed_125_4_500rpm 8 500 8468.75 /end AXIS_PTS
/begin CHARACTERISTIC CAL_torque_engine_ac_load_scaler "Calibration: torque engine A/C load scaler (val/255; 8-element array)." CURVE 0x40009CDE RL_VALUE_UBYTE 0 CM_u8_factor_1_255 0 100
 /begin AXIS_DESCR COM_AXIS NO_INPUT_QUANTITY CM_u8_rspeed_125_4_500rpm 8 500 8468.75 AXIS_PTS_REF CAL_torque_engine_ac_load_scaler_X_engine_speed /end AXIS_DESCR
/end CHARACTERISTIC
/begin AXIS_PTS CAL_ecu_engine_speed_target_sport_X_pps "Calibration: X-axis (pps) for the ECU engine speed target sport table (val/1023; 10-element array)." 0x40009CE6 NO_INPUT_QUANTITY RL_AXIS_UWORD 0 CM_u16_factor_1_1023 10 0 6406.15835777126 /end AXIS_PTS
/begin CHARACTERISTIC CAL_ecu_engine_speed_target_sport "Calibration: ECU engine speed target sport (RPM = val/4; 10-element array)." CURVE 0x40009CFA RL_VALUE_UWORD 0 CM_u16_rspeed_1_4rpm 0 16383.75
 /begin AXIS_DESCR COM_AXIS NO_INPUT_QUANTITY CM_u16_factor_1_1023 10 0 6406.15835777126 AXIS_PTS_REF CAL_ecu_engine_speed_target_sport_X_pps /end AXIS_DESCR
/end CHARACTERISTIC
/begin AXIS_PTS CAL_torque_limit_by_coolant_X_coolant "Calibration: X-axis (coolant) for the torque limit by coolant table (°C = val*5/8−40; 4-element array)." 0x40009D0E NO_INPUT_QUANTITY RL_AXIS_UBYTE 0 CM_u8_temp_5_8_40c 4 -40 119.375 /end AXIS_PTS
/begin CHARACTERISTIC CAL_torque_limit_by_coolant "*WARNING* This table has been patched to double the torque values. Each 8bit value represents 4nm of torque." CURVE 0x40009D12 RL_VALUE_UBYTE 0 CM_u8_torque_4nm 0 1020
 /begin AXIS_DESCR COM_AXIS NO_INPUT_QUANTITY CM_u8_temp_5_8_40c 4 -40 119.375 AXIS_PTS_REF CAL_torque_limit_by_coolant_X_coolant /end AXIS_DESCR
/end CHARACTERISTIC
/begin AXIS_PTS CAL_inj_enrichment_charge_air_temp_X_load "Calibration: X-axis (load) for the injector compensation air temp2 table (mg/stroke = val*4; 8-element array)." 0x40009D1A NO_INPUT_QUANTITY RL_AXIS_UBYTE 0 CM_u8_load_4mg_stroke 8 0 1020 /end AXIS_PTS
/begin AXIS_PTS CAL_inj_enrichment_charge_air_temp_Y_charge_temp "Calibration: Y-axis (air temp) for the injector compensation air temp2 table (°C = val*5/8−40; 16-element array)." 0x40009D22 NO_INPUT_QUANTITY RL_AXIS_UBYTE 0 CM_u8_temp_5_8_40c 16 -40 119.375 /end AXIS_PTS
/begin CHARACTERISTIC CAL_inj_enrichment_charge_air_temp "Calibration: injector compensation air temp2 (128-element array)." MAP 0x40009D32 RL_VALUE_UBYTE 0 NO_COMPU_METHOD 0 255
 /begin AXIS_DESCR COM_AXIS NO_INPUT_QUANTITY CM_u8_load_4mg_stroke 8 0 1020 AXIS_PTS_REF CAL_inj_enrichment_charge_air_temp_X_load /end AXIS_DESCR
 /begin AXIS_DESCR COM_AXIS NO_INPUT_QUANTITY CM_u8_temp_5_8_40c 16 -40 119.375 AXIS_PTS_REF CAL_inj_enrichment_charge_air_temp_Y_charge_temp /end AXIS_DESCR
/end CHARACTERISTIC
/begin AXIS_PTS CAL_load_source_selection_threshold_by_tps_X_rpm "Calibration: X-axis (rpm) for the load source selection threshold by throttle position table (RPM = val*125/4+500; 16-element array)." 0x40009DB2 NO_INPUT_QUANTITY RL_AXIS_UBYTE 0 CM_u8_rspeed_125_4_500rpm 16 500 8468.75 /end AXIS_PTS
/begin CHARACTERISTIC CAL_load_source_selection_threshold_by_tps "Calibration: load source selection threshold by throttle position (val/255; 16-element array)." CURVE 0x40009DC2 RL_VALUE_UBYTE 0 CM_u8_factor_1_255 0 100
 /begin AXIS_DESCR COM_AXIS NO_INPUT_QUANTITY CM_u8_rspeed_125_4_500rpm 16 500 8468.75 AXIS_PTS_REF CAL_load_source_selection_threshold_by_tps_X_rpm /end AXIS_DESCR
/end CHARACTERISTIC
/begin AXIS_PTS CAL_idle_comp_tps_while_cranking_X_baro "Calibration: X-axis (baro) for the idle compensation throttle position while cranking table (mbar = val*4; 4-element array)." 0x40009DD2 NO_INPUT_QUANTITY RL_AXIS_UBYTE 0 CM_u8_pressure_4mbar 4 0 1020 /end AXIS_PTS
/begin AXIS_PTS CAL_idle_comp_tps_while_cranking_Y_coolant_temp "Calibration: Y-axis (coolant temp) for the idle compensation throttle position while cranking table (°C = val*5/8−40; 16-element array)." 0x40009DD6 NO_INPUT_QUANTITY RL_AXIS_UBYTE 0 CM_u8_temp_5_8_40c 16 -40 119.375 /end AXIS_PTS
/begin CHARACTERISTIC CAL_idle_comp_tps_while_cranking "Calibration: idle compensation throttle position while cranking (val/255; 64-element array)." MAP 0x40009DE6 RL_VALUE_UBYTE 0 CM_u8_factor_1_255 0 100
 /begin AXIS_DESCR COM_AXIS NO_INPUT_QUANTITY CM_u8_pressure_4mbar 4 0 1020 AXIS_PTS_REF CAL_idle_comp_tps_while_cranking_X_baro /end AXIS_DESCR
 /begin AXIS_DESCR COM_AXIS NO_INPUT_QUANTITY CM_u8_temp_5_8_40c 16 -40 119.375 AXIS_PTS_REF CAL_idle_comp_tps_while_cranking_Y_coolant_temp /end AXIS_DESCR
/end CHARACTERISTIC
/begin AXIS_PTS CAL_knock_inhibit_tps_max_X_rpm "Calibration: X-axis (rpm) for the knock inhibit throttle position maximum table (RPM = val*125/4+500; 16-element array)." 0x40009E2A NO_INPUT_QUANTITY RL_AXIS_UBYTE 0 CM_u8_rspeed_125_4_500rpm 16 500 8468.75 /end AXIS_PTS
/begin CHARACTERISTIC CAL_knock_inhibit_tps_max "Calibration: knock inhibit throttle position maximum (val/255; 16-element array)." CURVE 0x40009E3A RL_VALUE_UBYTE 0 CM_u8_factor_1_255 0 100
 /begin AXIS_DESCR COM_AXIS NO_INPUT_QUANTITY CM_u8_rspeed_125_4_500rpm 16 500 8468.75 AXIS_PTS_REF CAL_knock_inhibit_tps_max_X_rpm /end AXIS_DESCR
/end CHARACTERISTIC
/begin AXIS_PTS CAL_idle_airflow_expected_X_rpm "Calibration: X-axis (rpm) for the idle airflow expected table (RPM; 16-element array)." 0x40009E4A NO_INPUT_QUANTITY RL_AXIS_UWORD 0 CM_u16_rspeed_rpm 16 0 65535 /end AXIS_PTS
/begin CHARACTERISTIC CAL_idle_airflow_expected "Calibration: idle airflow expected (16-element array)." CURVE 0x40009E6A RL_VALUE_UWORD 0 NO_COMPU_METHOD 0 65535
 /begin AXIS_DESCR COM_AXIS NO_INPUT_QUANTITY CM_u16_rspeed_rpm 16 0 65535 AXIS_PTS_REF CAL_idle_airflow_expected_X_rpm /end AXIS_DESCR
/end CHARACTERISTIC
/begin AXIS_PTS CAL_cooling_fan_afterrun_X_air_temp "Calibration: X-axis (air temp) for the cooling fan afterrun table (°C = val*5/8−40; 8-element array)." 0x40009E8A NO_INPUT_QUANTITY RL_AXIS_UBYTE 0 CM_u8_temp_5_8_40c 8 -40 119.375 /end AXIS_PTS
/begin AXIS_PTS CAL_cooling_fan_afterrun_Y_coolant_temp "Calibration: Y-axis (coolant temp) for the cooling fan afterrun table (°C = val*5/8−40; 8-element array)." 0x40009E92 NO_INPUT_QUANTITY RL_AXIS_UBYTE 0 CM_u8_temp_5_8_40c 8 -40 119.375 /end AXIS_PTS
/begin CHARACTERISTIC CAL_cooling_fan_afterrun "Calibration: cooling fan afterrun (ms = val*250; 64-element array)." MAP 0x40009E9A RL_VALUE_UBYTE 0 CM_u8_time_5s 0 1275
 /begin AXIS_DESCR COM_AXIS NO_INPUT_QUANTITY CM_u8_temp_5_8_40c 8 -40 119.375 AXIS_PTS_REF CAL_cooling_fan_afterrun_X_air_temp /end AXIS_DESCR
 /begin AXIS_DESCR COM_AXIS NO_INPUT_QUANTITY CM_u8_temp_5_8_40c 8 -40 119.375 AXIS_PTS_REF CAL_cooling_fan_afterrun_Y_coolant_temp /end AXIS_DESCR
/end CHARACTERISTIC
/begin AXIS_PTS CAL_idle_comp_fan_X_duty_cycle "Calibration: X-axis (duty cycle) for the idle compensation fan table (8-element array)." 0x40009EDA NO_INPUT_QUANTITY RL_AXIS_UWORD 0 NO_COMPU_METHOD 8 0 65535 /end AXIS_PTS
/begin CHARACTERISTIC CAL_idle_comp_fan "Calibration: idle compensation fan (8-element array)." CURVE 0x40009EEA RL_VALUE_UWORD 0 NO_COMPU_METHOD 0 65535
 /begin AXIS_DESCR COM_AXIS NO_INPUT_QUANTITY NO_COMPU_METHOD 8 0 65535 AXIS_PTS_REF CAL_idle_comp_fan_X_duty_cycle /end AXIS_DESCR
/end CHARACTERISTIC
/begin AXIS_PTS CAL_fuel_pump_proportional_gain_X_error "Calibration: X-axis (error) for the fuel pump proportional gain table (mbar = val*50; 8-element array)." 0x40009EFA NO_INPUT_QUANTITY RL_AXIS_UBYTE 0 CM_u8_pressure_50mbar 8 0 12750 /end AXIS_PTS
/begin CHARACTERISTIC CAL_fuel_pump_proportional_gain "Calibration: fuel pump proportional gain (val/255; 8-element array)." CURVE 0x40009F02 RL_VALUE_UBYTE 0 CM_u8_factor_1_255 0 100
 /begin AXIS_DESCR COM_AXIS NO_INPUT_QUANTITY CM_u8_pressure_50mbar 8 0 12750 AXIS_PTS_REF CAL_fuel_pump_proportional_gain_X_error /end AXIS_DESCR
/end CHARACTERISTIC
/begin AXIS_PTS CAL_inj_startup_enrichment_offset_X_coolant_temp_engine_stopped "Calibration: X-axis (coolant temp engine stopped) for the injector startup enrichment offset table (°C = val*5/8−40; 16-element array)." 0x40009F0A NO_INPUT_QUANTITY RL_AXIS_UBYTE 0 CM_u8_temp_5_8_40c 16 -40 119.375 /end AXIS_PTS
/begin CHARACTERISTIC CAL_inj_startup_enrichment_offset "Calibration: injector startup enrichment offset (µs = val*256; 16-element array)." CURVE 0x40009F1A RL_VALUE_UBYTE 0 CM_u8_time_256us 0 65280
 /begin AXIS_DESCR COM_AXIS NO_INPUT_QUANTITY CM_u8_temp_5_8_40c 16 -40 119.375 AXIS_PTS_REF CAL_inj_startup_enrichment_offset_X_coolant_temp_engine_stopped /end AXIS_DESCR
/end CHARACTERISTIC
/begin AXIS_PTS CAL_idle_comp_carspeed_manual_X_carspeed "Calibration: X-axis (carspeed) for the idle compensation carspeed manual table (km/h; 8-element array)." 0x40009F2A NO_INPUT_QUANTITY RL_AXIS_UBYTE 0 CM_u8_speed_kph 8 0 255 /end AXIS_PTS
/begin CHARACTERISTIC CAL_idle_comp_carspeed_manual "Calibration: idle compensation carspeed manual (RPM = val*4; 8-element array)." CURVE 0x40009F32 RL_VALUE_UBYTE 0 CM_u8_rspeed_4rpm 0 1020
 /begin AXIS_DESCR COM_AXIS NO_INPUT_QUANTITY CM_u8_speed_kph 8 0 255 AXIS_PTS_REF CAL_idle_comp_carspeed_manual_X_carspeed /end AXIS_DESCR
/end CHARACTERISTIC
/begin CHARACTERISTIC CAL_inj_deadtime_comp_iat "Calibration: injector compensation intake air temp (val/100; 8-element array)." VAL_BLK 0x40009F42 RL_VALUE_UBYTE 0 CM_u8_factor_1_100 0 255 NUMBER 8 /end CHARACTERISTIC
/begin AXIS_PTS CAL_idle_comp_timer_carspeed_manual_X_airtemp "Calibration: X-axis (airtemp) for the idle compensation timer carspeed manual table (°C = val*5/8−40; 8-element array)." 0x40009F4A NO_INPUT_QUANTITY RL_AXIS_UBYTE 0 CM_u8_temp_5_8_40c 8 -40 119.375 /end AXIS_PTS
/begin AXIS_PTS CAL_idle_comp_timer_carspeed_manual_Y_time_above_speed "Calibration: Y-axis (time above speed) for the idle compensation timer carspeed manual table (8-element array)." 0x40009F52 NO_INPUT_QUANTITY RL_AXIS_UBYTE 0 NO_COMPU_METHOD 8 0 255 /end AXIS_PTS
/begin CHARACTERISTIC CAL_idle_comp_timer_carspeed_manual "Calibration: idle compensation timer carspeed manual (RPM = val*8; 64-element array)." MAP 0x40009F5A RL_VALUE_UBYTE 0 CM_u8_rspeed_8rpm 0 2040
 /begin AXIS_DESCR COM_AXIS NO_INPUT_QUANTITY CM_u8_temp_5_8_40c 8 -40 119.375 AXIS_PTS_REF CAL_idle_comp_timer_carspeed_manual_X_airtemp /end AXIS_DESCR
 /begin AXIS_DESCR COM_AXIS NO_INPUT_QUANTITY NO_COMPU_METHOD 8 0 255 AXIS_PTS_REF CAL_idle_comp_timer_carspeed_manual_Y_time_above_speed /end AXIS_DESCR
/end CHARACTERISTIC
/begin AXIS_PTS CAL_injtip_dfco_pedal_ramp_target_X_pps "Calibration: X-axis (pps) for the injector tip-in decel fuel cut-off pedal ramp target table (val/255; 4-element array)." 0x40009F9A NO_INPUT_QUANTITY RL_AXIS_UBYTE 0 CM_u8_factor_1_255 4 0 100 /end AXIS_PTS
/begin CHARACTERISTIC CAL_injtip_dfco_pedal_ramp_target "Calibration: injector tip-in decel fuel cut-off pedal ramp target (4-element array)." CURVE 0x40009F9E RL_VALUE_UBYTE 0 NO_COMPU_METHOD 0 255
 /begin AXIS_DESCR COM_AXIS NO_INPUT_QUANTITY CM_u8_factor_1_255 4 0 100 AXIS_PTS_REF CAL_injtip_dfco_pedal_ramp_target_X_pps /end AXIS_DESCR
/end CHARACTERISTIC
/begin AXIS_PTS CAL_ign_comp_startup_tps_X_maf_accum "Calibration: X-axis (maf accum) for the ignition compensation MAF accum table (g; 8-element array)." 0x40009FA2 NO_INPUT_QUANTITY RL_AXIS_UBYTE 0 CM_u8_mass_g 8 0 255 /end AXIS_PTS
/begin AXIS_PTS CAL_ign_comp_startup_tps_Y_tps "Calibration: Y-axis (tps) for the ignition compensation MAF accum table (val/255; 8-element array)." 0x40009FAA NO_INPUT_QUANTITY RL_AXIS_UBYTE 0 CM_u8_factor_1_255 8 0 100 /end AXIS_PTS
/begin CHARACTERISTIC CAL_ign_comp_startup_tps "Calibration: ignition compensation MAF accum (° = val/4; 64-element array)." MAP 0x40009FB2 RL_VALUE_SBYTE 0 CM_u8_angle_1_4deg -32 31.75
 /begin AXIS_DESCR COM_AXIS NO_INPUT_QUANTITY CM_u8_mass_g 8 0 255 AXIS_PTS_REF CAL_ign_comp_startup_tps_X_maf_accum /end AXIS_DESCR
 /begin AXIS_DESCR COM_AXIS NO_INPUT_QUANTITY CM_u8_factor_1_255 8 0 100 AXIS_PTS_REF CAL_ign_comp_startup_tps_Y_tps /end AXIS_DESCR
/end CHARACTERISTIC
/begin AXIS_PTS CAL_ign_dwell_time_X_rpm "Calibration: X-axis (rpm) for the ignition dwell time table (RPM = val*125/4+500; 8-element array)." 0x40009FF2 NO_INPUT_QUANTITY RL_AXIS_UBYTE 0 CM_u8_rspeed_125_4_500rpm 8 500 8468.75 /end AXIS_PTS
/begin AXIS_PTS CAL_ign_dwell_time_Y_ecu_voltage "Calibration: Y-axis (ecu voltage) for the ignition dwell time table (V = val*72/1023; 8-element array)." 0x40009FFA NO_INPUT_QUANTITY RL_AXIS_UBYTE 0 CM_u8_voltage_72_1023v 8 0 17.9472140762463 /end AXIS_PTS
/begin CHARACTERISTIC CAL_ign_dwell_time "Calibration: ignition dwell time (µs = val*64; 64-element array)." MAP 0x4000A002 RL_VALUE_UBYTE 0 CM_u8_time_64us 0 16320
 /begin AXIS_DESCR COM_AXIS NO_INPUT_QUANTITY CM_u8_rspeed_125_4_500rpm 8 500 8468.75 AXIS_PTS_REF CAL_ign_dwell_time_X_rpm /end AXIS_DESCR
 /begin AXIS_DESCR COM_AXIS NO_INPUT_QUANTITY CM_u8_voltage_72_1023v 8 0 17.9472140762463 AXIS_PTS_REF CAL_ign_dwell_time_Y_ecu_voltage /end AXIS_DESCR
/end CHARACTERISTIC
/begin AXIS_PTS CAL_ign_knock_safe_X_engine_speed "Calibration: X-axis (engine speed) for the ignition knock safe table (RPM = val*125/4+500; 20-element array)." 0x4000A042 NO_INPUT_QUANTITY RL_AXIS_UBYTE 0 CM_u8_rspeed_125_4_500rpm 20 500 8468.75 /end AXIS_PTS
/begin AXIS_PTS CAL_ign_knock_safe_Y_load "Calibration: Y-axis (load) for the ignition knock safe table (mg/stroke = val*1173; 20-element array)." 0x4000A056 NO_INPUT_QUANTITY RL_AXIS_UBYTE 0 CM_u8_load_1173mg_255stroke 20 0 1173 /end AXIS_PTS
/begin CHARACTERISTIC CAL_ign_knock_safe "Calibration: ignition knock safe (° = val/4−10; 400-element array)." MAP 0x4000A06A RL_VALUE_UBYTE 0 CM_u8_angle_1_4_10deg -10 53.75
 /begin AXIS_DESCR COM_AXIS NO_INPUT_QUANTITY CM_u8_rspeed_125_4_500rpm 20 500 8468.75 AXIS_PTS_REF CAL_ign_knock_safe_X_engine_speed /end AXIS_DESCR
 /begin AXIS_DESCR COM_AXIS NO_INPUT_QUANTITY CM_u8_load_1173mg_255stroke 20 0 1173 AXIS_PTS_REF CAL_ign_knock_safe_Y_load /end AXIS_DESCR
/end CHARACTERISTIC
/begin AXIS_PTS CAL_inj_afr_base_X_engine_speed "Calibration: X-axis (engine speed) for the injector AFR base table (RPM = val*125/4+500; 20-element array)." 0x4000A1FA NO_INPUT_QUANTITY RL_AXIS_UBYTE 0 CM_u8_rspeed_125_4_500rpm 20 500 8468.75 /end AXIS_PTS
/begin AXIS_PTS CAL_inj_afr_base_Y_engine_load "Calibration: Y-axis (engine load) for the injector AFR base table (mg/stroke = val*1173; 20-element array)." 0x4000A20E NO_INPUT_QUANTITY RL_AXIS_UBYTE 0 CM_u8_load_1173mg_255stroke 20 0 1173 /end AXIS_PTS
/begin CHARACTERISTIC CAL_inj_afr_base "Calibration: injector AFR base (val/20+5; 400-element array)." MAP 0x4000A222 RL_VALUE_UBYTE 0 CM_u8_afr_1_20_5 5 17.75
 /begin AXIS_DESCR COM_AXIS NO_INPUT_QUANTITY CM_u8_rspeed_125_4_500rpm 20 500 8468.75 AXIS_PTS_REF CAL_inj_afr_base_X_engine_speed /end AXIS_DESCR
 /begin AXIS_DESCR COM_AXIS NO_INPUT_QUANTITY CM_u8_load_1173mg_255stroke 20 0 1173 AXIS_PTS_REF CAL_inj_afr_base_Y_engine_load /end AXIS_DESCR
/end CHARACTERISTIC
/begin AXIS_PTS CAL_ign_base_manual_X_engine_speed "Calibration: X-axis (engine speed) for the ignition base manual table (RPM = val*125/4+500; 20-element array)." 0x4000A3B2 NO_INPUT_QUANTITY RL_AXIS_UBYTE 0 CM_u8_rspeed_125_4_500rpm 20 500 8468.75 /end AXIS_PTS
/begin AXIS_PTS CAL_ign_base_manual_Y_load "Calibration: Y-axis (load) for the ignition base manual table (mg/stroke = val*1173; 20-element array)." 0x4000A3C6 NO_INPUT_QUANTITY RL_AXIS_UBYTE 0 CM_u8_load_1173mg_255stroke 20 0 1173 /end AXIS_PTS
/begin CHARACTERISTIC CAL_ign_base_manual "Calibration: ignition base manual (° = val/4−10; 400-element array)." MAP 0x4000A3DA RL_VALUE_UBYTE 0 CM_u8_angle_1_4_10deg -10 53.75
 /begin AXIS_DESCR COM_AXIS NO_INPUT_QUANTITY CM_u8_rspeed_125_4_500rpm 20 500 8468.75 AXIS_PTS_REF CAL_ign_base_manual_X_engine_speed /end AXIS_DESCR
 /begin AXIS_DESCR COM_AXIS NO_INPUT_QUANTITY CM_u8_load_1173mg_255stroke 20 0 1173 AXIS_PTS_REF CAL_ign_base_manual_Y_load /end AXIS_DESCR
/end CHARACTERISTIC
/begin AXIS_PTS CAL_torque_engine_friction_speed_component_X_engine_speed "Calibration: X-axis (engine speed) for the torque engine friction speed component table (RPM = val*125/4+500; 20-element array)." 0x4000A56A NO_INPUT_QUANTITY RL_AXIS_UBYTE 0 CM_u8_rspeed_125_4_500rpm 20 500 8468.75 /end AXIS_PTS
/begin AXIS_PTS CAL_torque_engine_friction_speed_component_Y_load "Calibration: Y-axis (load) for the torque engine friction speed component table (mg/stroke = val*1173; 20-element array)." 0x4000A57E NO_INPUT_QUANTITY RL_AXIS_UBYTE 0 CM_u8_load_1173mg_255stroke 20 0 1173 /end AXIS_PTS
/begin CHARACTERISTIC CAL_torque_engine_friction_speed_component "Calibration: torque engine friction speed component (Nm; 400-element array)." MAP 0x4000A592 RL_VALUE_UBYTE 0 CM_u8_torque_nm 0 255
 /begin AXIS_DESCR COM_AXIS NO_INPUT_QUANTITY CM_u8_rspeed_125_4_500rpm 20 500 8468.75 AXIS_PTS_REF CAL_torque_engine_friction_speed_component_X_engine_speed /end AXIS_DESCR
 /begin AXIS_DESCR COM_AXIS NO_INPUT_QUANTITY CM_u8_load_1173mg_255stroke 20 0 1173 AXIS_PTS_REF CAL_torque_engine_friction_speed_component_Y_load /end AXIS_DESCR
/end CHARACTERISTIC
/begin AXIS_PTS CAL_inj_cranking_enrichment_coolant_manual_X_coolant_engine_stopped "Calibration: X-axis (coolant engine stopped) for the injector cranking enrichment coolant manual table (°C = val*5/8−40; 12-element array)." 0x4000A722 NO_INPUT_QUANTITY RL_AXIS_UWORD 0 CM_u8_temp_5_8_40c 12 -40 40919.375 /end AXIS_PTS
/begin AXIS_PTS CAL_inj_cranking_enrichment_coolant_manual_Y_maf_accumulated "Calibration: Y-axis (maf accumulated) for the injector cranking enrichment coolant manual table (mg; 14-element array)." 0x4000A73A NO_INPUT_QUANTITY RL_AXIS_UWORD 0 CM_u16_mass_mg 14 0 65535 /end AXIS_PTS
/begin CHARACTERISTIC CAL_inj_cranking_enrichment_coolant_manual "Calibration: injector cranking enrichment coolant manual (val/32; 168-element array)." MAP 0x4000A756 RL_VALUE_UWORD 0 CM_u16_factor_1_32 0 204796.875
 /begin AXIS_DESCR COM_AXIS NO_INPUT_QUANTITY CM_u8_temp_5_8_40c 12 -40 40919.375 AXIS_PTS_REF CAL_inj_cranking_enrichment_coolant_manual_X_coolant_engine_stopped /end AXIS_DESCR
 /begin AXIS_DESCR COM_AXIS NO_INPUT_QUANTITY CM_u16_mass_mg 14 0 65535 AXIS_PTS_REF CAL_inj_cranking_enrichment_coolant_manual_Y_maf_accumulated /end AXIS_DESCR
/end CHARACTERISTIC
/begin AXIS_PTS CAL_tps_rate_steadystate_threshold_X_rpm "Calibration: X-axis (rpm) for the throttle position rate steadystate threshold table (RPM = val*125/4+500; 4-element array)." 0x4000A8A6 NO_INPUT_QUANTITY RL_AXIS_UBYTE 0 CM_u8_rspeed_125_4_500rpm 4 500 8468.75 /end AXIS_PTS
/begin AXIS_PTS CAL_tps_rate_steadystate_threshold_Y_tps "Calibration: Y-axis (tps) for the throttle position rate steadystate threshold table (val/255; 4-element array)." 0x4000A8AA NO_INPUT_QUANTITY RL_AXIS_UBYTE 0 CM_u8_factor_1_255 4 0 100 /end AXIS_PTS
/begin CHARACTERISTIC CAL_tps_rate_steadystate_threshold "Calibration: throttle position rate steadystate threshold (val/255; 16-element array)." MAP 0x4000A8AE RL_VALUE_UBYTE 0 CM_u8_factor_1_255 0 100
 /begin AXIS_DESCR COM_AXIS NO_INPUT_QUANTITY CM_u8_rspeed_125_4_500rpm 4 500 8468.75 AXIS_PTS_REF CAL_tps_rate_steadystate_threshold_X_rpm /end AXIS_DESCR
 /begin AXIS_DESCR COM_AXIS NO_INPUT_QUANTITY CM_u8_factor_1_255 4 0 100 AXIS_PTS_REF CAL_tps_rate_steadystate_threshold_Y_tps /end AXIS_DESCR
/end CHARACTERISTIC
/begin AXIS_PTS CAL_sensor_maf_scaling_X_signal "Calibration: X-axis (signal) for the sensor MAF scaling table (V = val*5/1023; 32-element array)." 0x4000A8C2 NO_INPUT_QUANTITY RL_AXIS_UWORD 0 CM_u16_voltage_5_1023v 32 0 320.307917888563 /end AXIS_PTS
/begin CHARACTERISTIC CAL_sensor_maf_scaling "Calibration: sensor MAF scaling (mg/s = val*10; 32-element array)." CURVE 0x4000A902 RL_VALUE_UWORD 0 CM_u16_flow_10mg_s 0 655350
 /begin AXIS_DESCR COM_AXIS NO_INPUT_QUANTITY CM_u16_voltage_5_1023v 32 0 320.307917888563 AXIS_PTS_REF CAL_sensor_maf_scaling_X_signal /end AXIS_DESCR
/end CHARACTERISTIC
/begin AXIS_PTS CAL_idle_comp_vehicle_speed_manual_X_carspeed "Calibration: X-axis (carspeed) for the idle compensation vehicle speed manual table (km/h = val/100; 8-element array)." 0x4000A942 NO_INPUT_QUANTITY RL_AXIS_UWORD 0 CM_u8_speed_1_100kph 8 0 655.35 /end AXIS_PTS
/begin CHARACTERISTIC CAL_idle_comp_vehicle_speed_manual "Calibration: idle compensation vehicle speed manual (8-element array)." CURVE 0x4000A952 RL_VALUE_UWORD 0 NO_COMPU_METHOD 0 65535
 /begin AXIS_DESCR COM_AXIS NO_INPUT_QUANTITY CM_u8_speed_1_100kph 8 0 655.35 AXIS_PTS_REF CAL_idle_comp_vehicle_speed_manual_X_carspeed /end AXIS_DESCR
/end CHARACTERISTIC
/begin AXIS_PTS CAL_tpssmooth_decrement_by_delta_X_tps_delta "Calibration: X-axis (tps delta) for the tpssmooth decrement by delta table (val/255; 8-element array)." 0x4000A962 NO_INPUT_QUANTITY RL_AXIS_UBYTE 0 CM_u8_factor_1_255 8 0 100 /end AXIS_PTS
/begin CHARACTERISTIC CAL_tpssmooth_decrement_by_delta "Calibration: tpssmooth decrement by delta (val/255; 8-element array)." CURVE 0x4000A96A RL_VALUE_UBYTE 0 CM_u8_factor_1_255 0 100
 /begin AXIS_DESCR COM_AXIS NO_INPUT_QUANTITY CM_u8_factor_1_255 8 0 100 AXIS_PTS_REF CAL_tpssmooth_decrement_by_delta_X_tps_delta /end AXIS_DESCR
/end CHARACTERISTIC
/begin AXIS_PTS CAL_revlimit_speedbase_manual_tour_X_coolant_temp "Calibration: X-axis (coolant temp) for the rev-limit speedbase manual tour table (°C = val*5/8−40; 4-element array)." 0x4000A972 NO_INPUT_QUANTITY RL_AXIS_UWORD 0 CM_u8_temp_5_8_40c 4 -40 40919.375 /end AXIS_PTS
/begin AXIS_PTS CAL_revlimit_speedbase_manual_tour_Y_timer "Calibration: Y-axis (timer) for the rev-limit speedbase manual tour table (ms = val*5; 4-element array)." 0x4000A97A NO_INPUT_QUANTITY RL_AXIS_UWORD 0 CM_u8_time_5ms 4 0 327675 /end AXIS_PTS
/begin CHARACTERISTIC CAL_revlimit_speedbase_manual_tour "Calibration: rev-limit speedbase manual tour (RPM; 16-element array)." MAP 0x4000A982 RL_VALUE_UWORD 0 CM_u16_rspeed_rpm 0 65535
 /begin AXIS_DESCR COM_AXIS NO_INPUT_QUANTITY CM_u8_temp_5_8_40c 4 -40 40919.375 AXIS_PTS_REF CAL_revlimit_speedbase_manual_tour_X_coolant_temp /end AXIS_DESCR
 /begin AXIS_DESCR COM_AXIS NO_INPUT_QUANTITY CM_u8_time_5ms 4 0 327675 AXIS_PTS_REF CAL_revlimit_speedbase_manual_tour_Y_timer /end AXIS_DESCR
/end CHARACTERISTIC
/begin AXIS_PTS CAL_idle_comp_ecu_voltage_X_voltage "Calibration: X-axis (voltage) for the idle compensation ECU voltage table (V = val*18/1023; 8-element array)." 0x4000A9A2 NO_INPUT_QUANTITY RL_AXIS_UWORD 0 CM_u16_voltage_18_1023v 8 0 1153.10850439883 /end AXIS_PTS
/begin CHARACTERISTIC CAL_idle_comp_ecu_voltage "Calibration: idle compensation ECU voltage (8-element array)." CURVE 0x4000A9B2 RL_VALUE_SWORD 0 NO_COMPU_METHOD -32768 32767
 /begin AXIS_DESCR COM_AXIS NO_INPUT_QUANTITY CM_u16_voltage_18_1023v 8 0 1153.10850439883 AXIS_PTS_REF CAL_idle_comp_ecu_voltage_X_voltage /end AXIS_DESCR
/end CHARACTERISTIC
/begin AXIS_PTS CAL_ign_comp_overtemp_X_rpm "Calibration: X-axis (rpm) for the ignition compensation overtemp table (RPM = val*125/4+500; 16-element array)." 0x4000A9C2 NO_INPUT_QUANTITY RL_AXIS_UBYTE 0 CM_u8_rspeed_125_4_500rpm 16 500 8468.75 /end AXIS_PTS
/begin CHARACTERISTIC CAL_ign_comp_overtemp "Calibration: ignition compensation overtemp (° = val/4−32; 16-element array)." CURVE 0x4000A9D2 RL_VALUE_UBYTE 0 CM_u8_angle_1_4_32deg -32 31.75
 /begin AXIS_DESCR COM_AXIS NO_INPUT_QUANTITY CM_u8_rspeed_125_4_500rpm 16 500 8468.75 AXIS_PTS_REF CAL_ign_comp_overtemp_X_rpm /end AXIS_DESCR
/end CHARACTERISTIC
/begin AXIS_PTS CAL_ign_comp_overtemp_coeff_X_coolant_temp "Calibration: X-axis (coolant temp) for the ignition compensation overtemp coeff table (°C = val*5/8−40; 8-element array)." 0x4000A9E2 NO_INPUT_QUANTITY RL_AXIS_UBYTE 0 CM_u8_temp_5_8_40c 8 -40 119.375 /end AXIS_PTS
/begin CHARACTERISTIC CAL_ign_comp_overtemp_coeff "Calibration: ignition compensation overtemp coeff (val/128; 8-element array)." CURVE 0x4000A9EA RL_VALUE_UBYTE 0 CM_u8_factor_1_128 0 199.21875
 /begin AXIS_DESCR COM_AXIS NO_INPUT_QUANTITY CM_u8_temp_5_8_40c 8 -40 119.375 AXIS_PTS_REF CAL_ign_comp_overtemp_coeff_X_coolant_temp /end AXIS_DESCR
/end CHARACTERISTIC
/begin AXIS_PTS CAL_ign_comp_idle_rpm_rate_X_rpm_delta "Calibration: X-axis (rpm delta) for the ignition compensation speed variation table (16-element array)." 0x4000A9F2 NO_INPUT_QUANTITY RL_AXIS_UBYTE 0 NO_COMPU_METHOD 16 0 255 /end AXIS_PTS
/begin CHARACTERISTIC CAL_ign_comp_idle_rpm_rate "Calibration: ignition compensation speed variation (16-element array)." CURVE 0x4000AA02 RL_VALUE_UBYTE 0 NO_COMPU_METHOD 0 255
 /begin AXIS_DESCR COM_AXIS NO_INPUT_QUANTITY NO_COMPU_METHOD 16 0 255 AXIS_PTS_REF CAL_ign_comp_idle_rpm_rate_X_rpm_delta /end AXIS_DESCR
/end CHARACTERISTIC
/begin AXIS_PTS CAL_vvt_start_timer_X_coolant_temp "Calibration: X-axis (coolant temp) for the VVT start timer table (°C = val*5/8−40; 8-element array)." 0x4000AA12 NO_INPUT_QUANTITY RL_AXIS_UBYTE 0 CM_u8_temp_5_8_40c 8 -40 119.375 /end AXIS_PTS
/begin CHARACTERISTIC CAL_vvt_start_timer "Calibration: VVT start timer (ms = val*100; 8-element array)." CURVE 0x4000AA1A RL_VALUE_UBYTE 0 CM_u8_time_100ms 0 25500
 /begin AXIS_DESCR COM_AXIS NO_INPUT_QUANTITY CM_u8_temp_5_8_40c 8 -40 119.375 AXIS_PTS_REF CAL_vvt_start_timer_X_coolant_temp /end AXIS_DESCR
/end CHARACTERISTIC
/begin AXIS_PTS CAL_closedloop_o2_switch_threshold_X_rpm "Calibration: X-axis (rpm) for the closedloop O2 switch threshold table (RPM = val*125/4+500; 8-element array)." 0x4000AA22 NO_INPUT_QUANTITY RL_AXIS_UBYTE 0 CM_u8_rspeed_125_4_500rpm 8 500 8468.75 /end AXIS_PTS
/begin CHARACTERISTIC CAL_closedloop_o2_switch_threshold "Calibration: closedloop O2 switch threshold (8-element array)." CURVE 0x4000AA2A RL_VALUE_UBYTE 0 NO_COMPU_METHOD 0 255
 /begin AXIS_DESCR COM_AXIS NO_INPUT_QUANTITY CM_u8_rspeed_125_4_500rpm 8 500 8468.75 AXIS_PTS_REF CAL_closedloop_o2_switch_threshold_X_rpm /end AXIS_DESCR
/end CHARACTERISTIC
/begin AXIS_PTS CAL_ign_comp_tps_rate_X_tps_rate "Calibration: X-axis (tps rate) for the ignition compensation throttle position rate table (8-element array)." 0x4000AA32 NO_INPUT_QUANTITY RL_AXIS_UBYTE 0 CM_u8_factor_1_255 8 0 100 /end AXIS_PTS
/begin CHARACTERISTIC CAL_ign_comp_tps_rate "ign_comp_tps_rate — timing pulled for fast pedal movement. This is a straight retard applied whenever the throttle is moving quickly, in either direction, and it's subtracted from the timing target in the normal running paths (:16069, :16090). It's a" CURVE 0x4000AA3A RL_VALUE_SBYTE 0 CM_u8_angle_1_4deg -32 31.75
 /begin AXIS_DESCR COM_AXIS NO_INPUT_QUANTITY CM_u8_factor_1_255 8 0 100 AXIS_PTS_REF CAL_ign_comp_tps_rate_X_tps_rate /end AXIS_DESCR
/end CHARACTERISTIC
/begin AXIS_PTS CAL_knock_sampling_window_X_rpm "Calibration: X-axis (rpm) for the knock sampling window table (RPM = val*125/4+500; 16-element array)." 0x4000AA42 NO_INPUT_QUANTITY RL_AXIS_UBYTE 0 CM_u8_rspeed_125_4_500rpm 16 500 8468.75 /end AXIS_PTS
/begin AXIS_PTS CAL_knock_sampling_window_Y_load "Calibration: Y-axis (load) for the knock sampling window table (mg/stroke = val*4; 16-element array)." 0x4000AA52 NO_INPUT_QUANTITY RL_AXIS_UBYTE 0 CM_u8_load_4mg_stroke 16 0 1020 /end AXIS_PTS
/begin CHARACTERISTIC CAL_knock_sampling_window "Calibration: knock sampling window (256-element array)." MAP 0x4000AA62 RL_VALUE_UBYTE 0 NO_COMPU_METHOD 0 255
 /begin AXIS_DESCR COM_AXIS NO_INPUT_QUANTITY CM_u8_rspeed_125_4_500rpm 16 500 8468.75 AXIS_PTS_REF CAL_knock_sampling_window_X_rpm /end AXIS_DESCR
 /begin AXIS_DESCR COM_AXIS NO_INPUT_QUANTITY CM_u8_load_4mg_stroke 16 0 1020 AXIS_PTS_REF CAL_knock_sampling_window_Y_load /end AXIS_DESCR
/end CHARACTERISTIC
/begin AXIS_PTS CAL_knock_buffer_size_X_engine_speed "Calibration: X-axis (engine speed) for the knock buffer size table (RPM = val*125/4+500; 16-element array)." 0x4000AB62 NO_INPUT_QUANTITY RL_AXIS_UBYTE 0 CM_u8_rspeed_125_4_500rpm 16 500 8468.75 /end AXIS_PTS
/begin AXIS_PTS CAL_knock_buffer_size_Y_load "Calibration: Y-axis (load) for the knock buffer size table (mg/stroke = val*4; 16-element array)." 0x4000AB72 NO_INPUT_QUANTITY RL_AXIS_UBYTE 0 CM_u8_load_4mg_stroke 16 0 1020 /end AXIS_PTS
/begin CHARACTERISTIC CAL_knock_buffer_size "Calibration: knock buffer size (256-element array)." MAP 0x4000AB82 RL_VALUE_UBYTE 0 NO_COMPU_METHOD 0 255
 /begin AXIS_DESCR COM_AXIS NO_INPUT_QUANTITY CM_u8_rspeed_125_4_500rpm 16 500 8468.75 AXIS_PTS_REF CAL_knock_buffer_size_X_engine_speed /end AXIS_DESCR
 /begin AXIS_DESCR COM_AXIS NO_INPUT_QUANTITY CM_u8_load_4mg_stroke 16 0 1020 AXIS_PTS_REF CAL_knock_buffer_size_Y_load /end AXIS_DESCR
/end CHARACTERISTIC
/begin AXIS_PTS CAL_cooling_fan_ac_on_X_air_temp "Calibration: X-axis (air temp) for the cooling fan A/C on table (°C = val*5/8−40; 6-element array)." 0x4000AC82 NO_INPUT_QUANTITY RL_AXIS_UBYTE 0 CM_u8_temp_5_8_40c 6 -40 119.375 /end AXIS_PTS
/begin AXIS_PTS CAL_cooling_fan_ac_on_Y_carspeed "Calibration: Y-axis (carspeed) for the cooling fan A/C on table (6-element array)." 0x4000AC88 NO_INPUT_QUANTITY RL_AXIS_UBYTE 0 NO_COMPU_METHOD 6 0 255 /end AXIS_PTS
/begin CHARACTERISTIC CAL_cooling_fan_ac_on "Calibration: cooling fan A/C on (% = val*100/255; 36-element array)." MAP 0x4000AC8E RL_VALUE_UBYTE 0 CM_u8_factor_1_255 0 100
 /begin AXIS_DESCR COM_AXIS NO_INPUT_QUANTITY CM_u8_temp_5_8_40c 6 -40 119.375 AXIS_PTS_REF CAL_cooling_fan_ac_on_X_air_temp /end AXIS_DESCR
 /begin AXIS_DESCR COM_AXIS NO_INPUT_QUANTITY NO_COMPU_METHOD 6 0 255 AXIS_PTS_REF CAL_cooling_fan_ac_on_Y_carspeed /end AXIS_DESCR
/end CHARACTERISTIC
/begin AXIS_PTS CAL_idle_comp_vehicle_speed_ips_X_vehicle_speed "Calibration: X-axis (vehicle speed) for the idle compensation vehicle speed IPS table (km/h = val/100; 8-element array)." 0x4000ACB2 NO_INPUT_QUANTITY RL_AXIS_UWORD 0 CM_u8_speed_1_100kph 8 0 655.35 /end AXIS_PTS
/begin CHARACTERISTIC CAL_idle_comp_vehicle_speed_ips "Calibration: idle compensation vehicle speed IPS (8-element array)." CURVE 0x4000ACC2 RL_VALUE_UWORD 0 NO_COMPU_METHOD 0 65535
 /begin AXIS_DESCR COM_AXIS NO_INPUT_QUANTITY CM_u8_speed_1_100kph 8 0 655.35 AXIS_PTS_REF CAL_idle_comp_vehicle_speed_ips_X_vehicle_speed /end AXIS_DESCR
/end CHARACTERISTIC
/begin AXIS_PTS CAL_inj_deadtime_base_X_car_voltage "Calibration: X-axis (car voltage) for the injector time base table (V = val*72/1023; 8-element array)." 0x4000ACD2 NO_INPUT_QUANTITY RL_AXIS_UBYTE 0 CM_u8_voltage_72_1023v 8 0 17.9472140762463 /end AXIS_PTS
/begin AXIS_PTS CAL_inj_deadtime_base_Y_fuel_pressure "Calibration: Y-axis (fuel pressure) for the injector time base table (mbar = val*50; 8-element array)." 0x4000ACDA NO_INPUT_QUANTITY RL_AXIS_UBYTE 0 CM_u8_pressure_50mbar 8 0 12750 /end AXIS_PTS
/begin CHARACTERISTIC CAL_inj_deadtime_base "Calibration: injector time base (µs = val*20; 64-element array)." MAP 0x4000ACE2 RL_VALUE_UBYTE 0 CM_u8_time_20us 0 5100
 /begin AXIS_DESCR COM_AXIS NO_INPUT_QUANTITY CM_u8_voltage_72_1023v 8 0 17.9472140762463 AXIS_PTS_REF CAL_inj_deadtime_base_X_car_voltage /end AXIS_DESCR
 /begin AXIS_DESCR COM_AXIS NO_INPUT_QUANTITY CM_u8_pressure_50mbar 8 0 12750 AXIS_PTS_REF CAL_inj_deadtime_base_Y_fuel_pressure /end AXIS_DESCR
/end CHARACTERISTIC
/begin AXIS_PTS CAL_sensor_ac_evap_temp_scaling_X_voltage "Calibration: X-axis (voltage) for the sensor A/C evaporative temperature scaling table (V = val*5/1023; 16-element array)." 0x4000AD22 NO_INPUT_QUANTITY RL_AXIS_UWORD 0 CM_u16_voltage_5_1023v 16 0 320.307917888563 /end AXIS_PTS
/begin CHARACTERISTIC CAL_sensor_ac_evap_temp_scaling "Calibration: sensor A/C evaporative temperature scaling (16-element array)." CURVE 0x4000AD42 RL_VALUE_UWORD 0 NO_COMPU_METHOD 0 65535
 /begin AXIS_DESCR COM_AXIS NO_INPUT_QUANTITY CM_u16_voltage_5_1023v 16 0 320.307917888563 AXIS_PTS_REF CAL_sensor_ac_evap_temp_scaling_X_voltage /end AXIS_DESCR
/end CHARACTERISTIC
/begin AXIS_PTS CAL_inj_accel_enrichment_load_threshold_X_rpm "Calibration: X-axis (rpm) for the injector accelerator enrichment load threshold table (RPM = val*125/4+500; 8-element array)." 0x4000AD62 NO_INPUT_QUANTITY RL_AXIS_UBYTE 0 CM_u8_rspeed_125_4_500rpm 8 500 8468.75 /end AXIS_PTS
/begin CHARACTERISTIC CAL_inj_accel_enrichment_load_threshold "Calibration: injector accelerator enrichment load threshold (val/100; 8-element array)." CURVE 0x4000AD6A RL_VALUE_UBYTE 0 CM_u8_factor_1_100 0 255
 /begin AXIS_DESCR COM_AXIS NO_INPUT_QUANTITY CM_u8_rspeed_125_4_500rpm 8 500 8468.75 AXIS_PTS_REF CAL_inj_accel_enrichment_load_threshold_X_rpm /end AXIS_DESCR
/end CHARACTERISTIC
/begin AXIS_PTS CAL_sensor_fuel_level_X_voltage "Calibration: X-axis (voltage) for the sensor fuel level table (V = val*5/1023; 8-element array)." 0x4000AD72 NO_INPUT_QUANTITY RL_AXIS_UWORD 0 CM_u16_voltage_5_1023v 8 0 320.307917888563 /end AXIS_PTS
/begin CHARACTERISTIC CAL_sensor_fuel_level "Calibration: sensor fuel level (gal = val/10; 8-element array)." CURVE 0x4000AD82 RL_VALUE_UWORD 0 CM_u8_volume_1_10gallon 0 6553.5
 /begin AXIS_DESCR COM_AXIS NO_INPUT_QUANTITY CM_u16_voltage_5_1023v 8 0 320.307917888563 AXIS_PTS_REF CAL_sensor_fuel_level_X_voltage /end AXIS_DESCR
/end CHARACTERISTIC
/begin AXIS_PTS CAL_revlimit_escalation_integrator_step_X_gear "Calibration: X-axis (gear) for the rev-limit escalation integrator step table (7-element array)." 0x4000AD92 NO_INPUT_QUANTITY RL_AXIS_UBYTE 0 NO_COMPU_METHOD 7 0 255 /end AXIS_PTS
/begin CHARACTERISTIC CAL_revlimit_escalation_integrator_step "Calibration: rev-limit escalation integrator step (7-element array)." CURVE 0x4000AD99 RL_VALUE_UBYTE 0 NO_COMPU_METHOD 0 255
 /begin AXIS_DESCR COM_AXIS NO_INPUT_QUANTITY NO_COMPU_METHOD 7 0 255 AXIS_PTS_REF CAL_revlimit_escalation_integrator_step_X_gear /end AXIS_DESCR
/end CHARACTERISTIC
/begin AXIS_PTS CAL_ign_comp_startup_manual_X_maf_accum "Calibration: X-axis (maf accum) for the ignition compensation startup manual table (mg; 8-element array)." 0x4000ADA2 NO_INPUT_QUANTITY RL_AXIS_UWORD 0 CM_u16_mass_mg 8 0 65535 /end AXIS_PTS
/begin CHARACTERISTIC CAL_ign_comp_startup_manual "Calibration: ignition compensation startup manual (° = val/4; 8-element array)." CURVE 0x4000ADB2 RL_VALUE_SWORD 0 CM_u8_angle_1_4deg -8192 8191.75
 /begin AXIS_DESCR COM_AXIS NO_INPUT_QUANTITY CM_u16_mass_mg 8 0 65535 AXIS_PTS_REF CAL_ign_comp_startup_manual_X_maf_accum /end AXIS_DESCR
/end CHARACTERISTIC
/begin AXIS_PTS CAL_torque_limit_integral_X_load_error "Calibration: X-axis (load error) for the torque limit integral table (8-element array)." 0x4000ADC2 NO_INPUT_QUANTITY RL_AXIS_UBYTE 0 CM_u8__127 8 -127 128 /end AXIS_PTS
/begin CHARACTERISTIC CAL_torque_limit_integral "Calibration: torque limit integral (val/255; 8-element array)." CURVE 0x4000ADCA RL_VALUE_UBYTE 0 CM_u8_factor_1_255 0 100
 /begin AXIS_DESCR COM_AXIS NO_INPUT_QUANTITY CM_u8__127 8 -127 128 AXIS_PTS_REF CAL_torque_limit_integral_X_load_error /end AXIS_DESCR
/end CHARACTERISTIC
/begin AXIS_PTS CAL_idle_target_ips_coolant_fallback_X_coolant_temp "Calibration: X-axis (coolant temp) for the idle target IPS coolant fallback table (°C = val*5/8−40; 16-element array)." 0x4000ADD2 NO_INPUT_QUANTITY RL_AXIS_UBYTE 0 CM_u8_temp_5_8_40c 16 -40 119.375 /end AXIS_PTS
/begin CHARACTERISTIC CAL_idle_target_ips_coolant_fallback "Calibration: idle target IPS coolant fallback (RPM = val*4+500; 16-element array)." CURVE 0x4000ADE2 RL_VALUE_UBYTE 0 CM_u8_rspeed_4_500rpm 500 1520
 /begin AXIS_DESCR COM_AXIS NO_INPUT_QUANTITY CM_u8_temp_5_8_40c 16 -40 119.375 AXIS_PTS_REF CAL_idle_target_ips_coolant_fallback_X_coolant_temp /end AXIS_DESCR
/end CHARACTERISTIC
/end MODULE
/end PROJECT
